VERSION "created by canmatrix"

NS_ :

BS_:

BU_: External_Tool ADAS RDR08

BO_ 1234 RDR_DETECTION_329_332: 64 RDR08
 SG_ DET_RANGE_329 : 7|15@0+ (0.015625,0) [0|500] "m" ADAS
 SG_ DET_RANGE_ERR_329 : 8|7@0+ (0.0075,0) [0|0.9525] "m" ADAS
 SG_ DET_RANGE_VELOCITY_329 : 17|15@0+ (0.0078125,-128) [-128|127.9921875] "m/s" ADAS
 SG_ DET_RANGE_VELOCITY_ERR_329 : 34|8@0+ (0.003,0) [0|0.765] "m/s" ADAS
 SG_ DET_AZIMUTH_329 : 60|13@0+ (0.0004,-1.5708) [-1.5708|1.5708] "rad" ADAS
 SG_ DET_AZIMUTH_ERR_329 : 78|7@0+ (0.00087267,0) [0|0.11082909] "rad" ADAS
 SG_ DET_ELEVATION_329 : 42|8@0+ (0.00275,-0.34925) [-0.34925|0.34925] "rad" ADAS
 SG_ DET_ELEVATION_ERR_329 : 50|6@0+ (0.00174533,0) [0|0.10995579] "rad" ADAS
 SG_ DET_RCS_329 : 119|8@0+ (0.5,-64) [-64|63.5] "dBsm" ADAS
 SG_ DET_VALID_FLAG_329 : 80|1@0+ (1,0) [0|1] "" ADAS
 SG_ DET_BI_STATIC_FLAG_329 : 487|1@0+ (1,0) [0|1] "" ADAS
 SG_ DET_SUPER_RES_TARGET_329 : 79|1@0+ (1,0) [0|1] "" ADAS
 SG_ DET_SNR_329 : 111|8@0+ (0.35156,0) [0|89.6478] "dB" ADAS
 SG_ DET_POINT_TARGET_PROB_329 : 86|4@0+ (6.67,0) [0|100] "%" ADAS
 SG_ DET_EXISTENCE_PROB_329 : 95|6@0+ (1.588,0) [0|100] "%" ADAS
 SG_ DET_OUTSIDE_SECTOR_329 : 103|1@0+ (1,0) [0|1] "" ADAS
 SG_ DET_HVC_FLAG_329 : 87|1@0+ (1,0) [0|1] "" ADAS
 SG_ DET_CONFD_AZIMUTH_329 : 89|2@0+ (1,0) [0|3] "" ADAS
 SG_ DET_CONFD_ELEVATION_329 : 82|2@0+ (1,0) [0|3] "" ADAS
 SG_ DET_RANGE_330 : 127|15@0+ (0.015625,0) [0|500] "m" ADAS
 SG_ DET_RANGE_ERR_330 : 128|7@0+ (0.0075,0) [0|0.9525] "m" ADAS
 SG_ DET_RANGE_VELOCITY_330 : 137|15@0+ (0.0078125,-128) [-128|127.9921875] "m/s" ADAS
 SG_ DET_RANGE_VELOCITY_ERR_330 : 154|8@0+ (0.003,0) [0|0.765] "m/s" ADAS
 SG_ DET_AZIMUTH_330 : 180|13@0+ (0.0004,-1.5708) [-1.5708|1.5708] "rad" ADAS
 SG_ DET_AZIMUTH_ERR_330 : 198|7@0+ (0.00087267,0) [0|0.11082909] "rad" ADAS
 SG_ DET_ELEVATION_330 : 162|8@0+ (0.00275,-0.34925) [-0.34925|0.34925] "rad" ADAS
 SG_ DET_ELEVATION_ERR_330 : 170|6@0+ (0.00174533,0) [0|0.10995579] "rad" ADAS
 SG_ DET_RCS_330 : 239|8@0+ (0.5,-64) [-64|63.5] "dBsm" ADAS
 SG_ DET_VALID_FLAG_330 : 220|1@0+ (1,0) [0|1] "" ADAS
 SG_ DET_BI_STATIC_FLAG_330 : 486|1@0+ (1,0) [0|1] "" ADAS
 SG_ DET_SUPER_RES_TARGET_330 : 199|1@0+ (1,0) [0|1] "" ADAS
 SG_ DET_SNR_330 : 231|8@0+ (0.35156,0) [0|89.6478] "dB" ADAS
 SG_ DET_POINT_TARGET_PROB_330 : 215|4@0+ (6.67,0) [0|100] "%" ADAS
 SG_ DET_EXISTENCE_PROB_330 : 211|6@0+ (1.588,0) [0|100] "%" ADAS
 SG_ DET_OUTSIDE_SECTOR_330 : 221|1@0+ (1,0) [0|1] "" ADAS
 SG_ DET_HVC_FLAG_330 : 207|1@0+ (1,0) [0|1] "" ADAS
 SG_ DET_CONFD_AZIMUTH_330 : 217|2@0+ (1,0) [0|3] "" ADAS
 SG_ DET_CONFD_ELEVATION_330 : 219|2@0+ (1,0) [0|3] "" ADAS
 SG_ DET_RANGE_331 : 247|15@0+ (0.015625,0) [0|500] "m" ADAS
 SG_ DET_RANGE_ERR_331 : 248|7@0+ (0.0075,0) [0|0.9525] "m" ADAS
 SG_ DET_RANGE_VELOCITY_331 : 257|15@0+ (0.0078125,-128) [-128|127.9921875] "m/s" ADAS
 SG_ DET_RANGE_VELOCITY_ERR_331 : 274|8@0+ (0.003,0) [0|0.765] "m/s" ADAS
 SG_ DET_AZIMUTH_331 : 300|13@0+ (0.0004,-1.5708) [-1.5708|1.5708] "rad" ADAS
 SG_ DET_AZIMUTH_ERR_331 : 318|7@0+ (0.00087267,0) [0|0.11082909] "rad" ADAS
 SG_ DET_ELEVATION_331 : 282|8@0+ (0.00275,-0.34925) [-0.34925|0.34925] "rad" ADAS
 SG_ DET_ELEVATION_ERR_331 : 290|6@0+ (0.00174533,0) [0|0.10995579] "rad" ADAS
 SG_ DET_RCS_331 : 359|8@0+ (0.5,-64) [-64|63.5] "dBsm" ADAS
 SG_ DET_VALID_FLAG_331 : 340|1@0+ (1,0) [0|1] "" ADAS
 SG_ DET_BI_STATIC_FLAG_331 : 485|1@0+ (1,0) [0|1] "" ADAS
 SG_ DET_SUPER_RES_TARGET_331 : 319|1@0+ (1,0) [0|1] "" ADAS
 SG_ DET_SNR_331 : 351|8@0+ (0.35156,0) [0|89.6478] "dB" ADAS
 SG_ DET_POINT_TARGET_PROB_331 : 335|4@0+ (6.67,0) [0|100] "%" ADAS
 SG_ DET_EXISTENCE_PROB_331 : 331|6@0+ (1.588,0) [0|100] "%" ADAS
 SG_ DET_OUTSIDE_SECTOR_331 : 341|1@0+ (1,0) [0|1] "" ADAS
 SG_ DET_HVC_FLAG_331 : 327|1@0+ (1,0) [0|1] "" ADAS
 SG_ DET_CONFD_AZIMUTH_331 : 337|2@0+ (1,0) [0|3] "" ADAS
 SG_ DET_CONFD_ELEVATION_331 : 339|2@0+ (1,0) [0|3] "" ADAS
 SG_ DET_RANGE_332 : 367|15@0+ (0.015625,0) [0|500] "m" ADAS
 SG_ DET_RANGE_ERR_332 : 368|7@0+ (0.0075,0) [0|0.9525] "m" ADAS
 SG_ DET_RANGE_VELOCITY_332 : 377|15@0+ (0.0078125,-128) [-128|127.9921875] "m/s" ADAS
 SG_ DET_RANGE_VELOCITY_ERR_332 : 394|8@0+ (0.003,0) [0|0.765] "m/s" ADAS
 SG_ DET_AZIMUTH_332 : 420|13@0+ (0.0004,-1.5708) [-1.5708|1.5708] "rad" ADAS
 SG_ DET_AZIMUTH_ERR_332 : 438|7@0+ (0.00087267,0) [0|0.11082909] "rad" ADAS
 SG_ DET_ELEVATION_332 : 402|8@0+ (0.00275,-0.34925) [-0.34925|0.34925] "rad" ADAS
 SG_ DET_ELEVATION_ERR_332 : 410|6@0+ (0.00174533,0) [0|0.10995579] "rad" ADAS
 SG_ DET_RCS_332 : 479|8@0+ (0.5,-64) [-64|63.5] "dBsm" ADAS
 SG_ DET_VALID_FLAG_332 : 460|1@0+ (1,0) [0|1] "" ADAS
 SG_ DET_BI_STATIC_FLAG_332 : 484|1@0+ (1,0) [0|1] "" ADAS
 SG_ DET_SUPER_RES_TARGET_332 : 439|1@0+ (1,0) [0|1] "" ADAS
 SG_ DET_SNR_332 : 471|8@0+ (0.35156,0) [0|89.6478] "dB" ADAS
 SG_ DET_POINT_TARGET_PROB_332 : 455|4@0+ (6.67,0) [0|100] "%" ADAS
 SG_ DET_EXISTENCE_PROB_332 : 451|6@0+ (1.588,0) [0|100] "%" ADAS
 SG_ DET_OUTSIDE_SECTOR_332 : 461|1@0+ (1,0) [0|1] "" ADAS
 SG_ DET_HVC_FLAG_332 : 447|1@0+ (1,0) [0|1] "" ADAS
 SG_ DET_CONFD_AZIMUTH_332 : 457|2@0+ (1,0) [0|3] "" ADAS
 SG_ DET_CONFD_ELEVATION_332 : 459|2@0+ (1,0) [0|3] "" ADAS
 SG_ DET_MH_SCAN_INDEX_4LSB_329_332 : 483|4@0+ (1,0) [0|15] "" ADAS
 SG_ DET_MH_CYCLE_COUNTER_329_332 : 495|8@0+ (1,0) [0|255] "" ADAS
 SG_ DET_MH_CRC16_329_332 : 503|16@0+ (1,0) [0|65535] "" ADAS

BO_ 1235 RDR_DETECTION_333_336: 64 RDR08
 SG_ DET_RANGE_333 : 7|15@0+ (0.015625,0) [0|500] "m" ADAS
 SG_ DET_RANGE_ERR_333 : 8|7@0+ (0.0075,0) [0|0.9525] "m" ADAS
 SG_ DET_RANGE_VELOCITY_333 : 17|15@0+ (0.0078125,-128) [-128|127.9921875] "m/s" ADAS
 SG_ DET_RANGE_VELOCITY_ERR_333 : 34|8@0+ (0.003,0) [0|0.765] "m/s" ADAS
 SG_ DET_AZIMUTH_333 : 60|13@0+ (0.0004,-1.5708) [-1.5708|1.5708] "rad" ADAS
 SG_ DET_AZIMUTH_ERR_333 : 78|7@0+ (0.00087267,0) [0|0.11082909] "rad" ADAS
 SG_ DET_ELEVATION_333 : 42|8@0+ (0.00275,-0.34925) [-0.34925|0.34925] "rad" ADAS
 SG_ DET_ELEVATION_ERR_333 : 50|6@0+ (0.00174533,0) [0|0.10995579] "rad" ADAS
 SG_ DET_RCS_333 : 119|8@0+ (0.5,-64) [-64|63.5] "dBsm" ADAS
 SG_ DET_VALID_FLAG_333 : 80|1@0+ (1,0) [0|1] "" ADAS
 SG_ DET_BI_STATIC_FLAG_333 : 487|1@0+ (1,0) [0|1] "" ADAS
 SG_ DET_SUPER_RES_TARGET_333 : 79|1@0+ (1,0) [0|1] "" ADAS
 SG_ DET_SNR_333 : 111|8@0+ (0.35156,0) [0|89.6478] "dB" ADAS
 SG_ DET_POINT_TARGET_PROB_333 : 86|4@0+ (6.67,0) [0|100] "%" ADAS
 SG_ DET_EXISTENCE_PROB_333 : 95|6@0+ (1.588,0) [0|100] "%" ADAS
 SG_ DET_OUTSIDE_SECTOR_333 : 103|1@0+ (1,0) [0|1] "" ADAS
 SG_ DET_HVC_FLAG_333 : 87|1@0+ (1,0) [0|1] "" ADAS
 SG_ DET_CONFD_AZIMUTH_333 : 89|2@0+ (1,0) [0|3] "" ADAS
 SG_ DET_CONFD_ELEVATION_333 : 82|2@0+ (1,0) [0|3] "" ADAS
 SG_ DET_RANGE_334 : 127|15@0+ (0.015625,0) [0|500] "m" ADAS
 SG_ DET_RANGE_ERR_334 : 128|7@0+ (0.0075,0) [0|0.9525] "m" ADAS
 SG_ DET_RANGE_VELOCITY_334 : 137|15@0+ (0.0078125,-128) [-128|127.9921875] "m/s" ADAS
 SG_ DET_RANGE_VELOCITY_ERR_334 : 154|8@0+ (0.003,0) [0|0.765] "m/s" ADAS
 SG_ DET_AZIMUTH_334 : 180|13@0+ (0.0004,-1.5708) [-1.5708|1.5708] "rad" ADAS
 SG_ DET_AZIMUTH_ERR_334 : 198|7@0+ (0.00087267,0) [0|0.11082909] "rad" ADAS
 SG_ DET_ELEVATION_334 : 162|8@0+ (0.00275,-0.34925) [-0.34925|0.34925] "rad" ADAS
 SG_ DET_ELEVATION_ERR_334 : 170|6@0+ (0.00174533,0) [0|0.10995579] "rad" ADAS
 SG_ DET_RCS_334 : 239|8@0+ (0.5,-64) [-64|63.5] "dBsm" ADAS
 SG_ DET_VALID_FLAG_334 : 220|1@0+ (1,0) [0|1] "" ADAS
 SG_ DET_BI_STATIC_FLAG_334 : 486|1@0+ (1,0) [0|1] "" ADAS
 SG_ DET_SUPER_RES_TARGET_334 : 199|1@0+ (1,0) [0|1] "" ADAS
 SG_ DET_SNR_334 : 231|8@0+ (0.35156,0) [0|89.6478] "dB" ADAS
 SG_ DET_POINT_TARGET_PROB_334 : 215|4@0+ (6.67,0) [0|100] "%" ADAS
 SG_ DET_EXISTENCE_PROB_334 : 211|6@0+ (1.588,0) [0|100] "%" ADAS
 SG_ DET_OUTSIDE_SECTOR_334 : 221|1@0+ (1,0) [0|1] "" ADAS
 SG_ DET_HVC_FLAG_334 : 207|1@0+ (1,0) [0|1] "" ADAS
 SG_ DET_CONFD_AZIMUTH_334 : 217|2@0+ (1,0) [0|3] "" ADAS
 SG_ DET_CONFD_ELEVATION_334 : 219|2@0+ (1,0) [0|3] "" ADAS
 SG_ DET_RANGE_335 : 247|15@0+ (0.015625,0) [0|500] "m" ADAS
 SG_ DET_RANGE_ERR_335 : 248|7@0+ (0.0075,0) [0|0.9525] "m" ADAS
 SG_ DET_RANGE_VELOCITY_335 : 257|15@0+ (0.0078125,-128) [-128|127.9921875] "m/s" ADAS
 SG_ DET_RANGE_VELOCITY_ERR_335 : 274|8@0+ (0.003,0) [0|0.765] "m/s" ADAS
 SG_ DET_AZIMUTH_335 : 300|13@0+ (0.0004,-1.5708) [-1.5708|1.5708] "rad" ADAS
 SG_ DET_AZIMUTH_ERR_335 : 318|7@0+ (0.00087267,0) [0|0.11082909] "rad" ADAS
 SG_ DET_ELEVATION_335 : 282|8@0+ (0.00275,-0.34925) [-0.34925|0.34925] "rad" ADAS
 SG_ DET_ELEVATION_ERR_335 : 290|6@0+ (0.00174533,0) [0|0.10995579] "rad" ADAS
 SG_ DET_RCS_335 : 359|8@0+ (0.5,-64) [-64|63.5] "dBsm" ADAS
 SG_ DET_VALID_FLAG_335 : 340|1@0+ (1,0) [0|1] "" ADAS
 SG_ DET_BI_STATIC_FLAG_335 : 485|1@0+ (1,0) [0|1] "" ADAS
 SG_ DET_SUPER_RES_TARGET_335 : 319|1@0+ (1,0) [0|1] "" ADAS
 SG_ DET_SNR_335 : 351|8@0+ (0.35156,0) [0|89.6478] "dB" ADAS
 SG_ DET_POINT_TARGET_PROB_335 : 335|4@0+ (6.67,0) [0|100] "%" ADAS
 SG_ DET_EXISTENCE_PROB_335 : 331|6@0+ (1.588,0) [0|100] "%" ADAS
 SG_ DET_OUTSIDE_SECTOR_335 : 341|1@0+ (1,0) [0|1] "" ADAS
 SG_ DET_HVC_FLAG_335 : 327|1@0+ (1,0) [0|1] "" ADAS
 SG_ DET_CONFD_AZIMUTH_335 : 337|2@0+ (1,0) [0|3] "" ADAS
 SG_ DET_CONFD_ELEVATION_335 : 339|2@0+ (1,0) [0|3] "" ADAS
 SG_ DET_RANGE_336 : 367|15@0+ (0.015625,0) [0|500] "m" ADAS
 SG_ DET_RANGE_ERR_336 : 368|7@0+ (0.0075,0) [0|0.9525] "m" ADAS
 SG_ DET_RANGE_VELOCITY_336 : 377|15@0+ (0.0078125,-128) [-128|127.9921875] "m/s" ADAS
 SG_ DET_RANGE_VELOCITY_ERR_336 : 394|8@0+ (0.003,0) [0|0.765] "m/s" ADAS
 SG_ DET_AZIMUTH_336 : 420|13@0+ (0.0004,-1.5708) [-1.5708|1.5708] "rad" ADAS
 SG_ DET_AZIMUTH_ERR_336 : 438|7@0+ (0.00087267,0) [0|0.11082909] "rad" ADAS
 SG_ DET_ELEVATION_336 : 402|8@0+ (0.00275,-0.34925) [-0.34925|0.34925] "rad" ADAS
 SG_ DET_ELEVATION_ERR_336 : 410|6@0+ (0.00174533,0) [0|0.10995579] "rad" ADAS
 SG_ DET_RCS_336 : 479|8@0+ (0.5,-64) [-64|63.5] "dBsm" ADAS
 SG_ DET_VALID_FLAG_336 : 460|1@0+ (1,0) [0|1] "" ADAS
 SG_ DET_BI_STATIC_FLAG_336 : 484|1@0+ (1,0) [0|1] "" ADAS
 SG_ DET_SUPER_RES_TARGET_336 : 439|1@0+ (1,0) [0|1] "" ADAS
 SG_ DET_SNR_336 : 471|8@0+ (0.35156,0) [0|89.6478] "dB" ADAS
 SG_ DET_POINT_TARGET_PROB_336 : 455|4@0+ (6.67,0) [0|100] "%" ADAS
 SG_ DET_EXISTENCE_PROB_336 : 451|6@0+ (1.588,0) [0|100] "%" ADAS
 SG_ DET_OUTSIDE_SECTOR_336 : 461|1@0+ (1,0) [0|1] "" ADAS
 SG_ DET_HVC_FLAG_336 : 447|1@0+ (1,0) [0|1] "" ADAS
 SG_ DET_CONFD_AZIMUTH_336 : 457|2@0+ (1,0) [0|3] "" ADAS
 SG_ DET_CONFD_ELEVATION_336 : 459|2@0+ (1,0) [0|3] "" ADAS
 SG_ DET_MH_SCAN_INDEX_4LSB_333_336 : 483|4@0+ (1,0) [0|15] "" ADAS
 SG_ DET_MH_CYCLE_COUNTER_333_336 : 495|8@0+ (1,0) [0|255] "" ADAS
 SG_ DET_MH_CRC16_333_336 : 503|16@0+ (1,0) [0|65535] "" ADAS

BO_ 1236 RDR_DETECTION_337_340: 64 RDR08
 SG_ DET_RANGE_337 : 7|15@0+ (0.015625,0) [0|500] "m" ADAS
 SG_ DET_RANGE_ERR_337 : 8|7@0+ (0.0075,0) [0|0.9525] "m" ADAS
 SG_ DET_RANGE_VELOCITY_337 : 17|15@0+ (0.0078125,-128) [-128|127.9921875] "m/s" ADAS
 SG_ DET_RANGE_VELOCITY_ERR_337 : 34|8@0+ (0.003,0) [0|0.765] "m/s" ADAS
 SG_ DET_AZIMUTH_337 : 60|13@0+ (0.0004,-1.5708) [-1.5708|1.5708] "rad" ADAS
 SG_ DET_AZIMUTH_ERR_337 : 78|7@0+ (0.00087267,0) [0|0.11082909] "rad" ADAS
 SG_ DET_ELEVATION_337 : 42|8@0+ (0.00275,-0.34925) [-0.34925|0.34925] "rad" ADAS
 SG_ DET_ELEVATION_ERR_337 : 50|6@0+ (0.00174533,0) [0|0.10995579] "rad" ADAS
 SG_ DET_RCS_337 : 119|8@0+ (0.5,-64) [-64|63.5] "dBsm" ADAS
 SG_ DET_VALID_FLAG_337 : 80|1@0+ (1,0) [0|1] "" ADAS
 SG_ DET_BI_STATIC_FLAG_337 : 487|1@0+ (1,0) [0|1] "" ADAS
 SG_ DET_SUPER_RES_TARGET_337 : 79|1@0+ (1,0) [0|1] "" ADAS
 SG_ DET_SNR_337 : 111|8@0+ (0.35156,0) [0|89.6478] "dB" ADAS
 SG_ DET_POINT_TARGET_PROB_337 : 86|4@0+ (6.67,0) [0|100] "%" ADAS
 SG_ DET_EXISTENCE_PROB_337 : 95|6@0+ (1.588,0) [0|100] "%" ADAS
 SG_ DET_OUTSIDE_SECTOR_337 : 103|1@0+ (1,0) [0|1] "" ADAS
 SG_ DET_HVC_FLAG_337 : 87|1@0+ (1,0) [0|1] "" ADAS
 SG_ DET_CONFD_AZIMUTH_337 : 89|2@0+ (1,0) [0|3] "" ADAS
 SG_ DET_CONFD_ELEVATION_337 : 82|2@0+ (1,0) [0|3] "" ADAS
 SG_ DET_RANGE_338 : 127|15@0+ (0.015625,0) [0|500] "m" ADAS
 SG_ DET_RANGE_ERR_338 : 128|7@0+ (0.0075,0) [0|0.9525] "m" ADAS
 SG_ DET_RANGE_VELOCITY_338 : 137|15@0+ (0.0078125,-128) [-128|127.9921875] "m/s" ADAS
 SG_ DET_RANGE_VELOCITY_ERR_338 : 154|8@0+ (0.003,0) [0|0.765] "m/s" ADAS
 SG_ DET_AZIMUTH_338 : 180|13@0+ (0.0004,-1.5708) [-1.5708|1.5708] "rad" ADAS
 SG_ DET_AZIMUTH_ERR_338 : 198|7@0+ (0.00087267,0) [0|0.11082909] "rad" ADAS
 SG_ DET_ELEVATION_338 : 162|8@0+ (0.00275,-0.34925) [-0.34925|0.34925] "rad" ADAS
 SG_ DET_ELEVATION_ERR_338 : 170|6@0+ (0.00174533,0) [0|0.10995579] "rad" ADAS
 SG_ DET_RCS_338 : 239|8@0+ (0.5,-64) [-64|63.5] "dBsm" ADAS
 SG_ DET_VALID_FLAG_338 : 220|1@0+ (1,0) [0|1] "" ADAS
 SG_ DET_BI_STATIC_FLAG_338 : 486|1@0+ (1,0) [0|1] "" ADAS
 SG_ DET_SUPER_RES_TARGET_338 : 199|1@0+ (1,0) [0|1] "" ADAS
 SG_ DET_SNR_338 : 231|8@0+ (0.35156,0) [0|89.6478] "dB" ADAS
 SG_ DET_POINT_TARGET_PROB_338 : 215|4@0+ (6.67,0) [0|100] "%" ADAS
 SG_ DET_EXISTENCE_PROB_338 : 211|6@0+ (1.588,0) [0|100] "%" ADAS
 SG_ DET_OUTSIDE_SECTOR_338 : 221|1@0+ (1,0) [0|1] "" ADAS
 SG_ DET_HVC_FLAG_338 : 207|1@0+ (1,0) [0|1] "" ADAS
 SG_ DET_CONFD_AZIMUTH_338 : 217|2@0+ (1,0) [0|3] "" ADAS
 SG_ DET_CONFD_ELEVATION_338 : 219|2@0+ (1,0) [0|3] "" ADAS
 SG_ DET_RANGE_339 : 247|15@0+ (0.015625,0) [0|500] "m" ADAS
 SG_ DET_RANGE_ERR_339 : 248|7@0+ (0.0075,0) [0|0.9525] "m" ADAS
 SG_ DET_RANGE_VELOCITY_339 : 257|15@0+ (0.0078125,-128) [-128|127.9921875] "m/s" ADAS
 SG_ DET_RANGE_VELOCITY_ERR_339 : 274|8@0+ (0.003,0) [0|0.765] "m/s" ADAS
 SG_ DET_AZIMUTH_339 : 300|13@0+ (0.0004,-1.5708) [-1.5708|1.5708] "rad" ADAS
 SG_ DET_AZIMUTH_ERR_339 : 318|7@0+ (0.00087267,0) [0|0.11082909] "rad" ADAS
 SG_ DET_ELEVATION_339 : 282|8@0+ (0.00275,-0.34925) [-0.34925|0.34925] "rad" ADAS
 SG_ DET_ELEVATION_ERR_339 : 290|6@0+ (0.00174533,0) [0|0.10995579] "rad" ADAS
 SG_ DET_RCS_339 : 359|8@0+ (0.5,-64) [-64|63.5] "dBsm" ADAS
 SG_ DET_VALID_FLAG_339 : 340|1@0+ (1,0) [0|1] "" ADAS
 SG_ DET_BI_STATIC_FLAG_339 : 485|1@0+ (1,0) [0|1] "" ADAS
 SG_ DET_SUPER_RES_TARGET_339 : 319|1@0+ (1,0) [0|1] "" ADAS
 SG_ DET_SNR_339 : 351|8@0+ (0.35156,0) [0|89.6478] "dB" ADAS
 SG_ DET_POINT_TARGET_PROB_339 : 335|4@0+ (6.67,0) [0|100] "%" ADAS
 SG_ DET_EXISTENCE_PROB_339 : 331|6@0+ (1.588,0) [0|100] "%" ADAS
 SG_ DET_OUTSIDE_SECTOR_339 : 341|1@0+ (1,0) [0|1] "" ADAS
 SG_ DET_HVC_FLAG_339 : 327|1@0+ (1,0) [0|1] "" ADAS
 SG_ DET_CONFD_AZIMUTH_339 : 337|2@0+ (1,0) [0|3] "" ADAS
 SG_ DET_CONFD_ELEVATION_339 : 339|2@0+ (1,0) [0|3] "" ADAS
 SG_ DET_RANGE_340 : 367|15@0+ (0.015625,0) [0|500] "m" ADAS
 SG_ DET_RANGE_ERR_340 : 368|7@0+ (0.0075,0) [0|0.9525] "m" ADAS
 SG_ DET_RANGE_VELOCITY_340 : 377|15@0+ (0.0078125,-128) [-128|127.9921875] "m/s" ADAS
 SG_ DET_RANGE_VELOCITY_ERR_340 : 394|8@0+ (0.003,0) [0|0.765] "m/s" ADAS
 SG_ DET_AZIMUTH_340 : 420|13@0+ (0.0004,-1.5708) [-1.5708|1.5708] "rad" ADAS
 SG_ DET_AZIMUTH_ERR_340 : 438|7@0+ (0.00087267,0) [0|0.11082909] "rad" ADAS
 SG_ DET_ELEVATION_340 : 402|8@0+ (0.00275,-0.34925) [-0.34925|0.34925] "rad" ADAS
 SG_ DET_ELEVATION_ERR_340 : 410|6@0+ (0.00174533,0) [0|0.10995579] "rad" ADAS
 SG_ DET_RCS_340 : 479|8@0+ (0.5,-64) [-64|63.5] "dBsm" ADAS
 SG_ DET_VALID_FLAG_340 : 460|1@0+ (1,0) [0|1] "" ADAS
 SG_ DET_BI_STATIC_FLAG_340 : 484|1@0+ (1,0) [0|1] "" ADAS
 SG_ DET_SUPER_RES_TARGET_340 : 439|1@0+ (1,0) [0|1] "" ADAS
 SG_ DET_SNR_340 : 471|8@0+ (0.35156,0) [0|89.6478] "dB" ADAS
 SG_ DET_POINT_TARGET_PROB_340 : 455|4@0+ (6.67,0) [0|100] "%" ADAS
 SG_ DET_EXISTENCE_PROB_340 : 451|6@0+ (1.588,0) [0|100] "%" ADAS
 SG_ DET_OUTSIDE_SECTOR_340 : 461|1@0+ (1,0) [0|1] "" ADAS
 SG_ DET_HVC_FLAG_340 : 447|1@0+ (1,0) [0|1] "" ADAS
 SG_ DET_CONFD_AZIMUTH_340 : 457|2@0+ (1,0) [0|3] "" ADAS
 SG_ DET_CONFD_ELEVATION_340 : 459|2@0+ (1,0) [0|3] "" ADAS
 SG_ DET_MH_SCAN_INDEX_4LSB_337_340 : 483|4@0+ (1,0) [0|15] "" ADAS
 SG_ DET_MH_CYCLE_COUNTER_337_340 : 495|8@0+ (1,0) [0|255] "" ADAS
 SG_ DET_MH_CRC16_337_340 : 503|16@0+ (1,0) [0|65535] "" ADAS

BO_ 1237 RDR_DETECTION_341_344: 64 RDR08
 SG_ DET_RANGE_341 : 7|15@0+ (0.015625,0) [0|500] "m" ADAS
 SG_ DET_RANGE_ERR_341 : 8|7@0+ (0.0075,0) [0|0.9525] "m" ADAS
 SG_ DET_RANGE_VELOCITY_341 : 17|15@0+ (0.0078125,-128) [-128|127.9921875] "m/s" ADAS
 SG_ DET_RANGE_VELOCITY_ERR_341 : 34|8@0+ (0.003,0) [0|0.765] "m/s" ADAS
 SG_ DET_AZIMUTH_341 : 60|13@0+ (0.0004,-1.5708) [-1.5708|1.5708] "rad" ADAS
 SG_ DET_AZIMUTH_ERR_341 : 78|7@0+ (0.00087267,0) [0|0.11082909] "rad" ADAS
 SG_ DET_ELEVATION_341 : 42|8@0+ (0.00275,-0.34925) [-0.34925|0.34925] "rad" ADAS
 SG_ DET_ELEVATION_ERR_341 : 50|6@0+ (0.00174533,0) [0|0.10995579] "rad" ADAS
 SG_ DET_RCS_341 : 119|8@0+ (0.5,-64) [-64|63.5] "dBsm" ADAS
 SG_ DET_VALID_FLAG_341 : 80|1@0+ (1,0) [0|1] "" ADAS
 SG_ DET_BI_STATIC_FLAG_341 : 487|1@0+ (1,0) [0|1] "" ADAS
 SG_ DET_SUPER_RES_TARGET_341 : 79|1@0+ (1,0) [0|1] "" ADAS
 SG_ DET_SNR_341 : 111|8@0+ (0.35156,0) [0|89.6478] "dB" ADAS
 SG_ DET_POINT_TARGET_PROB_341 : 86|4@0+ (6.67,0) [0|100] "%" ADAS
 SG_ DET_EXISTENCE_PROB_341 : 95|6@0+ (1.588,0) [0|100] "%" ADAS
 SG_ DET_OUTSIDE_SECTOR_341 : 103|1@0+ (1,0) [0|1] "" ADAS
 SG_ DET_HVC_FLAG_341 : 87|1@0+ (1,0) [0|1] "" ADAS
 SG_ DET_CONFD_AZIMUTH_341 : 89|2@0+ (1,0) [0|3] "" ADAS
 SG_ DET_CONFD_ELEVATION_341 : 82|2@0+ (1,0) [0|3] "" ADAS
 SG_ DET_RANGE_342 : 127|15@0+ (0.015625,0) [0|500] "m" ADAS
 SG_ DET_RANGE_ERR_342 : 128|7@0+ (0.0075,0) [0|0.9525] "m" ADAS
 SG_ DET_RANGE_VELOCITY_342 : 137|15@0+ (0.0078125,-128) [-128|127.9921875] "m/s" ADAS
 SG_ DET_RANGE_VELOCITY_ERR_342 : 154|8@0+ (0.003,0) [0|0.765] "m/s" ADAS
 SG_ DET_AZIMUTH_342 : 180|13@0+ (0.0004,-1.5708) [-1.5708|1.5708] "rad" ADAS
 SG_ DET_AZIMUTH_ERR_342 : 198|7@0+ (0.00087267,0) [0|0.11082909] "rad" ADAS
 SG_ DET_ELEVATION_342 : 162|8@0+ (0.00275,-0.34925) [-0.34925|0.34925] "rad" ADAS
 SG_ DET_ELEVATION_ERR_342 : 170|6@0+ (0.00174533,0) [0|0.10995579] "rad" ADAS
 SG_ DET_RCS_342 : 239|8@0+ (0.5,-64) [-64|63.5] "dBsm" ADAS
 SG_ DET_VALID_FLAG_342 : 220|1@0+ (1,0) [0|1] "" ADAS
 SG_ DET_BI_STATIC_FLAG_342 : 486|1@0+ (1,0) [0|1] "" ADAS
 SG_ DET_SUPER_RES_TARGET_342 : 199|1@0+ (1,0) [0|1] "" ADAS
 SG_ DET_SNR_342 : 231|8@0+ (0.35156,0) [0|89.6478] "dB" ADAS
 SG_ DET_POINT_TARGET_PROB_342 : 215|4@0+ (6.67,0) [0|100] "%" ADAS
 SG_ DET_EXISTENCE_PROB_342 : 211|6@0+ (1.588,0) [0|100] "%" ADAS
 SG_ DET_OUTSIDE_SECTOR_342 : 221|1@0+ (1,0) [0|1] "" ADAS
 SG_ DET_HVC_FLAG_342 : 207|1@0+ (1,0) [0|1] "" ADAS
 SG_ DET_CONFD_AZIMUTH_342 : 217|2@0+ (1,0) [0|3] "" ADAS
 SG_ DET_CONFD_ELEVATION_342 : 219|2@0+ (1,0) [0|3] "" ADAS
 SG_ DET_RANGE_343 : 247|15@0+ (0.015625,0) [0|500] "m" ADAS
 SG_ DET_RANGE_ERR_343 : 248|7@0+ (0.0075,0) [0|0.9525] "m" ADAS
 SG_ DET_RANGE_VELOCITY_343 : 257|15@0+ (0.0078125,-128) [-128|127.9921875] "m/s" ADAS
 SG_ DET_RANGE_VELOCITY_ERR_343 : 274|8@0+ (0.003,0) [0|0.765] "m/s" ADAS
 SG_ DET_AZIMUTH_343 : 300|13@0+ (0.0004,-1.5708) [-1.5708|1.5708] "rad" ADAS
 SG_ DET_AZIMUTH_ERR_343 : 318|7@0+ (0.00087267,0) [0|0.11082909] "rad" ADAS
 SG_ DET_ELEVATION_343 : 282|8@0+ (0.00275,-0.34925) [-0.34925|0.34925] "rad" ADAS
 SG_ DET_ELEVATION_ERR_343 : 290|6@0+ (0.00174533,0) [0|0.10995579] "rad" ADAS
 SG_ DET_RCS_343 : 359|8@0+ (0.5,-64) [-64|63.5] "dBsm" ADAS
 SG_ DET_VALID_FLAG_343 : 340|1@0+ (1,0) [0|1] "" ADAS
 SG_ DET_BI_STATIC_FLAG_343 : 485|1@0+ (1,0) [0|1] "" ADAS
 SG_ DET_SUPER_RES_TARGET_343 : 319|1@0+ (1,0) [0|1] "" ADAS
 SG_ DET_SNR_343 : 351|8@0+ (0.35156,0) [0|89.6478] "dB" ADAS
 SG_ DET_POINT_TARGET_PROB_343 : 335|4@0+ (6.67,0) [0|100] "%" ADAS
 SG_ DET_EXISTENCE_PROB_343 : 331|6@0+ (1.588,0) [0|100] "%" ADAS
 SG_ DET_OUTSIDE_SECTOR_343 : 341|1@0+ (1,0) [0|1] "" ADAS
 SG_ DET_HVC_FLAG_343 : 327|1@0+ (1,0) [0|1] "" ADAS
 SG_ DET_CONFD_AZIMUTH_343 : 337|2@0+ (1,0) [0|3] "" ADAS
 SG_ DET_CONFD_ELEVATION_343 : 339|2@0+ (1,0) [0|3] "" ADAS
 SG_ DET_RANGE_344 : 367|15@0+ (0.015625,0) [0|500] "m" ADAS
 SG_ DET_RANGE_ERR_344 : 368|7@0+ (0.0075,0) [0|0.9525] "m" ADAS
 SG_ DET_RANGE_VELOCITY_344 : 377|15@0+ (0.0078125,-128) [-128|127.9921875] "m/s" ADAS
 SG_ DET_RANGE_VELOCITY_ERR_344 : 394|8@0+ (0.003,0) [0|0.765] "m/s" ADAS
 SG_ DET_AZIMUTH_344 : 420|13@0+ (0.0004,-1.5708) [-1.5708|1.5708] "rad" ADAS
 SG_ DET_AZIMUTH_ERR_344 : 438|7@0+ (0.00087267,0) [0|0.11082909] "rad" ADAS
 SG_ DET_ELEVATION_344 : 402|8@0+ (0.00275,-0.34925) [-0.34925|0.34925] "rad" ADAS
 SG_ DET_ELEVATION_ERR_344 : 410|6@0+ (0.00174533,0) [0|0.10995579] "rad" ADAS
 SG_ DET_RCS_344 : 479|8@0+ (0.5,-64) [-64|63.5] "dBsm" ADAS
 SG_ DET_VALID_FLAG_344 : 460|1@0+ (1,0) [0|1] "" ADAS
 SG_ DET_BI_STATIC_FLAG_344 : 484|1@0+ (1,0) [0|1] "" ADAS
 SG_ DET_SUPER_RES_TARGET_344 : 439|1@0+ (1,0) [0|1] "" ADAS
 SG_ DET_SNR_344 : 471|8@0+ (0.35156,0) [0|89.6478] "dB" ADAS
 SG_ DET_POINT_TARGET_PROB_344 : 455|4@0+ (6.67,0) [0|100] "%" ADAS
 SG_ DET_EXISTENCE_PROB_344 : 451|6@0+ (1.588,0) [0|100] "%" ADAS
 SG_ DET_OUTSIDE_SECTOR_344 : 461|1@0+ (1,0) [0|1] "" ADAS
 SG_ DET_HVC_FLAG_344 : 447|1@0+ (1,0) [0|1] "" ADAS
 SG_ DET_CONFD_AZIMUTH_344 : 457|2@0+ (1,0) [0|3] "" ADAS
 SG_ DET_CONFD_ELEVATION_344 : 459|2@0+ (1,0) [0|3] "" ADAS
 SG_ DET_MH_SCAN_INDEX_4LSB_341_344 : 483|4@0+ (1,0) [0|15] "" ADAS
 SG_ DET_MH_CYCLE_COUNTER_341_344 : 495|8@0+ (1,0) [0|255] "" ADAS
 SG_ DET_MH_CRC16_341_344 : 503|16@0+ (1,0) [0|65535] "" ADAS

BO_ 1238 RDR_DETECTION_345_348: 64 RDR08
 SG_ DET_RANGE_345 : 7|15@0+ (0.015625,0) [0|500] "m" ADAS
 SG_ DET_RANGE_ERR_345 : 8|7@0+ (0.0075,0) [0|0.9525] "m" ADAS
 SG_ DET_RANGE_VELOCITY_345 : 17|15@0+ (0.0078125,-128) [-128|127.9921875] "m/s" ADAS
 SG_ DET_RANGE_VELOCITY_ERR_345 : 34|8@0+ (0.003,0) [0|0.765] "m/s" ADAS
 SG_ DET_AZIMUTH_345 : 60|13@0+ (0.0004,-1.5708) [-1.5708|1.5708] "rad" ADAS
 SG_ DET_AZIMUTH_ERR_345 : 78|7@0+ (0.00087267,0) [0|0.11082909] "rad" ADAS
 SG_ DET_ELEVATION_345 : 42|8@0+ (0.00275,-0.34925) [-0.34925|0.34925] "rad" ADAS
 SG_ DET_ELEVATION_ERR_345 : 50|6@0+ (0.00174533,0) [0|0.10995579] "rad" ADAS
 SG_ DET_RCS_345 : 119|8@0+ (0.5,-64) [-64|63.5] "dBsm" ADAS
 SG_ DET_VALID_FLAG_345 : 80|1@0+ (1,0) [0|1] "" ADAS
 SG_ DET_BI_STATIC_FLAG_345 : 487|1@0+ (1,0) [0|1] "" ADAS
 SG_ DET_SUPER_RES_TARGET_345 : 79|1@0+ (1,0) [0|1] "" ADAS
 SG_ DET_SNR_345 : 111|8@0+ (0.35156,0) [0|89.6478] "dB" ADAS
 SG_ DET_POINT_TARGET_PROB_345 : 86|4@0+ (6.67,0) [0|100] "%" ADAS
 SG_ DET_EXISTENCE_PROB_345 : 95|6@0+ (1.588,0) [0|100] "%" ADAS
 SG_ DET_OUTSIDE_SECTOR_345 : 103|1@0+ (1,0) [0|1] "" ADAS
 SG_ DET_HVC_FLAG_345 : 87|1@0+ (1,0) [0|1] "" ADAS
 SG_ DET_CONFD_AZIMUTH_345 : 89|2@0+ (1,0) [0|3] "" ADAS
 SG_ DET_CONFD_ELEVATION_345 : 82|2@0+ (1,0) [0|3] "" ADAS
 SG_ DET_RANGE_346 : 127|15@0+ (0.015625,0) [0|500] "m" ADAS
 SG_ DET_RANGE_ERR_346 : 128|7@0+ (0.0075,0) [0|0.9525] "m" ADAS
 SG_ DET_RANGE_VELOCITY_346 : 137|15@0+ (0.0078125,-128) [-128|127.9921875] "m/s" ADAS
 SG_ DET_RANGE_VELOCITY_ERR_346 : 154|8@0+ (0.003,0) [0|0.765] "m/s" ADAS
 SG_ DET_AZIMUTH_346 : 180|13@0+ (0.0004,-1.5708) [-1.5708|1.5708] "rad" ADAS
 SG_ DET_AZIMUTH_ERR_346 : 198|7@0+ (0.00087267,0) [0|0.11082909] "rad" ADAS
 SG_ DET_ELEVATION_346 : 162|8@0+ (0.00275,-0.34925) [-0.34925|0.34925] "rad" ADAS
 SG_ DET_ELEVATION_ERR_346 : 170|6@0+ (0.00174533,0) [0|0.10995579] "rad" ADAS
 SG_ DET_RCS_346 : 239|8@0+ (0.5,-64) [-64|63.5] "dBsm" ADAS
 SG_ DET_VALID_FLAG_346 : 220|1@0+ (1,0) [0|1] "" ADAS
 SG_ DET_BI_STATIC_FLAG_346 : 486|1@0+ (1,0) [0|1] "" ADAS
 SG_ DET_SUPER_RES_TARGET_346 : 199|1@0+ (1,0) [0|1] "" ADAS
 SG_ DET_SNR_346 : 231|8@0+ (0.35156,0) [0|89.6478] "dB" ADAS
 SG_ DET_POINT_TARGET_PROB_346 : 215|4@0+ (6.67,0) [0|100] "%" ADAS
 SG_ DET_EXISTENCE_PROB_346 : 211|6@0+ (1.588,0) [0|100] "%" ADAS
 SG_ DET_OUTSIDE_SECTOR_346 : 221|1@0+ (1,0) [0|1] "" ADAS
 SG_ DET_HVC_FLAG_346 : 207|1@0+ (1,0) [0|1] "" ADAS
 SG_ DET_CONFD_AZIMUTH_346 : 217|2@0+ (1,0) [0|3] "" ADAS
 SG_ DET_CONFD_ELEVATION_346 : 219|2@0+ (1,0) [0|3] "" ADAS
 SG_ DET_RANGE_347 : 247|15@0+ (0.015625,0) [0|500] "m" ADAS
 SG_ DET_RANGE_ERR_347 : 248|7@0+ (0.0075,0) [0|0.9525] "m" ADAS
 SG_ DET_RANGE_VELOCITY_347 : 257|15@0+ (0.0078125,-128) [-128|127.9921875] "m/s" ADAS
 SG_ DET_RANGE_VELOCITY_ERR_347 : 274|8@0+ (0.003,0) [0|0.765] "m/s" ADAS
 SG_ DET_AZIMUTH_347 : 300|13@0+ (0.0004,-1.5708) [-1.5708|1.5708] "rad" ADAS
 SG_ DET_AZIMUTH_ERR_347 : 318|7@0+ (0.00087267,0) [0|0.11082909] "rad" ADAS
 SG_ DET_ELEVATION_347 : 282|8@0+ (0.00275,-0.34925) [-0.34925|0.34925] "rad" ADAS
 SG_ DET_ELEVATION_ERR_347 : 290|6@0+ (0.00174533,0) [0|0.10995579] "rad" ADAS
 SG_ DET_RCS_347 : 359|8@0+ (0.5,-64) [-64|63.5] "dBsm" ADAS
 SG_ DET_VALID_FLAG_347 : 340|1@0+ (1,0) [0|1] "" ADAS
 SG_ DET_BI_STATIC_FLAG_347 : 485|1@0+ (1,0) [0|1] "" ADAS
 SG_ DET_SUPER_RES_TARGET_347 : 319|1@0+ (1,0) [0|1] "" ADAS
 SG_ DET_SNR_347 : 351|8@0+ (0.35156,0) [0|89.6478] "dB" ADAS
 SG_ DET_POINT_TARGET_PROB_347 : 335|4@0+ (6.67,0) [0|100] "%" ADAS
 SG_ DET_EXISTENCE_PROB_347 : 331|6@0+ (1.588,0) [0|100] "%" ADAS
 SG_ DET_OUTSIDE_SECTOR_347 : 341|1@0+ (1,0) [0|1] "" ADAS
 SG_ DET_HVC_FLAG_347 : 327|1@0+ (1,0) [0|1] "" ADAS
 SG_ DET_CONFD_AZIMUTH_347 : 337|2@0+ (1,0) [0|3] "" ADAS
 SG_ DET_CONFD_ELEVATION_347 : 339|2@0+ (1,0) [0|3] "" ADAS
 SG_ DET_RANGE_348 : 367|15@0+ (0.015625,0) [0|500] "m" ADAS
 SG_ DET_RANGE_ERR_348 : 368|7@0+ (0.0075,0) [0|0.9525] "m" ADAS
 SG_ DET_RANGE_VELOCITY_348 : 377|15@0+ (0.0078125,-128) [-128|127.9921875] "m/s" ADAS
 SG_ DET_RANGE_VELOCITY_ERR_348 : 394|8@0+ (0.003,0) [0|0.765] "m/s" ADAS
 SG_ DET_AZIMUTH_348 : 420|13@0+ (0.0004,-1.5708) [-1.5708|1.5708] "rad" ADAS
 SG_ DET_AZIMUTH_ERR_348 : 438|7@0+ (0.00087267,0) [0|0.11082909] "rad" ADAS
 SG_ DET_ELEVATION_348 : 402|8@0+ (0.00275,-0.34925) [-0.34925|0.34925] "rad" ADAS
 SG_ DET_ELEVATION_ERR_348 : 410|6@0+ (0.00174533,0) [0|0.10995579] "rad" ADAS
 SG_ DET_RCS_348 : 479|8@0+ (0.5,-64) [-64|63.5] "dBsm" ADAS
 SG_ DET_VALID_FLAG_348 : 460|1@0+ (1,0) [0|1] "" ADAS
 SG_ DET_BI_STATIC_FLAG_348 : 484|1@0+ (1,0) [0|1] "" ADAS
 SG_ DET_SUPER_RES_TARGET_348 : 439|1@0+ (1,0) [0|1] "" ADAS
 SG_ DET_SNR_348 : 471|8@0+ (0.35156,0) [0|89.6478] "dB" ADAS
 SG_ DET_POINT_TARGET_PROB_348 : 455|4@0+ (6.67,0) [0|100] "%" ADAS
 SG_ DET_EXISTENCE_PROB_348 : 451|6@0+ (1.588,0) [0|100] "%" ADAS
 SG_ DET_OUTSIDE_SECTOR_348 : 461|1@0+ (1,0) [0|1] "" ADAS
 SG_ DET_HVC_FLAG_348 : 447|1@0+ (1,0) [0|1] "" ADAS
 SG_ DET_CONFD_AZIMUTH_348 : 457|2@0+ (1,0) [0|3] "" ADAS
 SG_ DET_CONFD_ELEVATION_348 : 459|2@0+ (1,0) [0|3] "" ADAS
 SG_ DET_MH_SCAN_INDEX_4LSB_345_348 : 483|4@0+ (1,0) [0|15] "" ADAS
 SG_ DET_MH_CYCLE_COUNTER_345_348 : 495|8@0+ (1,0) [0|255] "" ADAS
 SG_ DET_MH_CRC16_345_348 : 503|16@0+ (1,0) [0|65535] "" ADAS

BO_ 1239 RDR_DETECTION_349_352: 64 RDR08
 SG_ DET_RANGE_349 : 7|15@0+ (0.015625,0) [0|500] "m" ADAS
 SG_ DET_RANGE_ERR_349 : 8|7@0+ (0.0075,0) [0|0.9525] "m" ADAS
 SG_ DET_RANGE_VELOCITY_349 : 17|15@0+ (0.0078125,-128) [-128|127.9921875] "m/s" ADAS
 SG_ DET_RANGE_VELOCITY_ERR_349 : 34|8@0+ (0.003,0) [0|0.765] "m/s" ADAS
 SG_ DET_AZIMUTH_349 : 60|13@0+ (0.0004,-1.5708) [-1.5708|1.5708] "rad" ADAS
 SG_ DET_AZIMUTH_ERR_349 : 78|7@0+ (0.00087267,0) [0|0.11082909] "rad" ADAS
 SG_ DET_ELEVATION_349 : 42|8@0+ (0.00275,-0.34925) [-0.34925|0.34925] "rad" ADAS
 SG_ DET_ELEVATION_ERR_349 : 50|6@0+ (0.00174533,0) [0|0.10995579] "rad" ADAS
 SG_ DET_RCS_349 : 119|8@0+ (0.5,-64) [-64|63.5] "dBsm" ADAS
 SG_ DET_VALID_FLAG_349 : 80|1@0+ (1,0) [0|1] "" ADAS
 SG_ DET_BI_STATIC_FLAG_349 : 487|1@0+ (1,0) [0|1] "" ADAS
 SG_ DET_SUPER_RES_TARGET_349 : 79|1@0+ (1,0) [0|1] "" ADAS
 SG_ DET_SNR_349 : 111|8@0+ (0.35156,0) [0|89.6478] "dB" ADAS
 SG_ DET_POINT_TARGET_PROB_349 : 86|4@0+ (6.67,0) [0|100] "%" ADAS
 SG_ DET_EXISTENCE_PROB_349 : 95|6@0+ (1.588,0) [0|100] "%" ADAS
 SG_ DET_OUTSIDE_SECTOR_349 : 103|1@0+ (1,0) [0|1] "" ADAS
 SG_ DET_HVC_FLAG_349 : 87|1@0+ (1,0) [0|1] "" ADAS
 SG_ DET_CONFD_AZIMUTH_349 : 89|2@0+ (1,0) [0|3] "" ADAS
 SG_ DET_CONFD_ELEVATION_349 : 82|2@0+ (1,0) [0|3] "" ADAS
 SG_ DET_RANGE_350 : 127|15@0+ (0.015625,0) [0|500] "m" ADAS
 SG_ DET_RANGE_ERR_350 : 128|7@0+ (0.0075,0) [0|0.9525] "m" ADAS
 SG_ DET_RANGE_VELOCITY_350 : 137|15@0+ (0.0078125,-128) [-128|127.9921875] "m/s" ADAS
 SG_ DET_RANGE_VELOCITY_ERR_350 : 154|8@0+ (0.003,0) [0|0.765] "m/s" ADAS
 SG_ DET_AZIMUTH_350 : 180|13@0+ (0.0004,-1.5708) [-1.5708|1.5708] "rad" ADAS
 SG_ DET_AZIMUTH_ERR_350 : 198|7@0+ (0.00087267,0) [0|0.11082909] "rad" ADAS
 SG_ DET_ELEVATION_350 : 162|8@0+ (0.00275,-0.34925) [-0.34925|0.34925] "rad" ADAS
 SG_ DET_ELEVATION_ERR_350 : 170|6@0+ (0.00174533,0) [0|0.10995579] "rad" ADAS
 SG_ DET_RCS_350 : 239|8@0+ (0.5,-64) [-64|63.5] "dBsm" ADAS
 SG_ DET_VALID_FLAG_350 : 220|1@0+ (1,0) [0|1] "" ADAS
 SG_ DET_BI_STATIC_FLAG_350 : 486|1@0+ (1,0) [0|1] "" ADAS
 SG_ DET_SUPER_RES_TARGET_350 : 199|1@0+ (1,0) [0|1] "" ADAS
 SG_ DET_SNR_350 : 231|8@0+ (0.35156,0) [0|89.6478] "dB" ADAS
 SG_ DET_POINT_TARGET_PROB_350 : 215|4@0+ (6.67,0) [0|100] "%" ADAS
 SG_ DET_EXISTENCE_PROB_350 : 211|6@0+ (1.588,0) [0|100] "%" ADAS
 SG_ DET_OUTSIDE_SECTOR_350 : 221|1@0+ (1,0) [0|1] "" ADAS
 SG_ DET_HVC_FLAG_350 : 207|1@0+ (1,0) [0|1] "" ADAS
 SG_ DET_CONFD_AZIMUTH_350 : 217|2@0+ (1,0) [0|3] "" ADAS
 SG_ DET_CONFD_ELEVATION_350 : 219|2@0+ (1,0) [0|3] "" ADAS
 SG_ DET_RANGE_351 : 247|15@0+ (0.015625,0) [0|500] "m" ADAS
 SG_ DET_RANGE_ERR_351 : 248|7@0+ (0.0075,0) [0|0.9525] "m" ADAS
 SG_ DET_RANGE_VELOCITY_351 : 257|15@0+ (0.0078125,-128) [-128|127.9921875] "m/s" ADAS
 SG_ DET_RANGE_VELOCITY_ERR_351 : 274|8@0+ (0.003,0) [0|0.765] "m/s" ADAS
 SG_ DET_AZIMUTH_351 : 300|13@0+ (0.0004,-1.5708) [-1.5708|1.5708] "rad" ADAS
 SG_ DET_AZIMUTH_ERR_351 : 318|7@0+ (0.00087267,0) [0|0.11082909] "rad" ADAS
 SG_ DET_ELEVATION_351 : 282|8@0+ (0.00275,-0.34925) [-0.34925|0.34925] "rad" ADAS
 SG_ DET_ELEVATION_ERR_351 : 290|6@0+ (0.00174533,0) [0|0.10995579] "rad" ADAS
 SG_ DET_RCS_351 : 359|8@0+ (0.5,-64) [-64|63.5] "dBsm" ADAS
 SG_ DET_VALID_FLAG_351 : 340|1@0+ (1,0) [0|1] "" ADAS
 SG_ DET_BI_STATIC_FLAG_351 : 485|1@0+ (1,0) [0|1] "" ADAS
 SG_ DET_SUPER_RES_TARGET_351 : 319|1@0+ (1,0) [0|1] "" ADAS
 SG_ DET_SNR_351 : 351|8@0+ (0.35156,0) [0|89.6478] "dB" ADAS
 SG_ DET_POINT_TARGET_PROB_351 : 335|4@0+ (6.67,0) [0|100] "%" ADAS
 SG_ DET_EXISTENCE_PROB_351 : 331|6@0+ (1.588,0) [0|100] "%" ADAS
 SG_ DET_OUTSIDE_SECTOR_351 : 341|1@0+ (1,0) [0|1] "" ADAS
 SG_ DET_HVC_FLAG_351 : 327|1@0+ (1,0) [0|1] "" ADAS
 SG_ DET_CONFD_AZIMUTH_351 : 337|2@0+ (1,0) [0|3] "" ADAS
 SG_ DET_CONFD_ELEVATION_351 : 339|2@0+ (1,0) [0|3] "" ADAS
 SG_ DET_RANGE_352 : 367|15@0+ (0.015625,0) [0|500] "m" ADAS
 SG_ DET_RANGE_ERR_352 : 368|7@0+ (0.0075,0) [0|0.9525] "m" ADAS
 SG_ DET_RANGE_VELOCITY_352 : 377|15@0+ (0.0078125,-128) [-128|127.9921875] "m/s" ADAS
 SG_ DET_RANGE_VELOCITY_ERR_352 : 394|8@0+ (0.003,0) [0|0.765] "m/s" ADAS
 SG_ DET_AZIMUTH_352 : 420|13@0+ (0.0004,-1.5708) [-1.5708|1.5708] "rad" ADAS
 SG_ DET_AZIMUTH_ERR_352 : 438|7@0+ (0.00087267,0) [0|0.11082909] "rad" ADAS
 SG_ DET_ELEVATION_352 : 402|8@0+ (0.00275,-0.34925) [-0.34925|0.34925] "rad" ADAS
 SG_ DET_ELEVATION_ERR_352 : 410|6@0+ (0.00174533,0) [0|0.10995579] "rad" ADAS
 SG_ DET_RCS_352 : 479|8@0+ (0.5,-64) [-64|63.5] "dBsm" ADAS
 SG_ DET_VALID_FLAG_352 : 460|1@0+ (1,0) [0|1] "" ADAS
 SG_ DET_BI_STATIC_FLAG_352 : 484|1@0+ (1,0) [0|1] "" ADAS
 SG_ DET_SUPER_RES_TARGET_352 : 439|1@0+ (1,0) [0|1] "" ADAS
 SG_ DET_SNR_352 : 471|8@0+ (0.35156,0) [0|89.6478] "dB" ADAS
 SG_ DET_POINT_TARGET_PROB_352 : 455|4@0+ (6.67,0) [0|100] "%" ADAS
 SG_ DET_EXISTENCE_PROB_352 : 451|6@0+ (1.588,0) [0|100] "%" ADAS
 SG_ DET_OUTSIDE_SECTOR_352 : 461|1@0+ (1,0) [0|1] "" ADAS
 SG_ DET_HVC_FLAG_352 : 447|1@0+ (1,0) [0|1] "" ADAS
 SG_ DET_CONFD_AZIMUTH_352 : 457|2@0+ (1,0) [0|3] "" ADAS
 SG_ DET_CONFD_ELEVATION_352 : 459|2@0+ (1,0) [0|3] "" ADAS
 SG_ DET_MH_SCAN_INDEX_4LSB_349_352 : 483|4@0+ (1,0) [0|15] "" ADAS
 SG_ DET_MH_CYCLE_COUNTER_349_352 : 495|8@0+ (1,0) [0|255] "" ADAS
 SG_ DET_MH_CRC16_349_352 : 503|16@0+ (1,0) [0|65535] "" ADAS

BO_ 1240 RDR_DETECTION_353_356: 64 RDR08
 SG_ DET_RANGE_353 : 7|15@0+ (0.015625,0) [0|500] "m" ADAS
 SG_ DET_RANGE_ERR_353 : 8|7@0+ (0.0075,0) [0|0.9525] "m" ADAS
 SG_ DET_RANGE_VELOCITY_353 : 17|15@0+ (0.0078125,-128) [-128|127.9921875] "m/s" ADAS
 SG_ DET_RANGE_VELOCITY_ERR_353 : 34|8@0+ (0.003,0) [0|0.765] "m/s" ADAS
 SG_ DET_AZIMUTH_353 : 60|13@0+ (0.0004,-1.5708) [-1.5708|1.5708] "rad" ADAS
 SG_ DET_AZIMUTH_ERR_353 : 78|7@0+ (0.00087267,0) [0|0.11082909] "rad" ADAS
 SG_ DET_ELEVATION_353 : 42|8@0+ (0.00275,-0.34925) [-0.34925|0.34925] "rad" ADAS
 SG_ DET_ELEVATION_ERR_353 : 50|6@0+ (0.00174533,0) [0|0.10995579] "rad" ADAS
 SG_ DET_RCS_353 : 119|8@0+ (0.5,-64) [-64|63.5] "dBsm" ADAS
 SG_ DET_VALID_FLAG_353 : 80|1@0+ (1,0) [0|1] "" ADAS
 SG_ DET_BI_STATIC_FLAG_353 : 487|1@0+ (1,0) [0|1] "" ADAS
 SG_ DET_SUPER_RES_TARGET_353 : 79|1@0+ (1,0) [0|1] "" ADAS
 SG_ DET_SNR_353 : 111|8@0+ (0.35156,0) [0|89.6478] "dB" ADAS
 SG_ DET_POINT_TARGET_PROB_353 : 86|4@0+ (6.67,0) [0|100] "%" ADAS
 SG_ DET_EXISTENCE_PROB_353 : 95|6@0+ (1.588,0) [0|100] "%" ADAS
 SG_ DET_OUTSIDE_SECTOR_353 : 103|1@0+ (1,0) [0|1] "" ADAS
 SG_ DET_HVC_FLAG_353 : 87|1@0+ (1,0) [0|1] "" ADAS
 SG_ DET_CONFD_AZIMUTH_353 : 89|2@0+ (1,0) [0|3] "" ADAS
 SG_ DET_CONFD_ELEVATION_353 : 82|2@0+ (1,0) [0|3] "" ADAS
 SG_ DET_RANGE_354 : 127|15@0+ (0.015625,0) [0|500] "m" ADAS
 SG_ DET_RANGE_ERR_354 : 128|7@0+ (0.0075,0) [0|0.9525] "m" ADAS
 SG_ DET_RANGE_VELOCITY_354 : 137|15@0+ (0.0078125,-128) [-128|127.9921875] "m/s" ADAS
 SG_ DET_RANGE_VELOCITY_ERR_354 : 154|8@0+ (0.003,0) [0|0.765] "m/s" ADAS
 SG_ DET_AZIMUTH_354 : 180|13@0+ (0.0004,-1.5708) [-1.5708|1.5708] "rad" ADAS
 SG_ DET_AZIMUTH_ERR_354 : 198|7@0+ (0.00087267,0) [0|0.11082909] "rad" ADAS
 SG_ DET_ELEVATION_354 : 162|8@0+ (0.00275,-0.34925) [-0.34925|0.34925] "rad" ADAS
 SG_ DET_ELEVATION_ERR_354 : 170|6@0+ (0.00174533,0) [0|0.10995579] "rad" ADAS
 SG_ DET_RCS_354 : 239|8@0+ (0.5,-64) [-64|63.5] "dBsm" ADAS
 SG_ DET_VALID_FLAG_354 : 220|1@0+ (1,0) [0|1] "" ADAS
 SG_ DET_BI_STATIC_FLAG_354 : 486|1@0+ (1,0) [0|1] "" ADAS
 SG_ DET_SUPER_RES_TARGET_354 : 199|1@0+ (1,0) [0|1] "" ADAS
 SG_ DET_SNR_354 : 231|8@0+ (0.35156,0) [0|89.6478] "dB" ADAS
 SG_ DET_POINT_TARGET_PROB_354 : 215|4@0+ (6.67,0) [0|100] "%" ADAS
 SG_ DET_EXISTENCE_PROB_354 : 211|6@0+ (1.588,0) [0|100] "%" ADAS
 SG_ DET_OUTSIDE_SECTOR_354 : 221|1@0+ (1,0) [0|1] "" ADAS
 SG_ DET_HVC_FLAG_354 : 207|1@0+ (1,0) [0|1] "" ADAS
 SG_ DET_CONFD_AZIMUTH_354 : 217|2@0+ (1,0) [0|3] "" ADAS
 SG_ DET_CONFD_ELEVATION_354 : 219|2@0+ (1,0) [0|3] "" ADAS
 SG_ DET_RANGE_355 : 247|15@0+ (0.015625,0) [0|500] "m" ADAS
 SG_ DET_RANGE_ERR_355 : 248|7@0+ (0.0075,0) [0|0.9525] "m" ADAS
 SG_ DET_RANGE_VELOCITY_355 : 257|15@0+ (0.0078125,-128) [-128|127.9921875] "m/s" ADAS
 SG_ DET_RANGE_VELOCITY_ERR_355 : 274|8@0+ (0.003,0) [0|0.765] "m/s" ADAS
 SG_ DET_AZIMUTH_355 : 300|13@0+ (0.0004,-1.5708) [-1.5708|1.5708] "rad" ADAS
 SG_ DET_AZIMUTH_ERR_355 : 318|7@0+ (0.00087267,0) [0|0.11082909] "rad" ADAS
 SG_ DET_ELEVATION_355 : 282|8@0+ (0.00275,-0.34925) [-0.34925|0.34925] "rad" ADAS
 SG_ DET_ELEVATION_ERR_355 : 290|6@0+ (0.00174533,0) [0|0.10995579] "rad" ADAS
 SG_ DET_RCS_355 : 359|8@0+ (0.5,-64) [-64|63.5] "dBsm" ADAS
 SG_ DET_VALID_FLAG_355 : 340|1@0+ (1,0) [0|1] "" ADAS
 SG_ DET_BI_STATIC_FLAG_355 : 485|1@0+ (1,0) [0|1] "" ADAS
 SG_ DET_SUPER_RES_TARGET_355 : 319|1@0+ (1,0) [0|1] "" ADAS
 SG_ DET_SNR_355 : 351|8@0+ (0.35156,0) [0|89.6478] "dB" ADAS
 SG_ DET_POINT_TARGET_PROB_355 : 335|4@0+ (6.67,0) [0|100] "%" ADAS
 SG_ DET_EXISTENCE_PROB_355 : 331|6@0+ (1.588,0) [0|100] "%" ADAS
 SG_ DET_OUTSIDE_SECTOR_355 : 341|1@0+ (1,0) [0|1] "" ADAS
 SG_ DET_HVC_FLAG_355 : 327|1@0+ (1,0) [0|1] "" ADAS
 SG_ DET_CONFD_AZIMUTH_355 : 337|2@0+ (1,0) [0|3] "" ADAS
 SG_ DET_CONFD_ELEVATION_355 : 339|2@0+ (1,0) [0|3] "" ADAS
 SG_ DET_RANGE_356 : 367|15@0+ (0.015625,0) [0|500] "m" ADAS
 SG_ DET_RANGE_ERR_356 : 368|7@0+ (0.0075,0) [0|0.9525] "m" ADAS
 SG_ DET_RANGE_VELOCITY_356 : 377|15@0+ (0.0078125,-128) [-128|127.9921875] "m/s" ADAS
 SG_ DET_RANGE_VELOCITY_ERR_356 : 394|8@0+ (0.003,0) [0|0.765] "m/s" ADAS
 SG_ DET_AZIMUTH_356 : 420|13@0+ (0.0004,-1.5708) [-1.5708|1.5708] "rad" ADAS
 SG_ DET_AZIMUTH_ERR_356 : 438|7@0+ (0.00087267,0) [0|0.11082909] "rad" ADAS
 SG_ DET_ELEVATION_356 : 402|8@0+ (0.00275,-0.34925) [-0.34925|0.34925] "rad" ADAS
 SG_ DET_ELEVATION_ERR_356 : 410|6@0+ (0.00174533,0) [0|0.10995579] "rad" ADAS
 SG_ DET_RCS_356 : 479|8@0+ (0.5,-64) [-64|63.5] "dBsm" ADAS
 SG_ DET_VALID_FLAG_356 : 460|1@0+ (1,0) [0|1] "" ADAS
 SG_ DET_BI_STATIC_FLAG_356 : 484|1@0+ (1,0) [0|1] "" ADAS
 SG_ DET_SUPER_RES_TARGET_356 : 439|1@0+ (1,0) [0|1] "" ADAS
 SG_ DET_SNR_356 : 471|8@0+ (0.35156,0) [0|89.6478] "dB" ADAS
 SG_ DET_POINT_TARGET_PROB_356 : 455|4@0+ (6.67,0) [0|100] "%" ADAS
 SG_ DET_EXISTENCE_PROB_356 : 451|6@0+ (1.588,0) [0|100] "%" ADAS
 SG_ DET_OUTSIDE_SECTOR_356 : 461|1@0+ (1,0) [0|1] "" ADAS
 SG_ DET_HVC_FLAG_356 : 447|1@0+ (1,0) [0|1] "" ADAS
 SG_ DET_CONFD_AZIMUTH_356 : 457|2@0+ (1,0) [0|3] "" ADAS
 SG_ DET_CONFD_ELEVATION_356 : 459|2@0+ (1,0) [0|3] "" ADAS
 SG_ DET_MH_SCAN_INDEX_4LSB_353_356 : 483|4@0+ (1,0) [0|15] "" ADAS
 SG_ DET_MH_CYCLE_COUNTER_353_356 : 495|8@0+ (1,0) [0|255] "" ADAS
 SG_ DET_MH_CRC16_353_356 : 503|16@0+ (1,0) [0|65535] "" ADAS

BO_ 1241 RDR_DETECTION_357_360: 64 RDR08
 SG_ DET_RANGE_357 : 7|15@0+ (0.015625,0) [0|500] "m" ADAS
 SG_ DET_RANGE_ERR_357 : 8|7@0+ (0.0075,0) [0|0.9525] "m" ADAS
 SG_ DET_RANGE_VELOCITY_357 : 17|15@0+ (0.0078125,-128) [-128|127.9921875] "m/s" ADAS
 SG_ DET_RANGE_VELOCITY_ERR_357 : 34|8@0+ (0.003,0) [0|0.765] "m/s" ADAS
 SG_ DET_AZIMUTH_357 : 60|13@0+ (0.0004,-1.5708) [-1.5708|1.5708] "rad" ADAS
 SG_ DET_AZIMUTH_ERR_357 : 78|7@0+ (0.00087267,0) [0|0.11082909] "rad" ADAS
 SG_ DET_ELEVATION_357 : 42|8@0+ (0.00275,-0.34925) [-0.34925|0.34925] "rad" ADAS
 SG_ DET_ELEVATION_ERR_357 : 50|6@0+ (0.00174533,0) [0|0.10995579] "rad" ADAS
 SG_ DET_RCS_357 : 119|8@0+ (0.5,-64) [-64|63.5] "dBsm" ADAS
 SG_ DET_VALID_FLAG_357 : 80|1@0+ (1,0) [0|1] "" ADAS
 SG_ DET_BI_STATIC_FLAG_357 : 487|1@0+ (1,0) [0|1] "" ADAS
 SG_ DET_SUPER_RES_TARGET_357 : 79|1@0+ (1,0) [0|1] "" ADAS
 SG_ DET_SNR_357 : 111|8@0+ (0.35156,0) [0|89.6478] "dB" ADAS
 SG_ DET_POINT_TARGET_PROB_357 : 86|4@0+ (6.67,0) [0|100] "%" ADAS
 SG_ DET_EXISTENCE_PROB_357 : 95|6@0+ (1.588,0) [0|100] "%" ADAS
 SG_ DET_OUTSIDE_SECTOR_357 : 103|1@0+ (1,0) [0|1] "" ADAS
 SG_ DET_HVC_FLAG_357 : 87|1@0+ (1,0) [0|1] "" ADAS
 SG_ DET_CONFD_AZIMUTH_357 : 89|2@0+ (1,0) [0|3] "" ADAS
 SG_ DET_CONFD_ELEVATION_357 : 82|2@0+ (1,0) [0|3] "" ADAS
 SG_ DET_RANGE_358 : 127|15@0+ (0.015625,0) [0|500] "m" ADAS
 SG_ DET_RANGE_ERR_358 : 128|7@0+ (0.0075,0) [0|0.9525] "m" ADAS
 SG_ DET_RANGE_VELOCITY_358 : 137|15@0+ (0.0078125,-128) [-128|127.9921875] "m/s" ADAS
 SG_ DET_RANGE_VELOCITY_ERR_358 : 154|8@0+ (0.003,0) [0|0.765] "m/s" ADAS
 SG_ DET_AZIMUTH_358 : 180|13@0+ (0.0004,-1.5708) [-1.5708|1.5708] "rad" ADAS
 SG_ DET_AZIMUTH_ERR_358 : 198|7@0+ (0.00087267,0) [0|0.11082909] "rad" ADAS
 SG_ DET_ELEVATION_358 : 162|8@0+ (0.00275,-0.34925) [-0.34925|0.34925] "rad" ADAS
 SG_ DET_ELEVATION_ERR_358 : 170|6@0+ (0.00174533,0) [0|0.10995579] "rad" ADAS
 SG_ DET_RCS_358 : 239|8@0+ (0.5,-64) [-64|63.5] "dBsm" ADAS
 SG_ DET_VALID_FLAG_358 : 220|1@0+ (1,0) [0|1] "" ADAS
 SG_ DET_BI_STATIC_FLAG_358 : 486|1@0+ (1,0) [0|1] "" ADAS
 SG_ DET_SUPER_RES_TARGET_358 : 199|1@0+ (1,0) [0|1] "" ADAS
 SG_ DET_SNR_358 : 231|8@0+ (0.35156,0) [0|89.6478] "dB" ADAS
 SG_ DET_POINT_TARGET_PROB_358 : 215|4@0+ (6.67,0) [0|100] "%" ADAS
 SG_ DET_EXISTENCE_PROB_358 : 211|6@0+ (1.588,0) [0|100] "%" ADAS
 SG_ DET_OUTSIDE_SECTOR_358 : 221|1@0+ (1,0) [0|1] "" ADAS
 SG_ DET_HVC_FLAG_358 : 207|1@0+ (1,0) [0|1] "" ADAS
 SG_ DET_CONFD_AZIMUTH_358 : 217|2@0+ (1,0) [0|3] "" ADAS
 SG_ DET_CONFD_ELEVATION_358 : 219|2@0+ (1,0) [0|3] "" ADAS
 SG_ DET_RANGE_359 : 247|15@0+ (0.015625,0) [0|500] "m" ADAS
 SG_ DET_RANGE_ERR_359 : 248|7@0+ (0.0075,0) [0|0.9525] "m" ADAS
 SG_ DET_RANGE_VELOCITY_359 : 257|15@0+ (0.0078125,-128) [-128|127.9921875] "m/s" ADAS
 SG_ DET_RANGE_VELOCITY_ERR_359 : 274|8@0+ (0.003,0) [0|0.765] "m/s" ADAS
 SG_ DET_AZIMUTH_359 : 300|13@0+ (0.0004,-1.5708) [-1.5708|1.5708] "rad" ADAS
 SG_ DET_AZIMUTH_ERR_359 : 318|7@0+ (0.00087267,0) [0|0.11082909] "rad" ADAS
 SG_ DET_ELEVATION_359 : 282|8@0+ (0.00275,-0.34925) [-0.34925|0.34925] "rad" ADAS
 SG_ DET_ELEVATION_ERR_359 : 290|6@0+ (0.00174533,0) [0|0.10995579] "rad" ADAS
 SG_ DET_RCS_359 : 359|8@0+ (0.5,-64) [-64|63.5] "dBsm" ADAS
 SG_ DET_VALID_FLAG_359 : 340|1@0+ (1,0) [0|1] "" ADAS
 SG_ DET_BI_STATIC_FLAG_359 : 485|1@0+ (1,0) [0|1] "" ADAS
 SG_ DET_SUPER_RES_TARGET_359 : 319|1@0+ (1,0) [0|1] "" ADAS
 SG_ DET_SNR_359 : 351|8@0+ (0.35156,0) [0|89.6478] "dB" ADAS
 SG_ DET_POINT_TARGET_PROB_359 : 335|4@0+ (6.67,0) [0|100] "%" ADAS
 SG_ DET_EXISTENCE_PROB_359 : 331|6@0+ (1.588,0) [0|100] "%" ADAS
 SG_ DET_OUTSIDE_SECTOR_359 : 341|1@0+ (1,0) [0|1] "" ADAS
 SG_ DET_HVC_FLAG_359 : 327|1@0+ (1,0) [0|1] "" ADAS
 SG_ DET_CONFD_AZIMUTH_359 : 337|2@0+ (1,0) [0|3] "" ADAS
 SG_ DET_CONFD_ELEVATION_359 : 339|2@0+ (1,0) [0|3] "" ADAS
 SG_ DET_RANGE_360 : 367|15@0+ (0.015625,0) [0|500] "m" ADAS
 SG_ DET_RANGE_ERR_360 : 368|7@0+ (0.0075,0) [0|0.9525] "m" ADAS
 SG_ DET_RANGE_VELOCITY_360 : 377|15@0+ (0.0078125,-128) [-128|127.9921875] "m/s" ADAS
 SG_ DET_RANGE_VELOCITY_ERR_360 : 394|8@0+ (0.003,0) [0|0.765] "m/s" ADAS
 SG_ DET_AZIMUTH_360 : 420|13@0+ (0.0004,-1.5708) [-1.5708|1.5708] "rad" ADAS
 SG_ DET_AZIMUTH_ERR_360 : 438|7@0+ (0.00087267,0) [0|0.11082909] "rad" ADAS
 SG_ DET_ELEVATION_360 : 402|8@0+ (0.00275,-0.34925) [-0.34925|0.34925] "rad" ADAS
 SG_ DET_ELEVATION_ERR_360 : 410|6@0+ (0.00174533,0) [0|0.10995579] "rad" ADAS
 SG_ DET_RCS_360 : 479|8@0+ (0.5,-64) [-64|63.5] "dBsm" ADAS
 SG_ DET_VALID_FLAG_360 : 460|1@0+ (1,0) [0|1] "" ADAS
 SG_ DET_BI_STATIC_FLAG_360 : 484|1@0+ (1,0) [0|1] "" ADAS
 SG_ DET_SUPER_RES_TARGET_360 : 439|1@0+ (1,0) [0|1] "" ADAS
 SG_ DET_SNR_360 : 471|8@0+ (0.35156,0) [0|89.6478] "dB" ADAS
 SG_ DET_POINT_TARGET_PROB_360 : 455|4@0+ (6.67,0) [0|100] "%" ADAS
 SG_ DET_EXISTENCE_PROB_360 : 451|6@0+ (1.588,0) [0|100] "%" ADAS
 SG_ DET_OUTSIDE_SECTOR_360 : 461|1@0+ (1,0) [0|1] "" ADAS
 SG_ DET_HVC_FLAG_360 : 447|1@0+ (1,0) [0|1] "" ADAS
 SG_ DET_CONFD_AZIMUTH_360 : 457|2@0+ (1,0) [0|3] "" ADAS
 SG_ DET_CONFD_ELEVATION_360 : 459|2@0+ (1,0) [0|3] "" ADAS
 SG_ DET_MH_SCAN_INDEX_4LSB_357_360 : 483|4@0+ (1,0) [0|15] "" ADAS
 SG_ DET_MH_CYCLE_COUNTER_357_360 : 495|8@0+ (1,0) [0|255] "" ADAS
 SG_ DET_MH_CRC16_357_360 : 503|16@0+ (1,0) [0|65535] "" ADAS

BO_ 1242 RDR_DETECTION_361_364: 64 RDR08
 SG_ DET_RANGE_361 : 7|15@0+ (0.015625,0) [0|500] "m" ADAS
 SG_ DET_RANGE_ERR_361 : 8|7@0+ (0.0075,0) [0|0.9525] "m" ADAS
 SG_ DET_RANGE_VELOCITY_361 : 17|15@0+ (0.0078125,-128) [-128|127.9921875] "m/s" ADAS
 SG_ DET_RANGE_VELOCITY_ERR_361 : 34|8@0+ (0.003,0) [0|0.765] "m/s" ADAS
 SG_ DET_AZIMUTH_361 : 60|13@0+ (0.0004,-1.5708) [-1.5708|1.5708] "rad" ADAS
 SG_ DET_AZIMUTH_ERR_361 : 78|7@0+ (0.00087267,0) [0|0.11082909] "rad" ADAS
 SG_ DET_ELEVATION_361 : 42|8@0+ (0.00275,-0.34925) [-0.34925|0.34925] "rad" ADAS
 SG_ DET_ELEVATION_ERR_361 : 50|6@0+ (0.00174533,0) [0|0.10995579] "rad" ADAS
 SG_ DET_RCS_361 : 119|8@0+ (0.5,-64) [-64|63.5] "dBsm" ADAS
 SG_ DET_VALID_FLAG_361 : 80|1@0+ (1,0) [0|1] "" ADAS
 SG_ DET_BI_STATIC_FLAG_361 : 487|1@0+ (1,0) [0|1] "" ADAS
 SG_ DET_SUPER_RES_TARGET_361 : 79|1@0+ (1,0) [0|1] "" ADAS
 SG_ DET_SNR_361 : 111|8@0+ (0.35156,0) [0|89.6478] "dB" ADAS
 SG_ DET_POINT_TARGET_PROB_361 : 86|4@0+ (6.67,0) [0|100] "%" ADAS
 SG_ DET_EXISTENCE_PROB_361 : 95|6@0+ (1.588,0) [0|100] "%" ADAS
 SG_ DET_OUTSIDE_SECTOR_361 : 103|1@0+ (1,0) [0|1] "" ADAS
 SG_ DET_HVC_FLAG_361 : 87|1@0+ (1,0) [0|1] "" ADAS
 SG_ DET_CONFD_AZIMUTH_361 : 89|2@0+ (1,0) [0|3] "" ADAS
 SG_ DET_CONFD_ELEVATION_361 : 82|2@0+ (1,0) [0|3] "" ADAS
 SG_ DET_RANGE_362 : 127|15@0+ (0.015625,0) [0|500] "m" ADAS
 SG_ DET_RANGE_ERR_362 : 128|7@0+ (0.0075,0) [0|0.9525] "m" ADAS
 SG_ DET_RANGE_VELOCITY_362 : 137|15@0+ (0.0078125,-128) [-128|127.9921875] "m/s" ADAS
 SG_ DET_RANGE_VELOCITY_ERR_362 : 154|8@0+ (0.003,0) [0|0.765] "m/s" ADAS
 SG_ DET_AZIMUTH_362 : 180|13@0+ (0.0004,-1.5708) [-1.5708|1.5708] "rad" ADAS
 SG_ DET_AZIMUTH_ERR_362 : 198|7@0+ (0.00087267,0) [0|0.11082909] "rad" ADAS
 SG_ DET_ELEVATION_362 : 162|8@0+ (0.00275,-0.34925) [-0.34925|0.34925] "rad" ADAS
 SG_ DET_ELEVATION_ERR_362 : 170|6@0+ (0.00174533,0) [0|0.10995579] "rad" ADAS
 SG_ DET_RCS_362 : 239|8@0+ (0.5,-64) [-64|63.5] "dBsm" ADAS
 SG_ DET_VALID_FLAG_362 : 220|1@0+ (1,0) [0|1] "" ADAS
 SG_ DET_BI_STATIC_FLAG_362 : 486|1@0+ (1,0) [0|1] "" ADAS
 SG_ DET_SUPER_RES_TARGET_362 : 199|1@0+ (1,0) [0|1] "" ADAS
 SG_ DET_SNR_362 : 231|8@0+ (0.35156,0) [0|89.6478] "dB" ADAS
 SG_ DET_POINT_TARGET_PROB_362 : 215|4@0+ (6.67,0) [0|100] "%" ADAS
 SG_ DET_EXISTENCE_PROB_362 : 211|6@0+ (1.588,0) [0|100] "%" ADAS
 SG_ DET_OUTSIDE_SECTOR_362 : 221|1@0+ (1,0) [0|1] "" ADAS
 SG_ DET_HVC_FLAG_362 : 207|1@0+ (1,0) [0|1] "" ADAS
 SG_ DET_CONFD_AZIMUTH_362 : 217|2@0+ (1,0) [0|3] "" ADAS
 SG_ DET_CONFD_ELEVATION_362 : 219|2@0+ (1,0) [0|3] "" ADAS
 SG_ DET_RANGE_363 : 247|15@0+ (0.015625,0) [0|500] "m" ADAS
 SG_ DET_RANGE_ERR_363 : 248|7@0+ (0.0075,0) [0|0.9525] "m" ADAS
 SG_ DET_RANGE_VELOCITY_363 : 257|15@0+ (0.0078125,-128) [-128|127.9921875] "m/s" ADAS
 SG_ DET_RANGE_VELOCITY_ERR_363 : 274|8@0+ (0.003,0) [0|0.765] "m/s" ADAS
 SG_ DET_AZIMUTH_363 : 300|13@0+ (0.0004,-1.5708) [-1.5708|1.5708] "rad" ADAS
 SG_ DET_AZIMUTH_ERR_363 : 318|7@0+ (0.00087267,0) [0|0.11082909] "rad" ADAS
 SG_ DET_ELEVATION_363 : 282|8@0+ (0.00275,-0.34925) [-0.34925|0.34925] "rad" ADAS
 SG_ DET_ELEVATION_ERR_363 : 290|6@0+ (0.00174533,0) [0|0.10995579] "rad" ADAS
 SG_ DET_RCS_363 : 359|8@0+ (0.5,-64) [-64|63.5] "dBsm" ADAS
 SG_ DET_VALID_FLAG_363 : 340|1@0+ (1,0) [0|1] "" ADAS
 SG_ DET_BI_STATIC_FLAG_363 : 485|1@0+ (1,0) [0|1] "" ADAS
 SG_ DET_SUPER_RES_TARGET_363 : 319|1@0+ (1,0) [0|1] "" ADAS
 SG_ DET_SNR_363 : 351|8@0+ (0.35156,0) [0|89.6478] "dB" ADAS
 SG_ DET_POINT_TARGET_PROB_363 : 335|4@0+ (6.67,0) [0|100] "%" ADAS
 SG_ DET_EXISTENCE_PROB_363 : 331|6@0+ (1.588,0) [0|100] "%" ADAS
 SG_ DET_OUTSIDE_SECTOR_363 : 341|1@0+ (1,0) [0|1] "" ADAS
 SG_ DET_HVC_FLAG_363 : 327|1@0+ (1,0) [0|1] "" ADAS
 SG_ DET_CONFD_AZIMUTH_363 : 337|2@0+ (1,0) [0|3] "" ADAS
 SG_ DET_CONFD_ELEVATION_363 : 339|2@0+ (1,0) [0|3] "" ADAS
 SG_ DET_RANGE_364 : 367|15@0+ (0.015625,0) [0|500] "m" ADAS
 SG_ DET_RANGE_ERR_364 : 368|7@0+ (0.0075,0) [0|0.9525] "m" ADAS
 SG_ DET_RANGE_VELOCITY_364 : 377|15@0+ (0.0078125,-128) [-128|127.9921875] "m/s" ADAS
 SG_ DET_RANGE_VELOCITY_ERR_364 : 394|8@0+ (0.003,0) [0|0.765] "m/s" ADAS
 SG_ DET_AZIMUTH_364 : 420|13@0+ (0.0004,-1.5708) [-1.5708|1.5708] "rad" ADAS
 SG_ DET_AZIMUTH_ERR_364 : 438|7@0+ (0.00087267,0) [0|0.11082909] "rad" ADAS
 SG_ DET_ELEVATION_364 : 402|8@0+ (0.00275,-0.34925) [-0.34925|0.34925] "rad" ADAS
 SG_ DET_ELEVATION_ERR_364 : 410|6@0+ (0.00174533,0) [0|0.10995579] "rad" ADAS
 SG_ DET_RCS_364 : 479|8@0+ (0.5,-64) [-64|63.5] "dBsm" ADAS
 SG_ DET_VALID_FLAG_364 : 460|1@0+ (1,0) [0|1] "" ADAS
 SG_ DET_BI_STATIC_FLAG_364 : 484|1@0+ (1,0) [0|1] "" ADAS
 SG_ DET_SUPER_RES_TARGET_364 : 439|1@0+ (1,0) [0|1] "" ADAS
 SG_ DET_SNR_364 : 471|8@0+ (0.35156,0) [0|89.6478] "dB" ADAS
 SG_ DET_POINT_TARGET_PROB_364 : 455|4@0+ (6.67,0) [0|100] "%" ADAS
 SG_ DET_EXISTENCE_PROB_364 : 451|6@0+ (1.588,0) [0|100] "%" ADAS
 SG_ DET_OUTSIDE_SECTOR_364 : 461|1@0+ (1,0) [0|1] "" ADAS
 SG_ DET_HVC_FLAG_364 : 447|1@0+ (1,0) [0|1] "" ADAS
 SG_ DET_CONFD_AZIMUTH_364 : 457|2@0+ (1,0) [0|3] "" ADAS
 SG_ DET_CONFD_ELEVATION_364 : 459|2@0+ (1,0) [0|3] "" ADAS
 SG_ DET_MH_SCAN_INDEX_4LSB_361_364 : 483|4@0+ (1,0) [0|15] "" ADAS
 SG_ DET_MH_CYCLE_COUNTER_361_364 : 495|8@0+ (1,0) [0|255] "" ADAS
 SG_ DET_MH_CRC16_361_364 : 503|16@0+ (1,0) [0|65535] "" ADAS

BO_ 1243 RDR_DETECTION_365_368: 64 RDR08
 SG_ DET_RANGE_365 : 7|15@0+ (0.015625,0) [0|500] "m" ADAS
 SG_ DET_RANGE_ERR_365 : 8|7@0+ (0.0075,0) [0|0.9525] "m" ADAS
 SG_ DET_RANGE_VELOCITY_365 : 17|15@0+ (0.0078125,-128) [-128|127.9921875] "m/s" ADAS
 SG_ DET_RANGE_VELOCITY_ERR_365 : 34|8@0+ (0.003,0) [0|0.765] "m/s" ADAS
 SG_ DET_AZIMUTH_365 : 60|13@0+ (0.0004,-1.5708) [-1.5708|1.5708] "rad" ADAS
 SG_ DET_AZIMUTH_ERR_365 : 78|7@0+ (0.00087267,0) [0|0.11082909] "rad" ADAS
 SG_ DET_ELEVATION_365 : 42|8@0+ (0.00275,-0.34925) [-0.34925|0.34925] "rad" ADAS
 SG_ DET_ELEVATION_ERR_365 : 50|6@0+ (0.00174533,0) [0|0.10995579] "rad" ADAS
 SG_ DET_RCS_365 : 119|8@0+ (0.5,-64) [-64|63.5] "dBsm" ADAS
 SG_ DET_VALID_FLAG_365 : 80|1@0+ (1,0) [0|1] "" ADAS
 SG_ DET_BI_STATIC_FLAG_365 : 487|1@0+ (1,0) [0|1] "" ADAS
 SG_ DET_SUPER_RES_TARGET_365 : 79|1@0+ (1,0) [0|1] "" ADAS
 SG_ DET_SNR_365 : 111|8@0+ (0.35156,0) [0|89.6478] "dB" ADAS
 SG_ DET_POINT_TARGET_PROB_365 : 86|4@0+ (6.67,0) [0|100] "%" ADAS
 SG_ DET_EXISTENCE_PROB_365 : 95|6@0+ (1.588,0) [0|100] "%" ADAS
 SG_ DET_OUTSIDE_SECTOR_365 : 103|1@0+ (1,0) [0|1] "" ADAS
 SG_ DET_HVC_FLAG_365 : 87|1@0+ (1,0) [0|1] "" ADAS
 SG_ DET_CONFD_AZIMUTH_365 : 89|2@0+ (1,0) [0|3] "" ADAS
 SG_ DET_CONFD_ELEVATION_365 : 82|2@0+ (1,0) [0|3] "" ADAS
 SG_ DET_RANGE_366 : 127|15@0+ (0.015625,0) [0|500] "m" ADAS
 SG_ DET_RANGE_ERR_366 : 128|7@0+ (0.0075,0) [0|0.9525] "m" ADAS
 SG_ DET_RANGE_VELOCITY_366 : 137|15@0+ (0.0078125,-128) [-128|127.9921875] "m/s" ADAS
 SG_ DET_RANGE_VELOCITY_ERR_366 : 154|8@0+ (0.003,0) [0|0.765] "m/s" ADAS
 SG_ DET_AZIMUTH_366 : 180|13@0+ (0.0004,-1.5708) [-1.5708|1.5708] "rad" ADAS
 SG_ DET_AZIMUTH_ERR_366 : 198|7@0+ (0.00087267,0) [0|0.11082909] "rad" ADAS
 SG_ DET_ELEVATION_366 : 162|8@0+ (0.00275,-0.34925) [-0.34925|0.34925] "rad" ADAS
 SG_ DET_ELEVATION_ERR_366 : 170|6@0+ (0.00174533,0) [0|0.10995579] "rad" ADAS
 SG_ DET_RCS_366 : 239|8@0+ (0.5,-64) [-64|63.5] "dBsm" ADAS
 SG_ DET_VALID_FLAG_366 : 220|1@0+ (1,0) [0|1] "" ADAS
 SG_ DET_BI_STATIC_FLAG_366 : 486|1@0+ (1,0) [0|1] "" ADAS
 SG_ DET_SUPER_RES_TARGET_366 : 199|1@0+ (1,0) [0|1] "" ADAS
 SG_ DET_SNR_366 : 231|8@0+ (0.35156,0) [0|89.6478] "dB" ADAS
 SG_ DET_POINT_TARGET_PROB_366 : 215|4@0+ (6.67,0) [0|100] "%" ADAS
 SG_ DET_EXISTENCE_PROB_366 : 211|6@0+ (1.588,0) [0|100] "%" ADAS
 SG_ DET_OUTSIDE_SECTOR_366 : 221|1@0+ (1,0) [0|1] "" ADAS
 SG_ DET_HVC_FLAG_366 : 207|1@0+ (1,0) [0|1] "" ADAS
 SG_ DET_CONFD_AZIMUTH_366 : 217|2@0+ (1,0) [0|3] "" ADAS
 SG_ DET_CONFD_ELEVATION_366 : 219|2@0+ (1,0) [0|3] "" ADAS
 SG_ DET_RANGE_367 : 247|15@0+ (0.015625,0) [0|500] "m" ADAS
 SG_ DET_RANGE_ERR_367 : 248|7@0+ (0.0075,0) [0|0.9525] "m" ADAS
 SG_ DET_RANGE_VELOCITY_367 : 257|15@0+ (0.0078125,-128) [-128|127.9921875] "m/s" ADAS
 SG_ DET_RANGE_VELOCITY_ERR_367 : 274|8@0+ (0.003,0) [0|0.765] "m/s" ADAS
 SG_ DET_AZIMUTH_367 : 300|13@0+ (0.0004,-1.5708) [-1.5708|1.5708] "rad" ADAS
 SG_ DET_AZIMUTH_ERR_367 : 318|7@0+ (0.00087267,0) [0|0.11082909] "rad" ADAS
 SG_ DET_ELEVATION_367 : 282|8@0+ (0.00275,-0.34925) [-0.34925|0.34925] "rad" ADAS
 SG_ DET_ELEVATION_ERR_367 : 290|6@0+ (0.00174533,0) [0|0.10995579] "rad" ADAS
 SG_ DET_RCS_367 : 359|8@0+ (0.5,-64) [-64|63.5] "dBsm" ADAS
 SG_ DET_VALID_FLAG_367 : 340|1@0+ (1,0) [0|1] "" ADAS
 SG_ DET_BI_STATIC_FLAG_367 : 485|1@0+ (1,0) [0|1] "" ADAS
 SG_ DET_SUPER_RES_TARGET_367 : 319|1@0+ (1,0) [0|1] "" ADAS
 SG_ DET_SNR_367 : 351|8@0+ (0.35156,0) [0|89.6478] "dB" ADAS
 SG_ DET_POINT_TARGET_PROB_367 : 335|4@0+ (6.67,0) [0|100] "%" ADAS
 SG_ DET_EXISTENCE_PROB_367 : 331|6@0+ (1.588,0) [0|100] "%" ADAS
 SG_ DET_OUTSIDE_SECTOR_367 : 341|1@0+ (1,0) [0|1] "" ADAS
 SG_ DET_HVC_FLAG_367 : 327|1@0+ (1,0) [0|1] "" ADAS
 SG_ DET_CONFD_AZIMUTH_367 : 337|2@0+ (1,0) [0|3] "" ADAS
 SG_ DET_CONFD_ELEVATION_367 : 339|2@0+ (1,0) [0|3] "" ADAS
 SG_ DET_RANGE_368 : 367|15@0+ (0.015625,0) [0|500] "m" ADAS
 SG_ DET_RANGE_ERR_368 : 368|7@0+ (0.0075,0) [0|0.9525] "m" ADAS
 SG_ DET_RANGE_VELOCITY_368 : 377|15@0+ (0.0078125,-128) [-128|127.9921875] "m/s" ADAS
 SG_ DET_RANGE_VELOCITY_ERR_368 : 394|8@0+ (0.003,0) [0|0.765] "m/s" ADAS
 SG_ DET_AZIMUTH_368 : 420|13@0+ (0.0004,-1.5708) [-1.5708|1.5708] "rad" ADAS
 SG_ DET_AZIMUTH_ERR_368 : 438|7@0+ (0.00087267,0) [0|0.11082909] "rad" ADAS
 SG_ DET_ELEVATION_368 : 402|8@0+ (0.00275,-0.34925) [-0.34925|0.34925] "rad" ADAS
 SG_ DET_ELEVATION_ERR_368 : 410|6@0+ (0.00174533,0) [0|0.10995579] "rad" ADAS
 SG_ DET_RCS_368 : 479|8@0+ (0.5,-64) [-64|63.5] "dBsm" ADAS
 SG_ DET_VALID_FLAG_368 : 460|1@0+ (1,0) [0|1] "" ADAS
 SG_ DET_BI_STATIC_FLAG_368 : 484|1@0+ (1,0) [0|1] "" ADAS
 SG_ DET_SUPER_RES_TARGET_368 : 439|1@0+ (1,0) [0|1] "" ADAS
 SG_ DET_SNR_368 : 471|8@0+ (0.35156,0) [0|89.6478] "dB" ADAS
 SG_ DET_POINT_TARGET_PROB_368 : 455|4@0+ (6.67,0) [0|100] "%" ADAS
 SG_ DET_EXISTENCE_PROB_368 : 451|6@0+ (1.588,0) [0|100] "%" ADAS
 SG_ DET_OUTSIDE_SECTOR_368 : 461|1@0+ (1,0) [0|1] "" ADAS
 SG_ DET_HVC_FLAG_368 : 447|1@0+ (1,0) [0|1] "" ADAS
 SG_ DET_CONFD_AZIMUTH_368 : 457|2@0+ (1,0) [0|3] "" ADAS
 SG_ DET_CONFD_ELEVATION_368 : 459|2@0+ (1,0) [0|3] "" ADAS
 SG_ DET_MH_SCAN_INDEX_4LSB_365_368 : 483|4@0+ (1,0) [0|15] "" ADAS
 SG_ DET_MH_CYCLE_COUNTER_365_368 : 495|8@0+ (1,0) [0|255] "" ADAS
 SG_ DET_MH_CRC16_365_368 : 503|16@0+ (1,0) [0|65535] "" ADAS

BO_ 1244 RDR_DETECTION_369_372: 64 RDR08
 SG_ DET_RANGE_369 : 7|15@0+ (0.015625,0) [0|500] "m" ADAS
 SG_ DET_RANGE_ERR_369 : 8|7@0+ (0.0075,0) [0|0.9525] "m" ADAS
 SG_ DET_RANGE_VELOCITY_369 : 17|15@0+ (0.0078125,-128) [-128|127.9921875] "m/s" ADAS
 SG_ DET_RANGE_VELOCITY_ERR_369 : 34|8@0+ (0.003,0) [0|0.765] "m/s" ADAS
 SG_ DET_AZIMUTH_369 : 60|13@0+ (0.0004,-1.5708) [-1.5708|1.5708] "rad" ADAS
 SG_ DET_AZIMUTH_ERR_369 : 78|7@0+ (0.00087267,0) [0|0.11082909] "rad" ADAS
 SG_ DET_ELEVATION_369 : 42|8@0+ (0.00275,-0.34925) [-0.34925|0.34925] "rad" ADAS
 SG_ DET_ELEVATION_ERR_369 : 50|6@0+ (0.00174533,0) [0|0.10995579] "rad" ADAS
 SG_ DET_RCS_369 : 119|8@0+ (0.5,-64) [-64|63.5] "dBsm" ADAS
 SG_ DET_VALID_FLAG_369 : 80|1@0+ (1,0) [0|1] "" ADAS
 SG_ DET_BI_STATIC_FLAG_369 : 487|1@0+ (1,0) [0|1] "" ADAS
 SG_ DET_SUPER_RES_TARGET_369 : 79|1@0+ (1,0) [0|1] "" ADAS
 SG_ DET_SNR_369 : 111|8@0+ (0.35156,0) [0|89.6478] "dB" ADAS
 SG_ DET_POINT_TARGET_PROB_369 : 86|4@0+ (6.67,0) [0|100] "%" ADAS
 SG_ DET_EXISTENCE_PROB_369 : 95|6@0+ (1.588,0) [0|100] "%" ADAS
 SG_ DET_OUTSIDE_SECTOR_369 : 103|1@0+ (1,0) [0|1] "" ADAS
 SG_ DET_HVC_FLAG_369 : 87|1@0+ (1,0) [0|1] "" ADAS
 SG_ DET_CONFD_AZIMUTH_369 : 89|2@0+ (1,0) [0|3] "" ADAS
 SG_ DET_CONFD_ELEVATION_369 : 82|2@0+ (1,0) [0|3] "" ADAS
 SG_ DET_RANGE_370 : 127|15@0+ (0.015625,0) [0|500] "m" ADAS
 SG_ DET_RANGE_ERR_370 : 128|7@0+ (0.0075,0) [0|0.9525] "m" ADAS
 SG_ DET_RANGE_VELOCITY_370 : 137|15@0+ (0.0078125,-128) [-128|127.9921875] "m/s" ADAS
 SG_ DET_RANGE_VELOCITY_ERR_370 : 154|8@0+ (0.003,0) [0|0.765] "m/s" ADAS
 SG_ DET_AZIMUTH_370 : 180|13@0+ (0.0004,-1.5708) [-1.5708|1.5708] "rad" ADAS
 SG_ DET_AZIMUTH_ERR_370 : 198|7@0+ (0.00087267,0) [0|0.11082909] "rad" ADAS
 SG_ DET_ELEVATION_370 : 162|8@0+ (0.00275,-0.34925) [-0.34925|0.34925] "rad" ADAS
 SG_ DET_ELEVATION_ERR_370 : 170|6@0+ (0.00174533,0) [0|0.10995579] "rad" ADAS
 SG_ DET_RCS_370 : 239|8@0+ (0.5,-64) [-64|63.5] "dBsm" ADAS
 SG_ DET_VALID_FLAG_370 : 220|1@0+ (1,0) [0|1] "" ADAS
 SG_ DET_BI_STATIC_FLAG_370 : 486|1@0+ (1,0) [0|1] "" ADAS
 SG_ DET_SUPER_RES_TARGET_370 : 199|1@0+ (1,0) [0|1] "" ADAS
 SG_ DET_SNR_370 : 231|8@0+ (0.35156,0) [0|89.6478] "dB" ADAS
 SG_ DET_POINT_TARGET_PROB_370 : 215|4@0+ (6.67,0) [0|100] "%" ADAS
 SG_ DET_EXISTENCE_PROB_370 : 211|6@0+ (1.588,0) [0|100] "%" ADAS
 SG_ DET_OUTSIDE_SECTOR_370 : 221|1@0+ (1,0) [0|1] "" ADAS
 SG_ DET_HVC_FLAG_370 : 207|1@0+ (1,0) [0|1] "" ADAS
 SG_ DET_CONFD_AZIMUTH_370 : 217|2@0+ (1,0) [0|3] "" ADAS
 SG_ DET_CONFD_ELEVATION_370 : 219|2@0+ (1,0) [0|3] "" ADAS
 SG_ DET_RANGE_371 : 247|15@0+ (0.015625,0) [0|500] "m" ADAS
 SG_ DET_RANGE_ERR_371 : 248|7@0+ (0.0075,0) [0|0.9525] "m" ADAS
 SG_ DET_RANGE_VELOCITY_371 : 257|15@0+ (0.0078125,-128) [-128|127.9921875] "m/s" ADAS
 SG_ DET_RANGE_VELOCITY_ERR_371 : 274|8@0+ (0.003,0) [0|0.765] "m/s" ADAS
 SG_ DET_AZIMUTH_371 : 300|13@0+ (0.0004,-1.5708) [-1.5708|1.5708] "rad" ADAS
 SG_ DET_AZIMUTH_ERR_371 : 318|7@0+ (0.00087267,0) [0|0.11082909] "rad" ADAS
 SG_ DET_ELEVATION_371 : 282|8@0+ (0.00275,-0.34925) [-0.34925|0.34925] "rad" ADAS
 SG_ DET_ELEVATION_ERR_371 : 290|6@0+ (0.00174533,0) [0|0.10995579] "rad" ADAS
 SG_ DET_RCS_371 : 359|8@0+ (0.5,-64) [-64|63.5] "dBsm" ADAS
 SG_ DET_VALID_FLAG_371 : 340|1@0+ (1,0) [0|1] "" ADAS
 SG_ DET_BI_STATIC_FLAG_371 : 485|1@0+ (1,0) [0|1] "" ADAS
 SG_ DET_SUPER_RES_TARGET_371 : 319|1@0+ (1,0) [0|1] "" ADAS
 SG_ DET_SNR_371 : 351|8@0+ (0.35156,0) [0|89.6478] "dB" ADAS
 SG_ DET_POINT_TARGET_PROB_371 : 335|4@0+ (6.67,0) [0|100] "%" ADAS
 SG_ DET_EXISTENCE_PROB_371 : 331|6@0+ (1.588,0) [0|100] "%" ADAS
 SG_ DET_OUTSIDE_SECTOR_371 : 341|1@0+ (1,0) [0|1] "" ADAS
 SG_ DET_HVC_FLAG_371 : 327|1@0+ (1,0) [0|1] "" ADAS
 SG_ DET_CONFD_AZIMUTH_371 : 337|2@0+ (1,0) [0|3] "" ADAS
 SG_ DET_CONFD_ELEVATION_371 : 339|2@0+ (1,0) [0|3] "" ADAS
 SG_ DET_RANGE_372 : 367|15@0+ (0.015625,0) [0|500] "m" ADAS
 SG_ DET_RANGE_ERR_372 : 368|7@0+ (0.0075,0) [0|0.9525] "m" ADAS
 SG_ DET_RANGE_VELOCITY_372 : 377|15@0+ (0.0078125,-128) [-128|127.9921875] "m/s" ADAS
 SG_ DET_RANGE_VELOCITY_ERR_372 : 394|8@0+ (0.003,0) [0|0.765] "m/s" ADAS
 SG_ DET_AZIMUTH_372 : 420|13@0+ (0.0004,-1.5708) [-1.5708|1.5708] "rad" ADAS
 SG_ DET_AZIMUTH_ERR_372 : 438|7@0+ (0.00087267,0) [0|0.11082909] "rad" ADAS
 SG_ DET_ELEVATION_372 : 402|8@0+ (0.00275,-0.34925) [-0.34925|0.34925] "rad" ADAS
 SG_ DET_ELEVATION_ERR_372 : 410|6@0+ (0.00174533,0) [0|0.10995579] "rad" ADAS
 SG_ DET_RCS_372 : 479|8@0+ (0.5,-64) [-64|63.5] "dBsm" ADAS
 SG_ DET_VALID_FLAG_372 : 460|1@0+ (1,0) [0|1] "" ADAS
 SG_ DET_BI_STATIC_FLAG_372 : 484|1@0+ (1,0) [0|1] "" ADAS
 SG_ DET_SUPER_RES_TARGET_372 : 439|1@0+ (1,0) [0|1] "" ADAS
 SG_ DET_SNR_372 : 471|8@0+ (0.35156,0) [0|89.6478] "dB" ADAS
 SG_ DET_POINT_TARGET_PROB_372 : 455|4@0+ (6.67,0) [0|100] "%" ADAS
 SG_ DET_EXISTENCE_PROB_372 : 451|6@0+ (1.588,0) [0|100] "%" ADAS
 SG_ DET_OUTSIDE_SECTOR_372 : 461|1@0+ (1,0) [0|1] "" ADAS
 SG_ DET_HVC_FLAG_372 : 447|1@0+ (1,0) [0|1] "" ADAS
 SG_ DET_CONFD_AZIMUTH_372 : 457|2@0+ (1,0) [0|3] "" ADAS
 SG_ DET_CONFD_ELEVATION_372 : 459|2@0+ (1,0) [0|3] "" ADAS
 SG_ DET_MH_SCAN_INDEX_4LSB_369_372 : 483|4@0+ (1,0) [0|15] "" ADAS
 SG_ DET_MH_CYCLE_COUNTER_369_372 : 495|8@0+ (1,0) [0|255] "" ADAS
 SG_ DET_MH_CRC16_369_372 : 503|16@0+ (1,0) [0|65535] "" ADAS

BO_ 1245 RDR_DETECTION_373_376: 64 RDR08
 SG_ DET_RANGE_373 : 7|15@0+ (0.015625,0) [0|500] "m" ADAS
 SG_ DET_RANGE_ERR_373 : 8|7@0+ (0.0075,0) [0|0.9525] "m" ADAS
 SG_ DET_RANGE_VELOCITY_373 : 17|15@0+ (0.0078125,-128) [-128|127.9921875] "m/s" ADAS
 SG_ DET_RANGE_VELOCITY_ERR_373 : 34|8@0+ (0.003,0) [0|0.765] "m/s" ADAS
 SG_ DET_AZIMUTH_373 : 60|13@0+ (0.0004,-1.5708) [-1.5708|1.5708] "rad" ADAS
 SG_ DET_AZIMUTH_ERR_373 : 78|7@0+ (0.00087267,0) [0|0.11082909] "rad" ADAS
 SG_ DET_ELEVATION_373 : 42|8@0+ (0.00275,-0.34925) [-0.34925|0.34925] "rad" ADAS
 SG_ DET_ELEVATION_ERR_373 : 50|6@0+ (0.00174533,0) [0|0.10995579] "rad" ADAS
 SG_ DET_RCS_373 : 119|8@0+ (0.5,-64) [-64|63.5] "dBsm" ADAS
 SG_ DET_VALID_FLAG_373 : 80|1@0+ (1,0) [0|1] "" ADAS
 SG_ DET_BI_STATIC_FLAG_373 : 487|1@0+ (1,0) [0|1] "" ADAS
 SG_ DET_SUPER_RES_TARGET_373 : 79|1@0+ (1,0) [0|1] "" ADAS
 SG_ DET_SNR_373 : 111|8@0+ (0.35156,0) [0|89.6478] "dB" ADAS
 SG_ DET_POINT_TARGET_PROB_373 : 86|4@0+ (6.67,0) [0|100] "%" ADAS
 SG_ DET_EXISTENCE_PROB_373 : 95|6@0+ (1.588,0) [0|100] "%" ADAS
 SG_ DET_OUTSIDE_SECTOR_373 : 103|1@0+ (1,0) [0|1] "" ADAS
 SG_ DET_HVC_FLAG_373 : 87|1@0+ (1,0) [0|1] "" ADAS
 SG_ DET_CONFD_AZIMUTH_373 : 89|2@0+ (1,0) [0|3] "" ADAS
 SG_ DET_CONFD_ELEVATION_373 : 82|2@0+ (1,0) [0|3] "" ADAS
 SG_ DET_RANGE_374 : 127|15@0+ (0.015625,0) [0|500] "m" ADAS
 SG_ DET_RANGE_ERR_374 : 128|7@0+ (0.0075,0) [0|0.9525] "m" ADAS
 SG_ DET_RANGE_VELOCITY_374 : 137|15@0+ (0.0078125,-128) [-128|127.9921875] "m/s" ADAS
 SG_ DET_RANGE_VELOCITY_ERR_374 : 154|8@0+ (0.003,0) [0|0.765] "m/s" ADAS
 SG_ DET_AZIMUTH_374 : 180|13@0+ (0.0004,-1.5708) [-1.5708|1.5708] "rad" ADAS
 SG_ DET_AZIMUTH_ERR_374 : 198|7@0+ (0.00087267,0) [0|0.11082909] "rad" ADAS
 SG_ DET_ELEVATION_374 : 162|8@0+ (0.00275,-0.34925) [-0.34925|0.34925] "rad" ADAS
 SG_ DET_ELEVATION_ERR_374 : 170|6@0+ (0.00174533,0) [0|0.10995579] "rad" ADAS
 SG_ DET_RCS_374 : 239|8@0+ (0.5,-64) [-64|63.5] "dBsm" ADAS
 SG_ DET_VALID_FLAG_374 : 220|1@0+ (1,0) [0|1] "" ADAS
 SG_ DET_BI_STATIC_FLAG_374 : 486|1@0+ (1,0) [0|1] "" ADAS
 SG_ DET_SUPER_RES_TARGET_374 : 199|1@0+ (1,0) [0|1] "" ADAS
 SG_ DET_SNR_374 : 231|8@0+ (0.35156,0) [0|89.6478] "dB" ADAS
 SG_ DET_POINT_TARGET_PROB_374 : 215|4@0+ (6.67,0) [0|100] "%" ADAS
 SG_ DET_EXISTENCE_PROB_374 : 211|6@0+ (1.588,0) [0|100] "%" ADAS
 SG_ DET_OUTSIDE_SECTOR_374 : 221|1@0+ (1,0) [0|1] "" ADAS
 SG_ DET_HVC_FLAG_374 : 207|1@0+ (1,0) [0|1] "" ADAS
 SG_ DET_CONFD_AZIMUTH_374 : 217|2@0+ (1,0) [0|3] "" ADAS
 SG_ DET_CONFD_ELEVATION_374 : 219|2@0+ (1,0) [0|3] "" ADAS
 SG_ DET_RANGE_375 : 247|15@0+ (0.015625,0) [0|500] "m" ADAS
 SG_ DET_RANGE_ERR_375 : 248|7@0+ (0.0075,0) [0|0.9525] "m" ADAS
 SG_ DET_RANGE_VELOCITY_375 : 257|15@0+ (0.0078125,-128) [-128|127.9921875] "m/s" ADAS
 SG_ DET_RANGE_VELOCITY_ERR_375 : 274|8@0+ (0.003,0) [0|0.765] "m/s" ADAS
 SG_ DET_AZIMUTH_375 : 300|13@0+ (0.0004,-1.5708) [-1.5708|1.5708] "rad" ADAS
 SG_ DET_AZIMUTH_ERR_375 : 318|7@0+ (0.00087267,0) [0|0.11082909] "rad" ADAS
 SG_ DET_ELEVATION_375 : 282|8@0+ (0.00275,-0.34925) [-0.34925|0.34925] "rad" ADAS
 SG_ DET_ELEVATION_ERR_375 : 290|6@0+ (0.00174533,0) [0|0.10995579] "rad" ADAS
 SG_ DET_RCS_375 : 359|8@0+ (0.5,-64) [-64|63.5] "dBsm" ADAS
 SG_ DET_VALID_FLAG_375 : 340|1@0+ (1,0) [0|1] "" ADAS
 SG_ DET_BI_STATIC_FLAG_375 : 485|1@0+ (1,0) [0|1] "" ADAS
 SG_ DET_SUPER_RES_TARGET_375 : 319|1@0+ (1,0) [0|1] "" ADAS
 SG_ DET_SNR_375 : 351|8@0+ (0.35156,0) [0|89.6478] "dB" ADAS
 SG_ DET_POINT_TARGET_PROB_375 : 335|4@0+ (6.67,0) [0|100] "%" ADAS
 SG_ DET_EXISTENCE_PROB_375 : 331|6@0+ (1.588,0) [0|100] "%" ADAS
 SG_ DET_OUTSIDE_SECTOR_375 : 341|1@0+ (1,0) [0|1] "" ADAS
 SG_ DET_HVC_FLAG_375 : 327|1@0+ (1,0) [0|1] "" ADAS
 SG_ DET_CONFD_AZIMUTH_375 : 337|2@0+ (1,0) [0|3] "" ADAS
 SG_ DET_CONFD_ELEVATION_375 : 339|2@0+ (1,0) [0|3] "" ADAS
 SG_ DET_RANGE_376 : 367|15@0+ (0.015625,0) [0|500] "m" ADAS
 SG_ DET_RANGE_ERR_376 : 368|7@0+ (0.0075,0) [0|0.9525] "m" ADAS
 SG_ DET_RANGE_VELOCITY_376 : 377|15@0+ (0.0078125,-128) [-128|127.9921875] "m/s" ADAS
 SG_ DET_RANGE_VELOCITY_ERR_376 : 394|8@0+ (0.003,0) [0|0.765] "m/s" ADAS
 SG_ DET_AZIMUTH_376 : 420|13@0+ (0.0004,-1.5708) [-1.5708|1.5708] "rad" ADAS
 SG_ DET_AZIMUTH_ERR_376 : 438|7@0+ (0.00087267,0) [0|0.11082909] "rad" ADAS
 SG_ DET_ELEVATION_376 : 402|8@0+ (0.00275,-0.34925) [-0.34925|0.34925] "rad" ADAS
 SG_ DET_ELEVATION_ERR_376 : 410|6@0+ (0.00174533,0) [0|0.10995579] "rad" ADAS
 SG_ DET_RCS_376 : 479|8@0+ (0.5,-64) [-64|63.5] "dBsm" ADAS
 SG_ DET_VALID_FLAG_376 : 460|1@0+ (1,0) [0|1] "" ADAS
 SG_ DET_BI_STATIC_FLAG_376 : 484|1@0+ (1,0) [0|1] "" ADAS
 SG_ DET_SUPER_RES_TARGET_376 : 439|1@0+ (1,0) [0|1] "" ADAS
 SG_ DET_SNR_376 : 471|8@0+ (0.35156,0) [0|89.6478] "dB" ADAS
 SG_ DET_POINT_TARGET_PROB_376 : 455|4@0+ (6.67,0) [0|100] "%" ADAS
 SG_ DET_EXISTENCE_PROB_376 : 451|6@0+ (1.588,0) [0|100] "%" ADAS
 SG_ DET_OUTSIDE_SECTOR_376 : 461|1@0+ (1,0) [0|1] "" ADAS
 SG_ DET_HVC_FLAG_376 : 447|1@0+ (1,0) [0|1] "" ADAS
 SG_ DET_CONFD_AZIMUTH_376 : 457|2@0+ (1,0) [0|3] "" ADAS
 SG_ DET_CONFD_ELEVATION_376 : 459|2@0+ (1,0) [0|3] "" ADAS
 SG_ DET_MH_SCAN_INDEX_4LSB_373_376 : 483|4@0+ (1,0) [0|15] "" ADAS
 SG_ DET_MH_CYCLE_COUNTER_373_376 : 495|8@0+ (1,0) [0|255] "" ADAS
 SG_ DET_MH_CRC16_373_376 : 503|16@0+ (1,0) [0|65535] "" ADAS

BO_ 1246 RDR_DETECTION_377_380: 64 RDR08
 SG_ DET_RANGE_377 : 7|15@0+ (0.015625,0) [0|500] "m" ADAS
 SG_ DET_RANGE_ERR_377 : 8|7@0+ (0.0075,0) [0|0.9525] "m" ADAS
 SG_ DET_RANGE_VELOCITY_377 : 17|15@0+ (0.0078125,-128) [-128|127.9921875] "m/s" ADAS
 SG_ DET_RANGE_VELOCITY_ERR_377 : 34|8@0+ (0.003,0) [0|0.765] "m/s" ADAS
 SG_ DET_AZIMUTH_377 : 60|13@0+ (0.0004,-1.5708) [-1.5708|1.5708] "rad" ADAS
 SG_ DET_AZIMUTH_ERR_377 : 78|7@0+ (0.00087267,0) [0|0.11082909] "rad" ADAS
 SG_ DET_ELEVATION_377 : 42|8@0+ (0.00275,-0.34925) [-0.34925|0.34925] "rad" ADAS
 SG_ DET_ELEVATION_ERR_377 : 50|6@0+ (0.00174533,0) [0|0.10995579] "rad" ADAS
 SG_ DET_RCS_377 : 119|8@0+ (0.5,-64) [-64|63.5] "dBsm" ADAS
 SG_ DET_VALID_FLAG_377 : 80|1@0+ (1,0) [0|1] "" ADAS
 SG_ DET_BI_STATIC_FLAG_377 : 487|1@0+ (1,0) [0|1] "" ADAS
 SG_ DET_SUPER_RES_TARGET_377 : 79|1@0+ (1,0) [0|1] "" ADAS
 SG_ DET_SNR_377 : 111|8@0+ (0.35156,0) [0|89.6478] "dB" ADAS
 SG_ DET_POINT_TARGET_PROB_377 : 86|4@0+ (6.67,0) [0|100] "%" ADAS
 SG_ DET_EXISTENCE_PROB_377 : 95|6@0+ (1.588,0) [0|100] "%" ADAS
 SG_ DET_OUTSIDE_SECTOR_377 : 103|1@0+ (1,0) [0|1] "" ADAS
 SG_ DET_HVC_FLAG_377 : 87|1@0+ (1,0) [0|1] "" ADAS
 SG_ DET_CONFD_AZIMUTH_377 : 89|2@0+ (1,0) [0|3] "" ADAS
 SG_ DET_CONFD_ELEVATION_377 : 82|2@0+ (1,0) [0|3] "" ADAS
 SG_ DET_RANGE_378 : 127|15@0+ (0.015625,0) [0|500] "m" ADAS
 SG_ DET_RANGE_ERR_378 : 128|7@0+ (0.0075,0) [0|0.9525] "m" ADAS
 SG_ DET_RANGE_VELOCITY_378 : 137|15@0+ (0.0078125,-128) [-128|127.9921875] "m/s" ADAS
 SG_ DET_RANGE_VELOCITY_ERR_378 : 154|8@0+ (0.003,0) [0|0.765] "m/s" ADAS
 SG_ DET_AZIMUTH_378 : 180|13@0+ (0.0004,-1.5708) [-1.5708|1.5708] "rad" ADAS
 SG_ DET_AZIMUTH_ERR_378 : 198|7@0+ (0.00087267,0) [0|0.11082909] "rad" ADAS
 SG_ DET_ELEVATION_378 : 162|8@0+ (0.00275,-0.34925) [-0.34925|0.34925] "rad" ADAS
 SG_ DET_ELEVATION_ERR_378 : 170|6@0+ (0.00174533,0) [0|0.10995579] "rad" ADAS
 SG_ DET_RCS_378 : 239|8@0+ (0.5,-64) [-64|63.5] "dBsm" ADAS
 SG_ DET_VALID_FLAG_378 : 220|1@0+ (1,0) [0|1] "" ADAS
 SG_ DET_BI_STATIC_FLAG_378 : 486|1@0+ (1,0) [0|1] "" ADAS
 SG_ DET_SUPER_RES_TARGET_378 : 199|1@0+ (1,0) [0|1] "" ADAS
 SG_ DET_SNR_378 : 231|8@0+ (0.35156,0) [0|89.6478] "dB" ADAS
 SG_ DET_POINT_TARGET_PROB_378 : 215|4@0+ (6.67,0) [0|100] "%" ADAS
 SG_ DET_EXISTENCE_PROB_378 : 211|6@0+ (1.588,0) [0|100] "%" ADAS
 SG_ DET_OUTSIDE_SECTOR_378 : 221|1@0+ (1,0) [0|1] "" ADAS
 SG_ DET_HVC_FLAG_378 : 207|1@0+ (1,0) [0|1] "" ADAS
 SG_ DET_CONFD_AZIMUTH_378 : 217|2@0+ (1,0) [0|3] "" ADAS
 SG_ DET_CONFD_ELEVATION_378 : 219|2@0+ (1,0) [0|3] "" ADAS
 SG_ DET_RANGE_379 : 247|15@0+ (0.015625,0) [0|500] "m" ADAS
 SG_ DET_RANGE_ERR_379 : 248|7@0+ (0.0075,0) [0|0.9525] "m" ADAS
 SG_ DET_RANGE_VELOCITY_379 : 257|15@0+ (0.0078125,-128) [-128|127.9921875] "m/s" ADAS
 SG_ DET_RANGE_VELOCITY_ERR_379 : 274|8@0+ (0.003,0) [0|0.765] "m/s" ADAS
 SG_ DET_AZIMUTH_379 : 300|13@0+ (0.0004,-1.5708) [-1.5708|1.5708] "rad" ADAS
 SG_ DET_AZIMUTH_ERR_379 : 318|7@0+ (0.00087267,0) [0|0.11082909] "rad" ADAS
 SG_ DET_ELEVATION_379 : 282|8@0+ (0.00275,-0.34925) [-0.34925|0.34925] "rad" ADAS
 SG_ DET_ELEVATION_ERR_379 : 290|6@0+ (0.00174533,0) [0|0.10995579] "rad" ADAS
 SG_ DET_RCS_379 : 359|8@0+ (0.5,-64) [-64|63.5] "dBsm" ADAS
 SG_ DET_VALID_FLAG_379 : 340|1@0+ (1,0) [0|1] "" ADAS
 SG_ DET_BI_STATIC_FLAG_379 : 485|1@0+ (1,0) [0|1] "" ADAS
 SG_ DET_SUPER_RES_TARGET_379 : 319|1@0+ (1,0) [0|1] "" ADAS
 SG_ DET_SNR_379 : 351|8@0+ (0.35156,0) [0|89.6478] "dB" ADAS
 SG_ DET_POINT_TARGET_PROB_379 : 335|4@0+ (6.67,0) [0|100] "%" ADAS
 SG_ DET_EXISTENCE_PROB_379 : 331|6@0+ (1.588,0) [0|100] "%" ADAS
 SG_ DET_OUTSIDE_SECTOR_379 : 341|1@0+ (1,0) [0|1] "" ADAS
 SG_ DET_HVC_FLAG_379 : 327|1@0+ (1,0) [0|1] "" ADAS
 SG_ DET_CONFD_AZIMUTH_379 : 337|2@0+ (1,0) [0|3] "" ADAS
 SG_ DET_CONFD_ELEVATION_379 : 339|2@0+ (1,0) [0|3] "" ADAS
 SG_ DET_RANGE_380 : 367|15@0+ (0.015625,0) [0|500] "m" ADAS
 SG_ DET_RANGE_ERR_380 : 368|7@0+ (0.0075,0) [0|0.9525] "m" ADAS
 SG_ DET_RANGE_VELOCITY_380 : 377|15@0+ (0.0078125,-128) [-128|127.9921875] "m/s" ADAS
 SG_ DET_RANGE_VELOCITY_ERR_380 : 394|8@0+ (0.003,0) [0|0.765] "m/s" ADAS
 SG_ DET_AZIMUTH_380 : 420|13@0+ (0.0004,-1.5708) [-1.5708|1.5708] "rad" ADAS
 SG_ DET_AZIMUTH_ERR_380 : 438|7@0+ (0.00087267,0) [0|0.11082909] "rad" ADAS
 SG_ DET_ELEVATION_380 : 402|8@0+ (0.00275,-0.34925) [-0.34925|0.34925] "rad" ADAS
 SG_ DET_ELEVATION_ERR_380 : 410|6@0+ (0.00174533,0) [0|0.10995579] "rad" ADAS
 SG_ DET_RCS_380 : 479|8@0+ (0.5,-64) [-64|63.5] "dBsm" ADAS
 SG_ DET_VALID_FLAG_380 : 460|1@0+ (1,0) [0|1] "" ADAS
 SG_ DET_BI_STATIC_FLAG_380 : 484|1@0+ (1,0) [0|1] "" ADAS
 SG_ DET_SUPER_RES_TARGET_380 : 439|1@0+ (1,0) [0|1] "" ADAS
 SG_ DET_SNR_380 : 471|8@0+ (0.35156,0) [0|89.6478] "dB" ADAS
 SG_ DET_POINT_TARGET_PROB_380 : 455|4@0+ (6.67,0) [0|100] "%" ADAS
 SG_ DET_EXISTENCE_PROB_380 : 451|6@0+ (1.588,0) [0|100] "%" ADAS
 SG_ DET_OUTSIDE_SECTOR_380 : 461|1@0+ (1,0) [0|1] "" ADAS
 SG_ DET_HVC_FLAG_380 : 447|1@0+ (1,0) [0|1] "" ADAS
 SG_ DET_CONFD_AZIMUTH_380 : 457|2@0+ (1,0) [0|3] "" ADAS
 SG_ DET_CONFD_ELEVATION_380 : 459|2@0+ (1,0) [0|3] "" ADAS
 SG_ DET_MH_SCAN_INDEX_4LSB_377_380 : 483|4@0+ (1,0) [0|15] "" ADAS
 SG_ DET_MH_CYCLE_COUNTER_377_380 : 495|8@0+ (1,0) [0|255] "" ADAS
 SG_ DET_MH_CRC16_377_380 : 503|16@0+ (1,0) [0|65535] "" ADAS

BO_ 1247 RDR_DETECTION_381_384: 64 RDR08
 SG_ DET_RANGE_381 : 7|15@0+ (0.015625,0) [0|500] "m" ADAS
 SG_ DET_RANGE_ERR_381 : 8|7@0+ (0.0075,0) [0|0.9525] "m" ADAS
 SG_ DET_RANGE_VELOCITY_381 : 17|15@0+ (0.0078125,-128) [-128|127.9921875] "m/s" ADAS
 SG_ DET_RANGE_VELOCITY_ERR_381 : 34|8@0+ (0.003,0) [0|0.765] "m/s" ADAS
 SG_ DET_AZIMUTH_381 : 60|13@0+ (0.0004,-1.5708) [-1.5708|1.5708] "rad" ADAS
 SG_ DET_AZIMUTH_ERR_381 : 78|7@0+ (0.00087267,0) [0|0.11082909] "rad" ADAS
 SG_ DET_ELEVATION_381 : 42|8@0+ (0.00275,-0.34925) [-0.34925|0.34925] "rad" ADAS
 SG_ DET_ELEVATION_ERR_381 : 50|6@0+ (0.00174533,0) [0|0.10995579] "rad" ADAS
 SG_ DET_RCS_381 : 119|8@0+ (0.5,-64) [-64|63.5] "dBsm" ADAS
 SG_ DET_VALID_FLAG_381 : 80|1@0+ (1,0) [0|1] "" ADAS
 SG_ DET_BI_STATIC_FLAG_381 : 487|1@0+ (1,0) [0|1] "" ADAS
 SG_ DET_SUPER_RES_TARGET_381 : 79|1@0+ (1,0) [0|1] "" ADAS
 SG_ DET_SNR_381 : 111|8@0+ (0.35156,0) [0|89.6478] "dB" ADAS
 SG_ DET_POINT_TARGET_PROB_381 : 86|4@0+ (6.67,0) [0|100] "%" ADAS
 SG_ DET_EXISTENCE_PROB_381 : 95|6@0+ (1.588,0) [0|100] "%" ADAS
 SG_ DET_OUTSIDE_SECTOR_381 : 103|1@0+ (1,0) [0|1] "" ADAS
 SG_ DET_HVC_FLAG_381 : 87|1@0+ (1,0) [0|1] "" ADAS
 SG_ DET_CONFD_AZIMUTH_381 : 89|2@0+ (1,0) [0|3] "" ADAS
 SG_ DET_CONFD_ELEVATION_381 : 82|2@0+ (1,0) [0|3] "" ADAS
 SG_ DET_RANGE_382 : 127|15@0+ (0.015625,0) [0|500] "m" ADAS
 SG_ DET_RANGE_ERR_382 : 128|7@0+ (0.0075,0) [0|0.9525] "m" ADAS
 SG_ DET_RANGE_VELOCITY_382 : 137|15@0+ (0.0078125,-128) [-128|127.9921875] "m/s" ADAS
 SG_ DET_RANGE_VELOCITY_ERR_382 : 154|8@0+ (0.003,0) [0|0.765] "m/s" ADAS
 SG_ DET_AZIMUTH_382 : 180|13@0+ (0.0004,-1.5708) [-1.5708|1.5708] "rad" ADAS
 SG_ DET_AZIMUTH_ERR_382 : 198|7@0+ (0.00087267,0) [0|0.11082909] "rad" ADAS
 SG_ DET_ELEVATION_382 : 162|8@0+ (0.00275,-0.34925) [-0.34925|0.34925] "rad" ADAS
 SG_ DET_ELEVATION_ERR_382 : 170|6@0+ (0.00174533,0) [0|0.10995579] "rad" ADAS
 SG_ DET_RCS_382 : 239|8@0+ (0.5,-64) [-64|63.5] "dBsm" ADAS
 SG_ DET_VALID_FLAG_382 : 220|1@0+ (1,0) [0|1] "" ADAS
 SG_ DET_BI_STATIC_FLAG_382 : 486|1@0+ (1,0) [0|1] "" ADAS
 SG_ DET_SUPER_RES_TARGET_382 : 199|1@0+ (1,0) [0|1] "" ADAS
 SG_ DET_SNR_382 : 231|8@0+ (0.35156,0) [0|89.6478] "dB" ADAS
 SG_ DET_POINT_TARGET_PROB_382 : 215|4@0+ (6.67,0) [0|100] "%" ADAS
 SG_ DET_EXISTENCE_PROB_382 : 211|6@0+ (1.588,0) [0|100] "%" ADAS
 SG_ DET_OUTSIDE_SECTOR_382 : 221|1@0+ (1,0) [0|1] "" ADAS
 SG_ DET_HVC_FLAG_382 : 207|1@0+ (1,0) [0|1] "" ADAS
 SG_ DET_CONFD_AZIMUTH_382 : 217|2@0+ (1,0) [0|3] "" ADAS
 SG_ DET_CONFD_ELEVATION_382 : 219|2@0+ (1,0) [0|3] "" ADAS
 SG_ DET_RANGE_383 : 247|15@0+ (0.015625,0) [0|500] "m" ADAS
 SG_ DET_RANGE_ERR_383 : 248|7@0+ (0.0075,0) [0|0.9525] "m" ADAS
 SG_ DET_RANGE_VELOCITY_383 : 257|15@0+ (0.0078125,-128) [-128|127.9921875] "m/s" ADAS
 SG_ DET_RANGE_VELOCITY_ERR_383 : 274|8@0+ (0.003,0) [0|0.765] "m/s" ADAS
 SG_ DET_AZIMUTH_383 : 300|13@0+ (0.0004,-1.5708) [-1.5708|1.5708] "rad" ADAS
 SG_ DET_AZIMUTH_ERR_383 : 318|7@0+ (0.00087267,0) [0|0.11082909] "rad" ADAS
 SG_ DET_ELEVATION_383 : 282|8@0+ (0.00275,-0.34925) [-0.34925|0.34925] "rad" ADAS
 SG_ DET_ELEVATION_ERR_383 : 290|6@0+ (0.00174533,0) [0|0.10995579] "rad" ADAS
 SG_ DET_RCS_383 : 359|8@0+ (0.5,-64) [-64|63.5] "dBsm" ADAS
 SG_ DET_VALID_FLAG_383 : 340|1@0+ (1,0) [0|1] "" ADAS
 SG_ DET_BI_STATIC_FLAG_383 : 485|1@0+ (1,0) [0|1] "" ADAS
 SG_ DET_SUPER_RES_TARGET_383 : 319|1@0+ (1,0) [0|1] "" ADAS
 SG_ DET_SNR_383 : 351|8@0+ (0.35156,0) [0|89.6478] "dB" ADAS
 SG_ DET_POINT_TARGET_PROB_383 : 335|4@0+ (6.67,0) [0|100] "%" ADAS
 SG_ DET_EXISTENCE_PROB_383 : 331|6@0+ (1.588,0) [0|100] "%" ADAS
 SG_ DET_OUTSIDE_SECTOR_383 : 341|1@0+ (1,0) [0|1] "" ADAS
 SG_ DET_HVC_FLAG_383 : 327|1@0+ (1,0) [0|1] "" ADAS
 SG_ DET_CONFD_AZIMUTH_383 : 337|2@0+ (1,0) [0|3] "" ADAS
 SG_ DET_CONFD_ELEVATION_383 : 339|2@0+ (1,0) [0|3] "" ADAS
 SG_ DET_RANGE_384 : 367|15@0+ (0.015625,0) [0|500] "m" ADAS
 SG_ DET_RANGE_ERR_384 : 368|7@0+ (0.0075,0) [0|0.9525] "m" ADAS
 SG_ DET_RANGE_VELOCITY_384 : 377|15@0+ (0.0078125,-128) [-128|127.9921875] "m/s" ADAS
 SG_ DET_RANGE_VELOCITY_ERR_384 : 394|8@0+ (0.003,0) [0|0.765] "m/s" ADAS
 SG_ DET_AZIMUTH_384 : 420|13@0+ (0.0004,-1.5708) [-1.5708|1.5708] "rad" ADAS
 SG_ DET_AZIMUTH_ERR_384 : 438|7@0+ (0.00087267,0) [0|0.11082909] "rad" ADAS
 SG_ DET_ELEVATION_384 : 402|8@0+ (0.00275,-0.34925) [-0.34925|0.34925] "rad" ADAS
 SG_ DET_ELEVATION_ERR_384 : 410|6@0+ (0.00174533,0) [0|0.10995579] "rad" ADAS
 SG_ DET_RCS_384 : 479|8@0+ (0.5,-64) [-64|63.5] "dBsm" ADAS
 SG_ DET_VALID_FLAG_384 : 460|1@0+ (1,0) [0|1] "" ADAS
 SG_ DET_BI_STATIC_FLAG_384 : 484|1@0+ (1,0) [0|1] "" ADAS
 SG_ DET_SUPER_RES_TARGET_384 : 439|1@0+ (1,0) [0|1] "" ADAS
 SG_ DET_SNR_384 : 471|8@0+ (0.35156,0) [0|89.6478] "dB" ADAS
 SG_ DET_POINT_TARGET_PROB_384 : 455|4@0+ (6.67,0) [0|100] "%" ADAS
 SG_ DET_EXISTENCE_PROB_384 : 451|6@0+ (1.588,0) [0|100] "%" ADAS
 SG_ DET_OUTSIDE_SECTOR_384 : 461|1@0+ (1,0) [0|1] "" ADAS
 SG_ DET_HVC_FLAG_384 : 447|1@0+ (1,0) [0|1] "" ADAS
 SG_ DET_CONFD_AZIMUTH_384 : 457|2@0+ (1,0) [0|3] "" ADAS
 SG_ DET_CONFD_ELEVATION_384 : 459|2@0+ (1,0) [0|3] "" ADAS
 SG_ DET_MH_SCAN_INDEX_4LSB_381_384 : 483|4@0+ (1,0) [0|15] "" ADAS
 SG_ DET_MH_CYCLE_COUNTER_381_384 : 495|8@0+ (1,0) [0|255] "" ADAS
 SG_ DET_MH_CRC16_381_384 : 503|16@0+ (1,0) [0|65535] "" ADAS

BO_ 1248 RDR_DETECTION_385_388: 64 RDR08
 SG_ DET_RANGE_385 : 7|15@0+ (0.015625,0) [0|500] "m" ADAS
 SG_ DET_RANGE_ERR_385 : 8|7@0+ (0.0075,0) [0|0.9525] "m" ADAS
 SG_ DET_RANGE_VELOCITY_385 : 17|15@0+ (0.0078125,-128) [-128|127.9921875] "m/s" ADAS
 SG_ DET_RANGE_VELOCITY_ERR_385 : 34|8@0+ (0.003,0) [0|0.765] "m/s" ADAS
 SG_ DET_AZIMUTH_385 : 60|13@0+ (0.0004,-1.5708) [-1.5708|1.5708] "rad" ADAS
 SG_ DET_AZIMUTH_ERR_385 : 78|7@0+ (0.00087267,0) [0|0.11082909] "rad" ADAS
 SG_ DET_ELEVATION_385 : 42|8@0+ (0.00275,-0.34925) [-0.34925|0.34925] "rad" ADAS
 SG_ DET_ELEVATION_ERR_385 : 50|6@0+ (0.00174533,0) [0|0.10995579] "rad" ADAS
 SG_ DET_RCS_385 : 119|8@0+ (0.5,-64) [-64|63.5] "dBsm" ADAS
 SG_ DET_VALID_FLAG_385 : 80|1@0+ (1,0) [0|1] "" ADAS
 SG_ DET_BI_STATIC_FLAG_385 : 487|1@0+ (1,0) [0|1] "" ADAS
 SG_ DET_SUPER_RES_TARGET_385 : 79|1@0+ (1,0) [0|1] "" ADAS
 SG_ DET_SNR_385 : 111|8@0+ (0.35156,0) [0|89.6478] "dB" ADAS
 SG_ DET_POINT_TARGET_PROB_385 : 86|4@0+ (6.67,0) [0|100] "%" ADAS
 SG_ DET_EXISTENCE_PROB_385 : 95|6@0+ (1.588,0) [0|100] "%" ADAS
 SG_ DET_OUTSIDE_SECTOR_385 : 103|1@0+ (1,0) [0|1] "" ADAS
 SG_ DET_HVC_FLAG_385 : 87|1@0+ (1,0) [0|1] "" ADAS
 SG_ DET_CONFD_AZIMUTH_385 : 89|2@0+ (1,0) [0|3] "" ADAS
 SG_ DET_CONFD_ELEVATION_385 : 82|2@0+ (1,0) [0|3] "" ADAS
 SG_ DET_RANGE_386 : 127|15@0+ (0.015625,0) [0|500] "m" ADAS
 SG_ DET_RANGE_ERR_386 : 128|7@0+ (0.0075,0) [0|0.9525] "m" ADAS
 SG_ DET_RANGE_VELOCITY_386 : 137|15@0+ (0.0078125,-128) [-128|127.9921875] "m/s" ADAS
 SG_ DET_RANGE_VELOCITY_ERR_386 : 154|8@0+ (0.003,0) [0|0.765] "m/s" ADAS
 SG_ DET_AZIMUTH_386 : 180|13@0+ (0.0004,-1.5708) [-1.5708|1.5708] "rad" ADAS
 SG_ DET_AZIMUTH_ERR_386 : 198|7@0+ (0.00087267,0) [0|0.11082909] "rad" ADAS
 SG_ DET_ELEVATION_386 : 162|8@0+ (0.00275,-0.34925) [-0.34925|0.34925] "rad" ADAS
 SG_ DET_ELEVATION_ERR_386 : 170|6@0+ (0.00174533,0) [0|0.10995579] "rad" ADAS
 SG_ DET_RCS_386 : 239|8@0+ (0.5,-64) [-64|63.5] "dBsm" ADAS
 SG_ DET_VALID_FLAG_386 : 220|1@0+ (1,0) [0|1] "" ADAS
 SG_ DET_BI_STATIC_FLAG_386 : 486|1@0+ (1,0) [0|1] "" ADAS
 SG_ DET_SUPER_RES_TARGET_386 : 199|1@0+ (1,0) [0|1] "" ADAS
 SG_ DET_SNR_386 : 231|8@0+ (0.35156,0) [0|89.6478] "dB" ADAS
 SG_ DET_POINT_TARGET_PROB_386 : 215|4@0+ (6.67,0) [0|100] "%" ADAS
 SG_ DET_EXISTENCE_PROB_386 : 211|6@0+ (1.588,0) [0|100] "%" ADAS
 SG_ DET_OUTSIDE_SECTOR_386 : 221|1@0+ (1,0) [0|1] "" ADAS
 SG_ DET_HVC_FLAG_386 : 207|1@0+ (1,0) [0|1] "" ADAS
 SG_ DET_CONFD_AZIMUTH_386 : 217|2@0+ (1,0) [0|3] "" ADAS
 SG_ DET_CONFD_ELEVATION_386 : 219|2@0+ (1,0) [0|3] "" ADAS
 SG_ DET_RANGE_387 : 247|15@0+ (0.015625,0) [0|500] "m" ADAS
 SG_ DET_RANGE_ERR_387 : 248|7@0+ (0.0075,0) [0|0.9525] "m" ADAS
 SG_ DET_RANGE_VELOCITY_387 : 257|15@0+ (0.0078125,-128) [-128|127.9921875] "m/s" ADAS
 SG_ DET_RANGE_VELOCITY_ERR_387 : 274|8@0+ (0.003,0) [0|0.765] "m/s" ADAS
 SG_ DET_AZIMUTH_387 : 300|13@0+ (0.0004,-1.5708) [-1.5708|1.5708] "rad" ADAS
 SG_ DET_AZIMUTH_ERR_387 : 318|7@0+ (0.00087267,0) [0|0.11082909] "rad" ADAS
 SG_ DET_ELEVATION_387 : 282|8@0+ (0.00275,-0.34925) [-0.34925|0.34925] "rad" ADAS
 SG_ DET_ELEVATION_ERR_387 : 290|6@0+ (0.00174533,0) [0|0.10995579] "rad" ADAS
 SG_ DET_RCS_387 : 359|8@0+ (0.5,-64) [-64|63.5] "dBsm" ADAS
 SG_ DET_VALID_FLAG_387 : 340|1@0+ (1,0) [0|1] "" ADAS
 SG_ DET_BI_STATIC_FLAG_387 : 485|1@0+ (1,0) [0|1] "" ADAS
 SG_ DET_SUPER_RES_TARGET_387 : 319|1@0+ (1,0) [0|1] "" ADAS
 SG_ DET_SNR_387 : 351|8@0+ (0.35156,0) [0|89.6478] "dB" ADAS
 SG_ DET_POINT_TARGET_PROB_387 : 335|4@0+ (6.67,0) [0|100] "%" ADAS
 SG_ DET_EXISTENCE_PROB_387 : 331|6@0+ (1.588,0) [0|100] "%" ADAS
 SG_ DET_OUTSIDE_SECTOR_387 : 341|1@0+ (1,0) [0|1] "" ADAS
 SG_ DET_HVC_FLAG_387 : 327|1@0+ (1,0) [0|1] "" ADAS
 SG_ DET_CONFD_AZIMUTH_387 : 337|2@0+ (1,0) [0|3] "" ADAS
 SG_ DET_CONFD_ELEVATION_387 : 339|2@0+ (1,0) [0|3] "" ADAS
 SG_ DET_RANGE_388 : 367|15@0+ (0.015625,0) [0|500] "m" ADAS
 SG_ DET_RANGE_ERR_388 : 368|7@0+ (0.0075,0) [0|0.9525] "m" ADAS
 SG_ DET_RANGE_VELOCITY_388 : 377|15@0+ (0.0078125,-128) [-128|127.9921875] "m/s" ADAS
 SG_ DET_RANGE_VELOCITY_ERR_388 : 394|8@0+ (0.003,0) [0|0.765] "m/s" ADAS
 SG_ DET_AZIMUTH_388 : 420|13@0+ (0.0004,-1.5708) [-1.5708|1.5708] "rad" ADAS
 SG_ DET_AZIMUTH_ERR_388 : 438|7@0+ (0.00087267,0) [0|0.11082909] "rad" ADAS
 SG_ DET_ELEVATION_388 : 402|8@0+ (0.00275,-0.34925) [-0.34925|0.34925] "rad" ADAS
 SG_ DET_ELEVATION_ERR_388 : 410|6@0+ (0.00174533,0) [0|0.10995579] "rad" ADAS
 SG_ DET_RCS_388 : 479|8@0+ (0.5,-64) [-64|63.5] "dBsm" ADAS
 SG_ DET_VALID_FLAG_388 : 460|1@0+ (1,0) [0|1] "" ADAS
 SG_ DET_BI_STATIC_FLAG_388 : 484|1@0+ (1,0) [0|1] "" ADAS
 SG_ DET_SUPER_RES_TARGET_388 : 439|1@0+ (1,0) [0|1] "" ADAS
 SG_ DET_SNR_388 : 471|8@0+ (0.35156,0) [0|89.6478] "dB" ADAS
 SG_ DET_POINT_TARGET_PROB_388 : 455|4@0+ (6.67,0) [0|100] "%" ADAS
 SG_ DET_EXISTENCE_PROB_388 : 451|6@0+ (1.588,0) [0|100] "%" ADAS
 SG_ DET_OUTSIDE_SECTOR_388 : 461|1@0+ (1,0) [0|1] "" ADAS
 SG_ DET_HVC_FLAG_388 : 447|1@0+ (1,0) [0|1] "" ADAS
 SG_ DET_CONFD_AZIMUTH_388 : 457|2@0+ (1,0) [0|3] "" ADAS
 SG_ DET_CONFD_ELEVATION_388 : 459|2@0+ (1,0) [0|3] "" ADAS
 SG_ DET_MH_SCAN_INDEX_4LSB_385_388 : 483|4@0+ (1,0) [0|15] "" ADAS
 SG_ DET_MH_CYCLE_COUNTER_385_388 : 495|8@0+ (1,0) [0|255] "" ADAS
 SG_ DET_MH_CRC16_385_388 : 503|16@0+ (1,0) [0|65535] "" ADAS

BO_ 1249 RDR_DETECTION_389_392: 64 RDR08
 SG_ DET_RANGE_389 : 7|15@0+ (0.015625,0) [0|500] "m" ADAS
 SG_ DET_RANGE_ERR_389 : 8|7@0+ (0.0075,0) [0|0.9525] "m" ADAS
 SG_ DET_RANGE_VELOCITY_389 : 17|15@0+ (0.0078125,-128) [-128|127.9921875] "m/s" ADAS
 SG_ DET_RANGE_VELOCITY_ERR_389 : 34|8@0+ (0.003,0) [0|0.765] "m/s" ADAS
 SG_ DET_AZIMUTH_389 : 60|13@0+ (0.0004,-1.5708) [-1.5708|1.5708] "rad" ADAS
 SG_ DET_AZIMUTH_ERR_389 : 78|7@0+ (0.00087267,0) [0|0.11082909] "rad" ADAS
 SG_ DET_ELEVATION_389 : 42|8@0+ (0.00275,-0.34925) [-0.34925|0.34925] "rad" ADAS
 SG_ DET_ELEVATION_ERR_389 : 50|6@0+ (0.00174533,0) [0|0.10995579] "rad" ADAS
 SG_ DET_RCS_389 : 119|8@0+ (0.5,-64) [-64|63.5] "dBsm" ADAS
 SG_ DET_VALID_FLAG_389 : 80|1@0+ (1,0) [0|1] "" ADAS
 SG_ DET_BI_STATIC_FLAG_389 : 487|1@0+ (1,0) [0|1] "" ADAS
 SG_ DET_SUPER_RES_TARGET_389 : 79|1@0+ (1,0) [0|1] "" ADAS
 SG_ DET_SNR_389 : 111|8@0+ (0.35156,0) [0|89.6478] "dB" ADAS
 SG_ DET_POINT_TARGET_PROB_389 : 86|4@0+ (6.67,0) [0|100] "%" ADAS
 SG_ DET_EXISTENCE_PROB_389 : 95|6@0+ (1.588,0) [0|100] "%" ADAS
 SG_ DET_OUTSIDE_SECTOR_389 : 103|1@0+ (1,0) [0|1] "" ADAS
 SG_ DET_HVC_FLAG_389 : 87|1@0+ (1,0) [0|1] "" ADAS
 SG_ DET_CONFD_AZIMUTH_389 : 89|2@0+ (1,0) [0|3] "" ADAS
 SG_ DET_CONFD_ELEVATION_389 : 82|2@0+ (1,0) [0|3] "" ADAS
 SG_ DET_RANGE_390 : 127|15@0+ (0.015625,0) [0|500] "m" ADAS
 SG_ DET_RANGE_ERR_390 : 128|7@0+ (0.0075,0) [0|0.9525] "m" ADAS
 SG_ DET_RANGE_VELOCITY_390 : 137|15@0+ (0.0078125,-128) [-128|127.9921875] "m/s" ADAS
 SG_ DET_RANGE_VELOCITY_ERR_390 : 154|8@0+ (0.003,0) [0|0.765] "m/s" ADAS
 SG_ DET_AZIMUTH_390 : 180|13@0+ (0.0004,-1.5708) [-1.5708|1.5708] "rad" ADAS
 SG_ DET_AZIMUTH_ERR_390 : 198|7@0+ (0.00087267,0) [0|0.11082909] "rad" ADAS
 SG_ DET_ELEVATION_390 : 162|8@0+ (0.00275,-0.34925) [-0.34925|0.34925] "rad" ADAS
 SG_ DET_ELEVATION_ERR_390 : 170|6@0+ (0.00174533,0) [0|0.10995579] "rad" ADAS
 SG_ DET_RCS_390 : 239|8@0+ (0.5,-64) [-64|63.5] "dBsm" ADAS
 SG_ DET_VALID_FLAG_390 : 220|1@0+ (1,0) [0|1] "" ADAS
 SG_ DET_BI_STATIC_FLAG_390 : 486|1@0+ (1,0) [0|1] "" ADAS
 SG_ DET_SUPER_RES_TARGET_390 : 199|1@0+ (1,0) [0|1] "" ADAS
 SG_ DET_SNR_390 : 231|8@0+ (0.35156,0) [0|89.6478] "dB" ADAS
 SG_ DET_POINT_TARGET_PROB_390 : 215|4@0+ (6.67,0) [0|100] "%" ADAS
 SG_ DET_EXISTENCE_PROB_390 : 211|6@0+ (1.588,0) [0|100] "%" ADAS
 SG_ DET_OUTSIDE_SECTOR_390 : 221|1@0+ (1,0) [0|1] "" ADAS
 SG_ DET_HVC_FLAG_390 : 207|1@0+ (1,0) [0|1] "" ADAS
 SG_ DET_CONFD_AZIMUTH_390 : 217|2@0+ (1,0) [0|3] "" ADAS
 SG_ DET_CONFD_ELEVATION_390 : 219|2@0+ (1,0) [0|3] "" ADAS
 SG_ DET_RANGE_391 : 247|15@0+ (0.015625,0) [0|500] "m" ADAS
 SG_ DET_RANGE_ERR_391 : 248|7@0+ (0.0075,0) [0|0.9525] "m" ADAS
 SG_ DET_RANGE_VELOCITY_391 : 257|15@0+ (0.0078125,-128) [-128|127.9921875] "m/s" ADAS
 SG_ DET_RANGE_VELOCITY_ERR_391 : 274|8@0+ (0.003,0) [0|0.765] "m/s" ADAS
 SG_ DET_AZIMUTH_391 : 300|13@0+ (0.0004,-1.5708) [-1.5708|1.5708] "rad" ADAS
 SG_ DET_AZIMUTH_ERR_391 : 318|7@0+ (0.00087267,0) [0|0.11082909] "rad" ADAS
 SG_ DET_ELEVATION_391 : 282|8@0+ (0.00275,-0.34925) [-0.34925|0.34925] "rad" ADAS
 SG_ DET_ELEVATION_ERR_391 : 290|6@0+ (0.00174533,0) [0|0.10995579] "rad" ADAS
 SG_ DET_RCS_391 : 359|8@0+ (0.5,-64) [-64|63.5] "dBsm" ADAS
 SG_ DET_VALID_FLAG_391 : 340|1@0+ (1,0) [0|1] "" ADAS
 SG_ DET_BI_STATIC_FLAG_391 : 485|1@0+ (1,0) [0|1] "" ADAS
 SG_ DET_SUPER_RES_TARGET_391 : 319|1@0+ (1,0) [0|1] "" ADAS
 SG_ DET_SNR_391 : 351|8@0+ (0.35156,0) [0|89.6478] "dB" ADAS
 SG_ DET_POINT_TARGET_PROB_391 : 335|4@0+ (6.67,0) [0|100] "%" ADAS
 SG_ DET_EXISTENCE_PROB_391 : 331|6@0+ (1.588,0) [0|100] "%" ADAS
 SG_ DET_OUTSIDE_SECTOR_391 : 341|1@0+ (1,0) [0|1] "" ADAS
 SG_ DET_HVC_FLAG_391 : 327|1@0+ (1,0) [0|1] "" ADAS
 SG_ DET_CONFD_AZIMUTH_391 : 337|2@0+ (1,0) [0|3] "" ADAS
 SG_ DET_CONFD_ELEVATION_391 : 339|2@0+ (1,0) [0|3] "" ADAS
 SG_ DET_RANGE_392 : 367|15@0+ (0.015625,0) [0|500] "m" ADAS
 SG_ DET_RANGE_ERR_392 : 368|7@0+ (0.0075,0) [0|0.9525] "m" ADAS
 SG_ DET_RANGE_VELOCITY_392 : 377|15@0+ (0.0078125,-128) [-128|127.9921875] "m/s" ADAS
 SG_ DET_RANGE_VELOCITY_ERR_392 : 394|8@0+ (0.003,0) [0|0.765] "m/s" ADAS
 SG_ DET_AZIMUTH_392 : 420|13@0+ (0.0004,-1.5708) [-1.5708|1.5708] "rad" ADAS
 SG_ DET_AZIMUTH_ERR_392 : 438|7@0+ (0.00087267,0) [0|0.11082909] "rad" ADAS
 SG_ DET_ELEVATION_392 : 402|8@0+ (0.00275,-0.34925) [-0.34925|0.34925] "rad" ADAS
 SG_ DET_ELEVATION_ERR_392 : 410|6@0+ (0.00174533,0) [0|0.10995579] "rad" ADAS
 SG_ DET_RCS_392 : 479|8@0+ (0.5,-64) [-64|63.5] "dBsm" ADAS
 SG_ DET_VALID_FLAG_392 : 460|1@0+ (1,0) [0|1] "" ADAS
 SG_ DET_BI_STATIC_FLAG_392 : 484|1@0+ (1,0) [0|1] "" ADAS
 SG_ DET_SUPER_RES_TARGET_392 : 439|1@0+ (1,0) [0|1] "" ADAS
 SG_ DET_SNR_392 : 471|8@0+ (0.35156,0) [0|89.6478] "dB" ADAS
 SG_ DET_POINT_TARGET_PROB_392 : 455|4@0+ (6.67,0) [0|100] "%" ADAS
 SG_ DET_EXISTENCE_PROB_392 : 451|6@0+ (1.588,0) [0|100] "%" ADAS
 SG_ DET_OUTSIDE_SECTOR_392 : 461|1@0+ (1,0) [0|1] "" ADAS
 SG_ DET_HVC_FLAG_392 : 447|1@0+ (1,0) [0|1] "" ADAS
 SG_ DET_CONFD_AZIMUTH_392 : 457|2@0+ (1,0) [0|3] "" ADAS
 SG_ DET_CONFD_ELEVATION_392 : 459|2@0+ (1,0) [0|3] "" ADAS
 SG_ DET_MH_SCAN_INDEX_4LSB_389_392 : 483|4@0+ (1,0) [0|15] "" ADAS
 SG_ DET_MH_CYCLE_COUNTER_389_392 : 495|8@0+ (1,0) [0|255] "" ADAS
 SG_ DET_MH_CRC16_389_392 : 503|16@0+ (1,0) [0|65535] "" ADAS

BO_ 1250 RDR_DETECTION_393_396: 64 RDR08
 SG_ DET_RANGE_393 : 7|15@0+ (0.015625,0) [0|500] "m" ADAS
 SG_ DET_RANGE_ERR_393 : 8|7@0+ (0.0075,0) [0|0.9525] "m" ADAS
 SG_ DET_RANGE_VELOCITY_393 : 17|15@0+ (0.0078125,-128) [-128|127.9921875] "m/s" ADAS
 SG_ DET_RANGE_VELOCITY_ERR_393 : 34|8@0+ (0.003,0) [0|0.765] "m/s" ADAS
 SG_ DET_AZIMUTH_393 : 60|13@0+ (0.0004,-1.5708) [-1.5708|1.5708] "rad" ADAS
 SG_ DET_AZIMUTH_ERR_393 : 78|7@0+ (0.00087267,0) [0|0.11082909] "rad" ADAS
 SG_ DET_ELEVATION_393 : 42|8@0+ (0.00275,-0.34925) [-0.34925|0.34925] "rad" ADAS
 SG_ DET_ELEVATION_ERR_393 : 50|6@0+ (0.00174533,0) [0|0.10995579] "rad" ADAS
 SG_ DET_RCS_393 : 119|8@0+ (0.5,-64) [-64|63.5] "dBsm" ADAS
 SG_ DET_VALID_FLAG_393 : 80|1@0+ (1,0) [0|1] "" ADAS
 SG_ DET_BI_STATIC_FLAG_393 : 487|1@0+ (1,0) [0|1] "" ADAS
 SG_ DET_SUPER_RES_TARGET_393 : 79|1@0+ (1,0) [0|1] "" ADAS
 SG_ DET_SNR_393 : 111|8@0+ (0.35156,0) [0|89.6478] "dB" ADAS
 SG_ DET_POINT_TARGET_PROB_393 : 86|4@0+ (6.67,0) [0|100] "%" ADAS
 SG_ DET_EXISTENCE_PROB_393 : 95|6@0+ (1.588,0) [0|100] "%" ADAS
 SG_ DET_OUTSIDE_SECTOR_393 : 103|1@0+ (1,0) [0|1] "" ADAS
 SG_ DET_HVC_FLAG_393 : 87|1@0+ (1,0) [0|1] "" ADAS
 SG_ DET_CONFD_AZIMUTH_393 : 89|2@0+ (1,0) [0|3] "" ADAS
 SG_ DET_CONFD_ELEVATION_393 : 82|2@0+ (1,0) [0|3] "" ADAS
 SG_ DET_RANGE_394 : 127|15@0+ (0.015625,0) [0|500] "m" ADAS
 SG_ DET_RANGE_ERR_394 : 128|7@0+ (0.0075,0) [0|0.9525] "m" ADAS
 SG_ DET_RANGE_VELOCITY_394 : 137|15@0+ (0.0078125,-128) [-128|127.9921875] "m/s" ADAS
 SG_ DET_RANGE_VELOCITY_ERR_394 : 154|8@0+ (0.003,0) [0|0.765] "m/s" ADAS
 SG_ DET_AZIMUTH_394 : 180|13@0+ (0.0004,-1.5708) [-1.5708|1.5708] "rad" ADAS
 SG_ DET_AZIMUTH_ERR_394 : 198|7@0+ (0.00087267,0) [0|0.11082909] "rad" ADAS
 SG_ DET_ELEVATION_394 : 162|8@0+ (0.00275,-0.34925) [-0.34925|0.34925] "rad" ADAS
 SG_ DET_ELEVATION_ERR_394 : 170|6@0+ (0.00174533,0) [0|0.10995579] "rad" ADAS
 SG_ DET_RCS_394 : 239|8@0+ (0.5,-64) [-64|63.5] "dBsm" ADAS
 SG_ DET_VALID_FLAG_394 : 220|1@0+ (1,0) [0|1] "" ADAS
 SG_ DET_BI_STATIC_FLAG_394 : 486|1@0+ (1,0) [0|1] "" ADAS
 SG_ DET_SUPER_RES_TARGET_394 : 199|1@0+ (1,0) [0|1] "" ADAS
 SG_ DET_SNR_394 : 231|8@0+ (0.35156,0) [0|89.6478] "dB" ADAS
 SG_ DET_POINT_TARGET_PROB_394 : 215|4@0+ (6.67,0) [0|100] "%" ADAS
 SG_ DET_EXISTENCE_PROB_394 : 211|6@0+ (1.588,0) [0|100] "%" ADAS
 SG_ DET_OUTSIDE_SECTOR_394 : 221|1@0+ (1,0) [0|1] "" ADAS
 SG_ DET_HVC_FLAG_394 : 207|1@0+ (1,0) [0|1] "" ADAS
 SG_ DET_CONFD_AZIMUTH_394 : 217|2@0+ (1,0) [0|3] "" ADAS
 SG_ DET_CONFD_ELEVATION_394 : 219|2@0+ (1,0) [0|3] "" ADAS
 SG_ DET_RANGE_395 : 247|15@0+ (0.015625,0) [0|500] "m" ADAS
 SG_ DET_RANGE_ERR_395 : 248|7@0+ (0.0075,0) [0|0.9525] "m" ADAS
 SG_ DET_RANGE_VELOCITY_395 : 257|15@0+ (0.0078125,-128) [-128|127.9921875] "m/s" ADAS
 SG_ DET_RANGE_VELOCITY_ERR_395 : 274|8@0+ (0.003,0) [0|0.765] "m/s" ADAS
 SG_ DET_AZIMUTH_395 : 300|13@0+ (0.0004,-1.5708) [-1.5708|1.5708] "rad" ADAS
 SG_ DET_AZIMUTH_ERR_395 : 318|7@0+ (0.00087267,0) [0|0.11082909] "rad" ADAS
 SG_ DET_ELEVATION_395 : 282|8@0+ (0.00275,-0.34925) [-0.34925|0.34925] "rad" ADAS
 SG_ DET_ELEVATION_ERR_395 : 290|6@0+ (0.00174533,0) [0|0.10995579] "rad" ADAS
 SG_ DET_RCS_395 : 359|8@0+ (0.5,-64) [-64|63.5] "dBsm" ADAS
 SG_ DET_VALID_FLAG_395 : 340|1@0+ (1,0) [0|1] "" ADAS
 SG_ DET_BI_STATIC_FLAG_395 : 485|1@0+ (1,0) [0|1] "" ADAS
 SG_ DET_SUPER_RES_TARGET_395 : 319|1@0+ (1,0) [0|1] "" ADAS
 SG_ DET_SNR_395 : 351|8@0+ (0.35156,0) [0|89.6478] "dB" ADAS
 SG_ DET_POINT_TARGET_PROB_395 : 335|4@0+ (6.67,0) [0|100] "%" ADAS
 SG_ DET_EXISTENCE_PROB_395 : 331|6@0+ (1.588,0) [0|100] "%" ADAS
 SG_ DET_OUTSIDE_SECTOR_395 : 341|1@0+ (1,0) [0|1] "" ADAS
 SG_ DET_HVC_FLAG_395 : 327|1@0+ (1,0) [0|1] "" ADAS
 SG_ DET_CONFD_AZIMUTH_395 : 337|2@0+ (1,0) [0|3] "" ADAS
 SG_ DET_CONFD_ELEVATION_395 : 339|2@0+ (1,0) [0|3] "" ADAS
 SG_ DET_RANGE_396 : 367|15@0+ (0.015625,0) [0|500] "m" ADAS
 SG_ DET_RANGE_ERR_396 : 368|7@0+ (0.0075,0) [0|0.9525] "m" ADAS
 SG_ DET_RANGE_VELOCITY_396 : 377|15@0+ (0.0078125,-128) [-128|127.9921875] "m/s" ADAS
 SG_ DET_RANGE_VELOCITY_ERR_396 : 394|8@0+ (0.003,0) [0|0.765] "m/s" ADAS
 SG_ DET_AZIMUTH_396 : 420|13@0+ (0.0004,-1.5708) [-1.5708|1.5708] "rad" ADAS
 SG_ DET_AZIMUTH_ERR_396 : 438|7@0+ (0.00087267,0) [0|0.11082909] "rad" ADAS
 SG_ DET_ELEVATION_396 : 402|8@0+ (0.00275,-0.34925) [-0.34925|0.34925] "rad" ADAS
 SG_ DET_ELEVATION_ERR_396 : 410|6@0+ (0.00174533,0) [0|0.10995579] "rad" ADAS
 SG_ DET_RCS_396 : 479|8@0+ (0.5,-64) [-64|63.5] "dBsm" ADAS
 SG_ DET_VALID_FLAG_396 : 460|1@0+ (1,0) [0|1] "" ADAS
 SG_ DET_BI_STATIC_FLAG_396 : 484|1@0+ (1,0) [0|1] "" ADAS
 SG_ DET_SUPER_RES_TARGET_396 : 439|1@0+ (1,0) [0|1] "" ADAS
 SG_ DET_SNR_396 : 471|8@0+ (0.35156,0) [0|89.6478] "dB" ADAS
 SG_ DET_POINT_TARGET_PROB_396 : 455|4@0+ (6.67,0) [0|100] "%" ADAS
 SG_ DET_EXISTENCE_PROB_396 : 451|6@0+ (1.588,0) [0|100] "%" ADAS
 SG_ DET_OUTSIDE_SECTOR_396 : 461|1@0+ (1,0) [0|1] "" ADAS
 SG_ DET_HVC_FLAG_396 : 447|1@0+ (1,0) [0|1] "" ADAS
 SG_ DET_CONFD_AZIMUTH_396 : 457|2@0+ (1,0) [0|3] "" ADAS
 SG_ DET_CONFD_ELEVATION_396 : 459|2@0+ (1,0) [0|3] "" ADAS
 SG_ DET_MH_SCAN_INDEX_4LSB_393_396 : 483|4@0+ (1,0) [0|15] "" ADAS
 SG_ DET_MH_CYCLE_COUNTER_393_396 : 495|8@0+ (1,0) [0|255] "" ADAS
 SG_ DET_MH_CRC16_393_396 : 503|16@0+ (1,0) [0|65535] "" ADAS

BO_ 1251 RDR_DETECTION_397_400: 64 RDR08
 SG_ DET_RANGE_397 : 7|15@0+ (0.015625,0) [0|500] "m" ADAS
 SG_ DET_RANGE_ERR_397 : 8|7@0+ (0.0075,0) [0|0.9525] "m" ADAS
 SG_ DET_RANGE_VELOCITY_397 : 17|15@0+ (0.0078125,-128) [-128|127.9921875] "m/s" ADAS
 SG_ DET_RANGE_VELOCITY_ERR_397 : 34|8@0+ (0.003,0) [0|0.765] "m/s" ADAS
 SG_ DET_AZIMUTH_397 : 60|13@0+ (0.0004,-1.5708) [-1.5708|1.5708] "rad" ADAS
 SG_ DET_AZIMUTH_ERR_397 : 78|7@0+ (0.00087267,0) [0|0.11082909] "rad" ADAS
 SG_ DET_ELEVATION_397 : 42|8@0+ (0.00275,-0.34925) [-0.34925|0.34925] "rad" ADAS
 SG_ DET_ELEVATION_ERR_397 : 50|6@0+ (0.00174533,0) [0|0.10995579] "rad" ADAS
 SG_ DET_RCS_397 : 119|8@0+ (0.5,-64) [-64|63.5] "dBsm" ADAS
 SG_ DET_VALID_FLAG_397 : 80|1@0+ (1,0) [0|1] "" ADAS
 SG_ DET_BI_STATIC_FLAG_397 : 487|1@0+ (1,0) [0|1] "" ADAS
 SG_ DET_SUPER_RES_TARGET_397 : 79|1@0+ (1,0) [0|1] "" ADAS
 SG_ DET_SNR_397 : 111|8@0+ (0.35156,0) [0|89.6478] "dB" ADAS
 SG_ DET_POINT_TARGET_PROB_397 : 86|4@0+ (6.67,0) [0|100] "%" ADAS
 SG_ DET_EXISTENCE_PROB_397 : 95|6@0+ (1.588,0) [0|100] "%" ADAS
 SG_ DET_OUTSIDE_SECTOR_397 : 103|1@0+ (1,0) [0|1] "" ADAS
 SG_ DET_HVC_FLAG_397 : 87|1@0+ (1,0) [0|1] "" ADAS
 SG_ DET_CONFD_AZIMUTH_397 : 89|2@0+ (1,0) [0|3] "" ADAS
 SG_ DET_CONFD_ELEVATION_397 : 82|2@0+ (1,0) [0|3] "" ADAS
 SG_ DET_RANGE_398 : 127|15@0+ (0.015625,0) [0|500] "m" ADAS
 SG_ DET_RANGE_ERR_398 : 128|7@0+ (0.0075,0) [0|0.9525] "m" ADAS
 SG_ DET_RANGE_VELOCITY_398 : 137|15@0+ (0.0078125,-128) [-128|127.9921875] "m/s" ADAS
 SG_ DET_RANGE_VELOCITY_ERR_398 : 154|8@0+ (0.003,0) [0|0.765] "m/s" ADAS
 SG_ DET_AZIMUTH_398 : 180|13@0+ (0.0004,-1.5708) [-1.5708|1.5708] "rad" ADAS
 SG_ DET_AZIMUTH_ERR_398 : 198|7@0+ (0.00087267,0) [0|0.11082909] "rad" ADAS
 SG_ DET_ELEVATION_398 : 162|8@0+ (0.00275,-0.34925) [-0.34925|0.34925] "rad" ADAS
 SG_ DET_ELEVATION_ERR_398 : 170|6@0+ (0.00174533,0) [0|0.10995579] "rad" ADAS
 SG_ DET_RCS_398 : 239|8@0+ (0.5,-64) [-64|63.5] "dBsm" ADAS
 SG_ DET_VALID_FLAG_398 : 220|1@0+ (1,0) [0|1] "" ADAS
 SG_ DET_BI_STATIC_FLAG_398 : 486|1@0+ (1,0) [0|1] "" ADAS
 SG_ DET_SUPER_RES_TARGET_398 : 199|1@0+ (1,0) [0|1] "" ADAS
 SG_ DET_SNR_398 : 231|8@0+ (0.35156,0) [0|89.6478] "dB" ADAS
 SG_ DET_POINT_TARGET_PROB_398 : 215|4@0+ (6.67,0) [0|100] "%" ADAS
 SG_ DET_EXISTENCE_PROB_398 : 211|6@0+ (1.588,0) [0|100] "%" ADAS
 SG_ DET_OUTSIDE_SECTOR_398 : 221|1@0+ (1,0) [0|1] "" ADAS
 SG_ DET_HVC_FLAG_398 : 207|1@0+ (1,0) [0|1] "" ADAS
 SG_ DET_CONFD_AZIMUTH_398 : 217|2@0+ (1,0) [0|3] "" ADAS
 SG_ DET_CONFD_ELEVATION_398 : 219|2@0+ (1,0) [0|3] "" ADAS
 SG_ DET_RANGE_399 : 247|15@0+ (0.015625,0) [0|500] "m" ADAS
 SG_ DET_RANGE_ERR_399 : 248|7@0+ (0.0075,0) [0|0.9525] "m" ADAS
 SG_ DET_RANGE_VELOCITY_399 : 257|15@0+ (0.0078125,-128) [-128|127.9921875] "m/s" ADAS
 SG_ DET_RANGE_VELOCITY_ERR_399 : 274|8@0+ (0.003,0) [0|0.765] "m/s" ADAS
 SG_ DET_AZIMUTH_399 : 300|13@0+ (0.0004,-1.5708) [-1.5708|1.5708] "rad" ADAS
 SG_ DET_AZIMUTH_ERR_399 : 318|7@0+ (0.00087267,0) [0|0.11082909] "rad" ADAS
 SG_ DET_ELEVATION_399 : 282|8@0+ (0.00275,-0.34925) [-0.34925|0.34925] "rad" ADAS
 SG_ DET_ELEVATION_ERR_399 : 290|6@0+ (0.00174533,0) [0|0.10995579] "rad" ADAS
 SG_ DET_RCS_399 : 359|8@0+ (0.5,-64) [-64|63.5] "dBsm" ADAS
 SG_ DET_VALID_FLAG_399 : 340|1@0+ (1,0) [0|1] "" ADAS
 SG_ DET_BI_STATIC_FLAG_399 : 485|1@0+ (1,0) [0|1] "" ADAS
 SG_ DET_SUPER_RES_TARGET_399 : 319|1@0+ (1,0) [0|1] "" ADAS
 SG_ DET_SNR_399 : 351|8@0+ (0.35156,0) [0|89.6478] "dB" ADAS
 SG_ DET_POINT_TARGET_PROB_399 : 335|4@0+ (6.67,0) [0|100] "%" ADAS
 SG_ DET_EXISTENCE_PROB_399 : 331|6@0+ (1.588,0) [0|100] "%" ADAS
 SG_ DET_OUTSIDE_SECTOR_399 : 341|1@0+ (1,0) [0|1] "" ADAS
 SG_ DET_HVC_FLAG_399 : 327|1@0+ (1,0) [0|1] "" ADAS
 SG_ DET_CONFD_AZIMUTH_399 : 337|2@0+ (1,0) [0|3] "" ADAS
 SG_ DET_CONFD_ELEVATION_399 : 339|2@0+ (1,0) [0|3] "" ADAS
 SG_ DET_RANGE_400 : 367|15@0+ (0.015625,0) [0|500] "m" ADAS
 SG_ DET_RANGE_ERR_400 : 368|7@0+ (0.0075,0) [0|0.9525] "m" ADAS
 SG_ DET_RANGE_VELOCITY_400 : 377|15@0+ (0.0078125,-128) [-128|127.9921875] "m/s" ADAS
 SG_ DET_RANGE_VELOCITY_ERR_400 : 394|8@0+ (0.003,0) [0|0.765] "m/s" ADAS
 SG_ DET_AZIMUTH_400 : 420|13@0+ (0.0004,-1.5708) [-1.5708|1.5708] "rad" ADAS
 SG_ DET_AZIMUTH_ERR_400 : 438|7@0+ (0.00087267,0) [0|0.11082909] "rad" ADAS
 SG_ DET_ELEVATION_400 : 402|8@0+ (0.00275,-0.34925) [-0.34925|0.34925] "rad" ADAS
 SG_ DET_ELEVATION_ERR_400 : 410|6@0+ (0.00174533,0) [0|0.10995579] "rad" ADAS
 SG_ DET_RCS_400 : 479|8@0+ (0.5,-64) [-64|63.5] "dBsm" ADAS
 SG_ DET_VALID_FLAG_400 : 460|1@0+ (1,0) [0|1] "" ADAS
 SG_ DET_BI_STATIC_FLAG_400 : 484|1@0+ (1,0) [0|1] "" ADAS
 SG_ DET_SUPER_RES_TARGET_400 : 439|1@0+ (1,0) [0|1] "" ADAS
 SG_ DET_SNR_400 : 471|8@0+ (0.35156,0) [0|89.6478] "dB" ADAS
 SG_ DET_POINT_TARGET_PROB_400 : 455|4@0+ (6.67,0) [0|100] "%" ADAS
 SG_ DET_EXISTENCE_PROB_400 : 451|6@0+ (1.588,0) [0|100] "%" ADAS
 SG_ DET_OUTSIDE_SECTOR_400 : 461|1@0+ (1,0) [0|1] "" ADAS
 SG_ DET_HVC_FLAG_400 : 447|1@0+ (1,0) [0|1] "" ADAS
 SG_ DET_CONFD_AZIMUTH_400 : 457|2@0+ (1,0) [0|3] "" ADAS
 SG_ DET_CONFD_ELEVATION_400 : 459|2@0+ (1,0) [0|3] "" ADAS
 SG_ DET_MH_SCAN_INDEX_4LSB_397_400 : 483|4@0+ (1,0) [0|15] "" ADAS
 SG_ DET_MH_CYCLE_COUNTER_397_400 : 495|8@0+ (1,0) [0|255] "" ADAS
 SG_ DET_MH_CRC16_397_400 : 503|16@0+ (1,0) [0|65535] "" ADAS

CM_ SG_ 1234 DET_RANGE_329 " measured position  of the detection";
CM_ SG_ 1234 DET_RANGE_ERR_329 "RMSE or standard deviation of the measured angle  of the detection";
CM_ SG_ 1234 DET_RANGE_VELOCITY_329 "Radial velocity of the detection positive in direction to the sensor";
CM_ SG_ 1234 DET_RANGE_VELOCITY_ERR_329 "RMSE or standard deviation of the measure radial velocity of the detection";
CM_ SG_ 1234 DET_AZIMUTH_329 "Measured angle  of the detection";
CM_ SG_ 1234 DET_AZIMUTH_ERR_329 "RMSE or standard deviation of the measured angle  of the detection";
CM_ SG_ 1234 DET_ELEVATION_329 "measured elevation of the detection";
CM_ SG_ 1234 DET_ELEVATION_ERR_329 "RMSE or standard deviation of the measured elevation  of the detection";
CM_ SG_ 1234 DET_RCS_329 "Radar Cross Section or Amplitude, is a measure of how detectable an object is by radar. A larger RCS indicates that an object is more easily detected.";
CM_ SG_ 1234 DET_VALID_FLAG_329 "is set if the measured detection is valid";
CM_ SG_ 1234 DET_BI_STATIC_FLAG_329 "1 if detection is bi-static 0 otherwise";
CM_ SG_ 1234 DET_SUPER_RES_TARGET_329 "flasg is set if the detection is super resolution target";
CM_ SG_ 1234 DET_SNR_329 "The signal to noise ratio (SNR) of the radar detection";
CM_ SG_ 1234 DET_POINT_TARGET_PROB_329 "Describes the possibility if more than one real-world object has led to this detection. 0[%] := 100[%] Multi target probability";
CM_ SG_ 1234 DET_EXISTENCE_PROB_329 "Existence probability of the detection not based on history. Value does  not depend on any past experience with similar detections.
\note Use as confidence measure where a low value means less confidence
and a high value indicates strong confidence.";
CM_ SG_ 1234 DET_OUTSIDE_SECTOR_329 "Flag to indicate detections outside the sector, set if the wrong sector calibration matrix was used";
CM_ SG_ 1234 DET_HVC_FLAG_329 "Core2 Vehicle clutter flag";
CM_ SG_ 1234 DET_CONFD_AZIMUTH_329 "Define the Confidence of Azimuth for Detection ";
CM_ SG_ 1234 DET_CONFD_ELEVATION_329 "Define the Confidence of Elevation for the Detection ";
CM_ SG_ 1234 DET_BI_STATIC_FLAG_330 "1 if detection is bi-static 0 otherwise";
CM_ SG_ 1234 DET_BI_STATIC_FLAG_331 "1 if detection is bi-static 0 otherwise";
CM_ SG_ 1234 DET_BI_STATIC_FLAG_332 "1 if detection is bi-static 0 otherwise";
CM_ SG_ 1234 DET_MH_SCAN_INDEX_4LSB_329_332 "Scan index of the measured detection";
CM_ SG_ 1234 DET_MH_CYCLE_COUNTER_329_332 "Detection Alive Counter";
CM_ SG_ 1235 DET_RANGE_333 " measured position  of the detection";
CM_ SG_ 1235 DET_RANGE_ERR_333 "RMSE or standard deviation of the measured angle  of the detection";
CM_ SG_ 1235 DET_RANGE_VELOCITY_333 "Radial velocity of the detection positive in direction to the sensor";
CM_ SG_ 1235 DET_RANGE_VELOCITY_ERR_333 "RMSE or standard deviation of the measure radial velocity of the detection";
CM_ SG_ 1235 DET_AZIMUTH_333 "Measured angle  of the detection";
CM_ SG_ 1235 DET_AZIMUTH_ERR_333 "RMSE or standard deviation of the measured angle  of the detection";
CM_ SG_ 1235 DET_ELEVATION_333 "measured elevation of the detection";
CM_ SG_ 1235 DET_ELEVATION_ERR_333 "RMSE or standard deviation of the measured elevation  of the detection";
CM_ SG_ 1235 DET_RCS_333 "Radar Cross Section or Amplitude, is a measure of how detectable an object is by radar. A larger RCS indicates that an object is more easily detected.";
CM_ SG_ 1235 DET_VALID_FLAG_333 "is set if the measured detection is valid";
CM_ SG_ 1235 DET_BI_STATIC_FLAG_333 "1 if detection is bi-static 0 otherwise";
CM_ SG_ 1235 DET_SUPER_RES_TARGET_333 "flasg is set if the detection is super resolution target";
CM_ SG_ 1235 DET_SNR_333 "The signal to noise ratio (SNR) of the radar detection";
CM_ SG_ 1235 DET_POINT_TARGET_PROB_333 "Describes the possibility if more than one real-world object has led to this detection. 0[%] := 100[%] Multi target probability";
CM_ SG_ 1235 DET_EXISTENCE_PROB_333 "Existence probability of the detection not based on history. Value does  not depend on any past experience with similar detections.
\note Use as confidence measure where a low value means less confidence
and a high value indicates strong confidence.";
CM_ SG_ 1235 DET_OUTSIDE_SECTOR_333 "Flag to indicate detections outside the sector, set if the wrong sector calibration matrix was used";
CM_ SG_ 1235 DET_HVC_FLAG_333 "Core2 Vehicle clutter flag";
CM_ SG_ 1235 DET_CONFD_AZIMUTH_333 "Define the Confidence of Azimuth for Detection ";
CM_ SG_ 1235 DET_CONFD_ELEVATION_333 "Define the Confidence of Elevation for the Detection ";
CM_ SG_ 1235 DET_BI_STATIC_FLAG_334 "1 if detection is bi-static 0 otherwise";
CM_ SG_ 1235 DET_BI_STATIC_FLAG_335 "1 if detection is bi-static 0 otherwise";
CM_ SG_ 1235 DET_BI_STATIC_FLAG_336 "1 if detection is bi-static 0 otherwise";
CM_ SG_ 1235 DET_MH_SCAN_INDEX_4LSB_333_336 "Scan index of the measured detection";
CM_ SG_ 1235 DET_MH_CYCLE_COUNTER_333_336 "Detection Alive Counter";
CM_ SG_ 1236 DET_RANGE_337 " measured position  of the detection";
CM_ SG_ 1236 DET_RANGE_ERR_337 "RMSE or standard deviation of the measured angle  of the detection";
CM_ SG_ 1236 DET_RANGE_VELOCITY_337 "Radial velocity of the detection positive in direction to the sensor";
CM_ SG_ 1236 DET_RANGE_VELOCITY_ERR_337 "RMSE or standard deviation of the measure radial velocity of the detection";
CM_ SG_ 1236 DET_AZIMUTH_337 "Measured angle  of the detection";
CM_ SG_ 1236 DET_AZIMUTH_ERR_337 "RMSE or standard deviation of the measured angle  of the detection";
CM_ SG_ 1236 DET_ELEVATION_337 "measured elevation of the detection";
CM_ SG_ 1236 DET_ELEVATION_ERR_337 "RMSE or standard deviation of the measured elevation  of the detection";
CM_ SG_ 1236 DET_RCS_337 "Radar Cross Section or Amplitude, is a measure of how detectable an object is by radar. A larger RCS indicates that an object is more easily detected.";
CM_ SG_ 1236 DET_VALID_FLAG_337 "is set if the measured detection is valid";
CM_ SG_ 1236 DET_BI_STATIC_FLAG_337 "1 if detection is bi-static 0 otherwise";
CM_ SG_ 1236 DET_SUPER_RES_TARGET_337 "flasg is set if the detection is super resolution target";
CM_ SG_ 1236 DET_SNR_337 "The signal to noise ratio (SNR) of the radar detection";
CM_ SG_ 1236 DET_POINT_TARGET_PROB_337 "Describes the possibility if more than one real-world object has led to this detection. 0[%] := 100[%] Multi target probability";
CM_ SG_ 1236 DET_EXISTENCE_PROB_337 "Existence probability of the detection not based on history. Value does  not depend on any past experience with similar detections.
\note Use as confidence measure where a low value means less confidence
and a high value indicates strong confidence.";
CM_ SG_ 1236 DET_OUTSIDE_SECTOR_337 "Flag to indicate detections outside the sector, set if the wrong sector calibration matrix was used";
CM_ SG_ 1236 DET_HVC_FLAG_337 "Core2 Vehicle clutter flag";
CM_ SG_ 1236 DET_CONFD_AZIMUTH_337 "Define the Confidence of Azimuth for Detection ";
CM_ SG_ 1236 DET_CONFD_ELEVATION_337 "Define the Confidence of Elevation for the Detection ";
CM_ SG_ 1236 DET_BI_STATIC_FLAG_338 "1 if detection is bi-static 0 otherwise";
CM_ SG_ 1236 DET_BI_STATIC_FLAG_339 "1 if detection is bi-static 0 otherwise";
CM_ SG_ 1236 DET_BI_STATIC_FLAG_340 "1 if detection is bi-static 0 otherwise";
CM_ SG_ 1236 DET_MH_SCAN_INDEX_4LSB_337_340 "Scan index of the measured detection";
CM_ SG_ 1236 DET_MH_CYCLE_COUNTER_337_340 "Detection Alive Counter";
CM_ SG_ 1237 DET_RANGE_341 " measured position  of the detection";
CM_ SG_ 1237 DET_RANGE_ERR_341 "RMSE or standard deviation of the measured angle  of the detection";
CM_ SG_ 1237 DET_RANGE_VELOCITY_341 "Radial velocity of the detection positive in direction to the sensor";
CM_ SG_ 1237 DET_RANGE_VELOCITY_ERR_341 "RMSE or standard deviation of the measure radial velocity of the detection";
CM_ SG_ 1237 DET_AZIMUTH_341 "Measured angle  of the detection";
CM_ SG_ 1237 DET_AZIMUTH_ERR_341 "RMSE or standard deviation of the measured angle  of the detection";
CM_ SG_ 1237 DET_ELEVATION_341 "measured elevation of the detection";
CM_ SG_ 1237 DET_ELEVATION_ERR_341 "RMSE or standard deviation of the measured elevation  of the detection";
CM_ SG_ 1237 DET_RCS_341 "Radar Cross Section or Amplitude, is a measure of how detectable an object is by radar. A larger RCS indicates that an object is more easily detected.";
CM_ SG_ 1237 DET_VALID_FLAG_341 "is set if the measured detection is valid";
CM_ SG_ 1237 DET_BI_STATIC_FLAG_341 "1 if detection is bi-static 0 otherwise";
CM_ SG_ 1237 DET_SUPER_RES_TARGET_341 "flasg is set if the detection is super resolution target";
CM_ SG_ 1237 DET_SNR_341 "The signal to noise ratio (SNR) of the radar detection";
CM_ SG_ 1237 DET_POINT_TARGET_PROB_341 "Describes the possibility if more than one real-world object has led to this detection. 0[%] := 100[%] Multi target probability";
CM_ SG_ 1237 DET_EXISTENCE_PROB_341 "Existence probability of the detection not based on history. Value does  not depend on any past experience with similar detections.
\note Use as confidence measure where a low value means less confidence
and a high value indicates strong confidence.";
CM_ SG_ 1237 DET_OUTSIDE_SECTOR_341 "Flag to indicate detections outside the sector, set if the wrong sector calibration matrix was used";
CM_ SG_ 1237 DET_HVC_FLAG_341 "Core2 Vehicle clutter flag";
CM_ SG_ 1237 DET_CONFD_AZIMUTH_341 "Define the Confidence of Azimuth for Detection ";
CM_ SG_ 1237 DET_CONFD_ELEVATION_341 "Define the Confidence of Elevation for the Detection ";
CM_ SG_ 1237 DET_BI_STATIC_FLAG_342 "1 if detection is bi-static 0 otherwise";
CM_ SG_ 1237 DET_BI_STATIC_FLAG_343 "1 if detection is bi-static 0 otherwise";
CM_ SG_ 1237 DET_BI_STATIC_FLAG_344 "1 if detection is bi-static 0 otherwise";
CM_ SG_ 1237 DET_MH_SCAN_INDEX_4LSB_341_344 "Scan index of the measured detection";
CM_ SG_ 1237 DET_MH_CYCLE_COUNTER_341_344 "Detection Alive Counter";
CM_ SG_ 1238 DET_RANGE_345 " measured position  of the detection";
CM_ SG_ 1238 DET_RANGE_ERR_345 "RMSE or standard deviation of the measured angle  of the detection";
CM_ SG_ 1238 DET_RANGE_VELOCITY_345 "Radial velocity of the detection positive in direction to the sensor";
CM_ SG_ 1238 DET_RANGE_VELOCITY_ERR_345 "RMSE or standard deviation of the measure radial velocity of the detection";
CM_ SG_ 1238 DET_AZIMUTH_345 "Measured angle  of the detection";
CM_ SG_ 1238 DET_AZIMUTH_ERR_345 "RMSE or standard deviation of the measured angle  of the detection";
CM_ SG_ 1238 DET_ELEVATION_345 "measured elevation of the detection";
CM_ SG_ 1238 DET_ELEVATION_ERR_345 "RMSE or standard deviation of the measured elevation  of the detection";
CM_ SG_ 1238 DET_RCS_345 "Radar Cross Section or Amplitude, is a measure of how detectable an object is by radar. A larger RCS indicates that an object is more easily detected.";
CM_ SG_ 1238 DET_VALID_FLAG_345 "is set if the measured detection is valid";
CM_ SG_ 1238 DET_BI_STATIC_FLAG_345 "1 if detection is bi-static 0 otherwise";
CM_ SG_ 1238 DET_SUPER_RES_TARGET_345 "flasg is set if the detection is super resolution target";
CM_ SG_ 1238 DET_SNR_345 "The signal to noise ratio (SNR) of the radar detection";
CM_ SG_ 1238 DET_POINT_TARGET_PROB_345 "Describes the possibility if more than one real-world object has led to this detection. 0[%] := 100[%] Multi target probability";
CM_ SG_ 1238 DET_EXISTENCE_PROB_345 "Existence probability of the detection not based on history. Value does  not depend on any past experience with similar detections.
\note Use as confidence measure where a low value means less confidence
and a high value indicates strong confidence.";
CM_ SG_ 1238 DET_OUTSIDE_SECTOR_345 "Flag to indicate detections outside the sector, set if the wrong sector calibration matrix was used";
CM_ SG_ 1238 DET_HVC_FLAG_345 "Core2 Vehicle clutter flag";
CM_ SG_ 1238 DET_CONFD_AZIMUTH_345 "Define the Confidence of Azimuth for Detection ";
CM_ SG_ 1238 DET_CONFD_ELEVATION_345 "Define the Confidence of Elevation for the Detection ";
CM_ SG_ 1238 DET_BI_STATIC_FLAG_346 "1 if detection is bi-static 0 otherwise";
CM_ SG_ 1238 DET_BI_STATIC_FLAG_347 "1 if detection is bi-static 0 otherwise";
CM_ SG_ 1238 DET_BI_STATIC_FLAG_348 "1 if detection is bi-static 0 otherwise";
CM_ SG_ 1238 DET_MH_SCAN_INDEX_4LSB_345_348 "Scan index of the measured detection";
CM_ SG_ 1238 DET_MH_CYCLE_COUNTER_345_348 "Detection Alive Counter";
CM_ SG_ 1239 DET_RANGE_349 " measured position  of the detection";
CM_ SG_ 1239 DET_RANGE_ERR_349 "RMSE or standard deviation of the measured angle  of the detection";
CM_ SG_ 1239 DET_RANGE_VELOCITY_349 "Radial velocity of the detection positive in direction to the sensor";
CM_ SG_ 1239 DET_RANGE_VELOCITY_ERR_349 "RMSE or standard deviation of the measure radial velocity of the detection";
CM_ SG_ 1239 DET_AZIMUTH_349 "Measured angle  of the detection";
CM_ SG_ 1239 DET_AZIMUTH_ERR_349 "RMSE or standard deviation of the measured angle  of the detection";
CM_ SG_ 1239 DET_ELEVATION_349 "measured elevation of the detection";
CM_ SG_ 1239 DET_ELEVATION_ERR_349 "RMSE or standard deviation of the measured elevation  of the detection";
CM_ SG_ 1239 DET_RCS_349 "Radar Cross Section or Amplitude, is a measure of how detectable an object is by radar. A larger RCS indicates that an object is more easily detected.";
CM_ SG_ 1239 DET_VALID_FLAG_349 "is set if the measured detection is valid";
CM_ SG_ 1239 DET_BI_STATIC_FLAG_349 "1 if detection is bi-static 0 otherwise";
CM_ SG_ 1239 DET_SUPER_RES_TARGET_349 "flasg is set if the detection is super resolution target";
CM_ SG_ 1239 DET_SNR_349 "The signal to noise ratio (SNR) of the radar detection";
CM_ SG_ 1239 DET_POINT_TARGET_PROB_349 "Describes the possibility if more than one real-world object has led to this detection. 0[%] := 100[%] Multi target probability";
CM_ SG_ 1239 DET_EXISTENCE_PROB_349 "Existence probability of the detection not based on history. Value does  not depend on any past experience with similar detections.
\note Use as confidence measure where a low value means less confidence
and a high value indicates strong confidence.";
CM_ SG_ 1239 DET_OUTSIDE_SECTOR_349 "Flag to indicate detections outside the sector, set if the wrong sector calibration matrix was used";
CM_ SG_ 1239 DET_HVC_FLAG_349 "Core2 Vehicle clutter flag";
CM_ SG_ 1239 DET_CONFD_AZIMUTH_349 "Define the Confidence of Azimuth for Detection ";
CM_ SG_ 1239 DET_CONFD_ELEVATION_349 "Define the Confidence of Elevation for the Detection ";
CM_ SG_ 1239 DET_BI_STATIC_FLAG_350 "1 if detection is bi-static 0 otherwise";
CM_ SG_ 1239 DET_BI_STATIC_FLAG_351 "1 if detection is bi-static 0 otherwise";
CM_ SG_ 1239 DET_BI_STATIC_FLAG_352 "1 if detection is bi-static 0 otherwise";
CM_ SG_ 1239 DET_MH_SCAN_INDEX_4LSB_349_352 "Scan index of the measured detection";
CM_ SG_ 1239 DET_MH_CYCLE_COUNTER_349_352 "Detection Alive Counter";
CM_ SG_ 1240 DET_RANGE_353 " measured position  of the detection";
CM_ SG_ 1240 DET_RANGE_ERR_353 "RMSE or standard deviation of the measured angle  of the detection";
CM_ SG_ 1240 DET_RANGE_VELOCITY_353 "Radial velocity of the detection positive in direction to the sensor";
CM_ SG_ 1240 DET_RANGE_VELOCITY_ERR_353 "RMSE or standard deviation of the measure radial velocity of the detection";
CM_ SG_ 1240 DET_AZIMUTH_353 "Measured angle  of the detection";
CM_ SG_ 1240 DET_AZIMUTH_ERR_353 "RMSE or standard deviation of the measured angle  of the detection";
CM_ SG_ 1240 DET_ELEVATION_353 "measured elevation of the detection";
CM_ SG_ 1240 DET_ELEVATION_ERR_353 "RMSE or standard deviation of the measured elevation  of the detection";
CM_ SG_ 1240 DET_RCS_353 "Radar Cross Section or Amplitude, is a measure of how detectable an object is by radar. A larger RCS indicates that an object is more easily detected.";
CM_ SG_ 1240 DET_VALID_FLAG_353 "is set if the measured detection is valid";
CM_ SG_ 1240 DET_BI_STATIC_FLAG_353 "1 if detection is bi-static 0 otherwise";
CM_ SG_ 1240 DET_SUPER_RES_TARGET_353 "flasg is set if the detection is super resolution target";
CM_ SG_ 1240 DET_SNR_353 "The signal to noise ratio (SNR) of the radar detection";
CM_ SG_ 1240 DET_POINT_TARGET_PROB_353 "Describes the possibility if more than one real-world object has led to this detection. 0[%] := 100[%] Multi target probability";
CM_ SG_ 1240 DET_EXISTENCE_PROB_353 "Existence probability of the detection not based on history. Value does  not depend on any past experience with similar detections.
\note Use as confidence measure where a low value means less confidence
and a high value indicates strong confidence.";
CM_ SG_ 1240 DET_OUTSIDE_SECTOR_353 "Flag to indicate detections outside the sector, set if the wrong sector calibration matrix was used";
CM_ SG_ 1240 DET_HVC_FLAG_353 "Core2 Vehicle clutter flag";
CM_ SG_ 1240 DET_CONFD_AZIMUTH_353 "Define the Confidence of Azimuth for Detection ";
CM_ SG_ 1240 DET_CONFD_ELEVATION_353 "Define the Confidence of Elevation for the Detection ";
CM_ SG_ 1240 DET_BI_STATIC_FLAG_354 "1 if detection is bi-static 0 otherwise";
CM_ SG_ 1240 DET_BI_STATIC_FLAG_355 "1 if detection is bi-static 0 otherwise";
CM_ SG_ 1240 DET_BI_STATIC_FLAG_356 "1 if detection is bi-static 0 otherwise";
CM_ SG_ 1240 DET_MH_SCAN_INDEX_4LSB_353_356 "Scan index of the measured detection";
CM_ SG_ 1240 DET_MH_CYCLE_COUNTER_353_356 "Detection Alive Counter";
CM_ SG_ 1241 DET_RANGE_357 " measured position  of the detection";
CM_ SG_ 1241 DET_RANGE_ERR_357 "RMSE or standard deviation of the measured angle  of the detection";
CM_ SG_ 1241 DET_RANGE_VELOCITY_357 "Radial velocity of the detection positive in direction to the sensor";
CM_ SG_ 1241 DET_RANGE_VELOCITY_ERR_357 "RMSE or standard deviation of the measure radial velocity of the detection";
CM_ SG_ 1241 DET_AZIMUTH_357 "Measured angle  of the detection";
CM_ SG_ 1241 DET_AZIMUTH_ERR_357 "RMSE or standard deviation of the measured angle  of the detection";
CM_ SG_ 1241 DET_ELEVATION_357 "measured elevation of the detection";
CM_ SG_ 1241 DET_ELEVATION_ERR_357 "RMSE or standard deviation of the measured elevation  of the detection";
CM_ SG_ 1241 DET_RCS_357 "Radar Cross Section or Amplitude, is a measure of how detectable an object is by radar. A larger RCS indicates that an object is more easily detected.";
CM_ SG_ 1241 DET_VALID_FLAG_357 "is set if the measured detection is valid";
CM_ SG_ 1241 DET_BI_STATIC_FLAG_357 "1 if detection is bi-static 0 otherwise";
CM_ SG_ 1241 DET_SUPER_RES_TARGET_357 "flasg is set if the detection is super resolution target";
CM_ SG_ 1241 DET_SNR_357 "The signal to noise ratio (SNR) of the radar detection";
CM_ SG_ 1241 DET_POINT_TARGET_PROB_357 "Describes the possibility if more than one real-world object has led to this detection. 0[%] := 100[%] Multi target probability";
CM_ SG_ 1241 DET_EXISTENCE_PROB_357 "Existence probability of the detection not based on history. Value does  not depend on any past experience with similar detections.
\note Use as confidence measure where a low value means less confidence
and a high value indicates strong confidence.";
CM_ SG_ 1241 DET_OUTSIDE_SECTOR_357 "Flag to indicate detections outside the sector, set if the wrong sector calibration matrix was used";
CM_ SG_ 1241 DET_HVC_FLAG_357 "Core2 Vehicle clutter flag";
CM_ SG_ 1241 DET_CONFD_AZIMUTH_357 "Define the Confidence of Azimuth for Detection ";
CM_ SG_ 1241 DET_CONFD_ELEVATION_357 "Define the Confidence of Elevation for the Detection ";
CM_ SG_ 1241 DET_BI_STATIC_FLAG_358 "1 if detection is bi-static 0 otherwise";
CM_ SG_ 1241 DET_BI_STATIC_FLAG_359 "1 if detection is bi-static 0 otherwise";
CM_ SG_ 1241 DET_BI_STATIC_FLAG_360 "1 if detection is bi-static 0 otherwise";
CM_ SG_ 1241 DET_MH_SCAN_INDEX_4LSB_357_360 "Scan index of the measured detection";
CM_ SG_ 1241 DET_MH_CYCLE_COUNTER_357_360 "Detection Alive Counter";
CM_ SG_ 1242 DET_RANGE_361 " measured position  of the detection";
CM_ SG_ 1242 DET_RANGE_ERR_361 "RMSE or standard deviation of the measured angle  of the detection";
CM_ SG_ 1242 DET_RANGE_VELOCITY_361 "Radial velocity of the detection positive in direction to the sensor";
CM_ SG_ 1242 DET_RANGE_VELOCITY_ERR_361 "RMSE or standard deviation of the measure radial velocity of the detection";
CM_ SG_ 1242 DET_AZIMUTH_361 "Measured angle  of the detection";
CM_ SG_ 1242 DET_AZIMUTH_ERR_361 "RMSE or standard deviation of the measured angle  of the detection";
CM_ SG_ 1242 DET_ELEVATION_361 "measured elevation of the detection";
CM_ SG_ 1242 DET_ELEVATION_ERR_361 "RMSE or standard deviation of the measured elevation  of the detection";
CM_ SG_ 1242 DET_RCS_361 "Radar Cross Section or Amplitude, is a measure of how detectable an object is by radar. A larger RCS indicates that an object is more easily detected.";
CM_ SG_ 1242 DET_VALID_FLAG_361 "is set if the measured detection is valid";
CM_ SG_ 1242 DET_BI_STATIC_FLAG_361 "1 if detection is bi-static 0 otherwise";
CM_ SG_ 1242 DET_SUPER_RES_TARGET_361 "flasg is set if the detection is super resolution target";
CM_ SG_ 1242 DET_SNR_361 "The signal to noise ratio (SNR) of the radar detection";
CM_ SG_ 1242 DET_POINT_TARGET_PROB_361 "Describes the possibility if more than one real-world object has led to this detection. 0[%] := 100[%] Multi target probability";
CM_ SG_ 1242 DET_EXISTENCE_PROB_361 "Existence probability of the detection not based on history. Value does  not depend on any past experience with similar detections.
\note Use as confidence measure where a low value means less confidence
and a high value indicates strong confidence.";
CM_ SG_ 1242 DET_OUTSIDE_SECTOR_361 "Flag to indicate detections outside the sector, set if the wrong sector calibration matrix was used";
CM_ SG_ 1242 DET_HVC_FLAG_361 "Core2 Vehicle clutter flag";
CM_ SG_ 1242 DET_CONFD_AZIMUTH_361 "Define the Confidence of Azimuth for Detection ";
CM_ SG_ 1242 DET_CONFD_ELEVATION_361 "Define the Confidence of Elevation for the Detection ";
CM_ SG_ 1242 DET_BI_STATIC_FLAG_362 "1 if detection is bi-static 0 otherwise";
CM_ SG_ 1242 DET_BI_STATIC_FLAG_363 "1 if detection is bi-static 0 otherwise";
CM_ SG_ 1242 DET_BI_STATIC_FLAG_364 "1 if detection is bi-static 0 otherwise";
CM_ SG_ 1242 DET_MH_SCAN_INDEX_4LSB_361_364 "Scan index of the measured detection";
CM_ SG_ 1242 DET_MH_CYCLE_COUNTER_361_364 "Detection Alive Counter";
CM_ SG_ 1243 DET_RANGE_365 " measured position  of the detection";
CM_ SG_ 1243 DET_RANGE_ERR_365 "RMSE or standard deviation of the measured angle  of the detection";
CM_ SG_ 1243 DET_RANGE_VELOCITY_365 "Radial velocity of the detection positive in direction to the sensor";
CM_ SG_ 1243 DET_RANGE_VELOCITY_ERR_365 "RMSE or standard deviation of the measure radial velocity of the detection";
CM_ SG_ 1243 DET_AZIMUTH_365 "Measured angle  of the detection";
CM_ SG_ 1243 DET_AZIMUTH_ERR_365 "RMSE or standard deviation of the measured angle  of the detection";
CM_ SG_ 1243 DET_ELEVATION_365 "measured elevation of the detection";
CM_ SG_ 1243 DET_ELEVATION_ERR_365 "RMSE or standard deviation of the measured elevation  of the detection";
CM_ SG_ 1243 DET_RCS_365 "Radar Cross Section or Amplitude, is a measure of how detectable an object is by radar. A larger RCS indicates that an object is more easily detected.";
CM_ SG_ 1243 DET_VALID_FLAG_365 "is set if the measured detection is valid";
CM_ SG_ 1243 DET_BI_STATIC_FLAG_365 "1 if detection is bi-static 0 otherwise";
CM_ SG_ 1243 DET_SUPER_RES_TARGET_365 "flasg is set if the detection is super resolution target";
CM_ SG_ 1243 DET_SNR_365 "The signal to noise ratio (SNR) of the radar detection";
CM_ SG_ 1243 DET_POINT_TARGET_PROB_365 "Describes the possibility if more than one real-world object has led to this detection. 0[%] := 100[%] Multi target probability";
CM_ SG_ 1243 DET_EXISTENCE_PROB_365 "Existence probability of the detection not based on history. Value does  not depend on any past experience with similar detections.
\note Use as confidence measure where a low value means less confidence
and a high value indicates strong confidence.";
CM_ SG_ 1243 DET_OUTSIDE_SECTOR_365 "Flag to indicate detections outside the sector, set if the wrong sector calibration matrix was used";
CM_ SG_ 1243 DET_HVC_FLAG_365 "Core2 Vehicle clutter flag";
CM_ SG_ 1243 DET_CONFD_AZIMUTH_365 "Define the Confidence of Azimuth for Detection ";
CM_ SG_ 1243 DET_CONFD_ELEVATION_365 "Define the Confidence of Elevation for the Detection ";
CM_ SG_ 1243 DET_BI_STATIC_FLAG_366 "1 if detection is bi-static 0 otherwise";
CM_ SG_ 1243 DET_BI_STATIC_FLAG_367 "1 if detection is bi-static 0 otherwise";
CM_ SG_ 1243 DET_BI_STATIC_FLAG_368 "1 if detection is bi-static 0 otherwise";
CM_ SG_ 1243 DET_MH_SCAN_INDEX_4LSB_365_368 "Scan index of the measured detection";
CM_ SG_ 1243 DET_MH_CYCLE_COUNTER_365_368 "Detection Alive Counter";
CM_ SG_ 1244 DET_RANGE_369 " measured position  of the detection";
CM_ SG_ 1244 DET_RANGE_ERR_369 "RMSE or standard deviation of the measured angle  of the detection";
CM_ SG_ 1244 DET_RANGE_VELOCITY_369 "Radial velocity of the detection positive in direction to the sensor";
CM_ SG_ 1244 DET_RANGE_VELOCITY_ERR_369 "RMSE or standard deviation of the measure radial velocity of the detection";
CM_ SG_ 1244 DET_AZIMUTH_369 "Measured angle  of the detection";
CM_ SG_ 1244 DET_AZIMUTH_ERR_369 "RMSE or standard deviation of the measured angle  of the detection";
CM_ SG_ 1244 DET_ELEVATION_369 "measured elevation of the detection";
CM_ SG_ 1244 DET_ELEVATION_ERR_369 "RMSE or standard deviation of the measured elevation  of the detection";
CM_ SG_ 1244 DET_RCS_369 "Radar Cross Section or Amplitude, is a measure of how detectable an object is by radar. A larger RCS indicates that an object is more easily detected.";
CM_ SG_ 1244 DET_VALID_FLAG_369 "is set if the measured detection is valid";
CM_ SG_ 1244 DET_BI_STATIC_FLAG_369 "1 if detection is bi-static 0 otherwise";
CM_ SG_ 1244 DET_SUPER_RES_TARGET_369 "flasg is set if the detection is super resolution target";
CM_ SG_ 1244 DET_SNR_369 "The signal to noise ratio (SNR) of the radar detection";
CM_ SG_ 1244 DET_POINT_TARGET_PROB_369 "Describes the possibility if more than one real-world object has led to this detection. 0[%] := 100[%] Multi target probability";
CM_ SG_ 1244 DET_EXISTENCE_PROB_369 "Existence probability of the detection not based on history. Value does  not depend on any past experience with similar detections.
\note Use as confidence measure where a low value means less confidence
and a high value indicates strong confidence.";
CM_ SG_ 1244 DET_OUTSIDE_SECTOR_369 "Flag to indicate detections outside the sector, set if the wrong sector calibration matrix was used";
CM_ SG_ 1244 DET_HVC_FLAG_369 "Core2 Vehicle clutter flag";
CM_ SG_ 1244 DET_CONFD_AZIMUTH_369 "Define the Confidence of Azimuth for Detection ";
CM_ SG_ 1244 DET_CONFD_ELEVATION_369 "Define the Confidence of Elevation for the Detection ";
CM_ SG_ 1244 DET_BI_STATIC_FLAG_370 "1 if detection is bi-static 0 otherwise";
CM_ SG_ 1244 DET_BI_STATIC_FLAG_371 "1 if detection is bi-static 0 otherwise";
CM_ SG_ 1244 DET_BI_STATIC_FLAG_372 "1 if detection is bi-static 0 otherwise";
CM_ SG_ 1244 DET_MH_SCAN_INDEX_4LSB_369_372 "Scan index of the measured detection";
CM_ SG_ 1244 DET_MH_CYCLE_COUNTER_369_372 "Detection Alive Counter";
CM_ SG_ 1245 DET_RANGE_373 " measured position  of the detection";
CM_ SG_ 1245 DET_RANGE_ERR_373 "RMSE or standard deviation of the measured angle  of the detection";
CM_ SG_ 1245 DET_RANGE_VELOCITY_373 "Radial velocity of the detection positive in direction to the sensor";
CM_ SG_ 1245 DET_RANGE_VELOCITY_ERR_373 "RMSE or standard deviation of the measure radial velocity of the detection";
CM_ SG_ 1245 DET_AZIMUTH_373 "Measured angle  of the detection";
CM_ SG_ 1245 DET_AZIMUTH_ERR_373 "RMSE or standard deviation of the measured angle  of the detection";
CM_ SG_ 1245 DET_ELEVATION_373 "measured elevation of the detection";
CM_ SG_ 1245 DET_ELEVATION_ERR_373 "RMSE or standard deviation of the measured elevation  of the detection";
CM_ SG_ 1245 DET_RCS_373 "Radar Cross Section or Amplitude, is a measure of how detectable an object is by radar. A larger RCS indicates that an object is more easily detected.";
CM_ SG_ 1245 DET_VALID_FLAG_373 "is set if the measured detection is valid";
CM_ SG_ 1245 DET_BI_STATIC_FLAG_373 "1 if detection is bi-static 0 otherwise";
CM_ SG_ 1245 DET_SUPER_RES_TARGET_373 "flasg is set if the detection is super resolution target";
CM_ SG_ 1245 DET_SNR_373 "The signal to noise ratio (SNR) of the radar detection";
CM_ SG_ 1245 DET_POINT_TARGET_PROB_373 "Describes the possibility if more than one real-world object has led to this detection. 0[%] := 100[%] Multi target probability";
CM_ SG_ 1245 DET_EXISTENCE_PROB_373 "Existence probability of the detection not based on history. Value does  not depend on any past experience with similar detections.
\note Use as confidence measure where a low value means less confidence
and a high value indicates strong confidence.";
CM_ SG_ 1245 DET_OUTSIDE_SECTOR_373 "Flag to indicate detections outside the sector, set if the wrong sector calibration matrix was used";
CM_ SG_ 1245 DET_HVC_FLAG_373 "Core2 Vehicle clutter flag";
CM_ SG_ 1245 DET_CONFD_AZIMUTH_373 "Define the Confidence of Azimuth for Detection ";
CM_ SG_ 1245 DET_CONFD_ELEVATION_373 "Define the Confidence of Elevation for the Detection ";
CM_ SG_ 1245 DET_BI_STATIC_FLAG_374 "1 if detection is bi-static 0 otherwise";
CM_ SG_ 1245 DET_BI_STATIC_FLAG_375 "1 if detection is bi-static 0 otherwise";
CM_ SG_ 1245 DET_BI_STATIC_FLAG_376 "1 if detection is bi-static 0 otherwise";
CM_ SG_ 1245 DET_MH_SCAN_INDEX_4LSB_373_376 "Scan index of the measured detection";
CM_ SG_ 1245 DET_MH_CYCLE_COUNTER_373_376 "Detection Alive Counter";
CM_ SG_ 1246 DET_RANGE_377 " measured position  of the detection";
CM_ SG_ 1246 DET_RANGE_ERR_377 "RMSE or standard deviation of the measured angle  of the detection";
CM_ SG_ 1246 DET_RANGE_VELOCITY_377 "Radial velocity of the detection positive in direction to the sensor";
CM_ SG_ 1246 DET_RANGE_VELOCITY_ERR_377 "RMSE or standard deviation of the measure radial velocity of the detection";
CM_ SG_ 1246 DET_AZIMUTH_377 "Measured angle  of the detection";
CM_ SG_ 1246 DET_AZIMUTH_ERR_377 "RMSE or standard deviation of the measured angle  of the detection";
CM_ SG_ 1246 DET_ELEVATION_377 "measured elevation of the detection";
CM_ SG_ 1246 DET_ELEVATION_ERR_377 "RMSE or standard deviation of the measured elevation  of the detection";
CM_ SG_ 1246 DET_RCS_377 "Radar Cross Section or Amplitude, is a measure of how detectable an object is by radar. A larger RCS indicates that an object is more easily detected.";
CM_ SG_ 1246 DET_VALID_FLAG_377 "is set if the measured detection is valid";
CM_ SG_ 1246 DET_BI_STATIC_FLAG_377 "1 if detection is bi-static 0 otherwise";
CM_ SG_ 1246 DET_SUPER_RES_TARGET_377 "flasg is set if the detection is super resolution target";
CM_ SG_ 1246 DET_SNR_377 "The signal to noise ratio (SNR) of the radar detection";
CM_ SG_ 1246 DET_POINT_TARGET_PROB_377 "Describes the possibility if more than one real-world object has led to this detection. 0[%] := 100[%] Multi target probability";
CM_ SG_ 1246 DET_EXISTENCE_PROB_377 "Existence probability of the detection not based on history. Value does  not depend on any past experience with similar detections.
\note Use as confidence measure where a low value means less confidence
and a high value indicates strong confidence.";
CM_ SG_ 1246 DET_OUTSIDE_SECTOR_377 "Flag to indicate detections outside the sector, set if the wrong sector calibration matrix was used";
CM_ SG_ 1246 DET_HVC_FLAG_377 "Core2 Vehicle clutter flag";
CM_ SG_ 1246 DET_CONFD_AZIMUTH_377 "Define the Confidence of Azimuth for Detection ";
CM_ SG_ 1246 DET_CONFD_ELEVATION_377 "Define the Confidence of Elevation for the Detection ";
CM_ SG_ 1246 DET_BI_STATIC_FLAG_378 "1 if detection is bi-static 0 otherwise";
CM_ SG_ 1246 DET_BI_STATIC_FLAG_379 "1 if detection is bi-static 0 otherwise";
CM_ SG_ 1246 DET_BI_STATIC_FLAG_380 "1 if detection is bi-static 0 otherwise";
CM_ SG_ 1246 DET_MH_SCAN_INDEX_4LSB_377_380 "Scan index of the measured detection";
CM_ SG_ 1246 DET_MH_CYCLE_COUNTER_377_380 "Detection Alive Counter";
CM_ SG_ 1247 DET_RANGE_381 " measured position  of the detection";
CM_ SG_ 1247 DET_RANGE_ERR_381 "RMSE or standard deviation of the measured angle  of the detection";
CM_ SG_ 1247 DET_RANGE_VELOCITY_381 "Radial velocity of the detection positive in direction to the sensor";
CM_ SG_ 1247 DET_RANGE_VELOCITY_ERR_381 "RMSE or standard deviation of the measure radial velocity of the detection";
CM_ SG_ 1247 DET_AZIMUTH_381 "Measured angle  of the detection";
CM_ SG_ 1247 DET_AZIMUTH_ERR_381 "RMSE or standard deviation of the measured angle  of the detection";
CM_ SG_ 1247 DET_ELEVATION_381 "measured elevation of the detection";
CM_ SG_ 1247 DET_ELEVATION_ERR_381 "RMSE or standard deviation of the measured elevation  of the detection";
CM_ SG_ 1247 DET_RCS_381 "Radar Cross Section or Amplitude, is a measure of how detectable an object is by radar. A larger RCS indicates that an object is more easily detected.";
CM_ SG_ 1247 DET_VALID_FLAG_381 "is set if the measured detection is valid";
CM_ SG_ 1247 DET_BI_STATIC_FLAG_381 "1 if detection is bi-static 0 otherwise";
CM_ SG_ 1247 DET_SUPER_RES_TARGET_381 "flasg is set if the detection is super resolution target";
CM_ SG_ 1247 DET_SNR_381 "The signal to noise ratio (SNR) of the radar detection";
CM_ SG_ 1247 DET_POINT_TARGET_PROB_381 "Describes the possibility if more than one real-world object has led to this detection. 0[%] := 100[%] Multi target probability";
CM_ SG_ 1247 DET_EXISTENCE_PROB_381 "Existence probability of the detection not based on history. Value does  not depend on any past experience with similar detections.
\note Use as confidence measure where a low value means less confidence
and a high value indicates strong confidence.";
CM_ SG_ 1247 DET_OUTSIDE_SECTOR_381 "Flag to indicate detections outside the sector, set if the wrong sector calibration matrix was used";
CM_ SG_ 1247 DET_HVC_FLAG_381 "Core2 Vehicle clutter flag";
CM_ SG_ 1247 DET_CONFD_AZIMUTH_381 "Define the Confidence of Azimuth for Detection ";
CM_ SG_ 1247 DET_CONFD_ELEVATION_381 "Define the Confidence of Elevation for the Detection ";
CM_ SG_ 1247 DET_BI_STATIC_FLAG_382 "1 if detection is bi-static 0 otherwise";
CM_ SG_ 1247 DET_BI_STATIC_FLAG_383 "1 if detection is bi-static 0 otherwise";
CM_ SG_ 1247 DET_BI_STATIC_FLAG_384 "1 if detection is bi-static 0 otherwise";
CM_ SG_ 1247 DET_MH_SCAN_INDEX_4LSB_381_384 "Scan index of the measured detection";
CM_ SG_ 1247 DET_MH_CYCLE_COUNTER_381_384 "Detection Alive Counter";
CM_ SG_ 1248 DET_RANGE_385 " measured position  of the detection";
CM_ SG_ 1248 DET_RANGE_ERR_385 "RMSE or standard deviation of the measured angle  of the detection";
CM_ SG_ 1248 DET_RANGE_VELOCITY_385 "Radial velocity of the detection positive in direction to the sensor";
CM_ SG_ 1248 DET_RANGE_VELOCITY_ERR_385 "RMSE or standard deviation of the measure radial velocity of the detection";
CM_ SG_ 1248 DET_AZIMUTH_385 "Measured angle  of the detection";
CM_ SG_ 1248 DET_AZIMUTH_ERR_385 "RMSE or standard deviation of the measured angle  of the detection";
CM_ SG_ 1248 DET_ELEVATION_385 "measured elevation of the detection";
CM_ SG_ 1248 DET_ELEVATION_ERR_385 "RMSE or standard deviation of the measured elevation  of the detection";
CM_ SG_ 1248 DET_RCS_385 "Radar Cross Section or Amplitude, is a measure of how detectable an object is by radar. A larger RCS indicates that an object is more easily detected.";
CM_ SG_ 1248 DET_VALID_FLAG_385 "is set if the measured detection is valid";
CM_ SG_ 1248 DET_BI_STATIC_FLAG_385 "1 if detection is bi-static 0 otherwise";
CM_ SG_ 1248 DET_SUPER_RES_TARGET_385 "flasg is set if the detection is super resolution target";
CM_ SG_ 1248 DET_SNR_385 "The signal to noise ratio (SNR) of the radar detection";
CM_ SG_ 1248 DET_POINT_TARGET_PROB_385 "Describes the possibility if more than one real-world object has led to this detection. 0[%] := 100[%] Multi target probability";
CM_ SG_ 1248 DET_EXISTENCE_PROB_385 "Existence probability of the detection not based on history. Value does  not depend on any past experience with similar detections.
\note Use as confidence measure where a low value means less confidence
and a high value indicates strong confidence.";
CM_ SG_ 1248 DET_OUTSIDE_SECTOR_385 "Flag to indicate detections outside the sector, set if the wrong sector calibration matrix was used";
CM_ SG_ 1248 DET_HVC_FLAG_385 "Core2 Vehicle clutter flag";
CM_ SG_ 1248 DET_CONFD_AZIMUTH_385 "Define the Confidence of Azimuth for Detection ";
CM_ SG_ 1248 DET_CONFD_ELEVATION_385 "Define the Confidence of Elevation for the Detection ";
CM_ SG_ 1248 DET_BI_STATIC_FLAG_386 "1 if detection is bi-static 0 otherwise";
CM_ SG_ 1248 DET_BI_STATIC_FLAG_387 "1 if detection is bi-static 0 otherwise";
CM_ SG_ 1248 DET_BI_STATIC_FLAG_388 "1 if detection is bi-static 0 otherwise";
CM_ SG_ 1248 DET_MH_SCAN_INDEX_4LSB_385_388 "Scan index of the measured detection";
CM_ SG_ 1248 DET_MH_CYCLE_COUNTER_385_388 "Detection Alive Counter";
CM_ SG_ 1249 DET_RANGE_389 " measured position  of the detection";
CM_ SG_ 1249 DET_RANGE_ERR_389 "RMSE or standard deviation of the measured angle  of the detection";
CM_ SG_ 1249 DET_RANGE_VELOCITY_389 "Radial velocity of the detection positive in direction to the sensor";
CM_ SG_ 1249 DET_RANGE_VELOCITY_ERR_389 "RMSE or standard deviation of the measure radial velocity of the detection";
CM_ SG_ 1249 DET_AZIMUTH_389 "Measured angle  of the detection";
CM_ SG_ 1249 DET_AZIMUTH_ERR_389 "RMSE or standard deviation of the measured angle  of the detection";
CM_ SG_ 1249 DET_ELEVATION_389 "measured elevation of the detection";
CM_ SG_ 1249 DET_ELEVATION_ERR_389 "RMSE or standard deviation of the measured elevation  of the detection";
CM_ SG_ 1249 DET_RCS_389 "Radar Cross Section or Amplitude, is a measure of how detectable an object is by radar. A larger RCS indicates that an object is more easily detected.";
CM_ SG_ 1249 DET_VALID_FLAG_389 "is set if the measured detection is valid";
CM_ SG_ 1249 DET_BI_STATIC_FLAG_389 "1 if detection is bi-static 0 otherwise";
CM_ SG_ 1249 DET_SUPER_RES_TARGET_389 "flasg is set if the detection is super resolution target";
CM_ SG_ 1249 DET_SNR_389 "The signal to noise ratio (SNR) of the radar detection";
CM_ SG_ 1249 DET_POINT_TARGET_PROB_389 "Describes the possibility if more than one real-world object has led to this detection. 0[%] := 100[%] Multi target probability";
CM_ SG_ 1249 DET_EXISTENCE_PROB_389 "Existence probability of the detection not based on history. Value does  not depend on any past experience with similar detections.
\note Use as confidence measure where a low value means less confidence
and a high value indicates strong confidence.";
CM_ SG_ 1249 DET_OUTSIDE_SECTOR_389 "Flag to indicate detections outside the sector, set if the wrong sector calibration matrix was used";
CM_ SG_ 1249 DET_HVC_FLAG_389 "Core2 Vehicle clutter flag";
CM_ SG_ 1249 DET_CONFD_AZIMUTH_389 "Define the Confidence of Azimuth for Detection ";
CM_ SG_ 1249 DET_CONFD_ELEVATION_389 "Define the Confidence of Elevation for the Detection ";
CM_ SG_ 1249 DET_BI_STATIC_FLAG_390 "1 if detection is bi-static 0 otherwise";
CM_ SG_ 1249 DET_BI_STATIC_FLAG_391 "1 if detection is bi-static 0 otherwise";
CM_ SG_ 1249 DET_BI_STATIC_FLAG_392 "1 if detection is bi-static 0 otherwise";
CM_ SG_ 1249 DET_MH_SCAN_INDEX_4LSB_389_392 "Scan index of the measured detection";
CM_ SG_ 1249 DET_MH_CYCLE_COUNTER_389_392 "Detection Alive Counter";
CM_ SG_ 1250 DET_RANGE_393 " measured position  of the detection";
CM_ SG_ 1250 DET_RANGE_ERR_393 "RMSE or standard deviation of the measured angle  of the detection";
CM_ SG_ 1250 DET_RANGE_VELOCITY_393 "Radial velocity of the detection positive in direction to the sensor";
CM_ SG_ 1250 DET_RANGE_VELOCITY_ERR_393 "RMSE or standard deviation of the measure radial velocity of the detection";
CM_ SG_ 1250 DET_AZIMUTH_393 "Measured angle  of the detection";
CM_ SG_ 1250 DET_AZIMUTH_ERR_393 "RMSE or standard deviation of the measured angle  of the detection";
CM_ SG_ 1250 DET_ELEVATION_393 "measured elevation of the detection";
CM_ SG_ 1250 DET_ELEVATION_ERR_393 "RMSE or standard deviation of the measured elevation  of the detection";
CM_ SG_ 1250 DET_RCS_393 "Radar Cross Section or Amplitude, is a measure of how detectable an object is by radar. A larger RCS indicates that an object is more easily detected.";
CM_ SG_ 1250 DET_VALID_FLAG_393 "is set if the measured detection is valid";
CM_ SG_ 1250 DET_BI_STATIC_FLAG_393 "1 if detection is bi-static 0 otherwise";
CM_ SG_ 1250 DET_SUPER_RES_TARGET_393 "flasg is set if the detection is super resolution target";
CM_ SG_ 1250 DET_SNR_393 "The signal to noise ratio (SNR) of the radar detection";
CM_ SG_ 1250 DET_POINT_TARGET_PROB_393 "Describes the possibility if more than one real-world object has led to this detection. 0[%] := 100[%] Multi target probability";
CM_ SG_ 1250 DET_EXISTENCE_PROB_393 "Existence probability of the detection not based on history. Value does  not depend on any past experience with similar detections.
\note Use as confidence measure where a low value means less confidence
and a high value indicates strong confidence.";
CM_ SG_ 1250 DET_OUTSIDE_SECTOR_393 "Flag to indicate detections outside the sector, set if the wrong sector calibration matrix was used";
CM_ SG_ 1250 DET_HVC_FLAG_393 "Core2 Vehicle clutter flag";
CM_ SG_ 1250 DET_CONFD_AZIMUTH_393 "Define the Confidence of Azimuth for Detection ";
CM_ SG_ 1250 DET_CONFD_ELEVATION_393 "Define the Confidence of Elevation for the Detection ";
CM_ SG_ 1250 DET_BI_STATIC_FLAG_394 "1 if detection is bi-static 0 otherwise";
CM_ SG_ 1250 DET_BI_STATIC_FLAG_395 "1 if detection is bi-static 0 otherwise";
CM_ SG_ 1250 DET_BI_STATIC_FLAG_396 "1 if detection is bi-static 0 otherwise";
CM_ SG_ 1250 DET_MH_SCAN_INDEX_4LSB_393_396 "Scan index of the measured detection";
CM_ SG_ 1250 DET_MH_CYCLE_COUNTER_393_396 "Detection Alive Counter";
CM_ SG_ 1251 DET_RANGE_397 " measured position  of the detection";
CM_ SG_ 1251 DET_RANGE_ERR_397 "RMSE or standard deviation of the measured angle  of the detection";
CM_ SG_ 1251 DET_RANGE_VELOCITY_397 "Radial velocity of the detection positive in direction to the sensor";
CM_ SG_ 1251 DET_RANGE_VELOCITY_ERR_397 "RMSE or standard deviation of the measure radial velocity of the detection";
CM_ SG_ 1251 DET_AZIMUTH_397 "Measured angle  of the detection";
CM_ SG_ 1251 DET_AZIMUTH_ERR_397 "RMSE or standard deviation of the measured angle  of the detection";
CM_ SG_ 1251 DET_ELEVATION_397 "measured elevation of the detection";
CM_ SG_ 1251 DET_ELEVATION_ERR_397 "RMSE or standard deviation of the measured elevation  of the detection";
CM_ SG_ 1251 DET_RCS_397 "Radar Cross Section or Amplitude, is a measure of how detectable an object is by radar. A larger RCS indicates that an object is more easily detected.";
CM_ SG_ 1251 DET_VALID_FLAG_397 "is set if the measured detection is valid";
CM_ SG_ 1251 DET_BI_STATIC_FLAG_397 "1 if detection is bi-static 0 otherwise";
CM_ SG_ 1251 DET_SUPER_RES_TARGET_397 "flasg is set if the detection is super resolution target";
CM_ SG_ 1251 DET_SNR_397 "The signal to noise ratio (SNR) of the radar detection";
CM_ SG_ 1251 DET_POINT_TARGET_PROB_397 "Describes the possibility if more than one real-world object has led to this detection. 0[%] := 100[%] Multi target probability";
CM_ SG_ 1251 DET_EXISTENCE_PROB_397 "Existence probability of the detection not based on history. Value does  not depend on any past experience with similar detections.
\note Use as confidence measure where a low value means less confidence
and a high value indicates strong confidence.";
CM_ SG_ 1251 DET_OUTSIDE_SECTOR_397 "Flag to indicate detections outside the sector, set if the wrong sector calibration matrix was used";
CM_ SG_ 1251 DET_HVC_FLAG_397 "Core2 Vehicle clutter flag";
CM_ SG_ 1251 DET_CONFD_AZIMUTH_397 "Define the Confidence of Azimuth for Detection ";
CM_ SG_ 1251 DET_CONFD_ELEVATION_397 "Define the Confidence of Elevation for the Detection ";
CM_ SG_ 1251 DET_BI_STATIC_FLAG_398 "1 if detection is bi-static 0 otherwise";
CM_ SG_ 1251 DET_BI_STATIC_FLAG_399 "1 if detection is bi-static 0 otherwise";
CM_ SG_ 1251 DET_BI_STATIC_FLAG_400 "1 if detection is bi-static 0 otherwise";
CM_ SG_ 1251 DET_MH_SCAN_INDEX_4LSB_397_400 "Scan index of the measured detection";
CM_ SG_ 1251 DET_MH_CYCLE_COUNTER_397_400 "Detection Alive Counter";

BA_DEF_ BO_ "CanTpBs" INT 0 255;
BA_DEF_ BO_ "DiagRequest" ENUM  "No","Yes";
BA_DEF_ BO_ "DiagResponse" ENUM  "No","Yes";
BA_DEF_ BO_ "EventRateOfChange" INT 10 10000;
BA_DEF_ BO_ "GenMsgCycleTime" INT 0 100000;
BA_DEF_ BO_ "GenMsgILSupport" ENUM  "No","Yes";
BA_DEF_ BO_ "GenMsgNrOfRepetition" INT 0 100;
BA_DEF_ BO_ "GenMsgSendType" ENUM  "FixedPeriodic","Event","EnabledPeriodic","NotUsed","NotUsed","EventPeriodic","NotUsed","NotUsed","NoMsgSendType";
BA_DEF_ BO_ "NetworkInitialization" ENUM  "No","Yes";
BA_DEF_ BO_ "NmAsrMessage" ENUM  "No","Yes";
BA_DEF_ BO_ "NmMessage" ENUM  "No","Yes";
BA_DEF_ BO_ "VFrameFormat" ENUM  "StandardCAN","ExtendedCAN","reserved","reserved","reserved","reserved","reserved","reserved","reserved","reserved","reserved","reserved","reserved","reserved","StandardCAN_FD","ExtendedCAN_FD";
BA_DEF_ SG_ "GenSigCmt" STRING;
BA_DEF_ SG_ "GenSigCycleTime" INT 0 0;
BA_DEF_ SG_ "GenSigSendType" ENUM  "Cyclic","OnWrite","vector_leerstring","OnChange","vector_leerstring","IfActive","vector_leerstring","NoSigSendType";
BA_DEF_ SG_ "GenSigStartValue" INT 0 1000000000;
BA_DEF_ SG_ "GenSigTimeoutTime" INT 0 0;
BA_DEF_ SG_ "GenSigVtEn" STRING;
BA_DEF_ SG_ "GenSigVtName" STRING;
BA_DEF_ SG_ "InvalidValue" STRING;
BA_DEF_DEF_ "CanTpBs" 255;
BA_DEF_DEF_ "DiagRequest" "No";
BA_DEF_DEF_ "DiagResponse" "No";
BA_DEF_DEF_ "EventRateOfChange" 10000;
BA_DEF_DEF_ "GenMsgCycleTime" 0;
BA_DEF_DEF_ "GenMsgILSupport" "Yes";
BA_DEF_DEF_ "GenMsgNrOfRepetition" 0;
BA_DEF_DEF_ "GenMsgSendType" "NoMsgSendType";
BA_DEF_DEF_ "GenSigCmt" "";
BA_DEF_DEF_ "GenSigCycleTime" 0;
BA_DEF_DEF_ "GenSigSendType" "NoSigSendType";
BA_DEF_DEF_ "GenSigStartValue" 0;
BA_DEF_DEF_ "GenSigTimeoutTime" 0;
BA_DEF_DEF_ "GenSigVtEn" "";
BA_DEF_DEF_ "GenSigVtName" "";
BA_DEF_DEF_ "InvalidValue" "";
BA_DEF_DEF_ "NetworkInitialization" "Yes";
BA_DEF_DEF_ "NmAsrMessage" "No";
BA_DEF_DEF_ "NmMessage" "No";
BA_DEF_DEF_ "VFrameFormat" "StandardCAN_FD";
BA_ "GenMsgSendType" BO_ 1234 1;
BA_ "GenMsgSendType" BO_ 1235 1;
BA_ "GenMsgSendType" BO_ 1236 1;
BA_ "GenMsgSendType" BO_ 1237 1;
BA_ "GenMsgSendType" BO_ 1238 1;
BA_ "GenMsgSendType" BO_ 1239 1;
BA_ "GenMsgSendType" BO_ 1240 1;
BA_ "GenMsgSendType" BO_ 1241 1;
BA_ "GenMsgSendType" BO_ 1242 1;
BA_ "GenMsgSendType" BO_ 1243 1;
BA_ "GenMsgSendType" BO_ 1244 1;
BA_ "GenMsgSendType" BO_ 1245 1;
BA_ "GenMsgSendType" BO_ 1246 1;
BA_ "GenMsgSendType" BO_ 1247 1;
BA_ "GenMsgSendType" BO_ 1248 1;
BA_ "GenMsgSendType" BO_ 1249 1;
BA_ "GenMsgSendType" BO_ 1250 1;
BA_ "GenMsgSendType" BO_ 1251 1;
BA_ "GenSigStartValue" SG_ 1234 DET_RANGE_VELOCITY_329 16384;
BA_ "GenSigStartValue" SG_ 1234 DET_RCS_329 128;
BA_ "GenSigStartValue" SG_ 1234 DET_RANGE_VELOCITY_330 16384;
BA_ "GenSigStartValue" SG_ 1234 DET_RCS_330 128;
BA_ "GenSigStartValue" SG_ 1234 DET_RANGE_VELOCITY_331 16384;
BA_ "GenSigStartValue" SG_ 1234 DET_RCS_331 128;
BA_ "GenSigStartValue" SG_ 1234 DET_RANGE_VELOCITY_332 16384;
BA_ "GenSigStartValue" SG_ 1234 DET_RCS_332 128;
BA_ "GenSigStartValue" SG_ 1235 DET_RANGE_VELOCITY_333 16384;
BA_ "GenSigStartValue" SG_ 1235 DET_RCS_333 128;
BA_ "GenSigStartValue" SG_ 1235 DET_RANGE_VELOCITY_334 16384;
BA_ "GenSigStartValue" SG_ 1235 DET_RCS_334 128;
BA_ "GenSigStartValue" SG_ 1235 DET_RANGE_VELOCITY_335 16384;
BA_ "GenSigStartValue" SG_ 1235 DET_RCS_335 128;
BA_ "GenSigStartValue" SG_ 1235 DET_RANGE_VELOCITY_336 16384;
BA_ "GenSigStartValue" SG_ 1235 DET_RCS_336 128;
BA_ "GenSigStartValue" SG_ 1236 DET_RANGE_VELOCITY_337 16384;
BA_ "GenSigStartValue" SG_ 1236 DET_RCS_337 128;
BA_ "GenSigStartValue" SG_ 1236 DET_RANGE_VELOCITY_338 16384;
BA_ "GenSigStartValue" SG_ 1236 DET_RCS_338 128;
BA_ "GenSigStartValue" SG_ 1236 DET_RANGE_VELOCITY_339 16384;
BA_ "GenSigStartValue" SG_ 1236 DET_RCS_339 128;
BA_ "GenSigStartValue" SG_ 1236 DET_RANGE_VELOCITY_340 16384;
BA_ "GenSigStartValue" SG_ 1236 DET_RCS_340 128;
BA_ "GenSigStartValue" SG_ 1237 DET_RANGE_VELOCITY_341 16384;
BA_ "GenSigStartValue" SG_ 1237 DET_RCS_341 128;
BA_ "GenSigStartValue" SG_ 1237 DET_RANGE_VELOCITY_342 16384;
BA_ "GenSigStartValue" SG_ 1237 DET_RCS_342 128;
BA_ "GenSigStartValue" SG_ 1237 DET_RANGE_VELOCITY_343 16384;
BA_ "GenSigStartValue" SG_ 1237 DET_RCS_343 128;
BA_ "GenSigStartValue" SG_ 1237 DET_RANGE_VELOCITY_344 16384;
BA_ "GenSigStartValue" SG_ 1237 DET_RCS_344 128;
BA_ "GenSigStartValue" SG_ 1238 DET_RANGE_VELOCITY_345 16384;
BA_ "GenSigStartValue" SG_ 1238 DET_RCS_345 128;
BA_ "GenSigStartValue" SG_ 1238 DET_RANGE_VELOCITY_346 16384;
BA_ "GenSigStartValue" SG_ 1238 DET_RCS_346 128;
BA_ "GenSigStartValue" SG_ 1238 DET_RANGE_VELOCITY_347 16384;
BA_ "GenSigStartValue" SG_ 1238 DET_RCS_347 128;
BA_ "GenSigStartValue" SG_ 1238 DET_RANGE_VELOCITY_348 16384;
BA_ "GenSigStartValue" SG_ 1238 DET_RCS_348 128;
BA_ "GenSigStartValue" SG_ 1239 DET_RANGE_VELOCITY_349 16384;
BA_ "GenSigStartValue" SG_ 1239 DET_RCS_349 128;
BA_ "GenSigStartValue" SG_ 1239 DET_RANGE_VELOCITY_350 16384;
BA_ "GenSigStartValue" SG_ 1239 DET_RCS_350 128;
BA_ "GenSigStartValue" SG_ 1239 DET_RANGE_VELOCITY_351 16384;
BA_ "GenSigStartValue" SG_ 1239 DET_RCS_351 128;
BA_ "GenSigStartValue" SG_ 1239 DET_RANGE_VELOCITY_352 16384;
BA_ "GenSigStartValue" SG_ 1239 DET_RCS_352 128;
BA_ "GenSigStartValue" SG_ 1240 DET_RANGE_VELOCITY_353 16384;
BA_ "GenSigStartValue" SG_ 1240 DET_RCS_353 128;
BA_ "GenSigStartValue" SG_ 1240 DET_RANGE_VELOCITY_354 16384;
BA_ "GenSigStartValue" SG_ 1240 DET_RCS_354 128;
BA_ "GenSigStartValue" SG_ 1240 DET_RANGE_VELOCITY_355 16384;
BA_ "GenSigStartValue" SG_ 1240 DET_RCS_355 128;
BA_ "GenSigStartValue" SG_ 1240 DET_RANGE_VELOCITY_356 16384;
BA_ "GenSigStartValue" SG_ 1240 DET_RCS_356 128;
BA_ "GenSigStartValue" SG_ 1241 DET_RANGE_VELOCITY_357 16384;
BA_ "GenSigStartValue" SG_ 1241 DET_RCS_357 128;
BA_ "GenSigStartValue" SG_ 1241 DET_RANGE_VELOCITY_358 16384;
BA_ "GenSigStartValue" SG_ 1241 DET_RCS_358 128;
BA_ "GenSigStartValue" SG_ 1241 DET_RANGE_VELOCITY_359 16384;
BA_ "GenSigStartValue" SG_ 1241 DET_RCS_359 128;
BA_ "GenSigStartValue" SG_ 1241 DET_RANGE_VELOCITY_360 16384;
BA_ "GenSigStartValue" SG_ 1241 DET_RCS_360 128;
BA_ "GenSigStartValue" SG_ 1242 DET_RANGE_VELOCITY_361 16384;
BA_ "GenSigStartValue" SG_ 1242 DET_RCS_361 128;
BA_ "GenSigStartValue" SG_ 1242 DET_RANGE_VELOCITY_362 16384;
BA_ "GenSigStartValue" SG_ 1242 DET_RCS_362 128;
BA_ "GenSigStartValue" SG_ 1242 DET_RANGE_VELOCITY_363 16384;
BA_ "GenSigStartValue" SG_ 1242 DET_RCS_363 128;
BA_ "GenSigStartValue" SG_ 1242 DET_RANGE_VELOCITY_364 16384;
BA_ "GenSigStartValue" SG_ 1242 DET_RCS_364 128;
BA_ "GenSigStartValue" SG_ 1243 DET_RANGE_VELOCITY_365 16384;
BA_ "GenSigStartValue" SG_ 1243 DET_RCS_365 128;
BA_ "GenSigStartValue" SG_ 1243 DET_RANGE_VELOCITY_366 16384;
BA_ "GenSigStartValue" SG_ 1243 DET_RCS_366 128;
BA_ "GenSigStartValue" SG_ 1243 DET_RANGE_VELOCITY_367 16384;
BA_ "GenSigStartValue" SG_ 1243 DET_RCS_367 128;
BA_ "GenSigStartValue" SG_ 1243 DET_RANGE_VELOCITY_368 16384;
BA_ "GenSigStartValue" SG_ 1243 DET_RCS_368 128;
BA_ "GenSigStartValue" SG_ 1244 DET_RANGE_VELOCITY_369 16384;
BA_ "GenSigStartValue" SG_ 1244 DET_RCS_369 128;
BA_ "GenSigStartValue" SG_ 1244 DET_RANGE_VELOCITY_370 16384;
BA_ "GenSigStartValue" SG_ 1244 DET_RCS_370 128;
BA_ "GenSigStartValue" SG_ 1244 DET_RANGE_VELOCITY_371 16384;
BA_ "GenSigStartValue" SG_ 1244 DET_RCS_371 128;
BA_ "GenSigStartValue" SG_ 1244 DET_RANGE_VELOCITY_372 16384;
BA_ "GenSigStartValue" SG_ 1244 DET_RCS_372 128;
BA_ "GenSigStartValue" SG_ 1245 DET_RANGE_VELOCITY_373 16384;
BA_ "GenSigStartValue" SG_ 1245 DET_RCS_373 128;
BA_ "GenSigStartValue" SG_ 1245 DET_RANGE_VELOCITY_374 16384;
BA_ "GenSigStartValue" SG_ 1245 DET_RCS_374 128;
BA_ "GenSigStartValue" SG_ 1245 DET_RANGE_VELOCITY_375 16384;
BA_ "GenSigStartValue" SG_ 1245 DET_RCS_375 128;
BA_ "GenSigStartValue" SG_ 1245 DET_RANGE_VELOCITY_376 16384;
BA_ "GenSigStartValue" SG_ 1245 DET_RCS_376 128;
BA_ "GenSigStartValue" SG_ 1246 DET_RANGE_VELOCITY_377 16384;
BA_ "GenSigStartValue" SG_ 1246 DET_RCS_377 128;
BA_ "GenSigStartValue" SG_ 1246 DET_RANGE_VELOCITY_378 16384;
BA_ "GenSigStartValue" SG_ 1246 DET_RCS_378 128;
BA_ "GenSigStartValue" SG_ 1246 DET_RANGE_VELOCITY_379 16384;
BA_ "GenSigStartValue" SG_ 1246 DET_RCS_379 128;
BA_ "GenSigStartValue" SG_ 1246 DET_RANGE_VELOCITY_380 16384;
BA_ "GenSigStartValue" SG_ 1246 DET_RCS_380 128;
BA_ "GenSigStartValue" SG_ 1247 DET_RANGE_VELOCITY_381 16384;
BA_ "GenSigStartValue" SG_ 1247 DET_RCS_381 128;
BA_ "GenSigStartValue" SG_ 1247 DET_RANGE_VELOCITY_382 16384;
BA_ "GenSigStartValue" SG_ 1247 DET_RCS_382 128;
BA_ "GenSigStartValue" SG_ 1247 DET_RANGE_VELOCITY_383 16384;
BA_ "GenSigStartValue" SG_ 1247 DET_RCS_383 128;
BA_ "GenSigStartValue" SG_ 1247 DET_RANGE_VELOCITY_384 16384;
BA_ "GenSigStartValue" SG_ 1247 DET_RCS_384 128;
BA_ "GenSigStartValue" SG_ 1248 DET_RANGE_VELOCITY_385 16384;
BA_ "GenSigStartValue" SG_ 1248 DET_RCS_385 128;
BA_ "GenSigStartValue" SG_ 1248 DET_RANGE_VELOCITY_386 16384;
BA_ "GenSigStartValue" SG_ 1248 DET_RCS_386 128;
BA_ "GenSigStartValue" SG_ 1248 DET_RANGE_VELOCITY_387 16384;
BA_ "GenSigStartValue" SG_ 1248 DET_RCS_387 128;
BA_ "GenSigStartValue" SG_ 1248 DET_RANGE_VELOCITY_388 16384;
BA_ "GenSigStartValue" SG_ 1248 DET_RCS_388 128;
BA_ "GenSigStartValue" SG_ 1249 DET_RANGE_VELOCITY_389 16384;
BA_ "GenSigStartValue" SG_ 1249 DET_RCS_389 128;
BA_ "GenSigStartValue" SG_ 1249 DET_RANGE_VELOCITY_390 16384;
BA_ "GenSigStartValue" SG_ 1249 DET_RCS_390 128;
BA_ "GenSigStartValue" SG_ 1249 DET_RANGE_VELOCITY_391 16384;
BA_ "GenSigStartValue" SG_ 1249 DET_RCS_391 128;
BA_ "GenSigStartValue" SG_ 1249 DET_RANGE_VELOCITY_392 16384;
BA_ "GenSigStartValue" SG_ 1249 DET_RCS_392 128;
BA_ "GenSigStartValue" SG_ 1250 DET_RANGE_VELOCITY_393 16384;
BA_ "GenSigStartValue" SG_ 1250 DET_RCS_393 128;
BA_ "GenSigStartValue" SG_ 1250 DET_RANGE_VELOCITY_394 16384;
BA_ "GenSigStartValue" SG_ 1250 DET_RCS_394 128;
BA_ "GenSigStartValue" SG_ 1250 DET_RANGE_VELOCITY_395 16384;
BA_ "GenSigStartValue" SG_ 1250 DET_RCS_395 128;
BA_ "GenSigStartValue" SG_ 1250 DET_RANGE_VELOCITY_396 16384;
BA_ "GenSigStartValue" SG_ 1250 DET_RCS_396 128;
BA_ "GenSigStartValue" SG_ 1251 DET_RANGE_VELOCITY_397 16384;
BA_ "GenSigStartValue" SG_ 1251 DET_RCS_397 128;
BA_ "GenSigStartValue" SG_ 1251 DET_RANGE_VELOCITY_398 16384;
BA_ "GenSigStartValue" SG_ 1251 DET_RCS_398 128;
BA_ "GenSigStartValue" SG_ 1251 DET_RANGE_VELOCITY_399 16384;
BA_ "GenSigStartValue" SG_ 1251 DET_RCS_399 128;
BA_ "GenSigStartValue" SG_ 1251 DET_RANGE_VELOCITY_400 16384;
BA_ "GenSigStartValue" SG_ 1251 DET_RCS_400 128;
VAL_ 1234 DET_CONFD_AZIMUTH_329 0 "High" 1 "MidHigh" 2 "MidLow" 3 "Low";
VAL_ 1234 DET_CONFD_ELEVATION_329 0 "High" 1 "MidHigh" 2 "MidLow" 3 "Low";
VAL_ 1234 DET_CONFD_AZIMUTH_330 0 "High" 1 "MidHigh" 2 "MidLow" 3 "Low";
VAL_ 1234 DET_CONFD_ELEVATION_330 0 "High" 1 "MidHigh" 2 "MidLow" 3 "Low";
VAL_ 1234 DET_CONFD_AZIMUTH_331 0 "High" 1 "MidHigh" 2 "MidLow" 3 "Low";
VAL_ 1234 DET_CONFD_ELEVATION_331 0 "High" 1 "MidHigh" 2 "MidLow" 3 "Low";
VAL_ 1235 DET_CONFD_AZIMUTH_333 0 "High" 1 "MidHigh" 2 "MidLow" 3 "Low";
VAL_ 1235 DET_CONFD_ELEVATION_333 0 "High" 1 "MidHigh" 2 "MidLow" 3 "Low";
VAL_ 1235 DET_CONFD_AZIMUTH_334 0 "High" 1 "MidHigh" 2 "MidLow" 3 "Low";
VAL_ 1235 DET_CONFD_ELEVATION_334 0 "High" 1 "MidHigh" 2 "MidLow" 3 "Low";
VAL_ 1235 DET_CONFD_AZIMUTH_335 0 "High" 1 "MidHigh" 2 "MidLow" 3 "Low";
VAL_ 1235 DET_CONFD_ELEVATION_335 0 "High" 1 "MidHigh" 2 "MidLow" 3 "Low";
VAL_ 1236 DET_CONFD_AZIMUTH_337 0 "High" 1 "MidHigh" 2 "MidLow" 3 "Low";
VAL_ 1236 DET_CONFD_ELEVATION_337 0 "High" 1 "MidHigh" 2 "MidLow" 3 "Low";
VAL_ 1236 DET_CONFD_AZIMUTH_338 0 "High" 1 "MidHigh" 2 "MidLow" 3 "Low";
VAL_ 1236 DET_CONFD_ELEVATION_338 0 "High" 1 "MidHigh" 2 "MidLow" 3 "Low";
VAL_ 1236 DET_CONFD_AZIMUTH_339 0 "High" 1 "MidHigh" 2 "MidLow" 3 "Low";
VAL_ 1236 DET_CONFD_ELEVATION_339 0 "High" 1 "MidHigh" 2 "MidLow" 3 "Low";
VAL_ 1237 DET_CONFD_AZIMUTH_341 0 "High" 1 "MidHigh" 2 "MidLow" 3 "Low";
VAL_ 1237 DET_CONFD_ELEVATION_341 0 "High" 1 "MidHigh" 2 "MidLow" 3 "Low";
VAL_ 1237 DET_CONFD_AZIMUTH_342 0 "High" 1 "MidHigh" 2 "MidLow" 3 "Low";
VAL_ 1237 DET_CONFD_ELEVATION_342 0 "High" 1 "MidHigh" 2 "MidLow" 3 "Low";
VAL_ 1237 DET_CONFD_AZIMUTH_343 0 "High" 1 "MidHigh" 2 "MidLow" 3 "Low";
VAL_ 1237 DET_CONFD_ELEVATION_343 0 "High" 1 "MidHigh" 2 "MidLow" 3 "Low";
VAL_ 1238 DET_CONFD_AZIMUTH_345 0 "High" 1 "MidHigh" 2 "MidLow" 3 "Low";
VAL_ 1238 DET_CONFD_ELEVATION_345 0 "High" 1 "MidHigh" 2 "MidLow" 3 "Low";
VAL_ 1238 DET_CONFD_AZIMUTH_346 0 "High" 1 "MidHigh" 2 "MidLow" 3 "Low";
VAL_ 1238 DET_CONFD_ELEVATION_346 0 "High" 1 "MidHigh" 2 "MidLow" 3 "Low";
VAL_ 1238 DET_CONFD_AZIMUTH_347 0 "High" 1 "MidHigh" 2 "MidLow" 3 "Low";
VAL_ 1238 DET_CONFD_ELEVATION_347 0 "High" 1 "MidHigh" 2 "MidLow" 3 "Low";
VAL_ 1239 DET_CONFD_AZIMUTH_349 0 "High" 1 "MidHigh" 2 "MidLow" 3 "Low";
VAL_ 1239 DET_CONFD_ELEVATION_349 0 "High" 1 "MidHigh" 2 "MidLow" 3 "Low";
VAL_ 1239 DET_CONFD_AZIMUTH_350 0 "High" 1 "MidHigh" 2 "MidLow" 3 "Low";
VAL_ 1239 DET_CONFD_ELEVATION_350 0 "High" 1 "MidHigh" 2 "MidLow" 3 "Low";
VAL_ 1239 DET_CONFD_AZIMUTH_351 0 "High" 1 "MidHigh" 2 "MidLow" 3 "Low";
VAL_ 1239 DET_CONFD_ELEVATION_351 0 "High" 1 "MidHigh" 2 "MidLow" 3 "Low";
VAL_ 1240 DET_CONFD_AZIMUTH_353 0 "High" 1 "MidHigh" 2 "MidLow" 3 "Low";
VAL_ 1240 DET_CONFD_ELEVATION_353 0 "High" 1 "MidHigh" 2 "MidLow" 3 "Low";
VAL_ 1240 DET_CONFD_AZIMUTH_354 0 "High" 1 "MidHigh" 2 "MidLow" 3 "Low";
VAL_ 1240 DET_CONFD_ELEVATION_354 0 "High" 1 "MidHigh" 2 "MidLow" 3 "Low";
VAL_ 1240 DET_CONFD_AZIMUTH_355 0 "High" 1 "MidHigh" 2 "MidLow" 3 "Low";
VAL_ 1240 DET_CONFD_ELEVATION_355 0 "High" 1 "MidHigh" 2 "MidLow" 3 "Low";
VAL_ 1241 DET_CONFD_AZIMUTH_357 0 "High" 1 "MidHigh" 2 "MidLow" 3 "Low";
VAL_ 1241 DET_CONFD_ELEVATION_357 0 "High" 1 "MidHigh" 2 "MidLow" 3 "Low";
VAL_ 1241 DET_CONFD_AZIMUTH_358 0 "High" 1 "MidHigh" 2 "MidLow" 3 "Low";
VAL_ 1241 DET_CONFD_ELEVATION_358 0 "High" 1 "MidHigh" 2 "MidLow" 3 "Low";
VAL_ 1241 DET_CONFD_AZIMUTH_359 0 "High" 1 "MidHigh" 2 "MidLow" 3 "Low";
VAL_ 1241 DET_CONFD_ELEVATION_359 0 "High" 1 "MidHigh" 2 "MidLow" 3 "Low";
VAL_ 1242 DET_CONFD_AZIMUTH_361 0 "High" 1 "MidHigh" 2 "MidLow" 3 "Low";
VAL_ 1242 DET_CONFD_ELEVATION_361 0 "High" 1 "MidHigh" 2 "MidLow" 3 "Low";
VAL_ 1242 DET_CONFD_AZIMUTH_362 0 "High" 1 "MidHigh" 2 "MidLow" 3 "Low";
VAL_ 1242 DET_CONFD_ELEVATION_362 0 "High" 1 "MidHigh" 2 "MidLow" 3 "Low";
VAL_ 1242 DET_CONFD_AZIMUTH_363 0 "High" 1 "MidHigh" 2 "MidLow" 3 "Low";
VAL_ 1242 DET_CONFD_ELEVATION_363 0 "High" 1 "MidHigh" 2 "MidLow" 3 "Low";
VAL_ 1243 DET_CONFD_AZIMUTH_365 0 "High" 1 "MidHigh" 2 "MidLow" 3 "Low";
VAL_ 1243 DET_CONFD_ELEVATION_365 0 "High" 1 "MidHigh" 2 "MidLow" 3 "Low";
VAL_ 1243 DET_CONFD_AZIMUTH_366 0 "High" 1 "MidHigh" 2 "MidLow" 3 "Low";
VAL_ 1243 DET_CONFD_ELEVATION_366 0 "High" 1 "MidHigh" 2 "MidLow" 3 "Low";
VAL_ 1243 DET_CONFD_AZIMUTH_367 0 "High" 1 "MidHigh" 2 "MidLow" 3 "Low";
VAL_ 1243 DET_CONFD_ELEVATION_367 0 "High" 1 "MidHigh" 2 "MidLow" 3 "Low";
VAL_ 1244 DET_CONFD_AZIMUTH_369 0 "High" 1 "MidHigh" 2 "MidLow" 3 "Low";
VAL_ 1244 DET_CONFD_ELEVATION_369 0 "High" 1 "MidHigh" 2 "MidLow" 3 "Low";
VAL_ 1244 DET_CONFD_AZIMUTH_370 0 "High" 1 "MidHigh" 2 "MidLow" 3 "Low";
VAL_ 1244 DET_CONFD_ELEVATION_370 0 "High" 1 "MidHigh" 2 "MidLow" 3 "Low";
VAL_ 1244 DET_CONFD_AZIMUTH_371 0 "High" 1 "MidHigh" 2 "MidLow" 3 "Low";
VAL_ 1244 DET_CONFD_ELEVATION_371 0 "High" 1 "MidHigh" 2 "MidLow" 3 "Low";
VAL_ 1245 DET_CONFD_AZIMUTH_373 0 "High" 1 "MidHigh" 2 "MidLow" 3 "Low";
VAL_ 1245 DET_CONFD_ELEVATION_373 0 "High" 1 "MidHigh" 2 "MidLow" 3 "Low";
VAL_ 1245 DET_CONFD_AZIMUTH_374 0 "High" 1 "MidHigh" 2 "MidLow" 3 "Low";
VAL_ 1245 DET_CONFD_ELEVATION_374 0 "High" 1 "MidHigh" 2 "MidLow" 3 "Low";
VAL_ 1245 DET_CONFD_AZIMUTH_375 0 "High" 1 "MidHigh" 2 "MidLow" 3 "Low";
VAL_ 1245 DET_CONFD_ELEVATION_375 0 "High" 1 "MidHigh" 2 "MidLow" 3 "Low";
VAL_ 1246 DET_CONFD_AZIMUTH_377 0 "High" 1 "MidHigh" 2 "MidLow" 3 "Low";
VAL_ 1246 DET_CONFD_ELEVATION_377 0 "High" 1 "MidHigh" 2 "MidLow" 3 "Low";
VAL_ 1246 DET_CONFD_AZIMUTH_378 0 "High" 1 "MidHigh" 2 "MidLow" 3 "Low";
VAL_ 1246 DET_CONFD_ELEVATION_378 0 "High" 1 "MidHigh" 2 "MidLow" 3 "Low";
VAL_ 1246 DET_CONFD_AZIMUTH_379 0 "High" 1 "MidHigh" 2 "MidLow" 3 "Low";
VAL_ 1246 DET_CONFD_ELEVATION_379 0 "High" 1 "MidHigh" 2 "MidLow" 3 "Low";
VAL_ 1247 DET_CONFD_AZIMUTH_381 0 "High" 1 "MidHigh" 2 "MidLow" 3 "Low";
VAL_ 1247 DET_CONFD_ELEVATION_381 0 "High" 1 "MidHigh" 2 "MidLow" 3 "Low";
VAL_ 1247 DET_CONFD_AZIMUTH_382 0 "High" 1 "MidHigh" 2 "MidLow" 3 "Low";
VAL_ 1247 DET_CONFD_ELEVATION_382 0 "High" 1 "MidHigh" 2 "MidLow" 3 "Low";
VAL_ 1247 DET_CONFD_AZIMUTH_383 0 "High" 1 "MidHigh" 2 "MidLow" 3 "Low";
VAL_ 1247 DET_CONFD_ELEVATION_383 0 "High" 1 "MidHigh" 2 "MidLow" 3 "Low";
VAL_ 1248 DET_CONFD_AZIMUTH_385 0 "High" 1 "MidHigh" 2 "MidLow" 3 "Low";
VAL_ 1248 DET_CONFD_ELEVATION_385 0 "High" 1 "MidHigh" 2 "MidLow" 3 "Low";
VAL_ 1248 DET_CONFD_AZIMUTH_386 0 "High" 1 "MidHigh" 2 "MidLow" 3 "Low";
VAL_ 1248 DET_CONFD_ELEVATION_386 0 "High" 1 "MidHigh" 2 "MidLow" 3 "Low";
VAL_ 1248 DET_CONFD_AZIMUTH_387 0 "High" 1 "MidHigh" 2 "MidLow" 3 "Low";
VAL_ 1248 DET_CONFD_ELEVATION_387 0 "High" 1 "MidHigh" 2 "MidLow" 3 "Low";
VAL_ 1249 DET_CONFD_AZIMUTH_389 0 "High" 1 "MidHigh" 2 "MidLow" 3 "Low";
VAL_ 1249 DET_CONFD_ELEVATION_389 0 "High" 1 "MidHigh" 2 "MidLow" 3 "Low";
VAL_ 1249 DET_CONFD_AZIMUTH_390 0 "High" 1 "MidHigh" 2 "MidLow" 3 "Low";
VAL_ 1249 DET_CONFD_ELEVATION_390 0 "High" 1 "MidHigh" 2 "MidLow" 3 "Low";
VAL_ 1249 DET_CONFD_AZIMUTH_391 0 "High" 1 "MidHigh" 2 "MidLow" 3 "Low";
VAL_ 1249 DET_CONFD_ELEVATION_391 0 "High" 1 "MidHigh" 2 "MidLow" 3 "Low";
VAL_ 1250 DET_CONFD_AZIMUTH_393 0 "High" 1 "MidHigh" 2 "MidLow" 3 "Low";
VAL_ 1250 DET_CONFD_ELEVATION_393 0 "High" 1 "MidHigh" 2 "MidLow" 3 "Low";
VAL_ 1250 DET_CONFD_AZIMUTH_394 0 "High" 1 "MidHigh" 2 "MidLow" 3 "Low";
VAL_ 1250 DET_CONFD_ELEVATION_394 0 "High" 1 "MidHigh" 2 "MidLow" 3 "Low";
VAL_ 1250 DET_CONFD_AZIMUTH_395 0 "High" 1 "MidHigh" 2 "MidLow" 3 "Low";
VAL_ 1250 DET_CONFD_ELEVATION_395 0 "High" 1 "MidHigh" 2 "MidLow" 3 "Low";
VAL_ 1251 DET_CONFD_AZIMUTH_397 0 "High" 1 "MidHigh" 2 "MidLow" 3 "Low";
VAL_ 1251 DET_CONFD_ELEVATION_397 0 "High" 1 "MidHigh" 2 "MidLow" 3 "Low";
VAL_ 1251 DET_CONFD_AZIMUTH_398 0 "High" 1 "MidHigh" 2 "MidLow" 3 "Low";
VAL_ 1251 DET_CONFD_ELEVATION_398 0 "High" 1 "MidHigh" 2 "MidLow" 3 "Low";
VAL_ 1251 DET_CONFD_AZIMUTH_399 0 "High" 1 "MidHigh" 2 "MidLow" 3 "Low";
VAL_ 1251 DET_CONFD_ELEVATION_399 0 "High" 1 "MidHigh" 2 "MidLow" 3 "Low";
SIG_GROUP_ 1234 Detections_329_332 1 : DET_MH_CRC16_329_332 DET_MH_CYCLE_COUNTER_329_332 DET_MH_SCAN_INDEX_4LSB_329_332 DET_CONFD_ELEVATION_329 DET_CONFD_AZIMUTH_329 DET_HVC_FLAG_329 DET_OUTSIDE_SECTOR_329 DET_EXISTENCE_PROB_329 DET_POINT_TARGET_PROB_329 DET_SNR_329 DET_SUPER_RES_TARGET_329 DET_BI_STATIC_FLAG_329 DET_VALID_FLAG_329 DET_RCS_329 DET_ELEVATION_ERR_329 DET_ELEVATION_329 DET_AZIMUTH_ERR_329 DET_AZIMUTH_329 DET_RANGE_VELOCITY_ERR_329 DET_RANGE_VELOCITY_329 DET_RANGE_ERR_329 DET_RANGE_329 DET_CONFD_ELEVATION_330 DET_CONFD_AZIMUTH_330 DET_HVC_FLAG_330 DET_OUTSIDE_SECTOR_330 DET_EXISTENCE_PROB_330 DET_POINT_TARGET_PROB_330 DET_SNR_330 DET_SUPER_RES_TARGET_330 DET_BI_STATIC_FLAG_330 DET_VALID_FLAG_330 DET_RCS_330 DET_ELEVATION_330 DET_ELEVATION_ERR_330 DET_AZIMUTH_ERR_330 DET_AZIMUTH_330 DET_RANGE_VELOCITY_ERR_330 DET_RANGE_VELOCITY_330 DET_RANGE_ERR_330 DET_RANGE_330 DET_CONFD_ELEVATION_331 DET_CONFD_AZIMUTH_331 DET_HVC_FLAG_331 DET_OUTSIDE_SECTOR_331 DET_EXISTENCE_PROB_331 DET_POINT_TARGET_PROB_331 DET_SUPER_RES_TARGET_331 DET_BI_STATIC_FLAG_331 DET_VALID_FLAG_331 DET_RCS_331 DET_ELEVATION_331 DET_SNR_331 DET_ELEVATION_ERR_331 DET_AZIMUTH_ERR_331 DET_RANGE_VELOCITY_ERR_331 DET_AZIMUTH_331 DET_RANGE_VELOCITY_331 DET_RANGE_ERR_331 DET_RANGE_331 DET_BI_STATIC_FLAG_332 DET_CONFD_ELEVATION_332 DET_CONFD_AZIMUTH_332 DET_HVC_FLAG_332 DET_OUTSIDE_SECTOR_332 DET_EXISTENCE_PROB_332 DET_POINT_TARGET_PROB_332 DET_SNR_332 DET_SUPER_RES_TARGET_332 DET_VALID_FLAG_332 DET_RCS_332 DET_ELEVATION_ERR_332 DET_ELEVATION_332 DET_AZIMUTH_ERR_332 DET_AZIMUTH_332 DET_RANGE_VELOCITY_ERR_332 DET_RANGE_VELOCITY_332 DET_RANGE_ERR_332 DET_RANGE_332;
SIG_GROUP_ 1235 Detections_333_336 1 : DET_MH_CRC16_333_336 DET_MH_CYCLE_COUNTER_333_336 DET_MH_SCAN_INDEX_4LSB_333_336 DET_CONFD_ELEVATION_333 DET_CONFD_AZIMUTH_333 DET_HVC_FLAG_333 DET_OUTSIDE_SECTOR_333 DET_EXISTENCE_PROB_333 DET_POINT_TARGET_PROB_333 DET_SNR_333 DET_SUPER_RES_TARGET_333 DET_BI_STATIC_FLAG_333 DET_VALID_FLAG_333 DET_RCS_333 DET_ELEVATION_ERR_333 DET_ELEVATION_333 DET_AZIMUTH_ERR_333 DET_AZIMUTH_333 DET_RANGE_VELOCITY_ERR_333 DET_RANGE_VELOCITY_333 DET_RANGE_ERR_333 DET_RANGE_333 DET_CONFD_ELEVATION_334 DET_CONFD_AZIMUTH_334 DET_HVC_FLAG_334 DET_OUTSIDE_SECTOR_334 DET_EXISTENCE_PROB_334 DET_POINT_TARGET_PROB_334 DET_SNR_334 DET_SUPER_RES_TARGET_334 DET_BI_STATIC_FLAG_334 DET_VALID_FLAG_334 DET_RCS_334 DET_ELEVATION_334 DET_ELEVATION_ERR_334 DET_AZIMUTH_ERR_334 DET_AZIMUTH_334 DET_RANGE_VELOCITY_ERR_334 DET_RANGE_VELOCITY_334 DET_RANGE_ERR_334 DET_RANGE_334 DET_CONFD_ELEVATION_335 DET_CONFD_AZIMUTH_335 DET_HVC_FLAG_335 DET_OUTSIDE_SECTOR_335 DET_EXISTENCE_PROB_335 DET_POINT_TARGET_PROB_335 DET_SUPER_RES_TARGET_335 DET_BI_STATIC_FLAG_335 DET_VALID_FLAG_335 DET_RCS_335 DET_ELEVATION_335 DET_SNR_335 DET_ELEVATION_ERR_335 DET_AZIMUTH_ERR_335 DET_RANGE_VELOCITY_ERR_335 DET_AZIMUTH_335 DET_RANGE_VELOCITY_335 DET_RANGE_ERR_335 DET_RANGE_335 DET_BI_STATIC_FLAG_336 DET_CONFD_ELEVATION_336 DET_CONFD_AZIMUTH_336 DET_HVC_FLAG_336 DET_OUTSIDE_SECTOR_336 DET_EXISTENCE_PROB_336 DET_POINT_TARGET_PROB_336 DET_SNR_336 DET_SUPER_RES_TARGET_336 DET_VALID_FLAG_336 DET_RCS_336 DET_ELEVATION_ERR_336 DET_ELEVATION_336 DET_AZIMUTH_ERR_336 DET_AZIMUTH_336 DET_RANGE_VELOCITY_ERR_336 DET_RANGE_VELOCITY_336 DET_RANGE_ERR_336 DET_RANGE_336;
SIG_GROUP_ 1236 Detections_337_340 1 : DET_MH_CRC16_337_340 DET_MH_CYCLE_COUNTER_337_340 DET_MH_SCAN_INDEX_4LSB_337_340 DET_CONFD_ELEVATION_337 DET_CONFD_AZIMUTH_337 DET_HVC_FLAG_337 DET_OUTSIDE_SECTOR_337 DET_EXISTENCE_PROB_337 DET_POINT_TARGET_PROB_337 DET_SNR_337 DET_SUPER_RES_TARGET_337 DET_BI_STATIC_FLAG_337 DET_VALID_FLAG_337 DET_RCS_337 DET_ELEVATION_ERR_337 DET_ELEVATION_337 DET_AZIMUTH_ERR_337 DET_AZIMUTH_337 DET_RANGE_VELOCITY_ERR_337 DET_RANGE_VELOCITY_337 DET_RANGE_ERR_337 DET_RANGE_337 DET_CONFD_ELEVATION_338 DET_CONFD_AZIMUTH_338 DET_HVC_FLAG_338 DET_OUTSIDE_SECTOR_338 DET_EXISTENCE_PROB_338 DET_POINT_TARGET_PROB_338 DET_SNR_338 DET_SUPER_RES_TARGET_338 DET_BI_STATIC_FLAG_338 DET_VALID_FLAG_338 DET_RCS_338 DET_ELEVATION_338 DET_ELEVATION_ERR_338 DET_AZIMUTH_ERR_338 DET_AZIMUTH_338 DET_RANGE_VELOCITY_ERR_338 DET_RANGE_VELOCITY_338 DET_RANGE_ERR_338 DET_RANGE_338 DET_CONFD_ELEVATION_339 DET_CONFD_AZIMUTH_339 DET_HVC_FLAG_339 DET_OUTSIDE_SECTOR_339 DET_EXISTENCE_PROB_339 DET_POINT_TARGET_PROB_339 DET_SUPER_RES_TARGET_339 DET_BI_STATIC_FLAG_339 DET_VALID_FLAG_339 DET_RCS_339 DET_ELEVATION_339 DET_SNR_339 DET_ELEVATION_ERR_339 DET_AZIMUTH_ERR_339 DET_RANGE_VELOCITY_ERR_339 DET_AZIMUTH_339 DET_RANGE_VELOCITY_339 DET_RANGE_ERR_339 DET_RANGE_339 DET_BI_STATIC_FLAG_340 DET_CONFD_ELEVATION_340 DET_CONFD_AZIMUTH_340 DET_HVC_FLAG_340 DET_OUTSIDE_SECTOR_340 DET_EXISTENCE_PROB_340 DET_POINT_TARGET_PROB_340 DET_SNR_340 DET_SUPER_RES_TARGET_340 DET_VALID_FLAG_340 DET_RCS_340 DET_ELEVATION_ERR_340 DET_ELEVATION_340 DET_AZIMUTH_ERR_340 DET_AZIMUTH_340 DET_RANGE_VELOCITY_ERR_340 DET_RANGE_VELOCITY_340 DET_RANGE_ERR_340 DET_RANGE_340;
SIG_GROUP_ 1237 Detections_341_344 1 : DET_MH_CRC16_341_344 DET_MH_CYCLE_COUNTER_341_344 DET_MH_SCAN_INDEX_4LSB_341_344 DET_CONFD_ELEVATION_341 DET_CONFD_AZIMUTH_341 DET_HVC_FLAG_341 DET_OUTSIDE_SECTOR_341 DET_EXISTENCE_PROB_341 DET_POINT_TARGET_PROB_341 DET_SNR_341 DET_SUPER_RES_TARGET_341 DET_BI_STATIC_FLAG_341 DET_VALID_FLAG_341 DET_RCS_341 DET_ELEVATION_ERR_341 DET_ELEVATION_341 DET_AZIMUTH_ERR_341 DET_AZIMUTH_341 DET_RANGE_VELOCITY_ERR_341 DET_RANGE_VELOCITY_341 DET_RANGE_ERR_341 DET_RANGE_341 DET_CONFD_ELEVATION_342 DET_CONFD_AZIMUTH_342 DET_HVC_FLAG_342 DET_OUTSIDE_SECTOR_342 DET_EXISTENCE_PROB_342 DET_POINT_TARGET_PROB_342 DET_SNR_342 DET_SUPER_RES_TARGET_342 DET_BI_STATIC_FLAG_342 DET_VALID_FLAG_342 DET_RCS_342 DET_ELEVATION_342 DET_ELEVATION_ERR_342 DET_AZIMUTH_ERR_342 DET_AZIMUTH_342 DET_RANGE_VELOCITY_ERR_342 DET_RANGE_VELOCITY_342 DET_RANGE_ERR_342 DET_RANGE_342 DET_CONFD_ELEVATION_343 DET_CONFD_AZIMUTH_343 DET_HVC_FLAG_343 DET_OUTSIDE_SECTOR_343 DET_EXISTENCE_PROB_343 DET_POINT_TARGET_PROB_343 DET_SUPER_RES_TARGET_343 DET_BI_STATIC_FLAG_343 DET_VALID_FLAG_343 DET_RCS_343 DET_ELEVATION_343 DET_SNR_343 DET_ELEVATION_ERR_343 DET_AZIMUTH_ERR_343 DET_RANGE_VELOCITY_ERR_343 DET_AZIMUTH_343 DET_RANGE_VELOCITY_343 DET_RANGE_ERR_343 DET_RANGE_343 DET_BI_STATIC_FLAG_344 DET_CONFD_ELEVATION_344 DET_CONFD_AZIMUTH_344 DET_HVC_FLAG_344 DET_OUTSIDE_SECTOR_344 DET_EXISTENCE_PROB_344 DET_POINT_TARGET_PROB_344 DET_SNR_344 DET_SUPER_RES_TARGET_344 DET_VALID_FLAG_344 DET_RCS_344 DET_ELEVATION_ERR_344 DET_ELEVATION_344 DET_AZIMUTH_ERR_344 DET_AZIMUTH_344 DET_RANGE_VELOCITY_ERR_344 DET_RANGE_VELOCITY_344 DET_RANGE_ERR_344 DET_RANGE_344;
SIG_GROUP_ 1238 Detections_345_348 1 : DET_MH_CRC16_345_348 DET_MH_CYCLE_COUNTER_345_348 DET_MH_SCAN_INDEX_4LSB_345_348 DET_CONFD_ELEVATION_345 DET_CONFD_AZIMUTH_345 DET_HVC_FLAG_345 DET_OUTSIDE_SECTOR_345 DET_EXISTENCE_PROB_345 DET_POINT_TARGET_PROB_345 DET_SNR_345 DET_SUPER_RES_TARGET_345 DET_BI_STATIC_FLAG_345 DET_VALID_FLAG_345 DET_RCS_345 DET_ELEVATION_ERR_345 DET_ELEVATION_345 DET_AZIMUTH_ERR_345 DET_AZIMUTH_345 DET_RANGE_VELOCITY_ERR_345 DET_RANGE_VELOCITY_345 DET_RANGE_ERR_345 DET_RANGE_345 DET_CONFD_ELEVATION_346 DET_CONFD_AZIMUTH_346 DET_HVC_FLAG_346 DET_OUTSIDE_SECTOR_346 DET_EXISTENCE_PROB_346 DET_POINT_TARGET_PROB_346 DET_SNR_346 DET_SUPER_RES_TARGET_346 DET_BI_STATIC_FLAG_346 DET_VALID_FLAG_346 DET_RCS_346 DET_ELEVATION_346 DET_ELEVATION_ERR_346 DET_AZIMUTH_ERR_346 DET_AZIMUTH_346 DET_RANGE_VELOCITY_ERR_346 DET_RANGE_VELOCITY_346 DET_RANGE_ERR_346 DET_RANGE_346 DET_CONFD_ELEVATION_347 DET_CONFD_AZIMUTH_347 DET_HVC_FLAG_347 DET_OUTSIDE_SECTOR_347 DET_EXISTENCE_PROB_347 DET_POINT_TARGET_PROB_347 DET_SUPER_RES_TARGET_347 DET_BI_STATIC_FLAG_347 DET_VALID_FLAG_347 DET_RCS_347 DET_ELEVATION_347 DET_SNR_347 DET_ELEVATION_ERR_347 DET_AZIMUTH_ERR_347 DET_RANGE_VELOCITY_ERR_347 DET_AZIMUTH_347 DET_RANGE_VELOCITY_347 DET_RANGE_ERR_347 DET_RANGE_347 DET_BI_STATIC_FLAG_348 DET_CONFD_ELEVATION_348 DET_CONFD_AZIMUTH_348 DET_HVC_FLAG_348 DET_OUTSIDE_SECTOR_348 DET_EXISTENCE_PROB_348 DET_POINT_TARGET_PROB_348 DET_SNR_348 DET_SUPER_RES_TARGET_348 DET_VALID_FLAG_348 DET_RCS_348 DET_ELEVATION_ERR_348 DET_ELEVATION_348 DET_AZIMUTH_ERR_348 DET_AZIMUTH_348 DET_RANGE_VELOCITY_ERR_348 DET_RANGE_VELOCITY_348 DET_RANGE_ERR_348 DET_RANGE_348;
SIG_GROUP_ 1239 Detections_349_352 1 : DET_MH_CRC16_349_352 DET_MH_CYCLE_COUNTER_349_352 DET_MH_SCAN_INDEX_4LSB_349_352 DET_CONFD_ELEVATION_349 DET_CONFD_AZIMUTH_349 DET_HVC_FLAG_349 DET_OUTSIDE_SECTOR_349 DET_EXISTENCE_PROB_349 DET_POINT_TARGET_PROB_349 DET_SNR_349 DET_SUPER_RES_TARGET_349 DET_BI_STATIC_FLAG_349 DET_VALID_FLAG_349 DET_RCS_349 DET_ELEVATION_ERR_349 DET_ELEVATION_349 DET_AZIMUTH_ERR_349 DET_AZIMUTH_349 DET_RANGE_VELOCITY_ERR_349 DET_RANGE_VELOCITY_349 DET_RANGE_ERR_349 DET_RANGE_349 DET_CONFD_ELEVATION_350 DET_CONFD_AZIMUTH_350 DET_HVC_FLAG_350 DET_OUTSIDE_SECTOR_350 DET_EXISTENCE_PROB_350 DET_POINT_TARGET_PROB_350 DET_SNR_350 DET_SUPER_RES_TARGET_350 DET_BI_STATIC_FLAG_350 DET_VALID_FLAG_350 DET_RCS_350 DET_ELEVATION_350 DET_ELEVATION_ERR_350 DET_AZIMUTH_ERR_350 DET_AZIMUTH_350 DET_RANGE_VELOCITY_ERR_350 DET_RANGE_VELOCITY_350 DET_RANGE_ERR_350 DET_RANGE_350 DET_CONFD_ELEVATION_351 DET_CONFD_AZIMUTH_351 DET_HVC_FLAG_351 DET_OUTSIDE_SECTOR_351 DET_EXISTENCE_PROB_351 DET_POINT_TARGET_PROB_351 DET_SUPER_RES_TARGET_351 DET_BI_STATIC_FLAG_351 DET_VALID_FLAG_351 DET_RCS_351 DET_ELEVATION_351 DET_SNR_351 DET_ELEVATION_ERR_351 DET_AZIMUTH_ERR_351 DET_RANGE_VELOCITY_ERR_351 DET_AZIMUTH_351 DET_RANGE_VELOCITY_351 DET_RANGE_ERR_351 DET_RANGE_351 DET_BI_STATIC_FLAG_352 DET_CONFD_ELEVATION_352 DET_CONFD_AZIMUTH_352 DET_HVC_FLAG_352 DET_OUTSIDE_SECTOR_352 DET_EXISTENCE_PROB_352 DET_POINT_TARGET_PROB_352 DET_SNR_352 DET_SUPER_RES_TARGET_352 DET_VALID_FLAG_352 DET_RCS_352 DET_ELEVATION_ERR_352 DET_ELEVATION_352 DET_AZIMUTH_ERR_352 DET_AZIMUTH_352 DET_RANGE_VELOCITY_ERR_352 DET_RANGE_VELOCITY_352 DET_RANGE_ERR_352 DET_RANGE_352;
SIG_GROUP_ 1240 Detections_353_356 1 : DET_MH_CRC16_353_356 DET_MH_CYCLE_COUNTER_353_356 DET_MH_SCAN_INDEX_4LSB_353_356 DET_CONFD_ELEVATION_353 DET_CONFD_AZIMUTH_353 DET_HVC_FLAG_353 DET_OUTSIDE_SECTOR_353 DET_EXISTENCE_PROB_353 DET_POINT_TARGET_PROB_353 DET_SNR_353 DET_SUPER_RES_TARGET_353 DET_BI_STATIC_FLAG_353 DET_VALID_FLAG_353 DET_RCS_353 DET_ELEVATION_ERR_353 DET_ELEVATION_353 DET_AZIMUTH_ERR_353 DET_AZIMUTH_353 DET_RANGE_VELOCITY_ERR_353 DET_RANGE_VELOCITY_353 DET_RANGE_ERR_353 DET_RANGE_353 DET_CONFD_ELEVATION_354 DET_CONFD_AZIMUTH_354 DET_HVC_FLAG_354 DET_OUTSIDE_SECTOR_354 DET_EXISTENCE_PROB_354 DET_POINT_TARGET_PROB_354 DET_SNR_354 DET_SUPER_RES_TARGET_354 DET_BI_STATIC_FLAG_354 DET_VALID_FLAG_354 DET_RCS_354 DET_ELEVATION_354 DET_ELEVATION_ERR_354 DET_AZIMUTH_ERR_354 DET_AZIMUTH_354 DET_RANGE_VELOCITY_ERR_354 DET_RANGE_VELOCITY_354 DET_RANGE_ERR_354 DET_RANGE_354 DET_CONFD_ELEVATION_355 DET_CONFD_AZIMUTH_355 DET_HVC_FLAG_355 DET_OUTSIDE_SECTOR_355 DET_EXISTENCE_PROB_355 DET_POINT_TARGET_PROB_355 DET_SUPER_RES_TARGET_355 DET_BI_STATIC_FLAG_355 DET_VALID_FLAG_355 DET_RCS_355 DET_ELEVATION_355 DET_SNR_355 DET_ELEVATION_ERR_355 DET_AZIMUTH_ERR_355 DET_RANGE_VELOCITY_ERR_355 DET_AZIMUTH_355 DET_RANGE_VELOCITY_355 DET_RANGE_ERR_355 DET_RANGE_355 DET_BI_STATIC_FLAG_356 DET_CONFD_ELEVATION_356 DET_CONFD_AZIMUTH_356 DET_HVC_FLAG_356 DET_OUTSIDE_SECTOR_356 DET_EXISTENCE_PROB_356 DET_POINT_TARGET_PROB_356 DET_SNR_356 DET_SUPER_RES_TARGET_356 DET_VALID_FLAG_356 DET_RCS_356 DET_ELEVATION_ERR_356 DET_ELEVATION_356 DET_AZIMUTH_ERR_356 DET_AZIMUTH_356 DET_RANGE_VELOCITY_ERR_356 DET_RANGE_VELOCITY_356 DET_RANGE_ERR_356 DET_RANGE_356;
SIG_GROUP_ 1241 Detections_357_360 1 : DET_MH_CRC16_357_360 DET_MH_CYCLE_COUNTER_357_360 DET_MH_SCAN_INDEX_4LSB_357_360 DET_CONFD_ELEVATION_357 DET_CONFD_AZIMUTH_357 DET_HVC_FLAG_357 DET_OUTSIDE_SECTOR_357 DET_EXISTENCE_PROB_357 DET_POINT_TARGET_PROB_357 DET_SNR_357 DET_SUPER_RES_TARGET_357 DET_BI_STATIC_FLAG_357 DET_VALID_FLAG_357 DET_RCS_357 DET_ELEVATION_ERR_357 DET_ELEVATION_357 DET_AZIMUTH_ERR_357 DET_AZIMUTH_357 DET_RANGE_VELOCITY_ERR_357 DET_RANGE_VELOCITY_357 DET_RANGE_ERR_357 DET_RANGE_357 DET_CONFD_ELEVATION_358 DET_CONFD_AZIMUTH_358 DET_HVC_FLAG_358 DET_OUTSIDE_SECTOR_358 DET_EXISTENCE_PROB_358 DET_POINT_TARGET_PROB_358 DET_SNR_358 DET_SUPER_RES_TARGET_358 DET_BI_STATIC_FLAG_358 DET_VALID_FLAG_358 DET_RCS_358 DET_ELEVATION_358 DET_ELEVATION_ERR_358 DET_AZIMUTH_ERR_358 DET_AZIMUTH_358 DET_RANGE_VELOCITY_ERR_358 DET_RANGE_VELOCITY_358 DET_RANGE_ERR_358 DET_RANGE_358 DET_CONFD_ELEVATION_359 DET_CONFD_AZIMUTH_359 DET_HVC_FLAG_359 DET_OUTSIDE_SECTOR_359 DET_EXISTENCE_PROB_359 DET_POINT_TARGET_PROB_359 DET_SUPER_RES_TARGET_359 DET_BI_STATIC_FLAG_359 DET_VALID_FLAG_359 DET_RCS_359 DET_ELEVATION_359 DET_SNR_359 DET_ELEVATION_ERR_359 DET_AZIMUTH_ERR_359 DET_RANGE_VELOCITY_ERR_359 DET_AZIMUTH_359 DET_RANGE_VELOCITY_359 DET_RANGE_ERR_359 DET_RANGE_359 DET_BI_STATIC_FLAG_360 DET_CONFD_ELEVATION_360 DET_CONFD_AZIMUTH_360 DET_HVC_FLAG_360 DET_OUTSIDE_SECTOR_360 DET_EXISTENCE_PROB_360 DET_POINT_TARGET_PROB_360 DET_SNR_360 DET_SUPER_RES_TARGET_360 DET_VALID_FLAG_360 DET_RCS_360 DET_ELEVATION_ERR_360 DET_ELEVATION_360 DET_AZIMUTH_ERR_360 DET_AZIMUTH_360 DET_RANGE_VELOCITY_ERR_360 DET_RANGE_VELOCITY_360 DET_RANGE_ERR_360 DET_RANGE_360;
SIG_GROUP_ 1242 Detections_361_364 1 : DET_MH_CRC16_361_364 DET_MH_CYCLE_COUNTER_361_364 DET_MH_SCAN_INDEX_4LSB_361_364 DET_CONFD_ELEVATION_361 DET_CONFD_AZIMUTH_361 DET_HVC_FLAG_361 DET_OUTSIDE_SECTOR_361 DET_EXISTENCE_PROB_361 DET_POINT_TARGET_PROB_361 DET_SNR_361 DET_SUPER_RES_TARGET_361 DET_BI_STATIC_FLAG_361 DET_VALID_FLAG_361 DET_RCS_361 DET_ELEVATION_ERR_361 DET_ELEVATION_361 DET_AZIMUTH_ERR_361 DET_AZIMUTH_361 DET_RANGE_VELOCITY_ERR_361 DET_RANGE_VELOCITY_361 DET_RANGE_ERR_361 DET_RANGE_361 DET_CONFD_ELEVATION_362 DET_CONFD_AZIMUTH_362 DET_HVC_FLAG_362 DET_OUTSIDE_SECTOR_362 DET_EXISTENCE_PROB_362 DET_POINT_TARGET_PROB_362 DET_SNR_362 DET_SUPER_RES_TARGET_362 DET_BI_STATIC_FLAG_362 DET_VALID_FLAG_362 DET_RCS_362 DET_ELEVATION_362 DET_ELEVATION_ERR_362 DET_AZIMUTH_ERR_362 DET_AZIMUTH_362 DET_RANGE_VELOCITY_ERR_362 DET_RANGE_VELOCITY_362 DET_RANGE_ERR_362 DET_RANGE_362 DET_CONFD_ELEVATION_363 DET_CONFD_AZIMUTH_363 DET_HVC_FLAG_363 DET_OUTSIDE_SECTOR_363 DET_EXISTENCE_PROB_363 DET_POINT_TARGET_PROB_363 DET_SUPER_RES_TARGET_363 DET_BI_STATIC_FLAG_363 DET_VALID_FLAG_363 DET_RCS_363 DET_ELEVATION_363 DET_SNR_363 DET_ELEVATION_ERR_363 DET_AZIMUTH_ERR_363 DET_RANGE_VELOCITY_ERR_363 DET_AZIMUTH_363 DET_RANGE_VELOCITY_363 DET_RANGE_ERR_363 DET_RANGE_363 DET_BI_STATIC_FLAG_364 DET_CONFD_ELEVATION_364 DET_CONFD_AZIMUTH_364 DET_HVC_FLAG_364 DET_OUTSIDE_SECTOR_364 DET_EXISTENCE_PROB_364 DET_POINT_TARGET_PROB_364 DET_SNR_364 DET_SUPER_RES_TARGET_364 DET_VALID_FLAG_364 DET_RCS_364 DET_ELEVATION_ERR_364 DET_ELEVATION_364 DET_AZIMUTH_ERR_364 DET_AZIMUTH_364 DET_RANGE_VELOCITY_ERR_364 DET_RANGE_VELOCITY_364 DET_RANGE_ERR_364 DET_RANGE_364;
SIG_GROUP_ 1243 Detections_365_368 1 : DET_MH_CRC16_365_368 DET_MH_CYCLE_COUNTER_365_368 DET_MH_SCAN_INDEX_4LSB_365_368 DET_CONFD_ELEVATION_365 DET_CONFD_AZIMUTH_365 DET_HVC_FLAG_365 DET_OUTSIDE_SECTOR_365 DET_EXISTENCE_PROB_365 DET_POINT_TARGET_PROB_365 DET_SNR_365 DET_SUPER_RES_TARGET_365 DET_BI_STATIC_FLAG_365 DET_VALID_FLAG_365 DET_RCS_365 DET_ELEVATION_ERR_365 DET_ELEVATION_365 DET_AZIMUTH_ERR_365 DET_AZIMUTH_365 DET_RANGE_VELOCITY_ERR_365 DET_RANGE_VELOCITY_365 DET_RANGE_ERR_365 DET_RANGE_365 DET_CONFD_ELEVATION_366 DET_CONFD_AZIMUTH_366 DET_HVC_FLAG_366 DET_OUTSIDE_SECTOR_366 DET_EXISTENCE_PROB_366 DET_POINT_TARGET_PROB_366 DET_SNR_366 DET_SUPER_RES_TARGET_366 DET_BI_STATIC_FLAG_366 DET_VALID_FLAG_366 DET_RCS_366 DET_ELEVATION_366 DET_ELEVATION_ERR_366 DET_AZIMUTH_ERR_366 DET_AZIMUTH_366 DET_RANGE_VELOCITY_ERR_366 DET_RANGE_VELOCITY_366 DET_RANGE_ERR_366 DET_RANGE_366 DET_CONFD_ELEVATION_367 DET_CONFD_AZIMUTH_367 DET_HVC_FLAG_367 DET_OUTSIDE_SECTOR_367 DET_EXISTENCE_PROB_367 DET_POINT_TARGET_PROB_367 DET_SUPER_RES_TARGET_367 DET_BI_STATIC_FLAG_367 DET_VALID_FLAG_367 DET_RCS_367 DET_ELEVATION_367 DET_SNR_367 DET_ELEVATION_ERR_367 DET_AZIMUTH_ERR_367 DET_RANGE_VELOCITY_ERR_367 DET_AZIMUTH_367 DET_RANGE_VELOCITY_367 DET_RANGE_ERR_367 DET_RANGE_367 DET_BI_STATIC_FLAG_368 DET_CONFD_ELEVATION_368 DET_CONFD_AZIMUTH_368 DET_HVC_FLAG_368 DET_OUTSIDE_SECTOR_368 DET_EXISTENCE_PROB_368 DET_POINT_TARGET_PROB_368 DET_SNR_368 DET_SUPER_RES_TARGET_368 DET_VALID_FLAG_368 DET_RCS_368 DET_ELEVATION_ERR_368 DET_ELEVATION_368 DET_AZIMUTH_ERR_368 DET_AZIMUTH_368 DET_RANGE_VELOCITY_ERR_368 DET_RANGE_VELOCITY_368 DET_RANGE_ERR_368 DET_RANGE_368;
SIG_GROUP_ 1244 Detections_369_372 1 : DET_MH_CRC16_369_372 DET_MH_CYCLE_COUNTER_369_372 DET_MH_SCAN_INDEX_4LSB_369_372 DET_CONFD_ELEVATION_369 DET_CONFD_AZIMUTH_369 DET_HVC_FLAG_369 DET_OUTSIDE_SECTOR_369 DET_EXISTENCE_PROB_369 DET_POINT_TARGET_PROB_369 DET_SNR_369 DET_SUPER_RES_TARGET_369 DET_BI_STATIC_FLAG_369 DET_VALID_FLAG_369 DET_RCS_369 DET_ELEVATION_ERR_369 DET_ELEVATION_369 DET_AZIMUTH_ERR_369 DET_AZIMUTH_369 DET_RANGE_VELOCITY_ERR_369 DET_RANGE_VELOCITY_369 DET_RANGE_ERR_369 DET_RANGE_369 DET_CONFD_ELEVATION_370 DET_CONFD_AZIMUTH_370 DET_HVC_FLAG_370 DET_OUTSIDE_SECTOR_370 DET_EXISTENCE_PROB_370 DET_POINT_TARGET_PROB_370 DET_SNR_370 DET_SUPER_RES_TARGET_370 DET_BI_STATIC_FLAG_370 DET_VALID_FLAG_370 DET_RCS_370 DET_ELEVATION_370 DET_ELEVATION_ERR_370 DET_AZIMUTH_ERR_370 DET_AZIMUTH_370 DET_RANGE_VELOCITY_ERR_370 DET_RANGE_VELOCITY_370 DET_RANGE_ERR_370 DET_RANGE_370 DET_CONFD_ELEVATION_371 DET_CONFD_AZIMUTH_371 DET_HVC_FLAG_371 DET_OUTSIDE_SECTOR_371 DET_EXISTENCE_PROB_371 DET_POINT_TARGET_PROB_371 DET_SUPER_RES_TARGET_371 DET_BI_STATIC_FLAG_371 DET_VALID_FLAG_371 DET_RCS_371 DET_ELEVATION_371 DET_SNR_371 DET_ELEVATION_ERR_371 DET_AZIMUTH_ERR_371 DET_RANGE_VELOCITY_ERR_371 DET_AZIMUTH_371 DET_RANGE_VELOCITY_371 DET_RANGE_ERR_371 DET_RANGE_371 DET_BI_STATIC_FLAG_372 DET_CONFD_ELEVATION_372 DET_CONFD_AZIMUTH_372 DET_HVC_FLAG_372 DET_OUTSIDE_SECTOR_372 DET_EXISTENCE_PROB_372 DET_POINT_TARGET_PROB_372 DET_SNR_372 DET_SUPER_RES_TARGET_372 DET_VALID_FLAG_372 DET_RCS_372 DET_ELEVATION_ERR_372 DET_ELEVATION_372 DET_AZIMUTH_ERR_372 DET_AZIMUTH_372 DET_RANGE_VELOCITY_ERR_372 DET_RANGE_VELOCITY_372 DET_RANGE_ERR_372 DET_RANGE_372;
SIG_GROUP_ 1245 Detections_373_376 1 : DET_MH_CRC16_373_376 DET_MH_CYCLE_COUNTER_373_376 DET_MH_SCAN_INDEX_4LSB_373_376 DET_CONFD_ELEVATION_373 DET_CONFD_AZIMUTH_373 DET_HVC_FLAG_373 DET_OUTSIDE_SECTOR_373 DET_EXISTENCE_PROB_373 DET_POINT_TARGET_PROB_373 DET_SNR_373 DET_SUPER_RES_TARGET_373 DET_BI_STATIC_FLAG_373 DET_VALID_FLAG_373 DET_RCS_373 DET_ELEVATION_ERR_373 DET_ELEVATION_373 DET_AZIMUTH_ERR_373 DET_AZIMUTH_373 DET_RANGE_VELOCITY_ERR_373 DET_RANGE_VELOCITY_373 DET_RANGE_ERR_373 DET_RANGE_373 DET_CONFD_ELEVATION_374 DET_CONFD_AZIMUTH_374 DET_HVC_FLAG_374 DET_OUTSIDE_SECTOR_374 DET_EXISTENCE_PROB_374 DET_POINT_TARGET_PROB_374 DET_SNR_374 DET_SUPER_RES_TARGET_374 DET_BI_STATIC_FLAG_374 DET_VALID_FLAG_374 DET_RCS_374 DET_ELEVATION_374 DET_ELEVATION_ERR_374 DET_AZIMUTH_ERR_374 DET_AZIMUTH_374 DET_RANGE_VELOCITY_ERR_374 DET_RANGE_VELOCITY_374 DET_RANGE_ERR_374 DET_RANGE_374 DET_CONFD_ELEVATION_375 DET_CONFD_AZIMUTH_375 DET_HVC_FLAG_375 DET_OUTSIDE_SECTOR_375 DET_EXISTENCE_PROB_375 DET_POINT_TARGET_PROB_375 DET_SUPER_RES_TARGET_375 DET_BI_STATIC_FLAG_375 DET_VALID_FLAG_375 DET_RCS_375 DET_ELEVATION_375 DET_SNR_375 DET_ELEVATION_ERR_375 DET_AZIMUTH_ERR_375 DET_RANGE_VELOCITY_ERR_375 DET_AZIMUTH_375 DET_RANGE_VELOCITY_375 DET_RANGE_ERR_375 DET_RANGE_375 DET_BI_STATIC_FLAG_376 DET_CONFD_ELEVATION_376 DET_CONFD_AZIMUTH_376 DET_HVC_FLAG_376 DET_OUTSIDE_SECTOR_376 DET_EXISTENCE_PROB_376 DET_POINT_TARGET_PROB_376 DET_SNR_376 DET_SUPER_RES_TARGET_376 DET_VALID_FLAG_376 DET_RCS_376 DET_ELEVATION_ERR_376 DET_ELEVATION_376 DET_AZIMUTH_ERR_376 DET_AZIMUTH_376 DET_RANGE_VELOCITY_ERR_376 DET_RANGE_VELOCITY_376 DET_RANGE_ERR_376 DET_RANGE_376;
SIG_GROUP_ 1246 Detections_377_380 1 : DET_MH_CRC16_377_380 DET_MH_CYCLE_COUNTER_377_380 DET_MH_SCAN_INDEX_4LSB_377_380 DET_CONFD_ELEVATION_377 DET_CONFD_AZIMUTH_377 DET_HVC_FLAG_377 DET_OUTSIDE_SECTOR_377 DET_EXISTENCE_PROB_377 DET_POINT_TARGET_PROB_377 DET_SNR_377 DET_SUPER_RES_TARGET_377 DET_BI_STATIC_FLAG_377 DET_VALID_FLAG_377 DET_RCS_377 DET_ELEVATION_ERR_377 DET_ELEVATION_377 DET_AZIMUTH_ERR_377 DET_AZIMUTH_377 DET_RANGE_VELOCITY_ERR_377 DET_RANGE_VELOCITY_377 DET_RANGE_ERR_377 DET_RANGE_377 DET_CONFD_ELEVATION_378 DET_CONFD_AZIMUTH_378 DET_HVC_FLAG_378 DET_OUTSIDE_SECTOR_378 DET_EXISTENCE_PROB_378 DET_POINT_TARGET_PROB_378 DET_SNR_378 DET_SUPER_RES_TARGET_378 DET_BI_STATIC_FLAG_378 DET_VALID_FLAG_378 DET_RCS_378 DET_ELEVATION_378 DET_ELEVATION_ERR_378 DET_AZIMUTH_ERR_378 DET_AZIMUTH_378 DET_RANGE_VELOCITY_ERR_378 DET_RANGE_VELOCITY_378 DET_RANGE_ERR_378 DET_RANGE_378 DET_CONFD_ELEVATION_379 DET_CONFD_AZIMUTH_379 DET_HVC_FLAG_379 DET_OUTSIDE_SECTOR_379 DET_EXISTENCE_PROB_379 DET_POINT_TARGET_PROB_379 DET_SUPER_RES_TARGET_379 DET_BI_STATIC_FLAG_379 DET_VALID_FLAG_379 DET_RCS_379 DET_ELEVATION_379 DET_SNR_379 DET_ELEVATION_ERR_379 DET_AZIMUTH_ERR_379 DET_RANGE_VELOCITY_ERR_379 DET_AZIMUTH_379 DET_RANGE_VELOCITY_379 DET_RANGE_ERR_379 DET_RANGE_379 DET_BI_STATIC_FLAG_380 DET_CONFD_ELEVATION_380 DET_CONFD_AZIMUTH_380 DET_HVC_FLAG_380 DET_OUTSIDE_SECTOR_380 DET_EXISTENCE_PROB_380 DET_POINT_TARGET_PROB_380 DET_SNR_380 DET_SUPER_RES_TARGET_380 DET_VALID_FLAG_380 DET_RCS_380 DET_ELEVATION_ERR_380 DET_ELEVATION_380 DET_AZIMUTH_ERR_380 DET_AZIMUTH_380 DET_RANGE_VELOCITY_ERR_380 DET_RANGE_VELOCITY_380 DET_RANGE_ERR_380 DET_RANGE_380;
SIG_GROUP_ 1247 Detections_381_384 1 : DET_MH_CRC16_381_384 DET_MH_CYCLE_COUNTER_381_384 DET_MH_SCAN_INDEX_4LSB_381_384 DET_CONFD_ELEVATION_381 DET_CONFD_AZIMUTH_381 DET_HVC_FLAG_381 DET_OUTSIDE_SECTOR_381 DET_EXISTENCE_PROB_381 DET_POINT_TARGET_PROB_381 DET_SNR_381 DET_SUPER_RES_TARGET_381 DET_BI_STATIC_FLAG_381 DET_VALID_FLAG_381 DET_RCS_381 DET_ELEVATION_ERR_381 DET_ELEVATION_381 DET_AZIMUTH_ERR_381 DET_AZIMUTH_381 DET_RANGE_VELOCITY_ERR_381 DET_RANGE_VELOCITY_381 DET_RANGE_ERR_381 DET_RANGE_381 DET_CONFD_ELEVATION_382 DET_CONFD_AZIMUTH_382 DET_HVC_FLAG_382 DET_OUTSIDE_SECTOR_382 DET_EXISTENCE_PROB_382 DET_POINT_TARGET_PROB_382 DET_SNR_382 DET_SUPER_RES_TARGET_382 DET_BI_STATIC_FLAG_382 DET_VALID_FLAG_382 DET_RCS_382 DET_ELEVATION_382 DET_ELEVATION_ERR_382 DET_AZIMUTH_ERR_382 DET_AZIMUTH_382 DET_RANGE_VELOCITY_ERR_382 DET_RANGE_VELOCITY_382 DET_RANGE_ERR_382 DET_RANGE_382 DET_CONFD_ELEVATION_383 DET_CONFD_AZIMUTH_383 DET_HVC_FLAG_383 DET_OUTSIDE_SECTOR_383 DET_EXISTENCE_PROB_383 DET_POINT_TARGET_PROB_383 DET_SUPER_RES_TARGET_383 DET_BI_STATIC_FLAG_383 DET_VALID_FLAG_383 DET_RCS_383 DET_ELEVATION_383 DET_SNR_383 DET_ELEVATION_ERR_383 DET_AZIMUTH_ERR_383 DET_RANGE_VELOCITY_ERR_383 DET_AZIMUTH_383 DET_RANGE_VELOCITY_383 DET_RANGE_ERR_383 DET_RANGE_383 DET_BI_STATIC_FLAG_384 DET_CONFD_ELEVATION_384 DET_CONFD_AZIMUTH_384 DET_HVC_FLAG_384 DET_OUTSIDE_SECTOR_384 DET_EXISTENCE_PROB_384 DET_POINT_TARGET_PROB_384 DET_SNR_384 DET_SUPER_RES_TARGET_384 DET_VALID_FLAG_384 DET_RCS_384 DET_ELEVATION_ERR_384 DET_ELEVATION_384 DET_AZIMUTH_ERR_384 DET_AZIMUTH_384 DET_RANGE_VELOCITY_ERR_384 DET_RANGE_VELOCITY_384 DET_RANGE_ERR_384 DET_RANGE_384;
SIG_GROUP_ 1248 Detections_385_388 1 : DET_MH_CRC16_385_388 DET_MH_CYCLE_COUNTER_385_388 DET_MH_SCAN_INDEX_4LSB_385_388 DET_CONFD_ELEVATION_385 DET_CONFD_AZIMUTH_385 DET_HVC_FLAG_385 DET_OUTSIDE_SECTOR_385 DET_EXISTENCE_PROB_385 DET_POINT_TARGET_PROB_385 DET_SNR_385 DET_SUPER_RES_TARGET_385 DET_BI_STATIC_FLAG_385 DET_VALID_FLAG_385 DET_RCS_385 DET_ELEVATION_ERR_385 DET_ELEVATION_385 DET_AZIMUTH_ERR_385 DET_AZIMUTH_385 DET_RANGE_VELOCITY_ERR_385 DET_RANGE_VELOCITY_385 DET_RANGE_ERR_385 DET_RANGE_385 DET_CONFD_ELEVATION_386 DET_CONFD_AZIMUTH_386 DET_HVC_FLAG_386 DET_OUTSIDE_SECTOR_386 DET_EXISTENCE_PROB_386 DET_POINT_TARGET_PROB_386 DET_SNR_386 DET_SUPER_RES_TARGET_386 DET_BI_STATIC_FLAG_386 DET_VALID_FLAG_386 DET_RCS_386 DET_ELEVATION_386 DET_ELEVATION_ERR_386 DET_AZIMUTH_ERR_386 DET_AZIMUTH_386 DET_RANGE_VELOCITY_ERR_386 DET_RANGE_VELOCITY_386 DET_RANGE_ERR_386 DET_RANGE_386 DET_CONFD_ELEVATION_387 DET_CONFD_AZIMUTH_387 DET_HVC_FLAG_387 DET_OUTSIDE_SECTOR_387 DET_EXISTENCE_PROB_387 DET_POINT_TARGET_PROB_387 DET_SUPER_RES_TARGET_387 DET_BI_STATIC_FLAG_387 DET_VALID_FLAG_387 DET_RCS_387 DET_ELEVATION_387 DET_SNR_387 DET_ELEVATION_ERR_387 DET_AZIMUTH_ERR_387 DET_RANGE_VELOCITY_ERR_387 DET_AZIMUTH_387 DET_RANGE_VELOCITY_387 DET_RANGE_ERR_387 DET_RANGE_387 DET_BI_STATIC_FLAG_388 DET_CONFD_ELEVATION_388 DET_CONFD_AZIMUTH_388 DET_HVC_FLAG_388 DET_OUTSIDE_SECTOR_388 DET_EXISTENCE_PROB_388 DET_POINT_TARGET_PROB_388 DET_SNR_388 DET_SUPER_RES_TARGET_388 DET_VALID_FLAG_388 DET_RCS_388 DET_ELEVATION_ERR_388 DET_ELEVATION_388 DET_AZIMUTH_ERR_388 DET_AZIMUTH_388 DET_RANGE_VELOCITY_ERR_388 DET_RANGE_VELOCITY_388 DET_RANGE_ERR_388 DET_RANGE_388;
SIG_GROUP_ 1249 Detections_389_392 1 : DET_MH_CRC16_389_392 DET_MH_CYCLE_COUNTER_389_392 DET_MH_SCAN_INDEX_4LSB_389_392 DET_CONFD_ELEVATION_389 DET_CONFD_AZIMUTH_389 DET_HVC_FLAG_389 DET_OUTSIDE_SECTOR_389 DET_EXISTENCE_PROB_389 DET_POINT_TARGET_PROB_389 DET_SNR_389 DET_SUPER_RES_TARGET_389 DET_BI_STATIC_FLAG_389 DET_VALID_FLAG_389 DET_RCS_389 DET_ELEVATION_ERR_389 DET_ELEVATION_389 DET_AZIMUTH_ERR_389 DET_AZIMUTH_389 DET_RANGE_VELOCITY_ERR_389 DET_RANGE_VELOCITY_389 DET_RANGE_ERR_389 DET_RANGE_389 DET_CONFD_ELEVATION_390 DET_CONFD_AZIMUTH_390 DET_HVC_FLAG_390 DET_OUTSIDE_SECTOR_390 DET_EXISTENCE_PROB_390 DET_POINT_TARGET_PROB_390 DET_SNR_390 DET_SUPER_RES_TARGET_390 DET_BI_STATIC_FLAG_390 DET_VALID_FLAG_390 DET_RCS_390 DET_ELEVATION_390 DET_ELEVATION_ERR_390 DET_AZIMUTH_ERR_390 DET_AZIMUTH_390 DET_RANGE_VELOCITY_ERR_390 DET_RANGE_VELOCITY_390 DET_RANGE_ERR_390 DET_RANGE_390 DET_CONFD_ELEVATION_391 DET_CONFD_AZIMUTH_391 DET_HVC_FLAG_391 DET_OUTSIDE_SECTOR_391 DET_EXISTENCE_PROB_391 DET_POINT_TARGET_PROB_391 DET_SUPER_RES_TARGET_391 DET_BI_STATIC_FLAG_391 DET_VALID_FLAG_391 DET_RCS_391 DET_ELEVATION_391 DET_SNR_391 DET_ELEVATION_ERR_391 DET_AZIMUTH_ERR_391 DET_RANGE_VELOCITY_ERR_391 DET_AZIMUTH_391 DET_RANGE_VELOCITY_391 DET_RANGE_ERR_391 DET_RANGE_391 DET_BI_STATIC_FLAG_392 DET_CONFD_ELEVATION_392 DET_CONFD_AZIMUTH_392 DET_HVC_FLAG_392 DET_OUTSIDE_SECTOR_392 DET_EXISTENCE_PROB_392 DET_POINT_TARGET_PROB_392 DET_SNR_392 DET_SUPER_RES_TARGET_392 DET_VALID_FLAG_392 DET_RCS_392 DET_ELEVATION_ERR_392 DET_ELEVATION_392 DET_AZIMUTH_ERR_392 DET_AZIMUTH_392 DET_RANGE_VELOCITY_ERR_392 DET_RANGE_VELOCITY_392 DET_RANGE_ERR_392 DET_RANGE_392;
SIG_GROUP_ 1250 Detections_393_396 1 : DET_MH_CRC16_393_396 DET_MH_CYCLE_COUNTER_393_396 DET_MH_SCAN_INDEX_4LSB_393_396 DET_CONFD_ELEVATION_393 DET_CONFD_AZIMUTH_393 DET_HVC_FLAG_393 DET_OUTSIDE_SECTOR_393 DET_EXISTENCE_PROB_393 DET_POINT_TARGET_PROB_393 DET_SNR_393 DET_SUPER_RES_TARGET_393 DET_BI_STATIC_FLAG_393 DET_VALID_FLAG_393 DET_RCS_393 DET_ELEVATION_ERR_393 DET_ELEVATION_393 DET_AZIMUTH_ERR_393 DET_AZIMUTH_393 DET_RANGE_VELOCITY_ERR_393 DET_RANGE_VELOCITY_393 DET_RANGE_ERR_393 DET_RANGE_393 DET_CONFD_ELEVATION_394 DET_CONFD_AZIMUTH_394 DET_HVC_FLAG_394 DET_OUTSIDE_SECTOR_394 DET_EXISTENCE_PROB_394 DET_POINT_TARGET_PROB_394 DET_SNR_394 DET_SUPER_RES_TARGET_394 DET_BI_STATIC_FLAG_394 DET_VALID_FLAG_394 DET_RCS_394 DET_ELEVATION_394 DET_ELEVATION_ERR_394 DET_AZIMUTH_ERR_394 DET_AZIMUTH_394 DET_RANGE_VELOCITY_ERR_394 DET_RANGE_VELOCITY_394 DET_RANGE_ERR_394 DET_RANGE_394 DET_CONFD_ELEVATION_395 DET_CONFD_AZIMUTH_395 DET_HVC_FLAG_395 DET_OUTSIDE_SECTOR_395 DET_EXISTENCE_PROB_395 DET_POINT_TARGET_PROB_395 DET_SUPER_RES_TARGET_395 DET_BI_STATIC_FLAG_395 DET_VALID_FLAG_395 DET_RCS_395 DET_ELEVATION_395 DET_SNR_395 DET_ELEVATION_ERR_395 DET_AZIMUTH_ERR_395 DET_RANGE_VELOCITY_ERR_395 DET_AZIMUTH_395 DET_RANGE_VELOCITY_395 DET_RANGE_ERR_395 DET_RANGE_395 DET_BI_STATIC_FLAG_396 DET_CONFD_ELEVATION_396 DET_CONFD_AZIMUTH_396 DET_HVC_FLAG_396 DET_OUTSIDE_SECTOR_396 DET_EXISTENCE_PROB_396 DET_POINT_TARGET_PROB_396 DET_SNR_396 DET_SUPER_RES_TARGET_396 DET_VALID_FLAG_396 DET_RCS_396 DET_ELEVATION_ERR_396 DET_ELEVATION_396 DET_AZIMUTH_ERR_396 DET_AZIMUTH_396 DET_RANGE_VELOCITY_ERR_396 DET_RANGE_VELOCITY_396 DET_RANGE_ERR_396 DET_RANGE_396;
SIG_GROUP_ 1251 Detections_397_400 1 : DET_MH_CRC16_397_400 DET_MH_CYCLE_COUNTER_397_400 DET_MH_SCAN_INDEX_4LSB_397_400 DET_CONFD_ELEVATION_397 DET_CONFD_AZIMUTH_397 DET_HVC_FLAG_397 DET_OUTSIDE_SECTOR_397 DET_EXISTENCE_PROB_397 DET_POINT_TARGET_PROB_397 DET_SNR_397 DET_SUPER_RES_TARGET_397 DET_BI_STATIC_FLAG_397 DET_VALID_FLAG_397 DET_RCS_397 DET_ELEVATION_ERR_397 DET_ELEVATION_397 DET_AZIMUTH_ERR_397 DET_AZIMUTH_397 DET_RANGE_VELOCITY_ERR_397 DET_RANGE_VELOCITY_397 DET_RANGE_ERR_397 DET_RANGE_397 DET_CONFD_ELEVATION_398 DET_CONFD_AZIMUTH_398 DET_HVC_FLAG_398 DET_OUTSIDE_SECTOR_398 DET_EXISTENCE_PROB_398 DET_POINT_TARGET_PROB_398 DET_SNR_398 DET_SUPER_RES_TARGET_398 DET_BI_STATIC_FLAG_398 DET_VALID_FLAG_398 DET_RCS_398 DET_ELEVATION_398 DET_ELEVATION_ERR_398 DET_AZIMUTH_ERR_398 DET_AZIMUTH_398 DET_RANGE_VELOCITY_ERR_398 DET_RANGE_VELOCITY_398 DET_RANGE_ERR_398 DET_RANGE_398 DET_CONFD_ELEVATION_399 DET_CONFD_AZIMUTH_399 DET_HVC_FLAG_399 DET_OUTSIDE_SECTOR_399 DET_EXISTENCE_PROB_399 DET_POINT_TARGET_PROB_399 DET_SUPER_RES_TARGET_399 DET_BI_STATIC_FLAG_399 DET_VALID_FLAG_399 DET_RCS_399 DET_ELEVATION_399 DET_SNR_399 DET_ELEVATION_ERR_399 DET_AZIMUTH_ERR_399 DET_RANGE_VELOCITY_ERR_399 DET_AZIMUTH_399 DET_RANGE_VELOCITY_399 DET_RANGE_ERR_399 DET_RANGE_399 DET_BI_STATIC_FLAG_400 DET_CONFD_ELEVATION_400 DET_CONFD_AZIMUTH_400 DET_HVC_FLAG_400 DET_OUTSIDE_SECTOR_400 DET_EXISTENCE_PROB_400 DET_POINT_TARGET_PROB_400 DET_SNR_400 DET_SUPER_RES_TARGET_400 DET_VALID_FLAG_400 DET_RCS_400 DET_ELEVATION_ERR_400 DET_ELEVATION_400 DET_AZIMUTH_ERR_400 DET_AZIMUTH_400 DET_RANGE_VELOCITY_ERR_400 DET_RANGE_VELOCITY_400 DET_RANGE_ERR_400 DET_RANGE_400;

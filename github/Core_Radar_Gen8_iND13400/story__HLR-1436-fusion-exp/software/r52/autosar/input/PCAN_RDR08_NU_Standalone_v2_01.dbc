VERSION "created by canmatrix"

NS_ :

BS_:

BU_: External_Tool ADAS RDR08

BO_ 1198 RDR_DETECTION_185_188: 64 RDR08
 SG_ DET_RANGE_185 : 7|15@0+ (0.015625,0) [0|500] "m" ADAS
 SG_ DET_RANGE_ERR_185 : 8|7@0+ (0.0075,0) [0|0.9525] "m" ADAS
 SG_ DET_RANGE_VELOCITY_185 : 17|15@0+ (0.0078125,-128) [-128|127.9921875] "m/s" ADAS
 SG_ DET_RANGE_VELOCITY_ERR_185 : 34|8@0+ (0.003,0) [0|0.765] "m/s" ADAS
 SG_ DET_AZIMUTH_185 : 60|13@0+ (0.0004,-1.5708) [-1.5708|1.5708] "rad" ADAS
 SG_ DET_AZIMUTH_ERR_185 : 78|7@0+ (0.00087267,0) [0|0.11082909] "rad" ADAS
 SG_ DET_ELEVATION_185 : 42|8@0+ (0.00275,-0.34925) [-0.34925|0.34925] "rad" ADAS
 SG_ DET_ELEVATION_ERR_185 : 50|6@0+ (0.00174533,0) [0|0.10995579] "rad" ADAS
 SG_ DET_RCS_185 : 119|8@0+ (0.5,-64) [-64|63.5] "dBsm" ADAS
 SG_ DET_VALID_FLAG_185 : 80|1@0+ (1,0) [0|1] "" ADAS
 SG_ DET_BI_STATIC_FLAG_185 : 487|1@0+ (1,0) [0|1] "" ADAS
 SG_ DET_SUPER_RES_TARGET_185 : 79|1@0+ (1,0) [0|1] "" ADAS
 SG_ DET_SNR_185 : 111|8@0+ (0.35156,0) [0|89.6478] "dB" ADAS
 SG_ DET_POINT_TARGET_PROB_185 : 86|4@0+ (6.67,0) [0|100] "%" ADAS
 SG_ DET_EXISTENCE_PROB_185 : 95|6@0+ (1.588,0) [0|100] "%" ADAS
 SG_ DET_OUTSIDE_SECTOR_185 : 103|1@0+ (1,0) [0|1] "" ADAS
 SG_ DET_HVC_FLAG_185 : 87|1@0+ (1,0) [0|1] "" ADAS
 SG_ DET_CONFD_AZIMUTH_185 : 89|2@0+ (1,0) [0|3] "" ADAS
 SG_ DET_CONFD_ELEVATION_185 : 82|2@0+ (1,0) [0|3] "" ADAS
 SG_ DET_RANGE_186 : 127|15@0+ (0.015625,0) [0|500] "m" ADAS
 SG_ DET_RANGE_ERR_186 : 128|7@0+ (0.0075,0) [0|0.9525] "m" ADAS
 SG_ DET_RANGE_VELOCITY_186 : 137|15@0+ (0.0078125,-128) [-128|127.9921875] "m/s" ADAS
 SG_ DET_RANGE_VELOCITY_ERR_186 : 154|8@0+ (0.003,0) [0|0.765] "m/s" ADAS
 SG_ DET_AZIMUTH_186 : 180|13@0+ (0.0004,-1.5708) [-1.5708|1.5708] "rad" ADAS
 SG_ DET_AZIMUTH_ERR_186 : 198|7@0+ (0.00087267,0) [0|0.11082909] "rad" ADAS
 SG_ DET_ELEVATION_186 : 162|8@0+ (0.00275,-0.34925) [-0.34925|0.34925] "rad" ADAS
 SG_ DET_ELEVATION_ERR_186 : 170|6@0+ (0.00174533,0) [0|0.10995579] "rad" ADAS
 SG_ DET_RCS_186 : 239|8@0+ (0.5,-64) [-64|63.5] "dBsm" ADAS
 SG_ DET_VALID_FLAG_186 : 220|1@0+ (1,0) [0|1] "" ADAS
 SG_ DET_BI_STATIC_FLAG_186 : 486|1@0+ (1,0) [0|1] "" ADAS
 SG_ DET_SUPER_RES_TARGET_186 : 199|1@0+ (1,0) [0|1] "" ADAS
 SG_ DET_SNR_186 : 231|8@0+ (0.35156,0) [0|89.6478] "dB" ADAS
 SG_ DET_POINT_TARGET_PROB_186 : 215|4@0+ (6.67,0) [0|100] "%" ADAS
 SG_ DET_EXISTENCE_PROB_186 : 211|6@0+ (1.588,0) [0|100] "%" ADAS
 SG_ DET_OUTSIDE_SECTOR_186 : 221|1@0+ (1,0) [0|1] "" ADAS
 SG_ DET_HVC_FLAG_186 : 207|1@0+ (1,0) [0|1] "" ADAS
 SG_ DET_CONFD_AZIMUTH_186 : 217|2@0+ (1,0) [0|3] "" ADAS
 SG_ DET_CONFD_ELEVATION_186 : 219|2@0+ (1,0) [0|3] "" ADAS
 SG_ DET_RANGE_187 : 247|15@0+ (0.015625,0) [0|500] "m" ADAS
 SG_ DET_RANGE_ERR_187 : 248|7@0+ (0.0075,0) [0|0.9525] "m" ADAS
 SG_ DET_RANGE_VELOCITY_187 : 257|15@0+ (0.0078125,-128) [-128|127.9921875] "m/s" ADAS
 SG_ DET_RANGE_VELOCITY_ERR_187 : 274|8@0+ (0.003,0) [0|0.765] "m/s" ADAS
 SG_ DET_AZIMUTH_187 : 300|13@0+ (0.0004,-1.5708) [-1.5708|1.5708] "rad" ADAS
 SG_ DET_AZIMUTH_ERR_187 : 318|7@0+ (0.00087267,0) [0|0.11082909] "rad" ADAS
 SG_ DET_ELEVATION_187 : 282|8@0+ (0.00275,-0.34925) [-0.34925|0.34925] "rad" ADAS
 SG_ DET_ELEVATION_ERR_187 : 290|6@0+ (0.00174533,0) [0|0.10995579] "rad" ADAS
 SG_ DET_RCS_187 : 359|8@0+ (0.5,-64) [-64|63.5] "dBsm" ADAS
 SG_ DET_VALID_FLAG_187 : 340|1@0+ (1,0) [0|1] "" ADAS
 SG_ DET_BI_STATIC_FLAG_187 : 485|1@0+ (1,0) [0|1] "" ADAS
 SG_ DET_SUPER_RES_TARGET_187 : 319|1@0+ (1,0) [0|1] "" ADAS
 SG_ DET_SNR_187 : 351|8@0+ (0.35156,0) [0|89.6478] "dB" ADAS
 SG_ DET_POINT_TARGET_PROB_187 : 335|4@0+ (6.67,0) [0|100] "%" ADAS
 SG_ DET_EXISTENCE_PROB_187 : 331|6@0+ (1.588,0) [0|100] "%" ADAS
 SG_ DET_OUTSIDE_SECTOR_187 : 341|1@0+ (1,0) [0|1] "" ADAS
 SG_ DET_HVC_FLAG_187 : 327|1@0+ (1,0) [0|1] "" ADAS
 SG_ DET_CONFD_AZIMUTH_187 : 337|2@0+ (1,0) [0|3] "" ADAS
 SG_ DET_CONFD_ELEVATION_187 : 339|2@0+ (1,0) [0|3] "" ADAS
 SG_ DET_RANGE_188 : 367|15@0+ (0.015625,0) [0|500] "m" ADAS
 SG_ DET_RANGE_ERR_188 : 368|7@0+ (0.0075,0) [0|0.9525] "m" ADAS
 SG_ DET_RANGE_VELOCITY_188 : 377|15@0+ (0.0078125,-128) [-128|127.9921875] "m/s" ADAS
 SG_ DET_RANGE_VELOCITY_ERR_188 : 394|8@0+ (0.003,0) [0|0.765] "m/s" ADAS
 SG_ DET_AZIMUTH_188 : 420|13@0+ (0.0004,-1.5708) [-1.5708|1.5708] "rad" ADAS
 SG_ DET_AZIMUTH_ERR_188 : 438|7@0+ (0.00087267,0) [0|0.11082909] "rad" ADAS
 SG_ DET_ELEVATION_188 : 402|8@0+ (0.00275,-0.34925) [-0.34925|0.34925] "rad" ADAS
 SG_ DET_ELEVATION_ERR_188 : 410|6@0+ (0.00174533,0) [0|0.10995579] "rad" ADAS
 SG_ DET_RCS_188 : 479|8@0+ (0.5,-64) [-64|63.5] "dBsm" ADAS
 SG_ DET_VALID_FLAG_188 : 460|1@0+ (1,0) [0|1] "" ADAS
 SG_ DET_BI_STATIC_FLAG_188 : 484|1@0+ (1,0) [0|1] "" ADAS
 SG_ DET_SUPER_RES_TARGET_188 : 439|1@0+ (1,0) [0|1] "" ADAS
 SG_ DET_SNR_188 : 471|8@0+ (0.35156,0) [0|89.6478] "dB" ADAS
 SG_ DET_POINT_TARGET_PROB_188 : 455|4@0+ (6.67,0) [0|100] "%" ADAS
 SG_ DET_EXISTENCE_PROB_188 : 451|6@0+ (1.588,0) [0|100] "%" ADAS
 SG_ DET_OUTSIDE_SECTOR_188 : 461|1@0+ (1,0) [0|1] "" ADAS
 SG_ DET_HVC_FLAG_188 : 447|1@0+ (1,0) [0|1] "" ADAS
 SG_ DET_CONFD_AZIMUTH_188 : 457|2@0+ (1,0) [0|3] "" ADAS
 SG_ DET_CONFD_ELEVATION_188 : 459|2@0+ (1,0) [0|3] "" ADAS
 SG_ DET_MH_SCAN_INDEX_4LSB_185_188 : 483|4@0+ (1,0) [0|15] "" ADAS
 SG_ DET_MH_CYCLE_COUNTER_185_188 : 495|8@0+ (1,0) [0|255] "" ADAS
 SG_ DET_MH_CRC16_185_188 : 503|16@0+ (1,0) [0|65535] "" ADAS

BO_ 1199 RDR_DETECTION_189_192: 64 RDR08
 SG_ DET_RANGE_189 : 7|15@0+ (0.015625,0) [0|500] "m" ADAS
 SG_ DET_RANGE_ERR_189 : 8|7@0+ (0.0075,0) [0|0.9525] "m" ADAS
 SG_ DET_RANGE_VELOCITY_189 : 17|15@0+ (0.0078125,-128) [-128|127.9921875] "m/s" ADAS
 SG_ DET_RANGE_VELOCITY_ERR_189 : 34|8@0+ (0.003,0) [0|0.765] "m/s" ADAS
 SG_ DET_AZIMUTH_189 : 60|13@0+ (0.0004,-1.5708) [-1.5708|1.5708] "rad" ADAS
 SG_ DET_AZIMUTH_ERR_189 : 78|7@0+ (0.00087267,0) [0|0.11082909] "rad" ADAS
 SG_ DET_ELEVATION_189 : 42|8@0+ (0.00275,-0.34925) [-0.34925|0.34925] "rad" ADAS
 SG_ DET_ELEVATION_ERR_189 : 50|6@0+ (0.00174533,0) [0|0.10995579] "rad" ADAS
 SG_ DET_RCS_189 : 119|8@0+ (0.5,-64) [-64|63.5] "dBsm" ADAS
 SG_ DET_VALID_FLAG_189 : 80|1@0+ (1,0) [0|1] "" ADAS
 SG_ DET_BI_STATIC_FLAG_189 : 487|1@0+ (1,0) [0|1] "" ADAS
 SG_ DET_SUPER_RES_TARGET_189 : 79|1@0+ (1,0) [0|1] "" ADAS
 SG_ DET_SNR_189 : 111|8@0+ (0.35156,0) [0|89.6478] "dB" ADAS
 SG_ DET_POINT_TARGET_PROB_189 : 86|4@0+ (6.67,0) [0|100] "%" ADAS
 SG_ DET_EXISTENCE_PROB_189 : 95|6@0+ (1.588,0) [0|100] "%" ADAS
 SG_ DET_OUTSIDE_SECTOR_189 : 103|1@0+ (1,0) [0|1] "" ADAS
 SG_ DET_HVC_FLAG_189 : 87|1@0+ (1,0) [0|1] "" ADAS
 SG_ DET_CONFD_AZIMUTH_189 : 89|2@0+ (1,0) [0|3] "" ADAS
 SG_ DET_CONFD_ELEVATION_189 : 82|2@0+ (1,0) [0|3] "" ADAS
 SG_ DET_RANGE_190 : 127|15@0+ (0.015625,0) [0|500] "m" ADAS
 SG_ DET_RANGE_ERR_190 : 128|7@0+ (0.0075,0) [0|0.9525] "m" ADAS
 SG_ DET_RANGE_VELOCITY_190 : 137|15@0+ (0.0078125,-128) [-128|127.9921875] "m/s" ADAS
 SG_ DET_RANGE_VELOCITY_ERR_190 : 154|8@0+ (0.003,0) [0|0.765] "m/s" ADAS
 SG_ DET_AZIMUTH_190 : 180|13@0+ (0.0004,-1.5708) [-1.5708|1.5708] "rad" ADAS
 SG_ DET_AZIMUTH_ERR_190 : 198|7@0+ (0.00087267,0) [0|0.11082909] "rad" ADAS
 SG_ DET_ELEVATION_190 : 162|8@0+ (0.00275,-0.34925) [-0.34925|0.34925] "rad" ADAS
 SG_ DET_ELEVATION_ERR_190 : 170|6@0+ (0.00174533,0) [0|0.10995579] "rad" ADAS
 SG_ DET_RCS_190 : 239|8@0+ (0.5,-64) [-64|63.5] "dBsm" ADAS
 SG_ DET_VALID_FLAG_190 : 220|1@0+ (1,0) [0|1] "" ADAS
 SG_ DET_BI_STATIC_FLAG_190 : 486|1@0+ (1,0) [0|1] "" ADAS
 SG_ DET_SUPER_RES_TARGET_190 : 199|1@0+ (1,0) [0|1] "" ADAS
 SG_ DET_SNR_190 : 231|8@0+ (0.35156,0) [0|89.6478] "dB" ADAS
 SG_ DET_POINT_TARGET_PROB_190 : 215|4@0+ (6.67,0) [0|100] "%" ADAS
 SG_ DET_EXISTENCE_PROB_190 : 211|6@0+ (1.588,0) [0|100] "%" ADAS
 SG_ DET_OUTSIDE_SECTOR_190 : 221|1@0+ (1,0) [0|1] "" ADAS
 SG_ DET_HVC_FLAG_190 : 207|1@0+ (1,0) [0|1] "" ADAS
 SG_ DET_CONFD_AZIMUTH_190 : 217|2@0+ (1,0) [0|3] "" ADAS
 SG_ DET_CONFD_ELEVATION_190 : 219|2@0+ (1,0) [0|3] "" ADAS
 SG_ DET_RANGE_191 : 247|15@0+ (0.015625,0) [0|500] "m" ADAS
 SG_ DET_RANGE_ERR_191 : 248|7@0+ (0.0075,0) [0|0.9525] "m" ADAS
 SG_ DET_RANGE_VELOCITY_191 : 257|15@0+ (0.0078125,-128) [-128|127.9921875] "m/s" ADAS
 SG_ DET_RANGE_VELOCITY_ERR_191 : 274|8@0+ (0.003,0) [0|0.765] "m/s" ADAS
 SG_ DET_AZIMUTH_191 : 300|13@0+ (0.0004,-1.5708) [-1.5708|1.5708] "rad" ADAS
 SG_ DET_AZIMUTH_ERR_191 : 318|7@0+ (0.00087267,0) [0|0.11082909] "rad" ADAS
 SG_ DET_ELEVATION_191 : 282|8@0+ (0.00275,-0.34925) [-0.34925|0.34925] "rad" ADAS
 SG_ DET_ELEVATION_ERR_191 : 290|6@0+ (0.00174533,0) [0|0.10995579] "rad" ADAS
 SG_ DET_RCS_191 : 359|8@0+ (0.5,-64) [-64|63.5] "dBsm" ADAS
 SG_ DET_VALID_FLAG_191 : 340|1@0+ (1,0) [0|1] "" ADAS
 SG_ DET_BI_STATIC_FLAG_191 : 485|1@0+ (1,0) [0|1] "" ADAS
 SG_ DET_SUPER_RES_TARGET_191 : 319|1@0+ (1,0) [0|1] "" ADAS
 SG_ DET_SNR_191 : 351|8@0+ (0.35156,0) [0|89.6478] "dB" ADAS
 SG_ DET_POINT_TARGET_PROB_191 : 335|4@0+ (6.67,0) [0|100] "%" ADAS
 SG_ DET_EXISTENCE_PROB_191 : 331|6@0+ (1.588,0) [0|100] "%" ADAS
 SG_ DET_OUTSIDE_SECTOR_191 : 341|1@0+ (1,0) [0|1] "" ADAS
 SG_ DET_HVC_FLAG_191 : 327|1@0+ (1,0) [0|1] "" ADAS
 SG_ DET_CONFD_AZIMUTH_191 : 337|2@0+ (1,0) [0|3] "" ADAS
 SG_ DET_CONFD_ELEVATION_191 : 339|2@0+ (1,0) [0|3] "" ADAS
 SG_ DET_RANGE_192 : 367|15@0+ (0.015625,0) [0|500] "m" ADAS
 SG_ DET_RANGE_ERR_192 : 368|7@0+ (0.0075,0) [0|0.9525] "m" ADAS
 SG_ DET_RANGE_VELOCITY_192 : 377|15@0+ (0.0078125,-128) [-128|127.9921875] "m/s" ADAS
 SG_ DET_RANGE_VELOCITY_ERR_192 : 394|8@0+ (0.003,0) [0|0.765] "m/s" ADAS
 SG_ DET_AZIMUTH_192 : 420|13@0+ (0.0004,-1.5708) [-1.5708|1.5708] "rad" ADAS
 SG_ DET_AZIMUTH_ERR_192 : 438|7@0+ (0.00087267,0) [0|0.11082909] "rad" ADAS
 SG_ DET_ELEVATION_192 : 402|8@0+ (0.00275,-0.34925) [-0.34925|0.34925] "rad" ADAS
 SG_ DET_ELEVATION_ERR_192 : 410|6@0+ (0.00174533,0) [0|0.10995579] "rad" ADAS
 SG_ DET_RCS_192 : 479|8@0+ (0.5,-64) [-64|63.5] "dBsm" ADAS
 SG_ DET_VALID_FLAG_192 : 460|1@0+ (1,0) [0|1] "" ADAS
 SG_ DET_BI_STATIC_FLAG_192 : 484|1@0+ (1,0) [0|1] "" ADAS
 SG_ DET_SUPER_RES_TARGET_192 : 439|1@0+ (1,0) [0|1] "" ADAS
 SG_ DET_SNR_192 : 471|8@0+ (0.35156,0) [0|89.6478] "dB" ADAS
 SG_ DET_POINT_TARGET_PROB_192 : 455|4@0+ (6.67,0) [0|100] "%" ADAS
 SG_ DET_EXISTENCE_PROB_192 : 451|6@0+ (1.588,0) [0|100] "%" ADAS
 SG_ DET_OUTSIDE_SECTOR_192 : 461|1@0+ (1,0) [0|1] "" ADAS
 SG_ DET_HVC_FLAG_192 : 447|1@0+ (1,0) [0|1] "" ADAS
 SG_ DET_CONFD_AZIMUTH_192 : 457|2@0+ (1,0) [0|3] "" ADAS
 SG_ DET_CONFD_ELEVATION_192 : 459|2@0+ (1,0) [0|3] "" ADAS
 SG_ DET_MH_SCAN_INDEX_4LSB_189_192 : 483|4@0+ (1,0) [0|15] "" ADAS
 SG_ DET_MH_CYCLE_COUNTER_189_192 : 495|8@0+ (1,0) [0|255] "" ADAS
 SG_ DET_MH_CRC16_189_192 : 503|16@0+ (1,0) [0|65535] "" ADAS

BO_ 1200 RDR_DETECTION_193_196: 64 RDR08
 SG_ DET_RANGE_193 : 7|15@0+ (0.015625,0) [0|500] "m" ADAS
 SG_ DET_RANGE_ERR_193 : 8|7@0+ (0.0075,0) [0|0.9525] "m" ADAS
 SG_ DET_RANGE_VELOCITY_193 : 17|15@0+ (0.0078125,-128) [-128|127.9921875] "m/s" ADAS
 SG_ DET_RANGE_VELOCITY_ERR_193 : 34|8@0+ (0.003,0) [0|0.765] "m/s" ADAS
 SG_ DET_AZIMUTH_193 : 60|13@0+ (0.0004,-1.5708) [-1.5708|1.5708] "rad" ADAS
 SG_ DET_AZIMUTH_ERR_193 : 78|7@0+ (0.00087267,0) [0|0.11082909] "rad" ADAS
 SG_ DET_ELEVATION_193 : 42|8@0+ (0.00275,-0.34925) [-0.34925|0.34925] "rad" ADAS
 SG_ DET_ELEVATION_ERR_193 : 50|6@0+ (0.00174533,0) [0|0.10995579] "rad" ADAS
 SG_ DET_RCS_193 : 119|8@0+ (0.5,-64) [-64|63.5] "dBsm" ADAS
 SG_ DET_VALID_FLAG_193 : 80|1@0+ (1,0) [0|1] "" ADAS
 SG_ DET_BI_STATIC_FLAG_193 : 487|1@0+ (1,0) [0|1] "" ADAS
 SG_ DET_SUPER_RES_TARGET_193 : 79|1@0+ (1,0) [0|1] "" ADAS
 SG_ DET_SNR_193 : 111|8@0+ (0.35156,0) [0|89.6478] "dB" ADAS
 SG_ DET_POINT_TARGET_PROB_193 : 86|4@0+ (6.67,0) [0|100] "%" ADAS
 SG_ DET_EXISTENCE_PROB_193 : 95|6@0+ (1.588,0) [0|100] "%" ADAS
 SG_ DET_OUTSIDE_SECTOR_193 : 103|1@0+ (1,0) [0|1] "" ADAS
 SG_ DET_HVC_FLAG_193 : 87|1@0+ (1,0) [0|1] "" ADAS
 SG_ DET_CONFD_AZIMUTH_193 : 89|2@0+ (1,0) [0|3] "" ADAS
 SG_ DET_CONFD_ELEVATION_193 : 82|2@0+ (1,0) [0|3] "" ADAS
 SG_ DET_RANGE_194 : 127|15@0+ (0.015625,0) [0|500] "m" ADAS
 SG_ DET_RANGE_ERR_194 : 128|7@0+ (0.0075,0) [0|0.9525] "m" ADAS
 SG_ DET_RANGE_VELOCITY_194 : 137|15@0+ (0.0078125,-128) [-128|127.9921875] "m/s" ADAS
 SG_ DET_RANGE_VELOCITY_ERR_194 : 154|8@0+ (0.003,0) [0|0.765] "m/s" ADAS
 SG_ DET_AZIMUTH_194 : 180|13@0+ (0.0004,-1.5708) [-1.5708|1.5708] "rad" ADAS
 SG_ DET_AZIMUTH_ERR_194 : 198|7@0+ (0.00087267,0) [0|0.11082909] "rad" ADAS
 SG_ DET_ELEVATION_194 : 162|8@0+ (0.00275,-0.34925) [-0.34925|0.34925] "rad" ADAS
 SG_ DET_ELEVATION_ERR_194 : 170|6@0+ (0.00174533,0) [0|0.10995579] "rad" ADAS
 SG_ DET_RCS_194 : 239|8@0+ (0.5,-64) [-64|63.5] "dBsm" ADAS
 SG_ DET_VALID_FLAG_194 : 220|1@0+ (1,0) [0|1] "" ADAS
 SG_ DET_BI_STATIC_FLAG_194 : 486|1@0+ (1,0) [0|1] "" ADAS
 SG_ DET_SUPER_RES_TARGET_194 : 199|1@0+ (1,0) [0|1] "" ADAS
 SG_ DET_SNR_194 : 231|8@0+ (0.35156,0) [0|89.6478] "dB" ADAS
 SG_ DET_POINT_TARGET_PROB_194 : 215|4@0+ (6.67,0) [0|100] "%" ADAS
 SG_ DET_EXISTENCE_PROB_194 : 211|6@0+ (1.588,0) [0|100] "%" ADAS
 SG_ DET_OUTSIDE_SECTOR_194 : 221|1@0+ (1,0) [0|1] "" ADAS
 SG_ DET_HVC_FLAG_194 : 207|1@0+ (1,0) [0|1] "" ADAS
 SG_ DET_CONFD_AZIMUTH_194 : 217|2@0+ (1,0) [0|3] "" ADAS
 SG_ DET_CONFD_ELEVATION_194 : 219|2@0+ (1,0) [0|3] "" ADAS
 SG_ DET_RANGE_195 : 247|15@0+ (0.015625,0) [0|500] "m" ADAS
 SG_ DET_RANGE_ERR_195 : 248|7@0+ (0.0075,0) [0|0.9525] "m" ADAS
 SG_ DET_RANGE_VELOCITY_195 : 257|15@0+ (0.0078125,-128) [-128|127.9921875] "m/s" ADAS
 SG_ DET_RANGE_VELOCITY_ERR_195 : 274|8@0+ (0.003,0) [0|0.765] "m/s" ADAS
 SG_ DET_AZIMUTH_195 : 300|13@0+ (0.0004,-1.5708) [-1.5708|1.5708] "rad" ADAS
 SG_ DET_AZIMUTH_ERR_195 : 318|7@0+ (0.00087267,0) [0|0.11082909] "rad" ADAS
 SG_ DET_ELEVATION_195 : 282|8@0+ (0.00275,-0.34925) [-0.34925|0.34925] "rad" ADAS
 SG_ DET_ELEVATION_ERR_195 : 290|6@0+ (0.00174533,0) [0|0.10995579] "rad" ADAS
 SG_ DET_RCS_195 : 359|8@0+ (0.5,-64) [-64|63.5] "dBsm" ADAS
 SG_ DET_VALID_FLAG_195 : 340|1@0+ (1,0) [0|1] "" ADAS
 SG_ DET_BI_STATIC_FLAG_195 : 485|1@0+ (1,0) [0|1] "" ADAS
 SG_ DET_SUPER_RES_TARGET_195 : 319|1@0+ (1,0) [0|1] "" ADAS
 SG_ DET_SNR_195 : 351|8@0+ (0.35156,0) [0|89.6478] "dB" ADAS
 SG_ DET_POINT_TARGET_PROB_195 : 335|4@0+ (6.67,0) [0|100] "%" ADAS
 SG_ DET_EXISTENCE_PROB_195 : 331|6@0+ (1.588,0) [0|100] "%" ADAS
 SG_ DET_OUTSIDE_SECTOR_195 : 341|1@0+ (1,0) [0|1] "" ADAS
 SG_ DET_HVC_FLAG_195 : 327|1@0+ (1,0) [0|1] "" ADAS
 SG_ DET_CONFD_AZIMUTH_195 : 337|2@0+ (1,0) [0|3] "" ADAS
 SG_ DET_CONFD_ELEVATION_195 : 339|2@0+ (1,0) [0|3] "" ADAS
 SG_ DET_RANGE_196 : 367|15@0+ (0.015625,0) [0|500] "m" ADAS
 SG_ DET_RANGE_ERR_196 : 368|7@0+ (0.0075,0) [0|0.9525] "m" ADAS
 SG_ DET_RANGE_VELOCITY_196 : 377|15@0+ (0.0078125,-128) [-128|127.9921875] "m/s" ADAS
 SG_ DET_RANGE_VELOCITY_ERR_196 : 394|8@0+ (0.003,0) [0|0.765] "m/s" ADAS
 SG_ DET_AZIMUTH_196 : 420|13@0+ (0.0004,-1.5708) [-1.5708|1.5708] "rad" ADAS
 SG_ DET_AZIMUTH_ERR_196 : 438|7@0+ (0.00087267,0) [0|0.11082909] "rad" ADAS
 SG_ DET_ELEVATION_196 : 402|8@0+ (0.00275,-0.34925) [-0.34925|0.34925] "rad" ADAS
 SG_ DET_ELEVATION_ERR_196 : 410|6@0+ (0.00174533,0) [0|0.10995579] "rad" ADAS
 SG_ DET_RCS_196 : 479|8@0+ (0.5,-64) [-64|63.5] "dBsm" ADAS
 SG_ DET_VALID_FLAG_196 : 460|1@0+ (1,0) [0|1] "" ADAS
 SG_ DET_BI_STATIC_FLAG_196 : 484|1@0+ (1,0) [0|1] "" ADAS
 SG_ DET_SUPER_RES_TARGET_196 : 439|1@0+ (1,0) [0|1] "" ADAS
 SG_ DET_SNR_196 : 471|8@0+ (0.35156,0) [0|89.6478] "dB" ADAS
 SG_ DET_POINT_TARGET_PROB_196 : 455|4@0+ (6.67,0) [0|100] "%" ADAS
 SG_ DET_EXISTENCE_PROB_196 : 451|6@0+ (1.588,0) [0|100] "%" ADAS
 SG_ DET_OUTSIDE_SECTOR_196 : 461|1@0+ (1,0) [0|1] "" ADAS
 SG_ DET_HVC_FLAG_196 : 447|1@0+ (1,0) [0|1] "" ADAS
 SG_ DET_CONFD_AZIMUTH_196 : 457|2@0+ (1,0) [0|3] "" ADAS
 SG_ DET_CONFD_ELEVATION_196 : 459|2@0+ (1,0) [0|3] "" ADAS
 SG_ DET_MH_SCAN_INDEX_4LSB_193_196 : 483|4@0+ (1,0) [0|15] "" ADAS
 SG_ DET_MH_CYCLE_COUNTER_193_196 : 495|8@0+ (1,0) [0|255] "" ADAS
 SG_ DET_MH_CRC16_193_196 : 503|16@0+ (1,0) [0|65535] "" ADAS

BO_ 1201 RDR_DETECTION_197_200: 64 RDR08
 SG_ DET_RANGE_197 : 7|15@0+ (0.015625,0) [0|500] "m" ADAS
 SG_ DET_RANGE_ERR_197 : 8|7@0+ (0.0075,0) [0|0.9525] "m" ADAS
 SG_ DET_RANGE_VELOCITY_197 : 17|15@0+ (0.0078125,-128) [-128|127.9921875] "m/s" ADAS
 SG_ DET_RANGE_VELOCITY_ERR_197 : 34|8@0+ (0.003,0) [0|0.765] "m/s" ADAS
 SG_ DET_AZIMUTH_197 : 60|13@0+ (0.0004,-1.5708) [-1.5708|1.5708] "rad" ADAS
 SG_ DET_AZIMUTH_ERR_197 : 78|7@0+ (0.00087267,0) [0|0.11082909] "rad" ADAS
 SG_ DET_ELEVATION_197 : 42|8@0+ (0.00275,-0.34925) [-0.34925|0.34925] "rad" ADAS
 SG_ DET_ELEVATION_ERR_197 : 50|6@0+ (0.00174533,0) [0|0.10995579] "rad" ADAS
 SG_ DET_RCS_197 : 119|8@0+ (0.5,-64) [-64|63.5] "dBsm" ADAS
 SG_ DET_VALID_FLAG_197 : 80|1@0+ (1,0) [0|1] "" ADAS
 SG_ DET_BI_STATIC_FLAG_197 : 487|1@0+ (1,0) [0|1] "" ADAS
 SG_ DET_SUPER_RES_TARGET_197 : 79|1@0+ (1,0) [0|1] "" ADAS
 SG_ DET_SNR_197 : 111|8@0+ (0.35156,0) [0|89.6478] "dB" ADAS
 SG_ DET_POINT_TARGET_PROB_197 : 86|4@0+ (6.67,0) [0|100] "%" ADAS
 SG_ DET_EXISTENCE_PROB_197 : 95|6@0+ (1.588,0) [0|100] "%" ADAS
 SG_ DET_OUTSIDE_SECTOR_197 : 103|1@0+ (1,0) [0|1] "" ADAS
 SG_ DET_HVC_FLAG_197 : 87|1@0+ (1,0) [0|1] "" ADAS
 SG_ DET_CONFD_AZIMUTH_197 : 89|2@0+ (1,0) [0|3] "" ADAS
 SG_ DET_CONFD_ELEVATION_197 : 82|2@0+ (1,0) [0|3] "" ADAS
 SG_ DET_RANGE_198 : 127|15@0+ (0.015625,0) [0|500] "m" ADAS
 SG_ DET_RANGE_ERR_198 : 128|7@0+ (0.0075,0) [0|0.9525] "m" ADAS
 SG_ DET_RANGE_VELOCITY_198 : 137|15@0+ (0.0078125,-128) [-128|127.9921875] "m/s" ADAS
 SG_ DET_RANGE_VELOCITY_ERR_198 : 154|8@0+ (0.003,0) [0|0.765] "m/s" ADAS
 SG_ DET_AZIMUTH_198 : 180|13@0+ (0.0004,-1.5708) [-1.5708|1.5708] "rad" ADAS
 SG_ DET_AZIMUTH_ERR_198 : 198|7@0+ (0.00087267,0) [0|0.11082909] "rad" ADAS
 SG_ DET_ELEVATION_198 : 162|8@0+ (0.00275,-0.34925) [-0.34925|0.34925] "rad" ADAS
 SG_ DET_ELEVATION_ERR_198 : 170|6@0+ (0.00174533,0) [0|0.10995579] "rad" ADAS
 SG_ DET_RCS_198 : 239|8@0+ (0.5,-64) [-64|63.5] "dBsm" ADAS
 SG_ DET_VALID_FLAG_198 : 220|1@0+ (1,0) [0|1] "" ADAS
 SG_ DET_BI_STATIC_FLAG_198 : 486|1@0+ (1,0) [0|1] "" ADAS
 SG_ DET_SUPER_RES_TARGET_198 : 199|1@0+ (1,0) [0|1] "" ADAS
 SG_ DET_SNR_198 : 231|8@0+ (0.35156,0) [0|89.6478] "dB" ADAS
 SG_ DET_POINT_TARGET_PROB_198 : 215|4@0+ (6.67,0) [0|100] "%" ADAS
 SG_ DET_EXISTENCE_PROB_198 : 211|6@0+ (1.588,0) [0|100] "%" ADAS
 SG_ DET_OUTSIDE_SECTOR_198 : 221|1@0+ (1,0) [0|1] "" ADAS
 SG_ DET_HVC_FLAG_198 : 207|1@0+ (1,0) [0|1] "" ADAS
 SG_ DET_CONFD_AZIMUTH_198 : 217|2@0+ (1,0) [0|3] "" ADAS
 SG_ DET_CONFD_ELEVATION_198 : 219|2@0+ (1,0) [0|3] "" ADAS
 SG_ DET_RANGE_199 : 247|15@0+ (0.015625,0) [0|500] "m" ADAS
 SG_ DET_RANGE_ERR_199 : 248|7@0+ (0.0075,0) [0|0.9525] "m" ADAS
 SG_ DET_RANGE_VELOCITY_199 : 257|15@0+ (0.0078125,-128) [-128|127.9921875] "m/s" ADAS
 SG_ DET_RANGE_VELOCITY_ERR_199 : 274|8@0+ (0.003,0) [0|0.765] "m/s" ADAS
 SG_ DET_AZIMUTH_199 : 300|13@0+ (0.0004,-1.5708) [-1.5708|1.5708] "rad" ADAS
 SG_ DET_AZIMUTH_ERR_199 : 318|7@0+ (0.00087267,0) [0|0.11082909] "rad" ADAS
 SG_ DET_ELEVATION_199 : 282|8@0+ (0.00275,-0.34925) [-0.34925|0.34925] "rad" ADAS
 SG_ DET_ELEVATION_ERR_199 : 290|6@0+ (0.00174533,0) [0|0.10995579] "rad" ADAS
 SG_ DET_RCS_199 : 359|8@0+ (0.5,-64) [-64|63.5] "dBsm" ADAS
 SG_ DET_VALID_FLAG_199 : 340|1@0+ (1,0) [0|1] "" ADAS
 SG_ DET_BI_STATIC_FLAG_199 : 485|1@0+ (1,0) [0|1] "" ADAS
 SG_ DET_SUPER_RES_TARGET_199 : 319|1@0+ (1,0) [0|1] "" ADAS
 SG_ DET_SNR_199 : 351|8@0+ (0.35156,0) [0|89.6478] "dB" ADAS
 SG_ DET_POINT_TARGET_PROB_199 : 335|4@0+ (6.67,0) [0|100] "%" ADAS
 SG_ DET_EXISTENCE_PROB_199 : 331|6@0+ (1.588,0) [0|100] "%" ADAS
 SG_ DET_OUTSIDE_SECTOR_199 : 341|1@0+ (1,0) [0|1] "" ADAS
 SG_ DET_HVC_FLAG_199 : 327|1@0+ (1,0) [0|1] "" ADAS
 SG_ DET_CONFD_AZIMUTH_199 : 337|2@0+ (1,0) [0|3] "" ADAS
 SG_ DET_CONFD_ELEVATION_199 : 339|2@0+ (1,0) [0|3] "" ADAS
 SG_ DET_RANGE_200 : 367|15@0+ (0.015625,0) [0|500] "m" ADAS
 SG_ DET_RANGE_ERR_200 : 368|7@0+ (0.0075,0) [0|0.9525] "m" ADAS
 SG_ DET_RANGE_VELOCITY_200 : 377|15@0+ (0.0078125,-128) [-128|127.9921875] "m/s" ADAS
 SG_ DET_RANGE_VELOCITY_ERR_200 : 394|8@0+ (0.003,0) [0|0.765] "m/s" ADAS
 SG_ DET_AZIMUTH_200 : 420|13@0+ (0.0004,-1.5708) [-1.5708|1.5708] "rad" ADAS
 SG_ DET_AZIMUTH_ERR_200 : 438|7@0+ (0.00087267,0) [0|0.11082909] "rad" ADAS
 SG_ DET_ELEVATION_200 : 402|8@0+ (0.00275,-0.34925) [-0.34925|0.34925] "rad" ADAS
 SG_ DET_ELEVATION_ERR_200 : 410|6@0+ (0.00174533,0) [0|0.10995579] "rad" ADAS
 SG_ DET_RCS_200 : 479|8@0+ (0.5,-64) [-64|63.5] "dBsm" ADAS
 SG_ DET_VALID_FLAG_200 : 460|1@0+ (1,0) [0|1] "" ADAS
 SG_ DET_BI_STATIC_FLAG_200 : 484|1@0+ (1,0) [0|1] "" ADAS
 SG_ DET_SUPER_RES_TARGET_200 : 439|1@0+ (1,0) [0|1] "" ADAS
 SG_ DET_SNR_200 : 471|8@0+ (0.35156,0) [0|89.6478] "dB" ADAS
 SG_ DET_POINT_TARGET_PROB_200 : 455|4@0+ (6.67,0) [0|100] "%" ADAS
 SG_ DET_EXISTENCE_PROB_200 : 451|6@0+ (1.588,0) [0|100] "%" ADAS
 SG_ DET_OUTSIDE_SECTOR_200 : 461|1@0+ (1,0) [0|1] "" ADAS
 SG_ DET_HVC_FLAG_200 : 447|1@0+ (1,0) [0|1] "" ADAS
 SG_ DET_CONFD_AZIMUTH_200 : 457|2@0+ (1,0) [0|3] "" ADAS
 SG_ DET_CONFD_ELEVATION_200 : 459|2@0+ (1,0) [0|3] "" ADAS
 SG_ DET_MH_SCAN_INDEX_4LSB_197_200 : 483|4@0+ (1,0) [0|15] "" ADAS
 SG_ DET_MH_CYCLE_COUNTER_197_200 : 495|8@0+ (1,0) [0|255] "" ADAS
 SG_ DET_MH_CRC16_197_200 : 503|16@0+ (1,0) [0|65535] "" ADAS

BO_ 1202 RDR_DETECTION_201_204: 64 RDR08
 SG_ DET_RANGE_201 : 7|15@0+ (0.015625,0) [0|500] "m" ADAS
 SG_ DET_RANGE_ERR_201 : 8|7@0+ (0.0075,0) [0|0.9525] "m" ADAS
 SG_ DET_RANGE_VELOCITY_201 : 17|15@0+ (0.0078125,-128) [-128|127.9921875] "m/s" ADAS
 SG_ DET_RANGE_VELOCITY_ERR_201 : 34|8@0+ (0.003,0) [0|0.765] "m/s" ADAS
 SG_ DET_AZIMUTH_201 : 60|13@0+ (0.0004,-1.5708) [-1.5708|1.5708] "rad" ADAS
 SG_ DET_AZIMUTH_ERR_201 : 78|7@0+ (0.00087267,0) [0|0.11082909] "rad" ADAS
 SG_ DET_ELEVATION_201 : 42|8@0+ (0.00275,-0.34925) [-0.34925|0.34925] "rad" ADAS
 SG_ DET_ELEVATION_ERR_201 : 50|6@0+ (0.00174533,0) [0|0.10995579] "rad" ADAS
 SG_ DET_RCS_201 : 119|8@0+ (0.5,-64) [-64|63.5] "dBsm" ADAS
 SG_ DET_VALID_FLAG_201 : 80|1@0+ (1,0) [0|1] "" ADAS
 SG_ DET_BI_STATIC_FLAG_201 : 487|1@0+ (1,0) [0|1] "" ADAS
 SG_ DET_SUPER_RES_TARGET_201 : 79|1@0+ (1,0) [0|1] "" ADAS
 SG_ DET_SNR_201 : 111|8@0+ (0.35156,0) [0|89.6478] "dB" ADAS
 SG_ DET_POINT_TARGET_PROB_201 : 86|4@0+ (6.67,0) [0|100] "%" ADAS
 SG_ DET_EXISTENCE_PROB_201 : 95|6@0+ (1.588,0) [0|100] "%" ADAS
 SG_ DET_OUTSIDE_SECTOR_201 : 103|1@0+ (1,0) [0|1] "" ADAS
 SG_ DET_HVC_FLAG_201 : 87|1@0+ (1,0) [0|1] "" ADAS
 SG_ DET_CONFD_AZIMUTH_201 : 89|2@0+ (1,0) [0|3] "" ADAS
 SG_ DET_CONFD_ELEVATION_201 : 82|2@0+ (1,0) [0|3] "" ADAS
 SG_ DET_RANGE_202 : 127|15@0+ (0.015625,0) [0|500] "m" ADAS
 SG_ DET_RANGE_ERR_202 : 128|7@0+ (0.0075,0) [0|0.9525] "m" ADAS
 SG_ DET_RANGE_VELOCITY_202 : 137|15@0+ (0.0078125,-128) [-128|127.9921875] "m/s" ADAS
 SG_ DET_RANGE_VELOCITY_ERR_202 : 154|8@0+ (0.003,0) [0|0.765] "m/s" ADAS
 SG_ DET_AZIMUTH_202 : 180|13@0+ (0.0004,-1.5708) [-1.5708|1.5708] "rad" ADAS
 SG_ DET_AZIMUTH_ERR_202 : 198|7@0+ (0.00087267,0) [0|0.11082909] "rad" ADAS
 SG_ DET_ELEVATION_202 : 162|8@0+ (0.00275,-0.34925) [-0.34925|0.34925] "rad" ADAS
 SG_ DET_ELEVATION_ERR_202 : 170|6@0+ (0.00174533,0) [0|0.10995579] "rad" ADAS
 SG_ DET_RCS_202 : 239|8@0+ (0.5,-64) [-64|63.5] "dBsm" ADAS
 SG_ DET_VALID_FLAG_202 : 220|1@0+ (1,0) [0|1] "" ADAS
 SG_ DET_BI_STATIC_FLAG_202 : 486|1@0+ (1,0) [0|1] "" ADAS
 SG_ DET_SUPER_RES_TARGET_202 : 199|1@0+ (1,0) [0|1] "" ADAS
 SG_ DET_SNR_202 : 231|8@0+ (0.35156,0) [0|89.6478] "dB" ADAS
 SG_ DET_POINT_TARGET_PROB_202 : 215|4@0+ (6.67,0) [0|100] "%" ADAS
 SG_ DET_EXISTENCE_PROB_202 : 211|6@0+ (1.588,0) [0|100] "%" ADAS
 SG_ DET_OUTSIDE_SECTOR_202 : 221|1@0+ (1,0) [0|1] "" ADAS
 SG_ DET_HVC_FLAG_202 : 207|1@0+ (1,0) [0|1] "" ADAS
 SG_ DET_CONFD_AZIMUTH_202 : 217|2@0+ (1,0) [0|3] "" ADAS
 SG_ DET_CONFD_ELEVATION_202 : 219|2@0+ (1,0) [0|3] "" ADAS
 SG_ DET_RANGE_203 : 247|15@0+ (0.015625,0) [0|500] "m" ADAS
 SG_ DET_RANGE_ERR_203 : 248|7@0+ (0.0075,0) [0|0.9525] "m" ADAS
 SG_ DET_RANGE_VELOCITY_203 : 257|15@0+ (0.0078125,-128) [-128|127.9921875] "m/s" ADAS
 SG_ DET_RANGE_VELOCITY_ERR_203 : 274|8@0+ (0.003,0) [0|0.765] "m/s" ADAS
 SG_ DET_AZIMUTH_203 : 300|13@0+ (0.0004,-1.5708) [-1.5708|1.5708] "rad" ADAS
 SG_ DET_AZIMUTH_ERR_203 : 318|7@0+ (0.00087267,0) [0|0.11082909] "rad" ADAS
 SG_ DET_ELEVATION_203 : 282|8@0+ (0.00275,-0.34925) [-0.34925|0.34925] "rad" ADAS
 SG_ DET_ELEVATION_ERR_203 : 290|6@0+ (0.00174533,0) [0|0.10995579] "rad" ADAS
 SG_ DET_RCS_203 : 359|8@0+ (0.5,-64) [-64|63.5] "dBsm" ADAS
 SG_ DET_VALID_FLAG_203 : 340|1@0+ (1,0) [0|1] "" ADAS
 SG_ DET_BI_STATIC_FLAG_203 : 485|1@0+ (1,0) [0|1] "" ADAS
 SG_ DET_SUPER_RES_TARGET_203 : 319|1@0+ (1,0) [0|1] "" ADAS
 SG_ DET_SNR_203 : 351|8@0+ (0.35156,0) [0|89.6478] "dB" ADAS
 SG_ DET_POINT_TARGET_PROB_203 : 335|4@0+ (6.67,0) [0|100] "%" ADAS
 SG_ DET_EXISTENCE_PROB_203 : 331|6@0+ (1.588,0) [0|100] "%" ADAS
 SG_ DET_OUTSIDE_SECTOR_203 : 341|1@0+ (1,0) [0|1] "" ADAS
 SG_ DET_HVC_FLAG_203 : 327|1@0+ (1,0) [0|1] "" ADAS
 SG_ DET_CONFD_AZIMUTH_203 : 337|2@0+ (1,0) [0|3] "" ADAS
 SG_ DET_CONFD_ELEVATION_203 : 339|2@0+ (1,0) [0|3] "" ADAS
 SG_ DET_RANGE_204 : 367|15@0+ (0.015625,0) [0|500] "m" ADAS
 SG_ DET_RANGE_ERR_204 : 368|7@0+ (0.0075,0) [0|0.9525] "m" ADAS
 SG_ DET_RANGE_VELOCITY_204 : 377|15@0+ (0.0078125,-128) [-128|127.9921875] "m/s" ADAS
 SG_ DET_RANGE_VELOCITY_ERR_204 : 394|8@0+ (0.003,0) [0|0.765] "m/s" ADAS
 SG_ DET_AZIMUTH_204 : 420|13@0+ (0.0004,-1.5708) [-1.5708|1.5708] "rad" ADAS
 SG_ DET_AZIMUTH_ERR_204 : 438|7@0+ (0.00087267,0) [0|0.11082909] "rad" ADAS
 SG_ DET_ELEVATION_204 : 402|8@0+ (0.00275,-0.34925) [-0.34925|0.34925] "rad" ADAS
 SG_ DET_ELEVATION_ERR_204 : 410|6@0+ (0.00174533,0) [0|0.10995579] "rad" ADAS
 SG_ DET_RCS_204 : 479|8@0+ (0.5,-64) [-64|63.5] "dBsm" ADAS
 SG_ DET_VALID_FLAG_204 : 460|1@0+ (1,0) [0|1] "" ADAS
 SG_ DET_BI_STATIC_FLAG_204 : 484|1@0+ (1,0) [0|1] "" ADAS
 SG_ DET_SUPER_RES_TARGET_204 : 439|1@0+ (1,0) [0|1] "" ADAS
 SG_ DET_SNR_204 : 471|8@0+ (0.35156,0) [0|89.6478] "dB" ADAS
 SG_ DET_POINT_TARGET_PROB_204 : 455|4@0+ (6.67,0) [0|100] "%" ADAS
 SG_ DET_EXISTENCE_PROB_204 : 451|6@0+ (1.588,0) [0|100] "%" ADAS
 SG_ DET_OUTSIDE_SECTOR_204 : 461|1@0+ (1,0) [0|1] "" ADAS
 SG_ DET_HVC_FLAG_204 : 447|1@0+ (1,0) [0|1] "" ADAS
 SG_ DET_CONFD_AZIMUTH_204 : 457|2@0+ (1,0) [0|3] "" ADAS
 SG_ DET_CONFD_ELEVATION_204 : 459|2@0+ (1,0) [0|3] "" ADAS
 SG_ DET_MH_SCAN_INDEX_4LSB_201_204 : 483|4@0+ (1,0) [0|15] "" ADAS
 SG_ DET_MH_CYCLE_COUNTER_201_204 : 495|8@0+ (1,0) [0|255] "" ADAS
 SG_ DET_MH_CRC16_201_204 : 503|16@0+ (1,0) [0|65535] "" ADAS

BO_ 1203 RDR_DETECTION_205_208: 64 RDR08
 SG_ DET_RANGE_205 : 7|15@0+ (0.015625,0) [0|500] "m" ADAS
 SG_ DET_RANGE_ERR_205 : 8|7@0+ (0.0075,0) [0|0.9525] "m" ADAS
 SG_ DET_RANGE_VELOCITY_205 : 17|15@0+ (0.0078125,-128) [-128|127.9921875] "m/s" ADAS
 SG_ DET_RANGE_VELOCITY_ERR_205 : 34|8@0+ (0.003,0) [0|0.765] "m/s" ADAS
 SG_ DET_AZIMUTH_205 : 60|13@0+ (0.0004,-1.5708) [-1.5708|1.5708] "rad" ADAS
 SG_ DET_AZIMUTH_ERR_205 : 78|7@0+ (0.00087267,0) [0|0.11082909] "rad" ADAS
 SG_ DET_ELEVATION_205 : 42|8@0+ (0.00275,-0.34925) [-0.34925|0.34925] "rad" ADAS
 SG_ DET_ELEVATION_ERR_205 : 50|6@0+ (0.00174533,0) [0|0.10995579] "rad" ADAS
 SG_ DET_RCS_205 : 119|8@0+ (0.5,-64) [-64|63.5] "dBsm" ADAS
 SG_ DET_VALID_FLAG_205 : 80|1@0+ (1,0) [0|1] "" ADAS
 SG_ DET_BI_STATIC_FLAG_205 : 487|1@0+ (1,0) [0|1] "" ADAS
 SG_ DET_SUPER_RES_TARGET_205 : 79|1@0+ (1,0) [0|1] "" ADAS
 SG_ DET_SNR_205 : 111|8@0+ (0.35156,0) [0|89.6478] "dB" ADAS
 SG_ DET_POINT_TARGET_PROB_205 : 86|4@0+ (6.67,0) [0|100] "%" ADAS
 SG_ DET_EXISTENCE_PROB_205 : 95|6@0+ (1.588,0) [0|100] "%" ADAS
 SG_ DET_OUTSIDE_SECTOR_205 : 103|1@0+ (1,0) [0|1] "" ADAS
 SG_ DET_HVC_FLAG_205 : 87|1@0+ (1,0) [0|1] "" ADAS
 SG_ DET_CONFD_AZIMUTH_205 : 89|2@0+ (1,0) [0|3] "" ADAS
 SG_ DET_CONFD_ELEVATION_205 : 82|2@0+ (1,0) [0|3] "" ADAS
 SG_ DET_RANGE_206 : 127|15@0+ (0.015625,0) [0|500] "m" ADAS
 SG_ DET_RANGE_ERR_206 : 128|7@0+ (0.0075,0) [0|0.9525] "m" ADAS
 SG_ DET_RANGE_VELOCITY_206 : 137|15@0+ (0.0078125,-128) [-128|127.9921875] "m/s" ADAS
 SG_ DET_RANGE_VELOCITY_ERR_206 : 154|8@0+ (0.003,0) [0|0.765] "m/s" ADAS
 SG_ DET_AZIMUTH_206 : 180|13@0+ (0.0004,-1.5708) [-1.5708|1.5708] "rad" ADAS
 SG_ DET_AZIMUTH_ERR_206 : 198|7@0+ (0.00087267,0) [0|0.11082909] "rad" ADAS
 SG_ DET_ELEVATION_206 : 162|8@0+ (0.00275,-0.34925) [-0.34925|0.34925] "rad" ADAS
 SG_ DET_ELEVATION_ERR_206 : 170|6@0+ (0.00174533,0) [0|0.10995579] "rad" ADAS
 SG_ DET_RCS_206 : 239|8@0+ (0.5,-64) [-64|63.5] "dBsm" ADAS
 SG_ DET_VALID_FLAG_206 : 220|1@0+ (1,0) [0|1] "" ADAS
 SG_ DET_BI_STATIC_FLAG_206 : 486|1@0+ (1,0) [0|1] "" ADAS
 SG_ DET_SUPER_RES_TARGET_206 : 199|1@0+ (1,0) [0|1] "" ADAS
 SG_ DET_SNR_206 : 231|8@0+ (0.35156,0) [0|89.6478] "dB" ADAS
 SG_ DET_POINT_TARGET_PROB_206 : 215|4@0+ (6.67,0) [0|100] "%" ADAS
 SG_ DET_EXISTENCE_PROB_206 : 211|6@0+ (1.588,0) [0|100] "%" ADAS
 SG_ DET_OUTSIDE_SECTOR_206 : 221|1@0+ (1,0) [0|1] "" ADAS
 SG_ DET_HVC_FLAG_206 : 207|1@0+ (1,0) [0|1] "" ADAS
 SG_ DET_CONFD_AZIMUTH_206 : 217|2@0+ (1,0) [0|3] "" ADAS
 SG_ DET_CONFD_ELEVATION_206 : 219|2@0+ (1,0) [0|3] "" ADAS
 SG_ DET_RANGE_207 : 247|15@0+ (0.015625,0) [0|500] "m" ADAS
 SG_ DET_RANGE_ERR_207 : 248|7@0+ (0.0075,0) [0|0.9525] "m" ADAS
 SG_ DET_RANGE_VELOCITY_207 : 257|15@0+ (0.0078125,-128) [-128|127.9921875] "m/s" ADAS
 SG_ DET_RANGE_VELOCITY_ERR_207 : 274|8@0+ (0.003,0) [0|0.765] "m/s" ADAS
 SG_ DET_AZIMUTH_207 : 300|13@0+ (0.0004,-1.5708) [-1.5708|1.5708] "rad" ADAS
 SG_ DET_AZIMUTH_ERR_207 : 318|7@0+ (0.00087267,0) [0|0.11082909] "rad" ADAS
 SG_ DET_ELEVATION_207 : 282|8@0+ (0.00275,-0.34925) [-0.34925|0.34925] "rad" ADAS
 SG_ DET_ELEVATION_ERR_207 : 290|6@0+ (0.00174533,0) [0|0.10995579] "rad" ADAS
 SG_ DET_RCS_207 : 359|8@0+ (0.5,-64) [-64|63.5] "dBsm" ADAS
 SG_ DET_VALID_FLAG_207 : 340|1@0+ (1,0) [0|1] "" ADAS
 SG_ DET_BI_STATIC_FLAG_207 : 485|1@0+ (1,0) [0|1] "" ADAS
 SG_ DET_SUPER_RES_TARGET_207 : 319|1@0+ (1,0) [0|1] "" ADAS
 SG_ DET_SNR_207 : 351|8@0+ (0.35156,0) [0|89.6478] "dB" ADAS
 SG_ DET_POINT_TARGET_PROB_207 : 335|4@0+ (6.67,0) [0|100] "%" ADAS
 SG_ DET_EXISTENCE_PROB_207 : 331|6@0+ (1.588,0) [0|100] "%" ADAS
 SG_ DET_OUTSIDE_SECTOR_207 : 341|1@0+ (1,0) [0|1] "" ADAS
 SG_ DET_HVC_FLAG_207 : 327|1@0+ (1,0) [0|1] "" ADAS
 SG_ DET_CONFD_AZIMUTH_207 : 337|2@0+ (1,0) [0|3] "" ADAS
 SG_ DET_CONFD_ELEVATION_207 : 339|2@0+ (1,0) [0|3] "" ADAS
 SG_ DET_RANGE_208 : 367|15@0+ (0.015625,0) [0|500] "m" ADAS
 SG_ DET_RANGE_ERR_208 : 368|7@0+ (0.0075,0) [0|0.9525] "m" ADAS
 SG_ DET_RANGE_VELOCITY_208 : 377|15@0+ (0.0078125,-128) [-128|127.9921875] "m/s" ADAS
 SG_ DET_RANGE_VELOCITY_ERR_208 : 394|8@0+ (0.003,0) [0|0.765] "m/s" ADAS
 SG_ DET_AZIMUTH_208 : 420|13@0+ (0.0004,-1.5708) [-1.5708|1.5708] "rad" ADAS
 SG_ DET_AZIMUTH_ERR_208 : 438|7@0+ (0.00087267,0) [0|0.11082909] "rad" ADAS
 SG_ DET_ELEVATION_208 : 402|8@0+ (0.00275,-0.34925) [-0.34925|0.34925] "rad" ADAS
 SG_ DET_ELEVATION_ERR_208 : 410|6@0+ (0.00174533,0) [0|0.10995579] "rad" ADAS
 SG_ DET_RCS_208 : 479|8@0+ (0.5,-64) [-64|63.5] "dBsm" ADAS
 SG_ DET_VALID_FLAG_208 : 460|1@0+ (1,0) [0|1] "" ADAS
 SG_ DET_BI_STATIC_FLAG_208 : 484|1@0+ (1,0) [0|1] "" ADAS
 SG_ DET_SUPER_RES_TARGET_208 : 439|1@0+ (1,0) [0|1] "" ADAS
 SG_ DET_SNR_208 : 471|8@0+ (0.35156,0) [0|89.6478] "dB" ADAS
 SG_ DET_POINT_TARGET_PROB_208 : 455|4@0+ (6.67,0) [0|100] "%" ADAS
 SG_ DET_EXISTENCE_PROB_208 : 451|6@0+ (1.588,0) [0|100] "%" ADAS
 SG_ DET_OUTSIDE_SECTOR_208 : 461|1@0+ (1,0) [0|1] "" ADAS
 SG_ DET_HVC_FLAG_208 : 447|1@0+ (1,0) [0|1] "" ADAS
 SG_ DET_CONFD_AZIMUTH_208 : 457|2@0+ (1,0) [0|3] "" ADAS
 SG_ DET_CONFD_ELEVATION_208 : 459|2@0+ (1,0) [0|3] "" ADAS
 SG_ DET_MH_SCAN_INDEX_4LSB_205_208 : 483|4@0+ (1,0) [0|15] "" ADAS
 SG_ DET_MH_CYCLE_COUNTER_205_208 : 495|8@0+ (1,0) [0|255] "" ADAS
 SG_ DET_MH_CRC16_205_208 : 503|16@0+ (1,0) [0|65535] "" ADAS

BO_ 1204 RDR_DETECTION_209_212: 64 RDR08
 SG_ DET_RANGE_209 : 7|15@0+ (0.015625,0) [0|500] "m" ADAS
 SG_ DET_RANGE_ERR_209 : 8|7@0+ (0.0075,0) [0|0.9525] "m" ADAS
 SG_ DET_RANGE_VELOCITY_209 : 17|15@0+ (0.0078125,-128) [-128|127.9921875] "m/s" ADAS
 SG_ DET_RANGE_VELOCITY_ERR_209 : 34|8@0+ (0.003,0) [0|0.765] "m/s" ADAS
 SG_ DET_AZIMUTH_209 : 60|13@0+ (0.0004,-1.5708) [-1.5708|1.5708] "rad" ADAS
 SG_ DET_AZIMUTH_ERR_209 : 78|7@0+ (0.00087267,0) [0|0.11082909] "rad" ADAS
 SG_ DET_ELEVATION_209 : 42|8@0+ (0.00275,-0.34925) [-0.34925|0.34925] "rad" ADAS
 SG_ DET_ELEVATION_ERR_209 : 50|6@0+ (0.00174533,0) [0|0.10995579] "rad" ADAS
 SG_ DET_RCS_209 : 119|8@0+ (0.5,-64) [-64|63.5] "dBsm" ADAS
 SG_ DET_VALID_FLAG_209 : 80|1@0+ (1,0) [0|1] "" ADAS
 SG_ DET_BI_STATIC_FLAG_209 : 487|1@0+ (1,0) [0|1] "" ADAS
 SG_ DET_SUPER_RES_TARGET_209 : 79|1@0+ (1,0) [0|1] "" ADAS
 SG_ DET_SNR_209 : 111|8@0+ (0.35156,0) [0|89.6478] "dB" ADAS
 SG_ DET_POINT_TARGET_PROB_209 : 86|4@0+ (6.67,0) [0|100] "%" ADAS
 SG_ DET_EXISTENCE_PROB_209 : 95|6@0+ (1.588,0) [0|100] "%" ADAS
 SG_ DET_OUTSIDE_SECTOR_209 : 103|1@0+ (1,0) [0|1] "" ADAS
 SG_ DET_HVC_FLAG_209 : 87|1@0+ (1,0) [0|1] "" ADAS
 SG_ DET_CONFD_AZIMUTH_209 : 89|2@0+ (1,0) [0|3] "" ADAS
 SG_ DET_CONFD_ELEVATION_209 : 82|2@0+ (1,0) [0|3] "" ADAS
 SG_ DET_RANGE_210 : 127|15@0+ (0.015625,0) [0|500] "m" ADAS
 SG_ DET_RANGE_ERR_210 : 128|7@0+ (0.0075,0) [0|0.9525] "m" ADAS
 SG_ DET_RANGE_VELOCITY_210 : 137|15@0+ (0.0078125,-128) [-128|127.9921875] "m/s" ADAS
 SG_ DET_RANGE_VELOCITY_ERR_210 : 154|8@0+ (0.003,0) [0|0.765] "m/s" ADAS
 SG_ DET_AZIMUTH_210 : 180|13@0+ (0.0004,-1.5708) [-1.5708|1.5708] "rad" ADAS
 SG_ DET_AZIMUTH_ERR_210 : 198|7@0+ (0.00087267,0) [0|0.11082909] "rad" ADAS
 SG_ DET_ELEVATION_210 : 162|8@0+ (0.00275,-0.34925) [-0.34925|0.34925] "rad" ADAS
 SG_ DET_ELEVATION_ERR_210 : 170|6@0+ (0.00174533,0) [0|0.10995579] "rad" ADAS
 SG_ DET_RCS_210 : 239|8@0+ (0.5,-64) [-64|63.5] "dBsm" ADAS
 SG_ DET_VALID_FLAG_210 : 220|1@0+ (1,0) [0|1] "" ADAS
 SG_ DET_BI_STATIC_FLAG_210 : 486|1@0+ (1,0) [0|1] "" ADAS
 SG_ DET_SUPER_RES_TARGET_210 : 199|1@0+ (1,0) [0|1] "" ADAS
 SG_ DET_SNR_210 : 231|8@0+ (0.35156,0) [0|89.6478] "dB" ADAS
 SG_ DET_POINT_TARGET_PROB_210 : 215|4@0+ (6.67,0) [0|100] "%" ADAS
 SG_ DET_EXISTENCE_PROB_210 : 211|6@0+ (1.588,0) [0|100] "%" ADAS
 SG_ DET_OUTSIDE_SECTOR_210 : 221|1@0+ (1,0) [0|1] "" ADAS
 SG_ DET_HVC_FLAG_210 : 207|1@0+ (1,0) [0|1] "" ADAS
 SG_ DET_CONFD_AZIMUTH_210 : 217|2@0+ (1,0) [0|3] "" ADAS
 SG_ DET_CONFD_ELEVATION_210 : 219|2@0+ (1,0) [0|3] "" ADAS
 SG_ DET_RANGE_211 : 247|15@0+ (0.015625,0) [0|500] "m" ADAS
 SG_ DET_RANGE_ERR_211 : 248|7@0+ (0.0075,0) [0|0.9525] "m" ADAS
 SG_ DET_RANGE_VELOCITY_211 : 257|15@0+ (0.0078125,-128) [-128|127.9921875] "m/s" ADAS
 SG_ DET_RANGE_VELOCITY_ERR_211 : 274|8@0+ (0.003,0) [0|0.765] "m/s" ADAS
 SG_ DET_AZIMUTH_211 : 300|13@0+ (0.0004,-1.5708) [-1.5708|1.5708] "rad" ADAS
 SG_ DET_AZIMUTH_ERR_211 : 318|7@0+ (0.00087267,0) [0|0.11082909] "rad" ADAS
 SG_ DET_ELEVATION_211 : 282|8@0+ (0.00275,-0.34925) [-0.34925|0.34925] "rad" ADAS
 SG_ DET_ELEVATION_ERR_211 : 290|6@0+ (0.00174533,0) [0|0.10995579] "rad" ADAS
 SG_ DET_RCS_211 : 359|8@0+ (0.5,-64) [-64|63.5] "dBsm" ADAS
 SG_ DET_VALID_FLAG_211 : 340|1@0+ (1,0) [0|1] "" ADAS
 SG_ DET_BI_STATIC_FLAG_211 : 485|1@0+ (1,0) [0|1] "" ADAS
 SG_ DET_SUPER_RES_TARGET_211 : 319|1@0+ (1,0) [0|1] "" ADAS
 SG_ DET_SNR_211 : 351|8@0+ (0.35156,0) [0|89.6478] "dB" ADAS
 SG_ DET_POINT_TARGET_PROB_211 : 335|4@0+ (6.67,0) [0|100] "%" ADAS
 SG_ DET_EXISTENCE_PROB_211 : 331|6@0+ (1.588,0) [0|100] "%" ADAS
 SG_ DET_OUTSIDE_SECTOR_211 : 341|1@0+ (1,0) [0|1] "" ADAS
 SG_ DET_HVC_FLAG_211 : 327|1@0+ (1,0) [0|1] "" ADAS
 SG_ DET_CONFD_AZIMUTH_211 : 337|2@0+ (1,0) [0|3] "" ADAS
 SG_ DET_CONFD_ELEVATION_211 : 339|2@0+ (1,0) [0|3] "" ADAS
 SG_ DET_RANGE_212 : 367|15@0+ (0.015625,0) [0|500] "m" ADAS
 SG_ DET_RANGE_ERR_212 : 368|7@0+ (0.0075,0) [0|0.9525] "m" ADAS
 SG_ DET_RANGE_VELOCITY_212 : 377|15@0+ (0.0078125,-128) [-128|127.9921875] "m/s" ADAS
 SG_ DET_RANGE_VELOCITY_ERR_212 : 394|8@0+ (0.003,0) [0|0.765] "m/s" ADAS
 SG_ DET_AZIMUTH_212 : 420|13@0+ (0.0004,-1.5708) [-1.5708|1.5708] "rad" ADAS
 SG_ DET_AZIMUTH_ERR_212 : 438|7@0+ (0.00087267,0) [0|0.11082909] "rad" ADAS
 SG_ DET_ELEVATION_212 : 402|8@0+ (0.00275,-0.34925) [-0.34925|0.34925] "rad" ADAS
 SG_ DET_ELEVATION_ERR_212 : 410|6@0+ (0.00174533,0) [0|0.10995579] "rad" ADAS
 SG_ DET_RCS_212 : 479|8@0+ (0.5,-64) [-64|63.5] "dBsm" ADAS
 SG_ DET_VALID_FLAG_212 : 460|1@0+ (1,0) [0|1] "" ADAS
 SG_ DET_BI_STATIC_FLAG_212 : 484|1@0+ (1,0) [0|1] "" ADAS
 SG_ DET_SUPER_RES_TARGET_212 : 439|1@0+ (1,0) [0|1] "" ADAS
 SG_ DET_SNR_212 : 471|8@0+ (0.35156,0) [0|89.6478] "dB" ADAS
 SG_ DET_POINT_TARGET_PROB_212 : 455|4@0+ (6.67,0) [0|100] "%" ADAS
 SG_ DET_EXISTENCE_PROB_212 : 451|6@0+ (1.588,0) [0|100] "%" ADAS
 SG_ DET_OUTSIDE_SECTOR_212 : 461|1@0+ (1,0) [0|1] "" ADAS
 SG_ DET_HVC_FLAG_212 : 447|1@0+ (1,0) [0|1] "" ADAS
 SG_ DET_CONFD_AZIMUTH_212 : 457|2@0+ (1,0) [0|3] "" ADAS
 SG_ DET_CONFD_ELEVATION_212 : 459|2@0+ (1,0) [0|3] "" ADAS
 SG_ DET_MH_SCAN_INDEX_4LSB_209_212 : 483|4@0+ (1,0) [0|15] "" ADAS
 SG_ DET_MH_CYCLE_COUNTER_209_212 : 495|8@0+ (1,0) [0|255] "" ADAS
 SG_ DET_MH_CRC16_209_212 : 503|16@0+ (1,0) [0|65535] "" ADAS

BO_ 1205 RDR_DETECTION_213_216: 64 RDR08
 SG_ DET_RANGE_213 : 7|15@0+ (0.015625,0) [0|500] "m" ADAS
 SG_ DET_RANGE_ERR_213 : 8|7@0+ (0.0075,0) [0|0.9525] "m" ADAS
 SG_ DET_RANGE_VELOCITY_213 : 17|15@0+ (0.0078125,-128) [-128|127.9921875] "m/s" ADAS
 SG_ DET_RANGE_VELOCITY_ERR_213 : 34|8@0+ (0.003,0) [0|0.765] "m/s" ADAS
 SG_ DET_AZIMUTH_213 : 60|13@0+ (0.0004,-1.5708) [-1.5708|1.5708] "rad" ADAS
 SG_ DET_AZIMUTH_ERR_213 : 78|7@0+ (0.00087267,0) [0|0.11082909] "rad" ADAS
 SG_ DET_ELEVATION_213 : 42|8@0+ (0.00275,-0.34925) [-0.34925|0.34925] "rad" ADAS
 SG_ DET_ELEVATION_ERR_213 : 50|6@0+ (0.00174533,0) [0|0.10995579] "rad" ADAS
 SG_ DET_RCS_213 : 119|8@0+ (0.5,-64) [-64|63.5] "dBsm" ADAS
 SG_ DET_VALID_FLAG_213 : 80|1@0+ (1,0) [0|1] "" ADAS
 SG_ DET_BI_STATIC_FLAG_213 : 487|1@0+ (1,0) [0|1] "" ADAS
 SG_ DET_SUPER_RES_TARGET_213 : 79|1@0+ (1,0) [0|1] "" ADAS
 SG_ DET_SNR_213 : 111|8@0+ (0.35156,0) [0|89.6478] "dB" ADAS
 SG_ DET_POINT_TARGET_PROB_213 : 86|4@0+ (6.67,0) [0|100] "%" ADAS
 SG_ DET_EXISTENCE_PROB_213 : 95|6@0+ (1.588,0) [0|100] "%" ADAS
 SG_ DET_OUTSIDE_SECTOR_213 : 103|1@0+ (1,0) [0|1] "" ADAS
 SG_ DET_HVC_FLAG_213 : 87|1@0+ (1,0) [0|1] "" ADAS
 SG_ DET_CONFD_AZIMUTH_213 : 89|2@0+ (1,0) [0|3] "" ADAS
 SG_ DET_CONFD_ELEVATION_213 : 82|2@0+ (1,0) [0|3] "" ADAS
 SG_ DET_RANGE_214 : 127|15@0+ (0.015625,0) [0|500] "m" ADAS
 SG_ DET_RANGE_ERR_214 : 128|7@0+ (0.0075,0) [0|0.9525] "m" ADAS
 SG_ DET_RANGE_VELOCITY_214 : 137|15@0+ (0.0078125,-128) [-128|127.9921875] "m/s" ADAS
 SG_ DET_RANGE_VELOCITY_ERR_214 : 154|8@0+ (0.003,0) [0|0.765] "m/s" ADAS
 SG_ DET_AZIMUTH_214 : 180|13@0+ (0.0004,-1.5708) [-1.5708|1.5708] "rad" ADAS
 SG_ DET_AZIMUTH_ERR_214 : 198|7@0+ (0.00087267,0) [0|0.11082909] "rad" ADAS
 SG_ DET_ELEVATION_214 : 162|8@0+ (0.00275,-0.34925) [-0.34925|0.34925] "rad" ADAS
 SG_ DET_ELEVATION_ERR_214 : 170|6@0+ (0.00174533,0) [0|0.10995579] "rad" ADAS
 SG_ DET_RCS_214 : 239|8@0+ (0.5,-64) [-64|63.5] "dBsm" ADAS
 SG_ DET_VALID_FLAG_214 : 220|1@0+ (1,0) [0|1] "" ADAS
 SG_ DET_BI_STATIC_FLAG_214 : 486|1@0+ (1,0) [0|1] "" ADAS
 SG_ DET_SUPER_RES_TARGET_214 : 199|1@0+ (1,0) [0|1] "" ADAS
 SG_ DET_SNR_214 : 231|8@0+ (0.35156,0) [0|89.6478] "dB" ADAS
 SG_ DET_POINT_TARGET_PROB_214 : 215|4@0+ (6.67,0) [0|100] "%" ADAS
 SG_ DET_EXISTENCE_PROB_214 : 211|6@0+ (1.588,0) [0|100] "%" ADAS
 SG_ DET_OUTSIDE_SECTOR_214 : 221|1@0+ (1,0) [0|1] "" ADAS
 SG_ DET_HVC_FLAG_214 : 207|1@0+ (1,0) [0|1] "" ADAS
 SG_ DET_CONFD_AZIMUTH_214 : 217|2@0+ (1,0) [0|3] "" ADAS
 SG_ DET_CONFD_ELEVATION_214 : 219|2@0+ (1,0) [0|3] "" ADAS
 SG_ DET_RANGE_215 : 247|15@0+ (0.015625,0) [0|500] "m" ADAS
 SG_ DET_RANGE_ERR_215 : 248|7@0+ (0.0075,0) [0|0.9525] "m" ADAS
 SG_ DET_RANGE_VELOCITY_215 : 257|15@0+ (0.0078125,-128) [-128|127.9921875] "m/s" ADAS
 SG_ DET_RANGE_VELOCITY_ERR_215 : 274|8@0+ (0.003,0) [0|0.765] "m/s" ADAS
 SG_ DET_AZIMUTH_215 : 300|13@0+ (0.0004,-1.5708) [-1.5708|1.5708] "rad" ADAS
 SG_ DET_AZIMUTH_ERR_215 : 318|7@0+ (0.00087267,0) [0|0.11082909] "rad" ADAS
 SG_ DET_ELEVATION_215 : 282|8@0+ (0.00275,-0.34925) [-0.34925|0.34925] "rad" ADAS
 SG_ DET_ELEVATION_ERR_215 : 290|6@0+ (0.00174533,0) [0|0.10995579] "rad" ADAS
 SG_ DET_RCS_215 : 359|8@0+ (0.5,-64) [-64|63.5] "dBsm" ADAS
 SG_ DET_VALID_FLAG_215 : 340|1@0+ (1,0) [0|1] "" ADAS
 SG_ DET_BI_STATIC_FLAG_215 : 485|1@0+ (1,0) [0|1] "" ADAS
 SG_ DET_SUPER_RES_TARGET_215 : 319|1@0+ (1,0) [0|1] "" ADAS
 SG_ DET_SNR_215 : 351|8@0+ (0.35156,0) [0|89.6478] "dB" ADAS
 SG_ DET_POINT_TARGET_PROB_215 : 335|4@0+ (6.67,0) [0|100] "%" ADAS
 SG_ DET_EXISTENCE_PROB_215 : 331|6@0+ (1.588,0) [0|100] "%" ADAS
 SG_ DET_OUTSIDE_SECTOR_215 : 341|1@0+ (1,0) [0|1] "" ADAS
 SG_ DET_HVC_FLAG_215 : 327|1@0+ (1,0) [0|1] "" ADAS
 SG_ DET_CONFD_AZIMUTH_215 : 337|2@0+ (1,0) [0|3] "" ADAS
 SG_ DET_CONFD_ELEVATION_215 : 339|2@0+ (1,0) [0|3] "" ADAS
 SG_ DET_RANGE_216 : 367|15@0+ (0.015625,0) [0|500] "m" ADAS
 SG_ DET_RANGE_ERR_216 : 368|7@0+ (0.0075,0) [0|0.9525] "m" ADAS
 SG_ DET_RANGE_VELOCITY_216 : 377|15@0+ (0.0078125,-128) [-128|127.9921875] "m/s" ADAS
 SG_ DET_RANGE_VELOCITY_ERR_216 : 394|8@0+ (0.003,0) [0|0.765] "m/s" ADAS
 SG_ DET_AZIMUTH_216 : 420|13@0+ (0.0004,-1.5708) [-1.5708|1.5708] "rad" ADAS
 SG_ DET_AZIMUTH_ERR_216 : 438|7@0+ (0.00087267,0) [0|0.11082909] "rad" ADAS
 SG_ DET_ELEVATION_216 : 402|8@0+ (0.00275,-0.34925) [-0.34925|0.34925] "rad" ADAS
 SG_ DET_ELEVATION_ERR_216 : 410|6@0+ (0.00174533,0) [0|0.10995579] "rad" ADAS
 SG_ DET_RCS_216 : 479|8@0+ (0.5,-64) [-64|63.5] "dBsm" ADAS
 SG_ DET_VALID_FLAG_216 : 460|1@0+ (1,0) [0|1] "" ADAS
 SG_ DET_BI_STATIC_FLAG_216 : 484|1@0+ (1,0) [0|1] "" ADAS
 SG_ DET_SUPER_RES_TARGET_216 : 439|1@0+ (1,0) [0|1] "" ADAS
 SG_ DET_SNR_216 : 471|8@0+ (0.35156,0) [0|89.6478] "dB" ADAS
 SG_ DET_POINT_TARGET_PROB_216 : 455|4@0+ (6.67,0) [0|100] "%" ADAS
 SG_ DET_EXISTENCE_PROB_216 : 451|6@0+ (1.588,0) [0|100] "%" ADAS
 SG_ DET_OUTSIDE_SECTOR_216 : 461|1@0+ (1,0) [0|1] "" ADAS
 SG_ DET_HVC_FLAG_216 : 447|1@0+ (1,0) [0|1] "" ADAS
 SG_ DET_CONFD_AZIMUTH_216 : 457|2@0+ (1,0) [0|3] "" ADAS
 SG_ DET_CONFD_ELEVATION_216 : 459|2@0+ (1,0) [0|3] "" ADAS
 SG_ DET_MH_SCAN_INDEX_4LSB_213_216 : 483|4@0+ (1,0) [0|15] "" ADAS
 SG_ DET_MH_CYCLE_COUNTER_213_216 : 495|8@0+ (1,0) [0|255] "" ADAS
 SG_ DET_MH_CRC16_213_216 : 503|16@0+ (1,0) [0|65535] "" ADAS

BO_ 1206 RDR_DETECTION_217_220: 64 RDR08
 SG_ DET_RANGE_217 : 7|15@0+ (0.015625,0) [0|500] "m" ADAS
 SG_ DET_RANGE_ERR_217 : 8|7@0+ (0.0075,0) [0|0.9525] "m" ADAS
 SG_ DET_RANGE_VELOCITY_217 : 17|15@0+ (0.0078125,-128) [-128|127.9921875] "m/s" ADAS
 SG_ DET_RANGE_VELOCITY_ERR_217 : 34|8@0+ (0.003,0) [0|0.765] "m/s" ADAS
 SG_ DET_AZIMUTH_217 : 60|13@0+ (0.0004,-1.5708) [-1.5708|1.5708] "rad" ADAS
 SG_ DET_AZIMUTH_ERR_217 : 78|7@0+ (0.00087267,0) [0|0.11082909] "rad" ADAS
 SG_ DET_ELEVATION_217 : 42|8@0+ (0.00275,-0.34925) [-0.34925|0.34925] "rad" ADAS
 SG_ DET_ELEVATION_ERR_217 : 50|6@0+ (0.00174533,0) [0|0.10995579] "rad" ADAS
 SG_ DET_RCS_217 : 119|8@0+ (0.5,-64) [-64|63.5] "dBsm" ADAS
 SG_ DET_VALID_FLAG_217 : 80|1@0+ (1,0) [0|1] "" ADAS
 SG_ DET_BI_STATIC_FLAG_217 : 487|1@0+ (1,0) [0|1] "" ADAS
 SG_ DET_SUPER_RES_TARGET_217 : 79|1@0+ (1,0) [0|1] "" ADAS
 SG_ DET_SNR_217 : 111|8@0+ (0.35156,0) [0|89.6478] "dB" ADAS
 SG_ DET_POINT_TARGET_PROB_217 : 86|4@0+ (6.67,0) [0|100] "%" ADAS
 SG_ DET_EXISTENCE_PROB_217 : 95|6@0+ (1.588,0) [0|100] "%" ADAS
 SG_ DET_OUTSIDE_SECTOR_217 : 103|1@0+ (1,0) [0|1] "" ADAS
 SG_ DET_HVC_FLAG_217 : 87|1@0+ (1,0) [0|1] "" ADAS
 SG_ DET_CONFD_AZIMUTH_217 : 89|2@0+ (1,0) [0|3] "" ADAS
 SG_ DET_CONFD_ELEVATION_217 : 82|2@0+ (1,0) [0|3] "" ADAS
 SG_ DET_RANGE_218 : 127|15@0+ (0.015625,0) [0|500] "m" ADAS
 SG_ DET_RANGE_ERR_218 : 128|7@0+ (0.0075,0) [0|0.9525] "m" ADAS
 SG_ DET_RANGE_VELOCITY_218 : 137|15@0+ (0.0078125,-128) [-128|127.9921875] "m/s" ADAS
 SG_ DET_RANGE_VELOCITY_ERR_218 : 154|8@0+ (0.003,0) [0|0.765] "m/s" ADAS
 SG_ DET_AZIMUTH_218 : 180|13@0+ (0.0004,-1.5708) [-1.5708|1.5708] "rad" ADAS
 SG_ DET_AZIMUTH_ERR_218 : 198|7@0+ (0.00087267,0) [0|0.11082909] "rad" ADAS
 SG_ DET_ELEVATION_218 : 162|8@0+ (0.00275,-0.34925) [-0.34925|0.34925] "rad" ADAS
 SG_ DET_ELEVATION_ERR_218 : 170|6@0+ (0.00174533,0) [0|0.10995579] "rad" ADAS
 SG_ DET_RCS_218 : 239|8@0+ (0.5,-64) [-64|63.5] "dBsm" ADAS
 SG_ DET_VALID_FLAG_218 : 220|1@0+ (1,0) [0|1] "" ADAS
 SG_ DET_BI_STATIC_FLAG_218 : 486|1@0+ (1,0) [0|1] "" ADAS
 SG_ DET_SUPER_RES_TARGET_218 : 199|1@0+ (1,0) [0|1] "" ADAS
 SG_ DET_SNR_218 : 231|8@0+ (0.35156,0) [0|89.6478] "dB" ADAS
 SG_ DET_POINT_TARGET_PROB_218 : 215|4@0+ (6.67,0) [0|100] "%" ADAS
 SG_ DET_EXISTENCE_PROB_218 : 211|6@0+ (1.588,0) [0|100] "%" ADAS
 SG_ DET_OUTSIDE_SECTOR_218 : 221|1@0+ (1,0) [0|1] "" ADAS
 SG_ DET_HVC_FLAG_218 : 207|1@0+ (1,0) [0|1] "" ADAS
 SG_ DET_CONFD_AZIMUTH_218 : 217|2@0+ (1,0) [0|3] "" ADAS
 SG_ DET_CONFD_ELEVATION_218 : 219|2@0+ (1,0) [0|3] "" ADAS
 SG_ DET_RANGE_219 : 247|15@0+ (0.015625,0) [0|500] "m" ADAS
 SG_ DET_RANGE_ERR_219 : 248|7@0+ (0.0075,0) [0|0.9525] "m" ADAS
 SG_ DET_RANGE_VELOCITY_219 : 257|15@0+ (0.0078125,-128) [-128|127.9921875] "m/s" ADAS
 SG_ DET_RANGE_VELOCITY_ERR_219 : 274|8@0+ (0.003,0) [0|0.765] "m/s" ADAS
 SG_ DET_AZIMUTH_219 : 300|13@0+ (0.0004,-1.5708) [-1.5708|1.5708] "rad" ADAS
 SG_ DET_AZIMUTH_ERR_219 : 318|7@0+ (0.00087267,0) [0|0.11082909] "rad" ADAS
 SG_ DET_ELEVATION_219 : 282|8@0+ (0.00275,-0.34925) [-0.34925|0.34925] "rad" ADAS
 SG_ DET_ELEVATION_ERR_219 : 290|6@0+ (0.00174533,0) [0|0.10995579] "rad" ADAS
 SG_ DET_RCS_219 : 359|8@0+ (0.5,-64) [-64|63.5] "dBsm" ADAS
 SG_ DET_VALID_FLAG_219 : 340|1@0+ (1,0) [0|1] "" ADAS
 SG_ DET_BI_STATIC_FLAG_219 : 485|1@0+ (1,0) [0|1] "" ADAS
 SG_ DET_SUPER_RES_TARGET_219 : 319|1@0+ (1,0) [0|1] "" ADAS
 SG_ DET_SNR_219 : 351|8@0+ (0.35156,0) [0|89.6478] "dB" ADAS
 SG_ DET_POINT_TARGET_PROB_219 : 335|4@0+ (6.67,0) [0|100] "%" ADAS
 SG_ DET_EXISTENCE_PROB_219 : 331|6@0+ (1.588,0) [0|100] "%" ADAS
 SG_ DET_OUTSIDE_SECTOR_219 : 341|1@0+ (1,0) [0|1] "" ADAS
 SG_ DET_HVC_FLAG_219 : 327|1@0+ (1,0) [0|1] "" ADAS
 SG_ DET_CONFD_AZIMUTH_219 : 337|2@0+ (1,0) [0|3] "" ADAS
 SG_ DET_CONFD_ELEVATION_219 : 339|2@0+ (1,0) [0|3] "" ADAS
 SG_ DET_RANGE_220 : 367|15@0+ (0.015625,0) [0|500] "m" ADAS
 SG_ DET_RANGE_ERR_220 : 368|7@0+ (0.0075,0) [0|0.9525] "m" ADAS
 SG_ DET_RANGE_VELOCITY_220 : 377|15@0+ (0.0078125,-128) [-128|127.9921875] "m/s" ADAS
 SG_ DET_RANGE_VELOCITY_ERR_220 : 394|8@0+ (0.003,0) [0|0.765] "m/s" ADAS
 SG_ DET_AZIMUTH_220 : 420|13@0+ (0.0004,-1.5708) [-1.5708|1.5708] "rad" ADAS
 SG_ DET_AZIMUTH_ERR_220 : 438|7@0+ (0.00087267,0) [0|0.11082909] "rad" ADAS
 SG_ DET_ELEVATION_220 : 402|8@0+ (0.00275,-0.34925) [-0.34925|0.34925] "rad" ADAS
 SG_ DET_ELEVATION_ERR_220 : 410|6@0+ (0.00174533,0) [0|0.10995579] "rad" ADAS
 SG_ DET_RCS_220 : 479|8@0+ (0.5,-64) [-64|63.5] "dBsm" ADAS
 SG_ DET_VALID_FLAG_220 : 460|1@0+ (1,0) [0|1] "" ADAS
 SG_ DET_BI_STATIC_FLAG_220 : 484|1@0+ (1,0) [0|1] "" ADAS
 SG_ DET_SUPER_RES_TARGET_220 : 439|1@0+ (1,0) [0|1] "" ADAS
 SG_ DET_SNR_220 : 471|8@0+ (0.35156,0) [0|89.6478] "dB" ADAS
 SG_ DET_POINT_TARGET_PROB_220 : 455|4@0+ (6.67,0) [0|100] "%" ADAS
 SG_ DET_EXISTENCE_PROB_220 : 451|6@0+ (1.588,0) [0|100] "%" ADAS
 SG_ DET_OUTSIDE_SECTOR_220 : 461|1@0+ (1,0) [0|1] "" ADAS
 SG_ DET_HVC_FLAG_220 : 447|1@0+ (1,0) [0|1] "" ADAS
 SG_ DET_CONFD_AZIMUTH_220 : 457|2@0+ (1,0) [0|3] "" ADAS
 SG_ DET_CONFD_ELEVATION_220 : 459|2@0+ (1,0) [0|3] "" ADAS
 SG_ DET_MH_SCAN_INDEX_4LSB_217_220 : 483|4@0+ (1,0) [0|15] "" ADAS
 SG_ DET_MH_CYCLE_COUNTER_217_220 : 495|8@0+ (1,0) [0|255] "" ADAS
 SG_ DET_MH_CRC16_217_220 : 503|16@0+ (1,0) [0|65535] "" ADAS

BO_ 1207 RDR_DETECTION_221_224: 64 RDR08
 SG_ DET_RANGE_221 : 7|15@0+ (0.015625,0) [0|500] "m" ADAS
 SG_ DET_RANGE_ERR_221 : 8|7@0+ (0.0075,0) [0|0.9525] "m" ADAS
 SG_ DET_RANGE_VELOCITY_221 : 17|15@0+ (0.0078125,-128) [-128|127.9921875] "m/s" ADAS
 SG_ DET_RANGE_VELOCITY_ERR_221 : 34|8@0+ (0.003,0) [0|0.765] "m/s" ADAS
 SG_ DET_AZIMUTH_221 : 60|13@0+ (0.0004,-1.5708) [-1.5708|1.5708] "rad" ADAS
 SG_ DET_AZIMUTH_ERR_221 : 78|7@0+ (0.00087267,0) [0|0.11082909] "rad" ADAS
 SG_ DET_ELEVATION_221 : 42|8@0+ (0.00275,-0.34925) [-0.34925|0.34925] "rad" ADAS
 SG_ DET_ELEVATION_ERR_221 : 50|6@0+ (0.00174533,0) [0|0.10995579] "rad" ADAS
 SG_ DET_RCS_221 : 119|8@0+ (0.5,-64) [-64|63.5] "dBsm" ADAS
 SG_ DET_VALID_FLAG_221 : 80|1@0+ (1,0) [0|1] "" ADAS
 SG_ DET_BI_STATIC_FLAG_221 : 487|1@0+ (1,0) [0|1] "" ADAS
 SG_ DET_SUPER_RES_TARGET_221 : 79|1@0+ (1,0) [0|1] "" ADAS
 SG_ DET_SNR_221 : 111|8@0+ (0.35156,0) [0|89.6478] "dB" ADAS
 SG_ DET_POINT_TARGET_PROB_221 : 86|4@0+ (6.67,0) [0|100] "%" ADAS
 SG_ DET_EXISTENCE_PROB_221 : 95|6@0+ (1.588,0) [0|100] "%" ADAS
 SG_ DET_OUTSIDE_SECTOR_221 : 103|1@0+ (1,0) [0|1] "" ADAS
 SG_ DET_HVC_FLAG_221 : 87|1@0+ (1,0) [0|1] "" ADAS
 SG_ DET_CONFD_AZIMUTH_221 : 89|2@0+ (1,0) [0|3] "" ADAS
 SG_ DET_CONFD_ELEVATION_221 : 82|2@0+ (1,0) [0|3] "" ADAS
 SG_ DET_RANGE_222 : 127|15@0+ (0.015625,0) [0|500] "m" ADAS
 SG_ DET_RANGE_ERR_222 : 128|7@0+ (0.0075,0) [0|0.9525] "m" ADAS
 SG_ DET_RANGE_VELOCITY_222 : 137|15@0+ (0.0078125,-128) [-128|127.9921875] "m/s" ADAS
 SG_ DET_RANGE_VELOCITY_ERR_222 : 154|8@0+ (0.003,0) [0|0.765] "m/s" ADAS
 SG_ DET_AZIMUTH_222 : 180|13@0+ (0.0004,-1.5708) [-1.5708|1.5708] "rad" ADAS
 SG_ DET_AZIMUTH_ERR_222 : 198|7@0+ (0.00087267,0) [0|0.11082909] "rad" ADAS
 SG_ DET_ELEVATION_222 : 162|8@0+ (0.00275,-0.34925) [-0.34925|0.34925] "rad" ADAS
 SG_ DET_ELEVATION_ERR_222 : 170|6@0+ (0.00174533,0) [0|0.10995579] "rad" ADAS
 SG_ DET_RCS_222 : 239|8@0+ (0.5,-64) [-64|63.5] "dBsm" ADAS
 SG_ DET_VALID_FLAG_222 : 220|1@0+ (1,0) [0|1] "" ADAS
 SG_ DET_BI_STATIC_FLAG_222 : 486|1@0+ (1,0) [0|1] "" ADAS
 SG_ DET_SUPER_RES_TARGET_222 : 199|1@0+ (1,0) [0|1] "" ADAS
 SG_ DET_SNR_222 : 231|8@0+ (0.35156,0) [0|89.6478] "dB" ADAS
 SG_ DET_POINT_TARGET_PROB_222 : 215|4@0+ (6.67,0) [0|100] "%" ADAS
 SG_ DET_EXISTENCE_PROB_222 : 211|6@0+ (1.588,0) [0|100] "%" ADAS
 SG_ DET_OUTSIDE_SECTOR_222 : 221|1@0+ (1,0) [0|1] "" ADAS
 SG_ DET_HVC_FLAG_222 : 207|1@0+ (1,0) [0|1] "" ADAS
 SG_ DET_CONFD_AZIMUTH_222 : 217|2@0+ (1,0) [0|3] "" ADAS
 SG_ DET_CONFD_ELEVATION_222 : 219|2@0+ (1,0) [0|3] "" ADAS
 SG_ DET_RANGE_223 : 247|15@0+ (0.015625,0) [0|500] "m" ADAS
 SG_ DET_RANGE_ERR_223 : 248|7@0+ (0.0075,0) [0|0.9525] "m" ADAS
 SG_ DET_RANGE_VELOCITY_223 : 257|15@0+ (0.0078125,-128) [-128|127.9921875] "m/s" ADAS
 SG_ DET_RANGE_VELOCITY_ERR_223 : 274|8@0+ (0.003,0) [0|0.765] "m/s" ADAS
 SG_ DET_AZIMUTH_223 : 300|13@0+ (0.0004,-1.5708) [-1.5708|1.5708] "rad" ADAS
 SG_ DET_AZIMUTH_ERR_223 : 318|7@0+ (0.00087267,0) [0|0.11082909] "rad" ADAS
 SG_ DET_ELEVATION_223 : 282|8@0+ (0.00275,-0.34925) [-0.34925|0.34925] "rad" ADAS
 SG_ DET_ELEVATION_ERR_223 : 290|6@0+ (0.00174533,0) [0|0.10995579] "rad" ADAS
 SG_ DET_RCS_223 : 359|8@0+ (0.5,-64) [-64|63.5] "dBsm" ADAS
 SG_ DET_VALID_FLAG_223 : 340|1@0+ (1,0) [0|1] "" ADAS
 SG_ DET_BI_STATIC_FLAG_223 : 485|1@0+ (1,0) [0|1] "" ADAS
 SG_ DET_SUPER_RES_TARGET_223 : 319|1@0+ (1,0) [0|1] "" ADAS
 SG_ DET_SNR_223 : 351|8@0+ (0.35156,0) [0|89.6478] "dB" ADAS
 SG_ DET_POINT_TARGET_PROB_223 : 335|4@0+ (6.67,0) [0|100] "%" ADAS
 SG_ DET_EXISTENCE_PROB_223 : 331|6@0+ (1.588,0) [0|100] "%" ADAS
 SG_ DET_OUTSIDE_SECTOR_223 : 341|1@0+ (1,0) [0|1] "" ADAS
 SG_ DET_HVC_FLAG_223 : 327|1@0+ (1,0) [0|1] "" ADAS
 SG_ DET_CONFD_AZIMUTH_223 : 337|2@0+ (1,0) [0|3] "" ADAS
 SG_ DET_CONFD_ELEVATION_223 : 339|2@0+ (1,0) [0|3] "" ADAS
 SG_ DET_RANGE_224 : 367|15@0+ (0.015625,0) [0|500] "m" ADAS
 SG_ DET_RANGE_ERR_224 : 368|7@0+ (0.0075,0) [0|0.9525] "m" ADAS
 SG_ DET_RANGE_VELOCITY_224 : 377|15@0+ (0.0078125,-128) [-128|127.9921875] "m/s" ADAS
 SG_ DET_RANGE_VELOCITY_ERR_224 : 394|8@0+ (0.003,0) [0|0.765] "m/s" ADAS
 SG_ DET_AZIMUTH_224 : 420|13@0+ (0.0004,-1.5708) [-1.5708|1.5708] "rad" ADAS
 SG_ DET_AZIMUTH_ERR_224 : 438|7@0+ (0.00087267,0) [0|0.11082909] "rad" ADAS
 SG_ DET_ELEVATION_224 : 402|8@0+ (0.00275,-0.34925) [-0.34925|0.34925] "rad" ADAS
 SG_ DET_ELEVATION_ERR_224 : 410|6@0+ (0.00174533,0) [0|0.10995579] "rad" ADAS
 SG_ DET_RCS_224 : 479|8@0+ (0.5,-64) [-64|63.5] "dBsm" ADAS
 SG_ DET_VALID_FLAG_224 : 460|1@0+ (1,0) [0|1] "" ADAS
 SG_ DET_BI_STATIC_FLAG_224 : 484|1@0+ (1,0) [0|1] "" ADAS
 SG_ DET_SUPER_RES_TARGET_224 : 439|1@0+ (1,0) [0|1] "" ADAS
 SG_ DET_SNR_224 : 471|8@0+ (0.35156,0) [0|89.6478] "dB" ADAS
 SG_ DET_POINT_TARGET_PROB_224 : 455|4@0+ (6.67,0) [0|100] "%" ADAS
 SG_ DET_EXISTENCE_PROB_224 : 451|6@0+ (1.588,0) [0|100] "%" ADAS
 SG_ DET_OUTSIDE_SECTOR_224 : 461|1@0+ (1,0) [0|1] "" ADAS
 SG_ DET_HVC_FLAG_224 : 447|1@0+ (1,0) [0|1] "" ADAS
 SG_ DET_CONFD_AZIMUTH_224 : 457|2@0+ (1,0) [0|3] "" ADAS
 SG_ DET_CONFD_ELEVATION_224 : 459|2@0+ (1,0) [0|3] "" ADAS
 SG_ DET_MH_SCAN_INDEX_4LSB_221_224 : 483|4@0+ (1,0) [0|15] "" ADAS
 SG_ DET_MH_CYCLE_COUNTER_221_224 : 495|8@0+ (1,0) [0|255] "" ADAS
 SG_ DET_MH_CRC16_221_224 : 503|16@0+ (1,0) [0|65535] "" ADAS

BO_ 1208 RDR_DETECTION_225_228: 64 RDR08
 SG_ DET_RANGE_225 : 7|15@0+ (0.015625,0) [0|500] "m" ADAS
 SG_ DET_RANGE_ERR_225 : 8|7@0+ (0.0075,0) [0|0.9525] "m" ADAS
 SG_ DET_RANGE_VELOCITY_225 : 17|15@0+ (0.0078125,-128) [-128|127.9921875] "m/s" ADAS
 SG_ DET_RANGE_VELOCITY_ERR_225 : 34|8@0+ (0.003,0) [0|0.765] "m/s" ADAS
 SG_ DET_AZIMUTH_225 : 60|13@0+ (0.0004,-1.5708) [-1.5708|1.5708] "rad" ADAS
 SG_ DET_AZIMUTH_ERR_225 : 78|7@0+ (0.00087267,0) [0|0.11082909] "rad" ADAS
 SG_ DET_ELEVATION_225 : 42|8@0+ (0.00275,-0.34925) [-0.34925|0.34925] "rad" ADAS
 SG_ DET_ELEVATION_ERR_225 : 50|6@0+ (0.00174533,0) [0|0.10995579] "rad" ADAS
 SG_ DET_RCS_225 : 119|8@0+ (0.5,-64) [-64|63.5] "dBsm" ADAS
 SG_ DET_VALID_FLAG_225 : 80|1@0+ (1,0) [0|1] "" ADAS
 SG_ DET_BI_STATIC_FLAG_225 : 487|1@0+ (1,0) [0|1] "" ADAS
 SG_ DET_SUPER_RES_TARGET_225 : 79|1@0+ (1,0) [0|1] "" ADAS
 SG_ DET_SNR_225 : 111|8@0+ (0.35156,0) [0|89.6478] "dB" ADAS
 SG_ DET_POINT_TARGET_PROB_225 : 86|4@0+ (6.67,0) [0|100] "%" ADAS
 SG_ DET_EXISTENCE_PROB_225 : 95|6@0+ (1.588,0) [0|100] "%" ADAS
 SG_ DET_OUTSIDE_SECTOR_225 : 103|1@0+ (1,0) [0|1] "" ADAS
 SG_ DET_HVC_FLAG_225 : 87|1@0+ (1,0) [0|1] "" ADAS
 SG_ DET_CONFD_AZIMUTH_225 : 89|2@0+ (1,0) [0|3] "" ADAS
 SG_ DET_CONFD_ELEVATION_225 : 82|2@0+ (1,0) [0|3] "" ADAS
 SG_ DET_RANGE_226 : 127|15@0+ (0.015625,0) [0|500] "m" ADAS
 SG_ DET_RANGE_ERR_226 : 128|7@0+ (0.0075,0) [0|0.9525] "m" ADAS
 SG_ DET_RANGE_VELOCITY_226 : 137|15@0+ (0.0078125,-128) [-128|127.9921875] "m/s" ADAS
 SG_ DET_RANGE_VELOCITY_ERR_226 : 154|8@0+ (0.003,0) [0|0.765] "m/s" ADAS
 SG_ DET_AZIMUTH_226 : 180|13@0+ (0.0004,-1.5708) [-1.5708|1.5708] "rad" ADAS
 SG_ DET_AZIMUTH_ERR_226 : 198|7@0+ (0.00087267,0) [0|0.11082909] "rad" ADAS
 SG_ DET_ELEVATION_226 : 162|8@0+ (0.00275,-0.34925) [-0.34925|0.34925] "rad" ADAS
 SG_ DET_ELEVATION_ERR_226 : 170|6@0+ (0.00174533,0) [0|0.10995579] "rad" ADAS
 SG_ DET_RCS_226 : 239|8@0+ (0.5,-64) [-64|63.5] "dBsm" ADAS
 SG_ DET_VALID_FLAG_226 : 220|1@0+ (1,0) [0|1] "" ADAS
 SG_ DET_BI_STATIC_FLAG_226 : 486|1@0+ (1,0) [0|1] "" ADAS
 SG_ DET_SUPER_RES_TARGET_226 : 199|1@0+ (1,0) [0|1] "" ADAS
 SG_ DET_SNR_226 : 231|8@0+ (0.35156,0) [0|89.6478] "dB" ADAS
 SG_ DET_POINT_TARGET_PROB_226 : 215|4@0+ (6.67,0) [0|100] "%" ADAS
 SG_ DET_EXISTENCE_PROB_226 : 211|6@0+ (1.588,0) [0|100] "%" ADAS
 SG_ DET_OUTSIDE_SECTOR_226 : 221|1@0+ (1,0) [0|1] "" ADAS
 SG_ DET_HVC_FLAG_226 : 207|1@0+ (1,0) [0|1] "" ADAS
 SG_ DET_CONFD_AZIMUTH_226 : 217|2@0+ (1,0) [0|3] "" ADAS
 SG_ DET_CONFD_ELEVATION_226 : 219|2@0+ (1,0) [0|3] "" ADAS
 SG_ DET_RANGE_227 : 247|15@0+ (0.015625,0) [0|500] "m" ADAS
 SG_ DET_RANGE_ERR_227 : 248|7@0+ (0.0075,0) [0|0.9525] "m" ADAS
 SG_ DET_RANGE_VELOCITY_227 : 257|15@0+ (0.0078125,-128) [-128|127.9921875] "m/s" ADAS
 SG_ DET_RANGE_VELOCITY_ERR_227 : 274|8@0+ (0.003,0) [0|0.765] "m/s" ADAS
 SG_ DET_AZIMUTH_227 : 300|13@0+ (0.0004,-1.5708) [-1.5708|1.5708] "rad" ADAS
 SG_ DET_AZIMUTH_ERR_227 : 318|7@0+ (0.00087267,0) [0|0.11082909] "rad" ADAS
 SG_ DET_ELEVATION_227 : 282|8@0+ (0.00275,-0.34925) [-0.34925|0.34925] "rad" ADAS
 SG_ DET_ELEVATION_ERR_227 : 290|6@0+ (0.00174533,0) [0|0.10995579] "rad" ADAS
 SG_ DET_RCS_227 : 359|8@0+ (0.5,-64) [-64|63.5] "dBsm" ADAS
 SG_ DET_VALID_FLAG_227 : 340|1@0+ (1,0) [0|1] "" ADAS
 SG_ DET_BI_STATIC_FLAG_227 : 485|1@0+ (1,0) [0|1] "" ADAS
 SG_ DET_SUPER_RES_TARGET_227 : 319|1@0+ (1,0) [0|1] "" ADAS
 SG_ DET_SNR_227 : 351|8@0+ (0.35156,0) [0|89.6478] "dB" ADAS
 SG_ DET_POINT_TARGET_PROB_227 : 335|4@0+ (6.67,0) [0|100] "%" ADAS
 SG_ DET_EXISTENCE_PROB_227 : 331|6@0+ (1.588,0) [0|100] "%" ADAS
 SG_ DET_OUTSIDE_SECTOR_227 : 341|1@0+ (1,0) [0|1] "" ADAS
 SG_ DET_HVC_FLAG_227 : 327|1@0+ (1,0) [0|1] "" ADAS
 SG_ DET_CONFD_AZIMUTH_227 : 337|2@0+ (1,0) [0|3] "" ADAS
 SG_ DET_CONFD_ELEVATION_227 : 339|2@0+ (1,0) [0|3] "" ADAS
 SG_ DET_RANGE_228 : 367|15@0+ (0.015625,0) [0|500] "m" ADAS
 SG_ DET_RANGE_ERR_228 : 368|7@0+ (0.0075,0) [0|0.9525] "m" ADAS
 SG_ DET_RANGE_VELOCITY_228 : 377|15@0+ (0.0078125,-128) [-128|127.9921875] "m/s" ADAS
 SG_ DET_RANGE_VELOCITY_ERR_228 : 394|8@0+ (0.003,0) [0|0.765] "m/s" ADAS
 SG_ DET_AZIMUTH_228 : 420|13@0+ (0.0004,-1.5708) [-1.5708|1.5708] "rad" ADAS
 SG_ DET_AZIMUTH_ERR_228 : 438|7@0+ (0.00087267,0) [0|0.11082909] "rad" ADAS
 SG_ DET_ELEVATION_228 : 402|8@0+ (0.00275,-0.34925) [-0.34925|0.34925] "rad" ADAS
 SG_ DET_ELEVATION_ERR_228 : 410|6@0+ (0.00174533,0) [0|0.10995579] "rad" ADAS
 SG_ DET_RCS_228 : 479|8@0+ (0.5,-64) [-64|63.5] "dBsm" ADAS
 SG_ DET_VALID_FLAG_228 : 460|1@0+ (1,0) [0|1] "" ADAS
 SG_ DET_BI_STATIC_FLAG_228 : 484|1@0+ (1,0) [0|1] "" ADAS
 SG_ DET_SUPER_RES_TARGET_228 : 439|1@0+ (1,0) [0|1] "" ADAS
 SG_ DET_SNR_228 : 471|8@0+ (0.35156,0) [0|89.6478] "dB" ADAS
 SG_ DET_POINT_TARGET_PROB_228 : 455|4@0+ (6.67,0) [0|100] "%" ADAS
 SG_ DET_EXISTENCE_PROB_228 : 451|6@0+ (1.588,0) [0|100] "%" ADAS
 SG_ DET_OUTSIDE_SECTOR_228 : 461|1@0+ (1,0) [0|1] "" ADAS
 SG_ DET_HVC_FLAG_228 : 447|1@0+ (1,0) [0|1] "" ADAS
 SG_ DET_CONFD_AZIMUTH_228 : 457|2@0+ (1,0) [0|3] "" ADAS
 SG_ DET_CONFD_ELEVATION_228 : 459|2@0+ (1,0) [0|3] "" ADAS
 SG_ DET_MH_SCAN_INDEX_4LSB_225_228 : 483|4@0+ (1,0) [0|15] "" ADAS
 SG_ DET_MH_CYCLE_COUNTER_225_228 : 495|8@0+ (1,0) [0|255] "" ADAS
 SG_ DET_MH_CRC16_225_228 : 503|16@0+ (1,0) [0|65535] "" ADAS

BO_ 1209 RDR_DETECTION_229_232: 64 RDR08
 SG_ DET_RANGE_229 : 7|15@0+ (0.015625,0) [0|500] "m" ADAS
 SG_ DET_RANGE_ERR_229 : 8|7@0+ (0.0075,0) [0|0.9525] "m" ADAS
 SG_ DET_RANGE_VELOCITY_229 : 17|15@0+ (0.0078125,-128) [-128|127.9921875] "m/s" ADAS
 SG_ DET_RANGE_VELOCITY_ERR_229 : 34|8@0+ (0.003,0) [0|0.765] "m/s" ADAS
 SG_ DET_AZIMUTH_229 : 60|13@0+ (0.0004,-1.5708) [-1.5708|1.5708] "rad" ADAS
 SG_ DET_AZIMUTH_ERR_229 : 78|7@0+ (0.00087267,0) [0|0.11082909] "rad" ADAS
 SG_ DET_ELEVATION_229 : 42|8@0+ (0.00275,-0.34925) [-0.34925|0.34925] "rad" ADAS
 SG_ DET_ELEVATION_ERR_229 : 50|6@0+ (0.00174533,0) [0|0.10995579] "rad" ADAS
 SG_ DET_RCS_229 : 119|8@0+ (0.5,-64) [-64|63.5] "dBsm" ADAS
 SG_ DET_VALID_FLAG_229 : 80|1@0+ (1,0) [0|1] "" ADAS
 SG_ DET_BI_STATIC_FLAG_229 : 487|1@0+ (1,0) [0|1] "" ADAS
 SG_ DET_SUPER_RES_TARGET_229 : 79|1@0+ (1,0) [0|1] "" ADAS
 SG_ DET_SNR_229 : 111|8@0+ (0.35156,0) [0|89.6478] "dB" ADAS
 SG_ DET_POINT_TARGET_PROB_229 : 86|4@0+ (6.67,0) [0|100] "%" ADAS
 SG_ DET_EXISTENCE_PROB_229 : 95|6@0+ (1.588,0) [0|100] "%" ADAS
 SG_ DET_OUTSIDE_SECTOR_229 : 103|1@0+ (1,0) [0|1] "" ADAS
 SG_ DET_HVC_FLAG_229 : 87|1@0+ (1,0) [0|1] "" ADAS
 SG_ DET_CONFD_AZIMUTH_229 : 89|2@0+ (1,0) [0|3] "" ADAS
 SG_ DET_CONFD_ELEVATION_229 : 82|2@0+ (1,0) [0|3] "" ADAS
 SG_ DET_RANGE_230 : 127|15@0+ (0.015625,0) [0|500] "m" ADAS
 SG_ DET_RANGE_ERR_230 : 128|7@0+ (0.0075,0) [0|0.9525] "m" ADAS
 SG_ DET_RANGE_VELOCITY_230 : 137|15@0+ (0.0078125,-128) [-128|127.9921875] "m/s" ADAS
 SG_ DET_RANGE_VELOCITY_ERR_230 : 154|8@0+ (0.003,0) [0|0.765] "m/s" ADAS
 SG_ DET_AZIMUTH_230 : 180|13@0+ (0.0004,-1.5708) [-1.5708|1.5708] "rad" ADAS
 SG_ DET_AZIMUTH_ERR_230 : 198|7@0+ (0.00087267,0) [0|0.11082909] "rad" ADAS
 SG_ DET_ELEVATION_230 : 162|8@0+ (0.00275,-0.34925) [-0.34925|0.34925] "rad" ADAS
 SG_ DET_ELEVATION_ERR_230 : 170|6@0+ (0.00174533,0) [0|0.10995579] "rad" ADAS
 SG_ DET_RCS_230 : 239|8@0+ (0.5,-64) [-64|63.5] "dBsm" ADAS
 SG_ DET_VALID_FLAG_230 : 220|1@0+ (1,0) [0|1] "" ADAS
 SG_ DET_BI_STATIC_FLAG_230 : 486|1@0+ (1,0) [0|1] "" ADAS
 SG_ DET_SUPER_RES_TARGET_230 : 199|1@0+ (1,0) [0|1] "" ADAS
 SG_ DET_SNR_230 : 231|8@0+ (0.35156,0) [0|89.6478] "dB" ADAS
 SG_ DET_POINT_TARGET_PROB_230 : 215|4@0+ (6.67,0) [0|100] "%" ADAS
 SG_ DET_EXISTENCE_PROB_230 : 211|6@0+ (1.588,0) [0|100] "%" ADAS
 SG_ DET_OUTSIDE_SECTOR_230 : 221|1@0+ (1,0) [0|1] "" ADAS
 SG_ DET_HVC_FLAG_230 : 207|1@0+ (1,0) [0|1] "" ADAS
 SG_ DET_CONFD_AZIMUTH_230 : 217|2@0+ (1,0) [0|3] "" ADAS
 SG_ DET_CONFD_ELEVATION_230 : 219|2@0+ (1,0) [0|3] "" ADAS
 SG_ DET_RANGE_231 : 247|15@0+ (0.015625,0) [0|500] "m" ADAS
 SG_ DET_RANGE_ERR_231 : 248|7@0+ (0.0075,0) [0|0.9525] "m" ADAS
 SG_ DET_RANGE_VELOCITY_231 : 257|15@0+ (0.0078125,-128) [-128|127.9921875] "m/s" ADAS
 SG_ DET_RANGE_VELOCITY_ERR_231 : 274|8@0+ (0.003,0) [0|0.765] "m/s" ADAS
 SG_ DET_AZIMUTH_231 : 300|13@0+ (0.0004,-1.5708) [-1.5708|1.5708] "rad" ADAS
 SG_ DET_AZIMUTH_ERR_231 : 318|7@0+ (0.00087267,0) [0|0.11082909] "rad" ADAS
 SG_ DET_ELEVATION_231 : 282|8@0+ (0.00275,-0.34925) [-0.34925|0.34925] "rad" ADAS
 SG_ DET_ELEVATION_ERR_231 : 290|6@0+ (0.00174533,0) [0|0.10995579] "rad" ADAS
 SG_ DET_RCS_231 : 359|8@0+ (0.5,-64) [-64|63.5] "dBsm" ADAS
 SG_ DET_VALID_FLAG_231 : 340|1@0+ (1,0) [0|1] "" ADAS
 SG_ DET_BI_STATIC_FLAG_231 : 485|1@0+ (1,0) [0|1] "" ADAS
 SG_ DET_SUPER_RES_TARGET_231 : 319|1@0+ (1,0) [0|1] "" ADAS
 SG_ DET_SNR_231 : 351|8@0+ (0.35156,0) [0|89.6478] "dB" ADAS
 SG_ DET_POINT_TARGET_PROB_231 : 335|4@0+ (6.67,0) [0|100] "%" ADAS
 SG_ DET_EXISTENCE_PROB_231 : 331|6@0+ (1.588,0) [0|100] "%" ADAS
 SG_ DET_OUTSIDE_SECTOR_231 : 341|1@0+ (1,0) [0|1] "" ADAS
 SG_ DET_HVC_FLAG_231 : 327|1@0+ (1,0) [0|1] "" ADAS
 SG_ DET_CONFD_AZIMUTH_231 : 337|2@0+ (1,0) [0|3] "" ADAS
 SG_ DET_CONFD_ELEVATION_231 : 339|2@0+ (1,0) [0|3] "" ADAS
 SG_ DET_RANGE_232 : 367|15@0+ (0.015625,0) [0|500] "m" ADAS
 SG_ DET_RANGE_ERR_232 : 368|7@0+ (0.0075,0) [0|0.9525] "m" ADAS
 SG_ DET_RANGE_VELOCITY_232 : 377|15@0+ (0.0078125,-128) [-128|127.9921875] "m/s" ADAS
 SG_ DET_RANGE_VELOCITY_ERR_232 : 394|8@0+ (0.003,0) [0|0.765] "m/s" ADAS
 SG_ DET_AZIMUTH_232 : 420|13@0+ (0.0004,-1.5708) [-1.5708|1.5708] "rad" ADAS
 SG_ DET_AZIMUTH_ERR_232 : 438|7@0+ (0.00087267,0) [0|0.11082909] "rad" ADAS
 SG_ DET_ELEVATION_232 : 402|8@0+ (0.00275,-0.34925) [-0.34925|0.34925] "rad" ADAS
 SG_ DET_ELEVATION_ERR_232 : 410|6@0+ (0.00174533,0) [0|0.10995579] "rad" ADAS
 SG_ DET_RCS_232 : 479|8@0+ (0.5,-64) [-64|63.5] "dBsm" ADAS
 SG_ DET_VALID_FLAG_232 : 460|1@0+ (1,0) [0|1] "" ADAS
 SG_ DET_BI_STATIC_FLAG_232 : 484|1@0+ (1,0) [0|1] "" ADAS
 SG_ DET_SUPER_RES_TARGET_232 : 439|1@0+ (1,0) [0|1] "" ADAS
 SG_ DET_SNR_232 : 471|8@0+ (0.35156,0) [0|89.6478] "dB" ADAS
 SG_ DET_POINT_TARGET_PROB_232 : 455|4@0+ (6.67,0) [0|100] "%" ADAS
 SG_ DET_EXISTENCE_PROB_232 : 451|6@0+ (1.588,0) [0|100] "%" ADAS
 SG_ DET_OUTSIDE_SECTOR_232 : 461|1@0+ (1,0) [0|1] "" ADAS
 SG_ DET_HVC_FLAG_232 : 447|1@0+ (1,0) [0|1] "" ADAS
 SG_ DET_CONFD_AZIMUTH_232 : 457|2@0+ (1,0) [0|3] "" ADAS
 SG_ DET_CONFD_ELEVATION_232 : 459|2@0+ (1,0) [0|3] "" ADAS
 SG_ DET_MH_SCAN_INDEX_4LSB_229_232 : 483|4@0+ (1,0) [0|15] "" ADAS
 SG_ DET_MH_CYCLE_COUNTER_229_232 : 495|8@0+ (1,0) [0|255] "" ADAS
 SG_ DET_MH_CRC16_229_232 : 503|16@0+ (1,0) [0|65535] "" ADAS

BO_ 1210 RDR_DETECTION_233_236: 64 RDR08
 SG_ DET_RANGE_233 : 7|15@0+ (0.015625,0) [0|500] "m" ADAS
 SG_ DET_RANGE_ERR_233 : 8|7@0+ (0.0075,0) [0|0.9525] "m" ADAS
 SG_ DET_RANGE_VELOCITY_233 : 17|15@0+ (0.0078125,-128) [-128|127.9921875] "m/s" ADAS
 SG_ DET_RANGE_VELOCITY_ERR_233 : 34|8@0+ (0.003,0) [0|0.765] "m/s" ADAS
 SG_ DET_AZIMUTH_233 : 60|13@0+ (0.0004,-1.5708) [-1.5708|1.5708] "rad" ADAS
 SG_ DET_AZIMUTH_ERR_233 : 78|7@0+ (0.00087267,0) [0|0.11082909] "rad" ADAS
 SG_ DET_ELEVATION_233 : 42|8@0+ (0.00275,-0.34925) [-0.34925|0.34925] "rad" ADAS
 SG_ DET_ELEVATION_ERR_233 : 50|6@0+ (0.00174533,0) [0|0.10995579] "rad" ADAS
 SG_ DET_RCS_233 : 119|8@0+ (0.5,-64) [-64|63.5] "dBsm" ADAS
 SG_ DET_VALID_FLAG_233 : 80|1@0+ (1,0) [0|1] "" ADAS
 SG_ DET_BI_STATIC_FLAG_233 : 487|1@0+ (1,0) [0|1] "" ADAS
 SG_ DET_SUPER_RES_TARGET_233 : 79|1@0+ (1,0) [0|1] "" ADAS
 SG_ DET_SNR_233 : 111|8@0+ (0.35156,0) [0|89.6478] "dB" ADAS
 SG_ DET_POINT_TARGET_PROB_233 : 86|4@0+ (6.67,0) [0|100] "%" ADAS
 SG_ DET_EXISTENCE_PROB_233 : 95|6@0+ (1.588,0) [0|100] "%" ADAS
 SG_ DET_OUTSIDE_SECTOR_233 : 103|1@0+ (1,0) [0|1] "" ADAS
 SG_ DET_HVC_FLAG_233 : 87|1@0+ (1,0) [0|1] "" ADAS
 SG_ DET_CONFD_AZIMUTH_233 : 89|2@0+ (1,0) [0|3] "" ADAS
 SG_ DET_CONFD_ELEVATION_233 : 82|2@0+ (1,0) [0|3] "" ADAS
 SG_ DET_RANGE_234 : 127|15@0+ (0.015625,0) [0|500] "m" ADAS
 SG_ DET_RANGE_ERR_234 : 128|7@0+ (0.0075,0) [0|0.9525] "m" ADAS
 SG_ DET_RANGE_VELOCITY_234 : 137|15@0+ (0.0078125,-128) [-128|127.9921875] "m/s" ADAS
 SG_ DET_RANGE_VELOCITY_ERR_234 : 154|8@0+ (0.003,0) [0|0.765] "m/s" ADAS
 SG_ DET_AZIMUTH_234 : 180|13@0+ (0.0004,-1.5708) [-1.5708|1.5708] "rad" ADAS
 SG_ DET_AZIMUTH_ERR_234 : 198|7@0+ (0.00087267,0) [0|0.11082909] "rad" ADAS
 SG_ DET_ELEVATION_234 : 162|8@0+ (0.00275,-0.34925) [-0.34925|0.34925] "rad" ADAS
 SG_ DET_ELEVATION_ERR_234 : 170|6@0+ (0.00174533,0) [0|0.10995579] "rad" ADAS
 SG_ DET_RCS_234 : 239|8@0+ (0.5,-64) [-64|63.5] "dBsm" ADAS
 SG_ DET_VALID_FLAG_234 : 220|1@0+ (1,0) [0|1] "" ADAS
 SG_ DET_BI_STATIC_FLAG_234 : 486|1@0+ (1,0) [0|1] "" ADAS
 SG_ DET_SUPER_RES_TARGET_234 : 199|1@0+ (1,0) [0|1] "" ADAS
 SG_ DET_SNR_234 : 231|8@0+ (0.35156,0) [0|89.6478] "dB" ADAS
 SG_ DET_POINT_TARGET_PROB_234 : 215|4@0+ (6.67,0) [0|100] "%" ADAS
 SG_ DET_EXISTENCE_PROB_234 : 211|6@0+ (1.588,0) [0|100] "%" ADAS
 SG_ DET_OUTSIDE_SECTOR_234 : 221|1@0+ (1,0) [0|1] "" ADAS
 SG_ DET_HVC_FLAG_234 : 207|1@0+ (1,0) [0|1] "" ADAS
 SG_ DET_CONFD_AZIMUTH_234 : 217|2@0+ (1,0) [0|3] "" ADAS
 SG_ DET_CONFD_ELEVATION_234 : 219|2@0+ (1,0) [0|3] "" ADAS
 SG_ DET_RANGE_235 : 247|15@0+ (0.015625,0) [0|500] "m" ADAS
 SG_ DET_RANGE_ERR_235 : 248|7@0+ (0.0075,0) [0|0.9525] "m" ADAS
 SG_ DET_RANGE_VELOCITY_235 : 257|15@0+ (0.0078125,-128) [-128|127.9921875] "m/s" ADAS
 SG_ DET_RANGE_VELOCITY_ERR_235 : 274|8@0+ (0.003,0) [0|0.765] "m/s" ADAS
 SG_ DET_AZIMUTH_235 : 300|13@0+ (0.0004,-1.5708) [-1.5708|1.5708] "rad" ADAS
 SG_ DET_AZIMUTH_ERR_235 : 318|7@0+ (0.00087267,0) [0|0.11082909] "rad" ADAS
 SG_ DET_ELEVATION_235 : 282|8@0+ (0.00275,-0.34925) [-0.34925|0.34925] "rad" ADAS
 SG_ DET_ELEVATION_ERR_235 : 290|6@0+ (0.00174533,0) [0|0.10995579] "rad" ADAS
 SG_ DET_RCS_235 : 359|8@0+ (0.5,-64) [-64|63.5] "dBsm" ADAS
 SG_ DET_VALID_FLAG_235 : 340|1@0+ (1,0) [0|1] "" ADAS
 SG_ DET_BI_STATIC_FLAG_235 : 485|1@0+ (1,0) [0|1] "" ADAS
 SG_ DET_SUPER_RES_TARGET_235 : 319|1@0+ (1,0) [0|1] "" ADAS
 SG_ DET_SNR_235 : 351|8@0+ (0.35156,0) [0|89.6478] "dB" ADAS
 SG_ DET_POINT_TARGET_PROB_235 : 335|4@0+ (6.67,0) [0|100] "%" ADAS
 SG_ DET_EXISTENCE_PROB_235 : 331|6@0+ (1.588,0) [0|100] "%" ADAS
 SG_ DET_OUTSIDE_SECTOR_235 : 341|1@0+ (1,0) [0|1] "" ADAS
 SG_ DET_HVC_FLAG_235 : 327|1@0+ (1,0) [0|1] "" ADAS
 SG_ DET_CONFD_AZIMUTH_235 : 337|2@0+ (1,0) [0|3] "" ADAS
 SG_ DET_CONFD_ELEVATION_235 : 339|2@0+ (1,0) [0|3] "" ADAS
 SG_ DET_RANGE_236 : 367|15@0+ (0.015625,0) [0|500] "m" ADAS
 SG_ DET_RANGE_ERR_236 : 368|7@0+ (0.0075,0) [0|0.9525] "m" ADAS
 SG_ DET_RANGE_VELOCITY_236 : 377|15@0+ (0.0078125,-128) [-128|127.9921875] "m/s" ADAS
 SG_ DET_RANGE_VELOCITY_ERR_236 : 394|8@0+ (0.003,0) [0|0.765] "m/s" ADAS
 SG_ DET_AZIMUTH_236 : 420|13@0+ (0.0004,-1.5708) [-1.5708|1.5708] "rad" ADAS
 SG_ DET_AZIMUTH_ERR_236 : 438|7@0+ (0.00087267,0) [0|0.11082909] "rad" ADAS
 SG_ DET_ELEVATION_236 : 402|8@0+ (0.00275,-0.34925) [-0.34925|0.34925] "rad" ADAS
 SG_ DET_ELEVATION_ERR_236 : 410|6@0+ (0.00174533,0) [0|0.10995579] "rad" ADAS
 SG_ DET_RCS_236 : 479|8@0+ (0.5,-64) [-64|63.5] "dBsm" ADAS
 SG_ DET_VALID_FLAG_236 : 460|1@0+ (1,0) [0|1] "" ADAS
 SG_ DET_BI_STATIC_FLAG_236 : 484|1@0+ (1,0) [0|1] "" ADAS
 SG_ DET_SUPER_RES_TARGET_236 : 439|1@0+ (1,0) [0|1] "" ADAS
 SG_ DET_SNR_236 : 471|8@0+ (0.35156,0) [0|89.6478] "dB" ADAS
 SG_ DET_POINT_TARGET_PROB_236 : 455|4@0+ (6.67,0) [0|100] "%" ADAS
 SG_ DET_EXISTENCE_PROB_236 : 451|6@0+ (1.588,0) [0|100] "%" ADAS
 SG_ DET_OUTSIDE_SECTOR_236 : 461|1@0+ (1,0) [0|1] "" ADAS
 SG_ DET_HVC_FLAG_236 : 447|1@0+ (1,0) [0|1] "" ADAS
 SG_ DET_CONFD_AZIMUTH_236 : 457|2@0+ (1,0) [0|3] "" ADAS
 SG_ DET_CONFD_ELEVATION_236 : 459|2@0+ (1,0) [0|3] "" ADAS
 SG_ DET_MH_SCAN_INDEX_4LSB_233_236 : 483|4@0+ (1,0) [0|15] "" ADAS
 SG_ DET_MH_CYCLE_COUNTER_233_236 : 495|8@0+ (1,0) [0|255] "" ADAS
 SG_ DET_MH_CRC16_233_236 : 503|16@0+ (1,0) [0|65535] "" ADAS

BO_ 1211 RDR_DETECTION_237_240: 64 RDR08
 SG_ DET_RANGE_237 : 7|15@0+ (0.015625,0) [0|500] "m" ADAS
 SG_ DET_RANGE_ERR_237 : 8|7@0+ (0.0075,0) [0|0.9525] "m" ADAS
 SG_ DET_RANGE_VELOCITY_237 : 17|15@0+ (0.0078125,-128) [-128|127.9921875] "m/s" ADAS
 SG_ DET_RANGE_VELOCITY_ERR_237 : 34|8@0+ (0.003,0) [0|0.765] "m/s" ADAS
 SG_ DET_AZIMUTH_237 : 60|13@0+ (0.0004,-1.5708) [-1.5708|1.5708] "rad" ADAS
 SG_ DET_AZIMUTH_ERR_237 : 78|7@0+ (0.00087267,0) [0|0.11082909] "rad" ADAS
 SG_ DET_ELEVATION_237 : 42|8@0+ (0.00275,-0.34925) [-0.34925|0.34925] "rad" ADAS
 SG_ DET_ELEVATION_ERR_237 : 50|6@0+ (0.00174533,0) [0|0.10995579] "rad" ADAS
 SG_ DET_RCS_237 : 119|8@0+ (0.5,-64) [-64|63.5] "dBsm" ADAS
 SG_ DET_VALID_FLAG_237 : 80|1@0+ (1,0) [0|1] "" ADAS
 SG_ DET_BI_STATIC_FLAG_237 : 487|1@0+ (1,0) [0|1] "" ADAS
 SG_ DET_SUPER_RES_TARGET_237 : 79|1@0+ (1,0) [0|1] "" ADAS
 SG_ DET_SNR_237 : 111|8@0+ (0.35156,0) [0|89.6478] "dB" ADAS
 SG_ DET_POINT_TARGET_PROB_237 : 86|4@0+ (6.67,0) [0|100] "%" ADAS
 SG_ DET_EXISTENCE_PROB_237 : 95|6@0+ (1.588,0) [0|100] "%" ADAS
 SG_ DET_OUTSIDE_SECTOR_237 : 103|1@0+ (1,0) [0|1] "" ADAS
 SG_ DET_HVC_FLAG_237 : 87|1@0+ (1,0) [0|1] "" ADAS
 SG_ DET_CONFD_AZIMUTH_237 : 89|2@0+ (1,0) [0|3] "" ADAS
 SG_ DET_CONFD_ELEVATION_237 : 82|2@0+ (1,0) [0|3] "" ADAS
 SG_ DET_RANGE_238 : 127|15@0+ (0.015625,0) [0|500] "m" ADAS
 SG_ DET_RANGE_ERR_238 : 128|7@0+ (0.0075,0) [0|0.9525] "m" ADAS
 SG_ DET_RANGE_VELOCITY_238 : 137|15@0+ (0.0078125,-128) [-128|127.9921875] "m/s" ADAS
 SG_ DET_RANGE_VELOCITY_ERR_238 : 154|8@0+ (0.003,0) [0|0.765] "m/s" ADAS
 SG_ DET_AZIMUTH_238 : 180|13@0+ (0.0004,-1.5708) [-1.5708|1.5708] "rad" ADAS
 SG_ DET_AZIMUTH_ERR_238 : 198|7@0+ (0.00087267,0) [0|0.11082909] "rad" ADAS
 SG_ DET_ELEVATION_238 : 162|8@0+ (0.00275,-0.34925) [-0.34925|0.34925] "rad" ADAS
 SG_ DET_ELEVATION_ERR_238 : 170|6@0+ (0.00174533,0) [0|0.10995579] "rad" ADAS
 SG_ DET_RCS_238 : 239|8@0+ (0.5,-64) [-64|63.5] "dBsm" ADAS
 SG_ DET_VALID_FLAG_238 : 220|1@0+ (1,0) [0|1] "" ADAS
 SG_ DET_BI_STATIC_FLAG_238 : 486|1@0+ (1,0) [0|1] "" ADAS
 SG_ DET_SUPER_RES_TARGET_238 : 199|1@0+ (1,0) [0|1] "" ADAS
 SG_ DET_SNR_238 : 231|8@0+ (0.35156,0) [0|89.6478] "dB" ADAS
 SG_ DET_POINT_TARGET_PROB_238 : 215|4@0+ (6.67,0) [0|100] "%" ADAS
 SG_ DET_EXISTENCE_PROB_238 : 211|6@0+ (1.588,0) [0|100] "%" ADAS
 SG_ DET_OUTSIDE_SECTOR_238 : 221|1@0+ (1,0) [0|1] "" ADAS
 SG_ DET_HVC_FLAG_238 : 207|1@0+ (1,0) [0|1] "" ADAS
 SG_ DET_CONFD_AZIMUTH_238 : 217|2@0+ (1,0) [0|3] "" ADAS
 SG_ DET_CONFD_ELEVATION_238 : 219|2@0+ (1,0) [0|3] "" ADAS
 SG_ DET_RANGE_239 : 247|15@0+ (0.015625,0) [0|500] "m" ADAS
 SG_ DET_RANGE_ERR_239 : 248|7@0+ (0.0075,0) [0|0.9525] "m" ADAS
 SG_ DET_RANGE_VELOCITY_239 : 257|15@0+ (0.0078125,-128) [-128|127.9921875] "m/s" ADAS
 SG_ DET_RANGE_VELOCITY_ERR_239 : 274|8@0+ (0.003,0) [0|0.765] "m/s" ADAS
 SG_ DET_AZIMUTH_239 : 300|13@0+ (0.0004,-1.5708) [-1.5708|1.5708] "rad" ADAS
 SG_ DET_AZIMUTH_ERR_239 : 318|7@0+ (0.00087267,0) [0|0.11082909] "rad" ADAS
 SG_ DET_ELEVATION_239 : 282|8@0+ (0.00275,-0.34925) [-0.34925|0.34925] "rad" ADAS
 SG_ DET_ELEVATION_ERR_239 : 290|6@0+ (0.00174533,0) [0|0.10995579] "rad" ADAS
 SG_ DET_RCS_239 : 359|8@0+ (0.5,-64) [-64|63.5] "dBsm" ADAS
 SG_ DET_VALID_FLAG_239 : 340|1@0+ (1,0) [0|1] "" ADAS
 SG_ DET_BI_STATIC_FLAG_239 : 485|1@0+ (1,0) [0|1] "" ADAS
 SG_ DET_SUPER_RES_TARGET_239 : 319|1@0+ (1,0) [0|1] "" ADAS
 SG_ DET_SNR_239 : 351|8@0+ (0.35156,0) [0|89.6478] "dB" ADAS
 SG_ DET_POINT_TARGET_PROB_239 : 335|4@0+ (6.67,0) [0|100] "%" ADAS
 SG_ DET_EXISTENCE_PROB_239 : 331|6@0+ (1.588,0) [0|100] "%" ADAS
 SG_ DET_OUTSIDE_SECTOR_239 : 341|1@0+ (1,0) [0|1] "" ADAS
 SG_ DET_HVC_FLAG_239 : 327|1@0+ (1,0) [0|1] "" ADAS
 SG_ DET_CONFD_AZIMUTH_239 : 337|2@0+ (1,0) [0|3] "" ADAS
 SG_ DET_CONFD_ELEVATION_239 : 339|2@0+ (1,0) [0|3] "" ADAS
 SG_ DET_RANGE_240 : 367|15@0+ (0.015625,0) [0|500] "m" ADAS
 SG_ DET_RANGE_ERR_240 : 368|7@0+ (0.0075,0) [0|0.9525] "m" ADAS
 SG_ DET_RANGE_VELOCITY_240 : 377|15@0+ (0.0078125,-128) [-128|127.9921875] "m/s" ADAS
 SG_ DET_RANGE_VELOCITY_ERR_240 : 394|8@0+ (0.003,0) [0|0.765] "m/s" ADAS
 SG_ DET_AZIMUTH_240 : 420|13@0+ (0.0004,-1.5708) [-1.5708|1.5708] "rad" ADAS
 SG_ DET_AZIMUTH_ERR_240 : 438|7@0+ (0.00087267,0) [0|0.11082909] "rad" ADAS
 SG_ DET_ELEVATION_240 : 402|8@0+ (0.00275,-0.34925) [-0.34925|0.34925] "rad" ADAS
 SG_ DET_ELEVATION_ERR_240 : 410|6@0+ (0.00174533,0) [0|0.10995579] "rad" ADAS
 SG_ DET_RCS_240 : 479|8@0+ (0.5,-64) [-64|63.5] "dBsm" ADAS
 SG_ DET_VALID_FLAG_240 : 460|1@0+ (1,0) [0|1] "" ADAS
 SG_ DET_BI_STATIC_FLAG_240 : 484|1@0+ (1,0) [0|1] "" ADAS
 SG_ DET_SUPER_RES_TARGET_240 : 439|1@0+ (1,0) [0|1] "" ADAS
 SG_ DET_SNR_240 : 471|8@0+ (0.35156,0) [0|89.6478] "dB" ADAS
 SG_ DET_POINT_TARGET_PROB_240 : 455|4@0+ (6.67,0) [0|100] "%" ADAS
 SG_ DET_EXISTENCE_PROB_240 : 451|6@0+ (1.588,0) [0|100] "%" ADAS
 SG_ DET_OUTSIDE_SECTOR_240 : 461|1@0+ (1,0) [0|1] "" ADAS
 SG_ DET_HVC_FLAG_240 : 447|1@0+ (1,0) [0|1] "" ADAS
 SG_ DET_CONFD_AZIMUTH_240 : 457|2@0+ (1,0) [0|3] "" ADAS
 SG_ DET_CONFD_ELEVATION_240 : 459|2@0+ (1,0) [0|3] "" ADAS
 SG_ DET_MH_SCAN_INDEX_4LSB_237_240 : 483|4@0+ (1,0) [0|15] "" ADAS
 SG_ DET_MH_CYCLE_COUNTER_237_240 : 495|8@0+ (1,0) [0|255] "" ADAS
 SG_ DET_MH_CRC16_237_240 : 503|16@0+ (1,0) [0|65535] "" ADAS

BO_ 1212 RDR_DETECTION_241_244: 64 RDR08
 SG_ DET_RANGE_241 : 7|15@0+ (0.015625,0) [0|500] "m" ADAS
 SG_ DET_RANGE_ERR_241 : 8|7@0+ (0.0075,0) [0|0.9525] "m" ADAS
 SG_ DET_RANGE_VELOCITY_241 : 17|15@0+ (0.0078125,-128) [-128|127.9921875] "m/s" ADAS
 SG_ DET_RANGE_VELOCITY_ERR_241 : 34|8@0+ (0.003,0) [0|0.765] "m/s" ADAS
 SG_ DET_AZIMUTH_241 : 60|13@0+ (0.0004,-1.5708) [-1.5708|1.5708] "rad" ADAS
 SG_ DET_AZIMUTH_ERR_241 : 78|7@0+ (0.00087267,0) [0|0.11082909] "rad" ADAS
 SG_ DET_ELEVATION_241 : 42|8@0+ (0.00275,-0.34925) [-0.34925|0.34925] "rad" ADAS
 SG_ DET_ELEVATION_ERR_241 : 50|6@0+ (0.00174533,0) [0|0.10995579] "rad" ADAS
 SG_ DET_RCS_241 : 119|8@0+ (0.5,-64) [-64|63.5] "dBsm" ADAS
 SG_ DET_VALID_FLAG_241 : 80|1@0+ (1,0) [0|1] "" ADAS
 SG_ DET_BI_STATIC_FLAG_241 : 487|1@0+ (1,0) [0|1] "" ADAS
 SG_ DET_SUPER_RES_TARGET_241 : 79|1@0+ (1,0) [0|1] "" ADAS
 SG_ DET_SNR_241 : 111|8@0+ (0.35156,0) [0|89.6478] "dB" ADAS
 SG_ DET_POINT_TARGET_PROB_241 : 86|4@0+ (6.67,0) [0|100] "%" ADAS
 SG_ DET_EXISTENCE_PROB_241 : 95|6@0+ (1.588,0) [0|100] "%" ADAS
 SG_ DET_OUTSIDE_SECTOR_241 : 103|1@0+ (1,0) [0|1] "" ADAS
 SG_ DET_HVC_FLAG_241 : 87|1@0+ (1,0) [0|1] "" ADAS
 SG_ DET_CONFD_AZIMUTH_241 : 89|2@0+ (1,0) [0|3] "" ADAS
 SG_ DET_CONFD_ELEVATION_241 : 82|2@0+ (1,0) [0|3] "" ADAS
 SG_ DET_RANGE_242 : 127|15@0+ (0.015625,0) [0|500] "m" ADAS
 SG_ DET_RANGE_ERR_242 : 128|7@0+ (0.0075,0) [0|0.9525] "m" ADAS
 SG_ DET_RANGE_VELOCITY_242 : 137|15@0+ (0.0078125,-128) [-128|127.9921875] "m/s" ADAS
 SG_ DET_RANGE_VELOCITY_ERR_242 : 154|8@0+ (0.003,0) [0|0.765] "m/s" ADAS
 SG_ DET_AZIMUTH_242 : 180|13@0+ (0.0004,-1.5708) [-1.5708|1.5708] "rad" ADAS
 SG_ DET_AZIMUTH_ERR_242 : 198|7@0+ (0.00087267,0) [0|0.11082909] "rad" ADAS
 SG_ DET_ELEVATION_242 : 162|8@0+ (0.00275,-0.34925) [-0.34925|0.34925] "rad" ADAS
 SG_ DET_ELEVATION_ERR_242 : 170|6@0+ (0.00174533,0) [0|0.10995579] "rad" ADAS
 SG_ DET_RCS_242 : 239|8@0+ (0.5,-64) [-64|63.5] "dBsm" ADAS
 SG_ DET_VALID_FLAG_242 : 220|1@0+ (1,0) [0|1] "" ADAS
 SG_ DET_BI_STATIC_FLAG_242 : 486|1@0+ (1,0) [0|1] "" ADAS
 SG_ DET_SUPER_RES_TARGET_242 : 199|1@0+ (1,0) [0|1] "" ADAS
 SG_ DET_SNR_242 : 231|8@0+ (0.35156,0) [0|89.6478] "dB" ADAS
 SG_ DET_POINT_TARGET_PROB_242 : 215|4@0+ (6.67,0) [0|100] "%" ADAS
 SG_ DET_EXISTENCE_PROB_242 : 211|6@0+ (1.588,0) [0|100] "%" ADAS
 SG_ DET_OUTSIDE_SECTOR_242 : 221|1@0+ (1,0) [0|1] "" ADAS
 SG_ DET_HVC_FLAG_242 : 207|1@0+ (1,0) [0|1] "" ADAS
 SG_ DET_CONFD_AZIMUTH_242 : 217|2@0+ (1,0) [0|3] "" ADAS
 SG_ DET_CONFD_ELEVATION_242 : 219|2@0+ (1,0) [0|3] "" ADAS
 SG_ DET_RANGE_243 : 247|15@0+ (0.015625,0) [0|500] "m" ADAS
 SG_ DET_RANGE_ERR_243 : 248|7@0+ (0.0075,0) [0|0.9525] "m" ADAS
 SG_ DET_RANGE_VELOCITY_243 : 257|15@0+ (0.0078125,-128) [-128|127.9921875] "m/s" ADAS
 SG_ DET_RANGE_VELOCITY_ERR_243 : 274|8@0+ (0.003,0) [0|0.765] "m/s" ADAS
 SG_ DET_AZIMUTH_243 : 300|13@0+ (0.0004,-1.5708) [-1.5708|1.5708] "rad" ADAS
 SG_ DET_AZIMUTH_ERR_243 : 318|7@0+ (0.00087267,0) [0|0.11082909] "rad" ADAS
 SG_ DET_ELEVATION_243 : 282|8@0+ (0.00275,-0.34925) [-0.34925|0.34925] "rad" ADAS
 SG_ DET_ELEVATION_ERR_243 : 290|6@0+ (0.00174533,0) [0|0.10995579] "rad" ADAS
 SG_ DET_RCS_243 : 359|8@0+ (0.5,-64) [-64|63.5] "dBsm" ADAS
 SG_ DET_VALID_FLAG_243 : 340|1@0+ (1,0) [0|1] "" ADAS
 SG_ DET_BI_STATIC_FLAG_243 : 485|1@0+ (1,0) [0|1] "" ADAS
 SG_ DET_SUPER_RES_TARGET_243 : 319|1@0+ (1,0) [0|1] "" ADAS
 SG_ DET_SNR_243 : 351|8@0+ (0.35156,0) [0|89.6478] "dB" ADAS
 SG_ DET_POINT_TARGET_PROB_243 : 335|4@0+ (6.67,0) [0|100] "%" ADAS
 SG_ DET_EXISTENCE_PROB_243 : 331|6@0+ (1.588,0) [0|100] "%" ADAS
 SG_ DET_OUTSIDE_SECTOR_243 : 341|1@0+ (1,0) [0|1] "" ADAS
 SG_ DET_HVC_FLAG_243 : 327|1@0+ (1,0) [0|1] "" ADAS
 SG_ DET_CONFD_AZIMUTH_243 : 337|2@0+ (1,0) [0|3] "" ADAS
 SG_ DET_CONFD_ELEVATION_243 : 339|2@0+ (1,0) [0|3] "" ADAS
 SG_ DET_RANGE_244 : 367|15@0+ (0.015625,0) [0|500] "m" ADAS
 SG_ DET_RANGE_ERR_244 : 368|7@0+ (0.0075,0) [0|0.9525] "m" ADAS
 SG_ DET_RANGE_VELOCITY_244 : 377|15@0+ (0.0078125,-128) [-128|127.9921875] "m/s" ADAS
 SG_ DET_RANGE_VELOCITY_ERR_244 : 394|8@0+ (0.003,0) [0|0.765] "m/s" ADAS
 SG_ DET_AZIMUTH_244 : 420|13@0+ (0.0004,-1.5708) [-1.5708|1.5708] "rad" ADAS
 SG_ DET_AZIMUTH_ERR_244 : 438|7@0+ (0.00087267,0) [0|0.11082909] "rad" ADAS
 SG_ DET_ELEVATION_244 : 402|8@0+ (0.00275,-0.34925) [-0.34925|0.34925] "rad" ADAS
 SG_ DET_ELEVATION_ERR_244 : 410|6@0+ (0.00174533,0) [0|0.10995579] "rad" ADAS
 SG_ DET_RCS_244 : 479|8@0+ (0.5,-64) [-64|63.5] "dBsm" ADAS
 SG_ DET_VALID_FLAG_244 : 460|1@0+ (1,0) [0|1] "" ADAS
 SG_ DET_BI_STATIC_FLAG_244 : 484|1@0+ (1,0) [0|1] "" ADAS
 SG_ DET_SUPER_RES_TARGET_244 : 439|1@0+ (1,0) [0|1] "" ADAS
 SG_ DET_SNR_244 : 471|8@0+ (0.35156,0) [0|89.6478] "dB" ADAS
 SG_ DET_POINT_TARGET_PROB_244 : 455|4@0+ (6.67,0) [0|100] "%" ADAS
 SG_ DET_EXISTENCE_PROB_244 : 451|6@0+ (1.588,0) [0|100] "%" ADAS
 SG_ DET_OUTSIDE_SECTOR_244 : 461|1@0+ (1,0) [0|1] "" ADAS
 SG_ DET_HVC_FLAG_244 : 447|1@0+ (1,0) [0|1] "" ADAS
 SG_ DET_CONFD_AZIMUTH_244 : 457|2@0+ (1,0) [0|3] "" ADAS
 SG_ DET_CONFD_ELEVATION_244 : 459|2@0+ (1,0) [0|3] "" ADAS
 SG_ DET_MH_SCAN_INDEX_4LSB_241_244 : 483|4@0+ (1,0) [0|15] "" ADAS
 SG_ DET_MH_CYCLE_COUNTER_241_244 : 495|8@0+ (1,0) [0|255] "" ADAS
 SG_ DET_MH_CRC16_241_244 : 503|16@0+ (1,0) [0|65535] "" ADAS

BO_ 1213 RDR_DETECTION_245_248: 64 RDR08
 SG_ DET_RANGE_245 : 7|15@0+ (0.015625,0) [0|500] "m" ADAS
 SG_ DET_RANGE_ERR_245 : 8|7@0+ (0.0075,0) [0|0.9525] "m" ADAS
 SG_ DET_RANGE_VELOCITY_245 : 17|15@0+ (0.0078125,-128) [-128|127.9921875] "m/s" ADAS
 SG_ DET_RANGE_VELOCITY_ERR_245 : 34|8@0+ (0.003,0) [0|0.765] "m/s" ADAS
 SG_ DET_AZIMUTH_245 : 60|13@0+ (0.0004,-1.5708) [-1.5708|1.5708] "rad" ADAS
 SG_ DET_AZIMUTH_ERR_245 : 78|7@0+ (0.00087267,0) [0|0.11082909] "rad" ADAS
 SG_ DET_ELEVATION_245 : 42|8@0+ (0.00275,-0.34925) [-0.34925|0.34925] "rad" ADAS
 SG_ DET_ELEVATION_ERR_245 : 50|6@0+ (0.00174533,0) [0|0.10995579] "rad" ADAS
 SG_ DET_RCS_245 : 119|8@0+ (0.5,-64) [-64|63.5] "dBsm" ADAS
 SG_ DET_VALID_FLAG_245 : 80|1@0+ (1,0) [0|1] "" ADAS
 SG_ DET_BI_STATIC_FLAG_245 : 487|1@0+ (1,0) [0|1] "" ADAS
 SG_ DET_SUPER_RES_TARGET_245 : 79|1@0+ (1,0) [0|1] "" ADAS
 SG_ DET_SNR_245 : 111|8@0+ (0.35156,0) [0|89.6478] "dB" ADAS
 SG_ DET_POINT_TARGET_PROB_245 : 86|4@0+ (6.67,0) [0|100] "%" ADAS
 SG_ DET_EXISTENCE_PROB_245 : 95|6@0+ (1.588,0) [0|100] "%" ADAS
 SG_ DET_OUTSIDE_SECTOR_245 : 103|1@0+ (1,0) [0|1] "" ADAS
 SG_ DET_HVC_FLAG_245 : 87|1@0+ (1,0) [0|1] "" ADAS
 SG_ DET_CONFD_AZIMUTH_245 : 89|2@0+ (1,0) [0|3] "" ADAS
 SG_ DET_CONFD_ELEVATION_245 : 82|2@0+ (1,0) [0|3] "" ADAS
 SG_ DET_RANGE_246 : 127|15@0+ (0.015625,0) [0|500] "m" ADAS
 SG_ DET_RANGE_ERR_246 : 128|7@0+ (0.0075,0) [0|0.9525] "m" ADAS
 SG_ DET_RANGE_VELOCITY_246 : 137|15@0+ (0.0078125,-128) [-128|127.9921875] "m/s" ADAS
 SG_ DET_RANGE_VELOCITY_ERR_246 : 154|8@0+ (0.003,0) [0|0.765] "m/s" ADAS
 SG_ DET_AZIMUTH_246 : 180|13@0+ (0.0004,-1.5708) [-1.5708|1.5708] "rad" ADAS
 SG_ DET_AZIMUTH_ERR_246 : 198|7@0+ (0.00087267,0) [0|0.11082909] "rad" ADAS
 SG_ DET_ELEVATION_246 : 162|8@0+ (0.00275,-0.34925) [-0.34925|0.34925] "rad" ADAS
 SG_ DET_ELEVATION_ERR_246 : 170|6@0+ (0.00174533,0) [0|0.10995579] "rad" ADAS
 SG_ DET_RCS_246 : 239|8@0+ (0.5,-64) [-64|63.5] "dBsm" ADAS
 SG_ DET_VALID_FLAG_246 : 220|1@0+ (1,0) [0|1] "" ADAS
 SG_ DET_BI_STATIC_FLAG_246 : 486|1@0+ (1,0) [0|1] "" ADAS
 SG_ DET_SUPER_RES_TARGET_246 : 199|1@0+ (1,0) [0|1] "" ADAS
 SG_ DET_SNR_246 : 231|8@0+ (0.35156,0) [0|89.6478] "dB" ADAS
 SG_ DET_POINT_TARGET_PROB_246 : 215|4@0+ (6.67,0) [0|100] "%" ADAS
 SG_ DET_EXISTENCE_PROB_246 : 211|6@0+ (1.588,0) [0|100] "%" ADAS
 SG_ DET_OUTSIDE_SECTOR_246 : 221|1@0+ (1,0) [0|1] "" ADAS
 SG_ DET_HVC_FLAG_246 : 207|1@0+ (1,0) [0|1] "" ADAS
 SG_ DET_CONFD_AZIMUTH_246 : 217|2@0+ (1,0) [0|3] "" ADAS
 SG_ DET_CONFD_ELEVATION_246 : 219|2@0+ (1,0) [0|3] "" ADAS
 SG_ DET_RANGE_247 : 247|15@0+ (0.015625,0) [0|500] "m" ADAS
 SG_ DET_RANGE_ERR_247 : 248|7@0+ (0.0075,0) [0|0.9525] "m" ADAS
 SG_ DET_RANGE_VELOCITY_247 : 257|15@0+ (0.0078125,-128) [-128|127.9921875] "m/s" ADAS
 SG_ DET_RANGE_VELOCITY_ERR_247 : 274|8@0+ (0.003,0) [0|0.765] "m/s" ADAS
 SG_ DET_AZIMUTH_247 : 300|13@0+ (0.0004,-1.5708) [-1.5708|1.5708] "rad" ADAS
 SG_ DET_AZIMUTH_ERR_247 : 318|7@0+ (0.00087267,0) [0|0.11082909] "rad" ADAS
 SG_ DET_ELEVATION_247 : 282|8@0+ (0.00275,-0.34925) [-0.34925|0.34925] "rad" ADAS
 SG_ DET_ELEVATION_ERR_247 : 290|6@0+ (0.00174533,0) [0|0.10995579] "rad" ADAS
 SG_ DET_RCS_247 : 359|8@0+ (0.5,-64) [-64|63.5] "dBsm" ADAS
 SG_ DET_VALID_FLAG_247 : 340|1@0+ (1,0) [0|1] "" ADAS
 SG_ DET_BI_STATIC_FLAG_247 : 485|1@0+ (1,0) [0|1] "" ADAS
 SG_ DET_SUPER_RES_TARGET_247 : 319|1@0+ (1,0) [0|1] "" ADAS
 SG_ DET_SNR_247 : 351|8@0+ (0.35156,0) [0|89.6478] "dB" ADAS
 SG_ DET_POINT_TARGET_PROB_247 : 335|4@0+ (6.67,0) [0|100] "%" ADAS
 SG_ DET_EXISTENCE_PROB_247 : 331|6@0+ (1.588,0) [0|100] "%" ADAS
 SG_ DET_OUTSIDE_SECTOR_247 : 341|1@0+ (1,0) [0|1] "" ADAS
 SG_ DET_HVC_FLAG_247 : 327|1@0+ (1,0) [0|1] "" ADAS
 SG_ DET_CONFD_AZIMUTH_247 : 337|2@0+ (1,0) [0|3] "" ADAS
 SG_ DET_CONFD_ELEVATION_247 : 339|2@0+ (1,0) [0|3] "" ADAS
 SG_ DET_RANGE_248 : 367|15@0+ (0.015625,0) [0|500] "m" ADAS
 SG_ DET_RANGE_ERR_248 : 368|7@0+ (0.0075,0) [0|0.9525] "m" ADAS
 SG_ DET_RANGE_VELOCITY_248 : 377|15@0+ (0.0078125,-128) [-128|127.9921875] "m/s" ADAS
 SG_ DET_RANGE_VELOCITY_ERR_248 : 394|8@0+ (0.003,0) [0|0.765] "m/s" ADAS
 SG_ DET_AZIMUTH_248 : 420|13@0+ (0.0004,-1.5708) [-1.5708|1.5708] "rad" ADAS
 SG_ DET_AZIMUTH_ERR_248 : 438|7@0+ (0.00087267,0) [0|0.11082909] "rad" ADAS
 SG_ DET_ELEVATION_248 : 402|8@0+ (0.00275,-0.34925) [-0.34925|0.34925] "rad" ADAS
 SG_ DET_ELEVATION_ERR_248 : 410|6@0+ (0.00174533,0) [0|0.10995579] "rad" ADAS
 SG_ DET_RCS_248 : 479|8@0+ (0.5,-64) [-64|63.5] "dBsm" ADAS
 SG_ DET_VALID_FLAG_248 : 460|1@0+ (1,0) [0|1] "" ADAS
 SG_ DET_BI_STATIC_FLAG_248 : 484|1@0+ (1,0) [0|1] "" ADAS
 SG_ DET_SUPER_RES_TARGET_248 : 439|1@0+ (1,0) [0|1] "" ADAS
 SG_ DET_SNR_248 : 471|8@0+ (0.35156,0) [0|89.6478] "dB" ADAS
 SG_ DET_POINT_TARGET_PROB_248 : 455|4@0+ (6.67,0) [0|100] "%" ADAS
 SG_ DET_EXISTENCE_PROB_248 : 451|6@0+ (1.588,0) [0|100] "%" ADAS
 SG_ DET_OUTSIDE_SECTOR_248 : 461|1@0+ (1,0) [0|1] "" ADAS
 SG_ DET_HVC_FLAG_248 : 447|1@0+ (1,0) [0|1] "" ADAS
 SG_ DET_CONFD_AZIMUTH_248 : 457|2@0+ (1,0) [0|3] "" ADAS
 SG_ DET_CONFD_ELEVATION_248 : 459|2@0+ (1,0) [0|3] "" ADAS
 SG_ DET_MH_SCAN_INDEX_4LSB_245_248 : 483|4@0+ (1,0) [0|15] "" ADAS
 SG_ DET_MH_CYCLE_COUNTER_245_248 : 495|8@0+ (1,0) [0|255] "" ADAS
 SG_ DET_MH_CRC16_245_248 : 503|16@0+ (1,0) [0|65535] "" ADAS

BO_ 1214 RDR_DETECTION_249_252: 64 RDR08
 SG_ DET_RANGE_249 : 7|15@0+ (0.015625,0) [0|500] "m" ADAS
 SG_ DET_RANGE_ERR_249 : 8|7@0+ (0.0075,0) [0|0.9525] "m" ADAS
 SG_ DET_RANGE_VELOCITY_249 : 17|15@0+ (0.0078125,-128) [-128|127.9921875] "m/s" ADAS
 SG_ DET_RANGE_VELOCITY_ERR_249 : 34|8@0+ (0.003,0) [0|0.765] "m/s" ADAS
 SG_ DET_AZIMUTH_249 : 60|13@0+ (0.0004,-1.5708) [-1.5708|1.5708] "rad" ADAS
 SG_ DET_AZIMUTH_ERR_249 : 78|7@0+ (0.00087267,0) [0|0.11082909] "rad" ADAS
 SG_ DET_ELEVATION_249 : 42|8@0+ (0.00275,-0.34925) [-0.34925|0.34925] "rad" ADAS
 SG_ DET_ELEVATION_ERR_249 : 50|6@0+ (0.00174533,0) [0|0.10995579] "rad" ADAS
 SG_ DET_RCS_249 : 119|8@0+ (0.5,-64) [-64|63.5] "dBsm" ADAS
 SG_ DET_VALID_FLAG_249 : 80|1@0+ (1,0) [0|1] "" ADAS
 SG_ DET_BI_STATIC_FLAG_249 : 487|1@0+ (1,0) [0|1] "" ADAS
 SG_ DET_SUPER_RES_TARGET_249 : 79|1@0+ (1,0) [0|1] "" ADAS
 SG_ DET_SNR_249 : 111|8@0+ (0.35156,0) [0|89.6478] "dB" ADAS
 SG_ DET_POINT_TARGET_PROB_249 : 86|4@0+ (6.67,0) [0|100] "%" ADAS
 SG_ DET_EXISTENCE_PROB_249 : 95|6@0+ (1.588,0) [0|100] "%" ADAS
 SG_ DET_OUTSIDE_SECTOR_249 : 103|1@0+ (1,0) [0|1] "" ADAS
 SG_ DET_HVC_FLAG_249 : 87|1@0+ (1,0) [0|1] "" ADAS
 SG_ DET_CONFD_AZIMUTH_249 : 89|2@0+ (1,0) [0|3] "" ADAS
 SG_ DET_CONFD_ELEVATION_249 : 82|2@0+ (1,0) [0|3] "" ADAS
 SG_ DET_RANGE_250 : 127|15@0+ (0.015625,0) [0|500] "m" ADAS
 SG_ DET_RANGE_ERR_250 : 128|7@0+ (0.0075,0) [0|0.9525] "m" ADAS
 SG_ DET_RANGE_VELOCITY_250 : 137|15@0+ (0.0078125,-128) [-128|127.9921875] "m/s" ADAS
 SG_ DET_RANGE_VELOCITY_ERR_250 : 154|8@0+ (0.003,0) [0|0.765] "m/s" ADAS
 SG_ DET_AZIMUTH_250 : 180|13@0+ (0.0004,-1.5708) [-1.5708|1.5708] "rad" ADAS
 SG_ DET_AZIMUTH_ERR_250 : 198|7@0+ (0.00087267,0) [0|0.11082909] "rad" ADAS
 SG_ DET_ELEVATION_250 : 162|8@0+ (0.00275,-0.34925) [-0.34925|0.34925] "rad" ADAS
 SG_ DET_ELEVATION_ERR_250 : 170|6@0+ (0.00174533,0) [0|0.10995579] "rad" ADAS
 SG_ DET_RCS_250 : 239|8@0+ (0.5,-64) [-64|63.5] "dBsm" ADAS
 SG_ DET_VALID_FLAG_250 : 220|1@0+ (1,0) [0|1] "" ADAS
 SG_ DET_BI_STATIC_FLAG_250 : 486|1@0+ (1,0) [0|1] "" ADAS
 SG_ DET_SUPER_RES_TARGET_250 : 199|1@0+ (1,0) [0|1] "" ADAS
 SG_ DET_SNR_250 : 231|8@0+ (0.35156,0) [0|89.6478] "dB" ADAS
 SG_ DET_POINT_TARGET_PROB_250 : 215|4@0+ (6.67,0) [0|100] "%" ADAS
 SG_ DET_EXISTENCE_PROB_250 : 211|6@0+ (1.588,0) [0|100] "%" ADAS
 SG_ DET_OUTSIDE_SECTOR_250 : 221|1@0+ (1,0) [0|1] "" ADAS
 SG_ DET_HVC_FLAG_250 : 207|1@0+ (1,0) [0|1] "" ADAS
 SG_ DET_CONFD_AZIMUTH_250 : 217|2@0+ (1,0) [0|3] "" ADAS
 SG_ DET_CONFD_ELEVATION_250 : 219|2@0+ (1,0) [0|3] "" ADAS
 SG_ DET_RANGE_251 : 247|15@0+ (0.015625,0) [0|500] "m" ADAS
 SG_ DET_RANGE_ERR_251 : 248|7@0+ (0.0075,0) [0|0.9525] "m" ADAS
 SG_ DET_RANGE_VELOCITY_251 : 257|15@0+ (0.0078125,-128) [-128|127.9921875] "m/s" ADAS
 SG_ DET_RANGE_VELOCITY_ERR_251 : 274|8@0+ (0.003,0) [0|0.765] "m/s" ADAS
 SG_ DET_AZIMUTH_251 : 300|13@0+ (0.0004,-1.5708) [-1.5708|1.5708] "rad" ADAS
 SG_ DET_AZIMUTH_ERR_251 : 318|7@0+ (0.00087267,0) [0|0.11082909] "rad" ADAS
 SG_ DET_ELEVATION_251 : 282|8@0+ (0.00275,-0.34925) [-0.34925|0.34925] "rad" ADAS
 SG_ DET_ELEVATION_ERR_251 : 290|6@0+ (0.00174533,0) [0|0.10995579] "rad" ADAS
 SG_ DET_RCS_251 : 359|8@0+ (0.5,-64) [-64|63.5] "dBsm" ADAS
 SG_ DET_VALID_FLAG_251 : 340|1@0+ (1,0) [0|1] "" ADAS
 SG_ DET_BI_STATIC_FLAG_251 : 485|1@0+ (1,0) [0|1] "" ADAS
 SG_ DET_SUPER_RES_TARGET_251 : 319|1@0+ (1,0) [0|1] "" ADAS
 SG_ DET_SNR_251 : 351|8@0+ (0.35156,0) [0|89.6478] "dB" ADAS
 SG_ DET_POINT_TARGET_PROB_251 : 335|4@0+ (6.67,0) [0|100] "%" ADAS
 SG_ DET_EXISTENCE_PROB_251 : 331|6@0+ (1.588,0) [0|100] "%" ADAS
 SG_ DET_OUTSIDE_SECTOR_251 : 341|1@0+ (1,0) [0|1] "" ADAS
 SG_ DET_HVC_FLAG_251 : 327|1@0+ (1,0) [0|1] "" ADAS
 SG_ DET_CONFD_AZIMUTH_251 : 337|2@0+ (1,0) [0|3] "" ADAS
 SG_ DET_CONFD_ELEVATION_251 : 339|2@0+ (1,0) [0|3] "" ADAS
 SG_ DET_RANGE_252 : 367|15@0+ (0.015625,0) [0|500] "m" ADAS
 SG_ DET_RANGE_ERR_252 : 368|7@0+ (0.0075,0) [0|0.9525] "m" ADAS
 SG_ DET_RANGE_VELOCITY_252 : 377|15@0+ (0.0078125,-128) [-128|127.9921875] "m/s" ADAS
 SG_ DET_RANGE_VELOCITY_ERR_252 : 394|8@0+ (0.003,0) [0|0.765] "m/s" ADAS
 SG_ DET_AZIMUTH_252 : 420|13@0+ (0.0004,-1.5708) [-1.5708|1.5708] "rad" ADAS
 SG_ DET_AZIMUTH_ERR_252 : 438|7@0+ (0.00087267,0) [0|0.11082909] "rad" ADAS
 SG_ DET_ELEVATION_252 : 402|8@0+ (0.00275,-0.34925) [-0.34925|0.34925] "rad" ADAS
 SG_ DET_ELEVATION_ERR_252 : 410|6@0+ (0.00174533,0) [0|0.10995579] "rad" ADAS
 SG_ DET_RCS_252 : 479|8@0+ (0.5,-64) [-64|63.5] "dBsm" ADAS
 SG_ DET_VALID_FLAG_252 : 460|1@0+ (1,0) [0|1] "" ADAS
 SG_ DET_BI_STATIC_FLAG_252 : 484|1@0+ (1,0) [0|1] "" ADAS
 SG_ DET_SUPER_RES_TARGET_252 : 439|1@0+ (1,0) [0|1] "" ADAS
 SG_ DET_SNR_252 : 471|8@0+ (0.35156,0) [0|89.6478] "dB" ADAS
 SG_ DET_POINT_TARGET_PROB_252 : 455|4@0+ (6.67,0) [0|100] "%" ADAS
 SG_ DET_EXISTENCE_PROB_252 : 451|6@0+ (1.588,0) [0|100] "%" ADAS
 SG_ DET_OUTSIDE_SECTOR_252 : 461|1@0+ (1,0) [0|1] "" ADAS
 SG_ DET_HVC_FLAG_252 : 447|1@0+ (1,0) [0|1] "" ADAS
 SG_ DET_CONFD_AZIMUTH_252 : 457|2@0+ (1,0) [0|3] "" ADAS
 SG_ DET_CONFD_ELEVATION_252 : 459|2@0+ (1,0) [0|3] "" ADAS
 SG_ DET_MH_SCAN_INDEX_4LSB_249_252 : 483|4@0+ (1,0) [0|15] "" ADAS
 SG_ DET_MH_CYCLE_COUNTER_249_252 : 495|8@0+ (1,0) [0|255] "" ADAS
 SG_ DET_MH_CRC16_249_252 : 503|16@0+ (1,0) [0|65535] "" ADAS

BO_ 1215 RDR_DETECTION_253_256: 64 RDR08
 SG_ DET_RANGE_253 : 7|15@0+ (0.015625,0) [0|500] "m" ADAS
 SG_ DET_RANGE_ERR_253 : 8|7@0+ (0.0075,0) [0|0.9525] "m" ADAS
 SG_ DET_RANGE_VELOCITY_253 : 17|15@0+ (0.0078125,-128) [-128|127.9921875] "m/s" ADAS
 SG_ DET_RANGE_VELOCITY_ERR_253 : 34|8@0+ (0.003,0) [0|0.765] "m/s" ADAS
 SG_ DET_AZIMUTH_253 : 60|13@0+ (0.0004,-1.5708) [-1.5708|1.5708] "rad" ADAS
 SG_ DET_AZIMUTH_ERR_253 : 78|7@0+ (0.00087267,0) [0|0.11082909] "rad" ADAS
 SG_ DET_ELEVATION_253 : 42|8@0+ (0.00275,-0.34925) [-0.34925|0.34925] "rad" ADAS
 SG_ DET_ELEVATION_ERR_253 : 50|6@0+ (0.00174533,0) [0|0.10995579] "rad" ADAS
 SG_ DET_RCS_253 : 119|8@0+ (0.5,-64) [-64|63.5] "dBsm" ADAS
 SG_ DET_VALID_FLAG_253 : 80|1@0+ (1,0) [0|1] "" ADAS
 SG_ DET_BI_STATIC_FLAG_253 : 487|1@0+ (1,0) [0|1] "" ADAS
 SG_ DET_SUPER_RES_TARGET_253 : 79|1@0+ (1,0) [0|1] "" ADAS
 SG_ DET_SNR_253 : 111|8@0+ (0.35156,0) [0|89.6478] "dB" ADAS
 SG_ DET_POINT_TARGET_PROB_253 : 86|4@0+ (6.67,0) [0|100] "%" ADAS
 SG_ DET_EXISTENCE_PROB_253 : 95|6@0+ (1.588,0) [0|100] "%" ADAS
 SG_ DET_OUTSIDE_SECTOR_253 : 103|1@0+ (1,0) [0|1] "" ADAS
 SG_ DET_HVC_FLAG_253 : 87|1@0+ (1,0) [0|1] "" ADAS
 SG_ DET_CONFD_AZIMUTH_253 : 89|2@0+ (1,0) [0|3] "" ADAS
 SG_ DET_CONFD_ELEVATION_253 : 82|2@0+ (1,0) [0|3] "" ADAS
 SG_ DET_RANGE_254 : 127|15@0+ (0.015625,0) [0|500] "m" ADAS
 SG_ DET_RANGE_ERR_254 : 128|7@0+ (0.0075,0) [0|0.9525] "m" ADAS
 SG_ DET_RANGE_VELOCITY_254 : 137|15@0+ (0.0078125,-128) [-128|127.9921875] "m/s" ADAS
 SG_ DET_RANGE_VELOCITY_ERR_254 : 154|8@0+ (0.003,0) [0|0.765] "m/s" ADAS
 SG_ DET_AZIMUTH_254 : 180|13@0+ (0.0004,-1.5708) [-1.5708|1.5708] "rad" ADAS
 SG_ DET_AZIMUTH_ERR_254 : 198|7@0+ (0.00087267,0) [0|0.11082909] "rad" ADAS
 SG_ DET_ELEVATION_254 : 162|8@0+ (0.00275,-0.34925) [-0.34925|0.34925] "rad" ADAS
 SG_ DET_ELEVATION_ERR_254 : 170|6@0+ (0.00174533,0) [0|0.10995579] "rad" ADAS
 SG_ DET_RCS_254 : 239|8@0+ (0.5,-64) [-64|63.5] "dBsm" ADAS
 SG_ DET_VALID_FLAG_254 : 220|1@0+ (1,0) [0|1] "" ADAS
 SG_ DET_BI_STATIC_FLAG_254 : 486|1@0+ (1,0) [0|1] "" ADAS
 SG_ DET_SUPER_RES_TARGET_254 : 199|1@0+ (1,0) [0|1] "" ADAS
 SG_ DET_SNR_254 : 231|8@0+ (0.35156,0) [0|89.6478] "dB" ADAS
 SG_ DET_POINT_TARGET_PROB_254 : 215|4@0+ (6.67,0) [0|100] "%" ADAS
 SG_ DET_EXISTENCE_PROB_254 : 211|6@0+ (1.588,0) [0|100] "%" ADAS
 SG_ DET_OUTSIDE_SECTOR_254 : 221|1@0+ (1,0) [0|1] "" ADAS
 SG_ DET_HVC_FLAG_254 : 207|1@0+ (1,0) [0|1] "" ADAS
 SG_ DET_CONFD_AZIMUTH_254 : 217|2@0+ (1,0) [0|3] "" ADAS
 SG_ DET_CONFD_ELEVATION_254 : 219|2@0+ (1,0) [0|3] "" ADAS
 SG_ DET_RANGE_255 : 247|15@0+ (0.015625,0) [0|500] "m" ADAS
 SG_ DET_RANGE_ERR_255 : 248|7@0+ (0.0075,0) [0|0.9525] "m" ADAS
 SG_ DET_RANGE_VELOCITY_255 : 257|15@0+ (0.0078125,-128) [-128|127.9921875] "m/s" ADAS
 SG_ DET_RANGE_VELOCITY_ERR_255 : 274|8@0+ (0.003,0) [0|0.765] "m/s" ADAS
 SG_ DET_AZIMUTH_255 : 300|13@0+ (0.0004,-1.5708) [-1.5708|1.5708] "rad" ADAS
 SG_ DET_AZIMUTH_ERR_255 : 318|7@0+ (0.00087267,0) [0|0.11082909] "rad" ADAS
 SG_ DET_ELEVATION_255 : 282|8@0+ (0.00275,-0.34925) [-0.34925|0.34925] "rad" ADAS
 SG_ DET_ELEVATION_ERR_255 : 290|6@0+ (0.00174533,0) [0|0.10995579] "rad" ADAS
 SG_ DET_RCS_255 : 359|8@0+ (0.5,-64) [-64|63.5] "dBsm" ADAS
 SG_ DET_VALID_FLAG_255 : 340|1@0+ (1,0) [0|1] "" ADAS
 SG_ DET_BI_STATIC_FLAG_255 : 485|1@0+ (1,0) [0|1] "" ADAS
 SG_ DET_SUPER_RES_TARGET_255 : 319|1@0+ (1,0) [0|1] "" ADAS
 SG_ DET_SNR_255 : 351|8@0+ (0.35156,0) [0|89.6478] "dB" ADAS
 SG_ DET_POINT_TARGET_PROB_255 : 335|4@0+ (6.67,0) [0|100] "%" ADAS
 SG_ DET_EXISTENCE_PROB_255 : 331|6@0+ (1.588,0) [0|100] "%" ADAS
 SG_ DET_OUTSIDE_SECTOR_255 : 341|1@0+ (1,0) [0|1] "" ADAS
 SG_ DET_HVC_FLAG_255 : 327|1@0+ (1,0) [0|1] "" ADAS
 SG_ DET_CONFD_AZIMUTH_255 : 337|2@0+ (1,0) [0|3] "" ADAS
 SG_ DET_CONFD_ELEVATION_255 : 339|2@0+ (1,0) [0|3] "" ADAS
 SG_ DET_RANGE_256 : 367|15@0+ (0.015625,0) [0|500] "m" ADAS
 SG_ DET_RANGE_ERR_256 : 368|7@0+ (0.0075,0) [0|0.9525] "m" ADAS
 SG_ DET_RANGE_VELOCITY_256 : 377|15@0+ (0.0078125,-128) [-128|127.9921875] "m/s" ADAS
 SG_ DET_RANGE_VELOCITY_ERR_256 : 394|8@0+ (0.003,0) [0|0.765] "m/s" ADAS
 SG_ DET_AZIMUTH_256 : 420|13@0+ (0.0004,-1.5708) [-1.5708|1.5708] "rad" ADAS
 SG_ DET_AZIMUTH_ERR_256 : 438|7@0+ (0.00087267,0) [0|0.11082909] "rad" ADAS
 SG_ DET_ELEVATION_256 : 402|8@0+ (0.00275,-0.34925) [-0.34925|0.34925] "rad" ADAS
 SG_ DET_ELEVATION_ERR_256 : 410|6@0+ (0.00174533,0) [0|0.10995579] "rad" ADAS
 SG_ DET_RCS_256 : 479|8@0+ (0.5,-64) [-64|63.5] "dBsm" ADAS
 SG_ DET_VALID_FLAG_256 : 460|1@0+ (1,0) [0|1] "" ADAS
 SG_ DET_BI_STATIC_FLAG_256 : 484|1@0+ (1,0) [0|1] "" ADAS
 SG_ DET_SUPER_RES_TARGET_256 : 439|1@0+ (1,0) [0|1] "" ADAS
 SG_ DET_SNR_256 : 471|8@0+ (0.35156,0) [0|89.6478] "dB" ADAS
 SG_ DET_POINT_TARGET_PROB_256 : 455|4@0+ (6.67,0) [0|100] "%" ADAS
 SG_ DET_EXISTENCE_PROB_256 : 451|6@0+ (1.588,0) [0|100] "%" ADAS
 SG_ DET_OUTSIDE_SECTOR_256 : 461|1@0+ (1,0) [0|1] "" ADAS
 SG_ DET_HVC_FLAG_256 : 447|1@0+ (1,0) [0|1] "" ADAS
 SG_ DET_CONFD_AZIMUTH_256 : 457|2@0+ (1,0) [0|3] "" ADAS
 SG_ DET_CONFD_ELEVATION_256 : 459|2@0+ (1,0) [0|3] "" ADAS
 SG_ DET_MH_SCAN_INDEX_4LSB_253_256 : 483|4@0+ (1,0) [0|15] "" ADAS
 SG_ DET_MH_CYCLE_COUNTER_253_256 : 495|8@0+ (1,0) [0|255] "" ADAS
 SG_ DET_MH_CRC16_253_256 : 503|16@0+ (1,0) [0|65535] "" ADAS

CM_ SG_ 1198 DET_RANGE_185 " measured position  of the detection";
CM_ SG_ 1198 DET_RANGE_ERR_185 "RMSE or standard deviation of the measured angle  of the detection";
CM_ SG_ 1198 DET_RANGE_VELOCITY_185 "Radial velocity of the detection positive in direction to the sensor";
CM_ SG_ 1198 DET_RANGE_VELOCITY_ERR_185 "RMSE or standard deviation of the measure radial velocity of the detection";
CM_ SG_ 1198 DET_AZIMUTH_185 "Measured angle  of the detection";
CM_ SG_ 1198 DET_AZIMUTH_ERR_185 "RMSE or standard deviation of the measured angle  of the detection";
CM_ SG_ 1198 DET_ELEVATION_185 "measured elevation of the detection";
CM_ SG_ 1198 DET_ELEVATION_ERR_185 "RMSE or standard deviation of the measured elevation  of the detection";
CM_ SG_ 1198 DET_RCS_185 "Radar Cross Section or Amplitude, is a measure of how detectable an object is by radar. A larger RCS indicates that an object is more easily detected.";
CM_ SG_ 1198 DET_VALID_FLAG_185 "is set if the measured detection is valid";
CM_ SG_ 1198 DET_BI_STATIC_FLAG_185 "1 if detection is bi-static 0 otherwise";
CM_ SG_ 1198 DET_SUPER_RES_TARGET_185 "flasg is set if the detection is super resolution target";
CM_ SG_ 1198 DET_SNR_185 "The signal to noise ratio (SNR) of the radar detection";
CM_ SG_ 1198 DET_POINT_TARGET_PROB_185 "Describes the possibility if more than one real-world object has led to this detection. 0[%] := 100[%] Multi target probability";
CM_ SG_ 1198 DET_EXISTENCE_PROB_185 "Existence probability of the detection not based on history. Value does  not depend on any past experience with similar detections.
\note Use as confidence measure where a low value means less confidence
and a high value indicates strong confidence.";
CM_ SG_ 1198 DET_OUTSIDE_SECTOR_185 "Flag to indicate detections outside the sector, set if the wrong sector calibration matrix was used";
CM_ SG_ 1198 DET_HVC_FLAG_185 "Core2 Vehicle clutter flag";
CM_ SG_ 1198 DET_CONFD_AZIMUTH_185 "Define the Confidence of Azimuth for Detection ";
CM_ SG_ 1198 DET_CONFD_ELEVATION_185 "Define the Confidence of Elevation for the Detection ";
CM_ SG_ 1198 DET_BI_STATIC_FLAG_186 "1 if detection is bi-static 0 otherwise";
CM_ SG_ 1198 DET_BI_STATIC_FLAG_187 "1 if detection is bi-static 0 otherwise";
CM_ SG_ 1198 DET_BI_STATIC_FLAG_188 "1 if detection is bi-static 0 otherwise";
CM_ SG_ 1198 DET_MH_SCAN_INDEX_4LSB_185_188 "Scan index of the measured detection";
CM_ SG_ 1198 DET_MH_CYCLE_COUNTER_185_188 "Detection Alive Counter";
CM_ SG_ 1199 DET_RANGE_189 " measured position  of the detection";
CM_ SG_ 1199 DET_RANGE_ERR_189 "RMSE or standard deviation of the measured angle  of the detection";
CM_ SG_ 1199 DET_RANGE_VELOCITY_189 "Radial velocity of the detection positive in direction to the sensor";
CM_ SG_ 1199 DET_RANGE_VELOCITY_ERR_189 "RMSE or standard deviation of the measure radial velocity of the detection";
CM_ SG_ 1199 DET_AZIMUTH_189 "Measured angle  of the detection";
CM_ SG_ 1199 DET_AZIMUTH_ERR_189 "RMSE or standard deviation of the measured angle  of the detection";
CM_ SG_ 1199 DET_ELEVATION_189 "measured elevation of the detection";
CM_ SG_ 1199 DET_ELEVATION_ERR_189 "RMSE or standard deviation of the measured elevation  of the detection";
CM_ SG_ 1199 DET_RCS_189 "Radar Cross Section or Amplitude, is a measure of how detectable an object is by radar. A larger RCS indicates that an object is more easily detected.";
CM_ SG_ 1199 DET_VALID_FLAG_189 "is set if the measured detection is valid";
CM_ SG_ 1199 DET_BI_STATIC_FLAG_189 "1 if detection is bi-static 0 otherwise";
CM_ SG_ 1199 DET_SUPER_RES_TARGET_189 "flasg is set if the detection is super resolution target";
CM_ SG_ 1199 DET_SNR_189 "The signal to noise ratio (SNR) of the radar detection";
CM_ SG_ 1199 DET_POINT_TARGET_PROB_189 "Describes the possibility if more than one real-world object has led to this detection. 0[%] := 100[%] Multi target probability";
CM_ SG_ 1199 DET_EXISTENCE_PROB_189 "Existence probability of the detection not based on history. Value does  not depend on any past experience with similar detections.
\note Use as confidence measure where a low value means less confidence
and a high value indicates strong confidence.";
CM_ SG_ 1199 DET_OUTSIDE_SECTOR_189 "Flag to indicate detections outside the sector, set if the wrong sector calibration matrix was used";
CM_ SG_ 1199 DET_HVC_FLAG_189 "Core2 Vehicle clutter flag";
CM_ SG_ 1199 DET_CONFD_AZIMUTH_189 "Define the Confidence of Azimuth for Detection ";
CM_ SG_ 1199 DET_CONFD_ELEVATION_189 "Define the Confidence of Elevation for the Detection ";
CM_ SG_ 1199 DET_BI_STATIC_FLAG_190 "1 if detection is bi-static 0 otherwise";
CM_ SG_ 1199 DET_BI_STATIC_FLAG_191 "1 if detection is bi-static 0 otherwise";
CM_ SG_ 1199 DET_BI_STATIC_FLAG_192 "1 if detection is bi-static 0 otherwise";
CM_ SG_ 1199 DET_MH_SCAN_INDEX_4LSB_189_192 "Scan index of the measured detection";
CM_ SG_ 1199 DET_MH_CYCLE_COUNTER_189_192 "Detection Alive Counter";
CM_ SG_ 1200 DET_RANGE_193 " measured position  of the detection";
CM_ SG_ 1200 DET_RANGE_ERR_193 "RMSE or standard deviation of the measured angle  of the detection";
CM_ SG_ 1200 DET_RANGE_VELOCITY_193 "Radial velocity of the detection positive in direction to the sensor";
CM_ SG_ 1200 DET_RANGE_VELOCITY_ERR_193 "RMSE or standard deviation of the measure radial velocity of the detection";
CM_ SG_ 1200 DET_AZIMUTH_193 "Measured angle  of the detection";
CM_ SG_ 1200 DET_AZIMUTH_ERR_193 "RMSE or standard deviation of the measured angle  of the detection";
CM_ SG_ 1200 DET_ELEVATION_193 "measured elevation of the detection";
CM_ SG_ 1200 DET_ELEVATION_ERR_193 "RMSE or standard deviation of the measured elevation  of the detection";
CM_ SG_ 1200 DET_RCS_193 "Radar Cross Section or Amplitude, is a measure of how detectable an object is by radar. A larger RCS indicates that an object is more easily detected.";
CM_ SG_ 1200 DET_VALID_FLAG_193 "is set if the measured detection is valid";
CM_ SG_ 1200 DET_BI_STATIC_FLAG_193 "1 if detection is bi-static 0 otherwise";
CM_ SG_ 1200 DET_SUPER_RES_TARGET_193 "flasg is set if the detection is super resolution target";
CM_ SG_ 1200 DET_SNR_193 "The signal to noise ratio (SNR) of the radar detection";
CM_ SG_ 1200 DET_POINT_TARGET_PROB_193 "Describes the possibility if more than one real-world object has led to this detection. 0[%] := 100[%] Multi target probability";
CM_ SG_ 1200 DET_EXISTENCE_PROB_193 "Existence probability of the detection not based on history. Value does  not depend on any past experience with similar detections.
\note Use as confidence measure where a low value means less confidence
and a high value indicates strong confidence.";
CM_ SG_ 1200 DET_OUTSIDE_SECTOR_193 "Flag to indicate detections outside the sector, set if the wrong sector calibration matrix was used";
CM_ SG_ 1200 DET_HVC_FLAG_193 "Core2 Vehicle clutter flag";
CM_ SG_ 1200 DET_CONFD_AZIMUTH_193 "Define the Confidence of Azimuth for Detection ";
CM_ SG_ 1200 DET_CONFD_ELEVATION_193 "Define the Confidence of Elevation for the Detection ";
CM_ SG_ 1200 DET_BI_STATIC_FLAG_194 "1 if detection is bi-static 0 otherwise";
CM_ SG_ 1200 DET_BI_STATIC_FLAG_195 "1 if detection is bi-static 0 otherwise";
CM_ SG_ 1200 DET_BI_STATIC_FLAG_196 "1 if detection is bi-static 0 otherwise";
CM_ SG_ 1200 DET_MH_SCAN_INDEX_4LSB_193_196 "Scan index of the measured detection";
CM_ SG_ 1200 DET_MH_CYCLE_COUNTER_193_196 "Detection Alive Counter";
CM_ SG_ 1201 DET_RANGE_197 " measured position  of the detection";
CM_ SG_ 1201 DET_RANGE_ERR_197 "RMSE or standard deviation of the measured angle  of the detection";
CM_ SG_ 1201 DET_RANGE_VELOCITY_197 "Radial velocity of the detection positive in direction to the sensor";
CM_ SG_ 1201 DET_RANGE_VELOCITY_ERR_197 "RMSE or standard deviation of the measure radial velocity of the detection";
CM_ SG_ 1201 DET_AZIMUTH_197 "Measured angle  of the detection";
CM_ SG_ 1201 DET_AZIMUTH_ERR_197 "RMSE or standard deviation of the measured angle  of the detection";
CM_ SG_ 1201 DET_ELEVATION_197 "measured elevation of the detection";
CM_ SG_ 1201 DET_ELEVATION_ERR_197 "RMSE or standard deviation of the measured elevation  of the detection";
CM_ SG_ 1201 DET_RCS_197 "Radar Cross Section or Amplitude, is a measure of how detectable an object is by radar. A larger RCS indicates that an object is more easily detected.";
CM_ SG_ 1201 DET_VALID_FLAG_197 "is set if the measured detection is valid";
CM_ SG_ 1201 DET_BI_STATIC_FLAG_197 "1 if detection is bi-static 0 otherwise";
CM_ SG_ 1201 DET_SUPER_RES_TARGET_197 "flasg is set if the detection is super resolution target";
CM_ SG_ 1201 DET_SNR_197 "The signal to noise ratio (SNR) of the radar detection";
CM_ SG_ 1201 DET_POINT_TARGET_PROB_197 "Describes the possibility if more than one real-world object has led to this detection. 0[%] := 100[%] Multi target probability";
CM_ SG_ 1201 DET_EXISTENCE_PROB_197 "Existence probability of the detection not based on history. Value does  not depend on any past experience with similar detections.
\note Use as confidence measure where a low value means less confidence
and a high value indicates strong confidence.";
CM_ SG_ 1201 DET_OUTSIDE_SECTOR_197 "Flag to indicate detections outside the sector, set if the wrong sector calibration matrix was used";
CM_ SG_ 1201 DET_HVC_FLAG_197 "Core2 Vehicle clutter flag";
CM_ SG_ 1201 DET_CONFD_AZIMUTH_197 "Define the Confidence of Azimuth for Detection ";
CM_ SG_ 1201 DET_CONFD_ELEVATION_197 "Define the Confidence of Elevation for the Detection ";
CM_ SG_ 1201 DET_BI_STATIC_FLAG_198 "1 if detection is bi-static 0 otherwise";
CM_ SG_ 1201 DET_BI_STATIC_FLAG_199 "1 if detection is bi-static 0 otherwise";
CM_ SG_ 1201 DET_BI_STATIC_FLAG_200 "1 if detection is bi-static 0 otherwise";
CM_ SG_ 1201 DET_MH_SCAN_INDEX_4LSB_197_200 "Scan index of the measured detection";
CM_ SG_ 1201 DET_MH_CYCLE_COUNTER_197_200 "Detection Alive Counter";
CM_ SG_ 1202 DET_RANGE_201 " measured position  of the detection";
CM_ SG_ 1202 DET_RANGE_ERR_201 "RMSE or standard deviation of the measured angle  of the detection";
CM_ SG_ 1202 DET_RANGE_VELOCITY_201 "Radial velocity of the detection positive in direction to the sensor";
CM_ SG_ 1202 DET_RANGE_VELOCITY_ERR_201 "RMSE or standard deviation of the measure radial velocity of the detection";
CM_ SG_ 1202 DET_AZIMUTH_201 "Measured angle  of the detection";
CM_ SG_ 1202 DET_AZIMUTH_ERR_201 "RMSE or standard deviation of the measured angle  of the detection";
CM_ SG_ 1202 DET_ELEVATION_201 "measured elevation of the detection";
CM_ SG_ 1202 DET_ELEVATION_ERR_201 "RMSE or standard deviation of the measured elevation  of the detection";
CM_ SG_ 1202 DET_RCS_201 "Radar Cross Section or Amplitude, is a measure of how detectable an object is by radar. A larger RCS indicates that an object is more easily detected.";
CM_ SG_ 1202 DET_VALID_FLAG_201 "is set if the measured detection is valid";
CM_ SG_ 1202 DET_BI_STATIC_FLAG_201 "1 if detection is bi-static 0 otherwise";
CM_ SG_ 1202 DET_SUPER_RES_TARGET_201 "flasg is set if the detection is super resolution target";
CM_ SG_ 1202 DET_SNR_201 "The signal to noise ratio (SNR) of the radar detection";
CM_ SG_ 1202 DET_POINT_TARGET_PROB_201 "Describes the possibility if more than one real-world object has led to this detection. 0[%] := 100[%] Multi target probability";
CM_ SG_ 1202 DET_EXISTENCE_PROB_201 "Existence probability of the detection not based on history. Value does  not depend on any past experience with similar detections.
\note Use as confidence measure where a low value means less confidence
and a high value indicates strong confidence.";
CM_ SG_ 1202 DET_OUTSIDE_SECTOR_201 "Flag to indicate detections outside the sector, set if the wrong sector calibration matrix was used";
CM_ SG_ 1202 DET_HVC_FLAG_201 "Core2 Vehicle clutter flag";
CM_ SG_ 1202 DET_CONFD_AZIMUTH_201 "Define the Confidence of Azimuth for Detection ";
CM_ SG_ 1202 DET_CONFD_ELEVATION_201 "Define the Confidence of Elevation for the Detection ";
CM_ SG_ 1202 DET_BI_STATIC_FLAG_202 "1 if detection is bi-static 0 otherwise";
CM_ SG_ 1202 DET_BI_STATIC_FLAG_203 "1 if detection is bi-static 0 otherwise";
CM_ SG_ 1202 DET_BI_STATIC_FLAG_204 "1 if detection is bi-static 0 otherwise";
CM_ SG_ 1202 DET_MH_SCAN_INDEX_4LSB_201_204 "Scan index of the measured detection";
CM_ SG_ 1202 DET_MH_CYCLE_COUNTER_201_204 "Detection Alive Counter";
CM_ SG_ 1203 DET_RANGE_205 " measured position  of the detection";
CM_ SG_ 1203 DET_RANGE_ERR_205 "RMSE or standard deviation of the measured angle  of the detection";
CM_ SG_ 1203 DET_RANGE_VELOCITY_205 "Radial velocity of the detection positive in direction to the sensor";
CM_ SG_ 1203 DET_RANGE_VELOCITY_ERR_205 "RMSE or standard deviation of the measure radial velocity of the detection";
CM_ SG_ 1203 DET_AZIMUTH_205 "Measured angle  of the detection";
CM_ SG_ 1203 DET_AZIMUTH_ERR_205 "RMSE or standard deviation of the measured angle  of the detection";
CM_ SG_ 1203 DET_ELEVATION_205 "measured elevation of the detection";
CM_ SG_ 1203 DET_ELEVATION_ERR_205 "RMSE or standard deviation of the measured elevation  of the detection";
CM_ SG_ 1203 DET_RCS_205 "Radar Cross Section or Amplitude, is a measure of how detectable an object is by radar. A larger RCS indicates that an object is more easily detected.";
CM_ SG_ 1203 DET_VALID_FLAG_205 "is set if the measured detection is valid";
CM_ SG_ 1203 DET_BI_STATIC_FLAG_205 "1 if detection is bi-static 0 otherwise";
CM_ SG_ 1203 DET_SUPER_RES_TARGET_205 "flasg is set if the detection is super resolution target";
CM_ SG_ 1203 DET_SNR_205 "The signal to noise ratio (SNR) of the radar detection";
CM_ SG_ 1203 DET_POINT_TARGET_PROB_205 "Describes the possibility if more than one real-world object has led to this detection. 0[%] := 100[%] Multi target probability";
CM_ SG_ 1203 DET_EXISTENCE_PROB_205 "Existence probability of the detection not based on history. Value does  not depend on any past experience with similar detections.
\note Use as confidence measure where a low value means less confidence
and a high value indicates strong confidence.";
CM_ SG_ 1203 DET_OUTSIDE_SECTOR_205 "Flag to indicate detections outside the sector, set if the wrong sector calibration matrix was used";
CM_ SG_ 1203 DET_HVC_FLAG_205 "Core2 Vehicle clutter flag";
CM_ SG_ 1203 DET_CONFD_AZIMUTH_205 "Define the Confidence of Azimuth for Detection ";
CM_ SG_ 1203 DET_CONFD_ELEVATION_205 "Define the Confidence of Elevation for the Detection ";
CM_ SG_ 1203 DET_BI_STATIC_FLAG_206 "1 if detection is bi-static 0 otherwise";
CM_ SG_ 1203 DET_BI_STATIC_FLAG_207 "1 if detection is bi-static 0 otherwise";
CM_ SG_ 1203 DET_BI_STATIC_FLAG_208 "1 if detection is bi-static 0 otherwise";
CM_ SG_ 1203 DET_MH_SCAN_INDEX_4LSB_205_208 "Scan index of the measured detection";
CM_ SG_ 1203 DET_MH_CYCLE_COUNTER_205_208 "Detection Alive Counter";
CM_ SG_ 1204 DET_RANGE_209 " measured position  of the detection";
CM_ SG_ 1204 DET_RANGE_ERR_209 "RMSE or standard deviation of the measured angle  of the detection";
CM_ SG_ 1204 DET_RANGE_VELOCITY_209 "Radial velocity of the detection positive in direction to the sensor";
CM_ SG_ 1204 DET_RANGE_VELOCITY_ERR_209 "RMSE or standard deviation of the measure radial velocity of the detection";
CM_ SG_ 1204 DET_AZIMUTH_209 "Measured angle  of the detection";
CM_ SG_ 1204 DET_AZIMUTH_ERR_209 "RMSE or standard deviation of the measured angle  of the detection";
CM_ SG_ 1204 DET_ELEVATION_209 "measured elevation of the detection";
CM_ SG_ 1204 DET_ELEVATION_ERR_209 "RMSE or standard deviation of the measured elevation  of the detection";
CM_ SG_ 1204 DET_RCS_209 "Radar Cross Section or Amplitude, is a measure of how detectable an object is by radar. A larger RCS indicates that an object is more easily detected.";
CM_ SG_ 1204 DET_VALID_FLAG_209 "is set if the measured detection is valid";
CM_ SG_ 1204 DET_BI_STATIC_FLAG_209 "1 if detection is bi-static 0 otherwise";
CM_ SG_ 1204 DET_SUPER_RES_TARGET_209 "flasg is set if the detection is super resolution target";
CM_ SG_ 1204 DET_SNR_209 "The signal to noise ratio (SNR) of the radar detection";
CM_ SG_ 1204 DET_POINT_TARGET_PROB_209 "Describes the possibility if more than one real-world object has led to this detection. 0[%] := 100[%] Multi target probability";
CM_ SG_ 1204 DET_EXISTENCE_PROB_209 "Existence probability of the detection not based on history. Value does  not depend on any past experience with similar detections.
\note Use as confidence measure where a low value means less confidence
and a high value indicates strong confidence.";
CM_ SG_ 1204 DET_OUTSIDE_SECTOR_209 "Flag to indicate detections outside the sector, set if the wrong sector calibration matrix was used";
CM_ SG_ 1204 DET_HVC_FLAG_209 "Core2 Vehicle clutter flag";
CM_ SG_ 1204 DET_CONFD_AZIMUTH_209 "Define the Confidence of Azimuth for Detection ";
CM_ SG_ 1204 DET_CONFD_ELEVATION_209 "Define the Confidence of Elevation for the Detection ";
CM_ SG_ 1204 DET_BI_STATIC_FLAG_210 "1 if detection is bi-static 0 otherwise";
CM_ SG_ 1204 DET_BI_STATIC_FLAG_211 "1 if detection is bi-static 0 otherwise";
CM_ SG_ 1204 DET_BI_STATIC_FLAG_212 "1 if detection is bi-static 0 otherwise";
CM_ SG_ 1204 DET_MH_SCAN_INDEX_4LSB_209_212 "Scan index of the measured detection";
CM_ SG_ 1204 DET_MH_CYCLE_COUNTER_209_212 "Detection Alive Counter";
CM_ SG_ 1205 DET_RANGE_213 " measured position  of the detection";
CM_ SG_ 1205 DET_RANGE_ERR_213 "RMSE or standard deviation of the measured angle  of the detection";
CM_ SG_ 1205 DET_RANGE_VELOCITY_213 "Radial velocity of the detection positive in direction to the sensor";
CM_ SG_ 1205 DET_RANGE_VELOCITY_ERR_213 "RMSE or standard deviation of the measure radial velocity of the detection";
CM_ SG_ 1205 DET_AZIMUTH_213 "Measured angle  of the detection";
CM_ SG_ 1205 DET_AZIMUTH_ERR_213 "RMSE or standard deviation of the measured angle  of the detection";
CM_ SG_ 1205 DET_ELEVATION_213 "measured elevation of the detection";
CM_ SG_ 1205 DET_ELEVATION_ERR_213 "RMSE or standard deviation of the measured elevation  of the detection";
CM_ SG_ 1205 DET_RCS_213 "Radar Cross Section or Amplitude, is a measure of how detectable an object is by radar. A larger RCS indicates that an object is more easily detected.";
CM_ SG_ 1205 DET_VALID_FLAG_213 "is set if the measured detection is valid";
CM_ SG_ 1205 DET_BI_STATIC_FLAG_213 "1 if detection is bi-static 0 otherwise";
CM_ SG_ 1205 DET_SUPER_RES_TARGET_213 "flasg is set if the detection is super resolution target";
CM_ SG_ 1205 DET_SNR_213 "The signal to noise ratio (SNR) of the radar detection";
CM_ SG_ 1205 DET_POINT_TARGET_PROB_213 "Describes the possibility if more than one real-world object has led to this detection. 0[%] := 100[%] Multi target probability";
CM_ SG_ 1205 DET_EXISTENCE_PROB_213 "Existence probability of the detection not based on history. Value does  not depend on any past experience with similar detections.
\note Use as confidence measure where a low value means less confidence
and a high value indicates strong confidence.";
CM_ SG_ 1205 DET_OUTSIDE_SECTOR_213 "Flag to indicate detections outside the sector, set if the wrong sector calibration matrix was used";
CM_ SG_ 1205 DET_HVC_FLAG_213 "Core2 Vehicle clutter flag";
CM_ SG_ 1205 DET_CONFD_AZIMUTH_213 "Define the Confidence of Azimuth for Detection ";
CM_ SG_ 1205 DET_CONFD_ELEVATION_213 "Define the Confidence of Elevation for the Detection ";
CM_ SG_ 1205 DET_BI_STATIC_FLAG_214 "1 if detection is bi-static 0 otherwise";
CM_ SG_ 1205 DET_BI_STATIC_FLAG_215 "1 if detection is bi-static 0 otherwise";
CM_ SG_ 1205 DET_BI_STATIC_FLAG_216 "1 if detection is bi-static 0 otherwise";
CM_ SG_ 1205 DET_MH_SCAN_INDEX_4LSB_213_216 "Scan index of the measured detection";
CM_ SG_ 1205 DET_MH_CYCLE_COUNTER_213_216 "Detection Alive Counter";
CM_ SG_ 1206 DET_RANGE_217 " measured position  of the detection";
CM_ SG_ 1206 DET_RANGE_ERR_217 "RMSE or standard deviation of the measured angle  of the detection";
CM_ SG_ 1206 DET_RANGE_VELOCITY_217 "Radial velocity of the detection positive in direction to the sensor";
CM_ SG_ 1206 DET_RANGE_VELOCITY_ERR_217 "RMSE or standard deviation of the measure radial velocity of the detection";
CM_ SG_ 1206 DET_AZIMUTH_217 "Measured angle  of the detection";
CM_ SG_ 1206 DET_AZIMUTH_ERR_217 "RMSE or standard deviation of the measured angle  of the detection";
CM_ SG_ 1206 DET_ELEVATION_217 "measured elevation of the detection";
CM_ SG_ 1206 DET_ELEVATION_ERR_217 "RMSE or standard deviation of the measured elevation  of the detection";
CM_ SG_ 1206 DET_RCS_217 "Radar Cross Section or Amplitude, is a measure of how detectable an object is by radar. A larger RCS indicates that an object is more easily detected.";
CM_ SG_ 1206 DET_VALID_FLAG_217 "is set if the measured detection is valid";
CM_ SG_ 1206 DET_BI_STATIC_FLAG_217 "1 if detection is bi-static 0 otherwise";
CM_ SG_ 1206 DET_SUPER_RES_TARGET_217 "flasg is set if the detection is super resolution target";
CM_ SG_ 1206 DET_SNR_217 "The signal to noise ratio (SNR) of the radar detection";
CM_ SG_ 1206 DET_POINT_TARGET_PROB_217 "Describes the possibility if more than one real-world object has led to this detection. 0[%] := 100[%] Multi target probability";
CM_ SG_ 1206 DET_EXISTENCE_PROB_217 "Existence probability of the detection not based on history. Value does  not depend on any past experience with similar detections.
\note Use as confidence measure where a low value means less confidence
and a high value indicates strong confidence.";
CM_ SG_ 1206 DET_OUTSIDE_SECTOR_217 "Flag to indicate detections outside the sector, set if the wrong sector calibration matrix was used";
CM_ SG_ 1206 DET_HVC_FLAG_217 "Core2 Vehicle clutter flag";
CM_ SG_ 1206 DET_CONFD_AZIMUTH_217 "Define the Confidence of Azimuth for Detection ";
CM_ SG_ 1206 DET_CONFD_ELEVATION_217 "Define the Confidence of Elevation for the Detection ";
CM_ SG_ 1206 DET_BI_STATIC_FLAG_218 "1 if detection is bi-static 0 otherwise";
CM_ SG_ 1206 DET_BI_STATIC_FLAG_219 "1 if detection is bi-static 0 otherwise";
CM_ SG_ 1206 DET_BI_STATIC_FLAG_220 "1 if detection is bi-static 0 otherwise";
CM_ SG_ 1206 DET_MH_SCAN_INDEX_4LSB_217_220 "Scan index of the measured detection";
CM_ SG_ 1206 DET_MH_CYCLE_COUNTER_217_220 "Detection Alive Counter";
CM_ SG_ 1207 DET_RANGE_221 " measured position  of the detection";
CM_ SG_ 1207 DET_RANGE_ERR_221 "RMSE or standard deviation of the measured angle  of the detection";
CM_ SG_ 1207 DET_RANGE_VELOCITY_221 "Radial velocity of the detection positive in direction to the sensor";
CM_ SG_ 1207 DET_RANGE_VELOCITY_ERR_221 "RMSE or standard deviation of the measure radial velocity of the detection";
CM_ SG_ 1207 DET_AZIMUTH_221 "Measured angle  of the detection";
CM_ SG_ 1207 DET_AZIMUTH_ERR_221 "RMSE or standard deviation of the measured angle  of the detection";
CM_ SG_ 1207 DET_ELEVATION_221 "measured elevation of the detection";
CM_ SG_ 1207 DET_ELEVATION_ERR_221 "RMSE or standard deviation of the measured elevation  of the detection";
CM_ SG_ 1207 DET_RCS_221 "Radar Cross Section or Amplitude, is a measure of how detectable an object is by radar. A larger RCS indicates that an object is more easily detected.";
CM_ SG_ 1207 DET_VALID_FLAG_221 "is set if the measured detection is valid";
CM_ SG_ 1207 DET_BI_STATIC_FLAG_221 "1 if detection is bi-static 0 otherwise";
CM_ SG_ 1207 DET_SUPER_RES_TARGET_221 "flasg is set if the detection is super resolution target";
CM_ SG_ 1207 DET_SNR_221 "The signal to noise ratio (SNR) of the radar detection";
CM_ SG_ 1207 DET_POINT_TARGET_PROB_221 "Describes the possibility if more than one real-world object has led to this detection. 0[%] := 100[%] Multi target probability";
CM_ SG_ 1207 DET_EXISTENCE_PROB_221 "Existence probability of the detection not based on history. Value does  not depend on any past experience with similar detections.
\note Use as confidence measure where a low value means less confidence
and a high value indicates strong confidence.";
CM_ SG_ 1207 DET_OUTSIDE_SECTOR_221 "Flag to indicate detections outside the sector, set if the wrong sector calibration matrix was used";
CM_ SG_ 1207 DET_HVC_FLAG_221 "Core2 Vehicle clutter flag";
CM_ SG_ 1207 DET_CONFD_AZIMUTH_221 "Define the Confidence of Azimuth for Detection ";
CM_ SG_ 1207 DET_CONFD_ELEVATION_221 "Define the Confidence of Elevation for the Detection ";
CM_ SG_ 1207 DET_BI_STATIC_FLAG_222 "1 if detection is bi-static 0 otherwise";
CM_ SG_ 1207 DET_BI_STATIC_FLAG_223 "1 if detection is bi-static 0 otherwise";
CM_ SG_ 1207 DET_BI_STATIC_FLAG_224 "1 if detection is bi-static 0 otherwise";
CM_ SG_ 1207 DET_MH_SCAN_INDEX_4LSB_221_224 "Scan index of the measured detection";
CM_ SG_ 1207 DET_MH_CYCLE_COUNTER_221_224 "Detection Alive Counter";
CM_ SG_ 1208 DET_RANGE_225 " measured position  of the detection";
CM_ SG_ 1208 DET_RANGE_ERR_225 "RMSE or standard deviation of the measured angle  of the detection";
CM_ SG_ 1208 DET_RANGE_VELOCITY_225 "Radial velocity of the detection positive in direction to the sensor";
CM_ SG_ 1208 DET_RANGE_VELOCITY_ERR_225 "RMSE or standard deviation of the measure radial velocity of the detection";
CM_ SG_ 1208 DET_AZIMUTH_225 "Measured angle  of the detection";
CM_ SG_ 1208 DET_AZIMUTH_ERR_225 "RMSE or standard deviation of the measured angle  of the detection";
CM_ SG_ 1208 DET_ELEVATION_225 "measured elevation of the detection";
CM_ SG_ 1208 DET_ELEVATION_ERR_225 "RMSE or standard deviation of the measured elevation  of the detection";
CM_ SG_ 1208 DET_RCS_225 "Radar Cross Section or Amplitude, is a measure of how detectable an object is by radar. A larger RCS indicates that an object is more easily detected.";
CM_ SG_ 1208 DET_VALID_FLAG_225 "is set if the measured detection is valid";
CM_ SG_ 1208 DET_BI_STATIC_FLAG_225 "1 if detection is bi-static 0 otherwise";
CM_ SG_ 1208 DET_SUPER_RES_TARGET_225 "flasg is set if the detection is super resolution target";
CM_ SG_ 1208 DET_SNR_225 "The signal to noise ratio (SNR) of the radar detection";
CM_ SG_ 1208 DET_POINT_TARGET_PROB_225 "Describes the possibility if more than one real-world object has led to this detection. 0[%] := 100[%] Multi target probability";
CM_ SG_ 1208 DET_EXISTENCE_PROB_225 "Existence probability of the detection not based on history. Value does  not depend on any past experience with similar detections.
\note Use as confidence measure where a low value means less confidence
and a high value indicates strong confidence.";
CM_ SG_ 1208 DET_OUTSIDE_SECTOR_225 "Flag to indicate detections outside the sector, set if the wrong sector calibration matrix was used";
CM_ SG_ 1208 DET_HVC_FLAG_225 "Core2 Vehicle clutter flag";
CM_ SG_ 1208 DET_CONFD_AZIMUTH_225 "Define the Confidence of Azimuth for Detection ";
CM_ SG_ 1208 DET_CONFD_ELEVATION_225 "Define the Confidence of Elevation for the Detection ";
CM_ SG_ 1208 DET_BI_STATIC_FLAG_226 "1 if detection is bi-static 0 otherwise";
CM_ SG_ 1208 DET_BI_STATIC_FLAG_227 "1 if detection is bi-static 0 otherwise";
CM_ SG_ 1208 DET_BI_STATIC_FLAG_228 "1 if detection is bi-static 0 otherwise";
CM_ SG_ 1208 DET_MH_SCAN_INDEX_4LSB_225_228 "Scan index of the measured detection";
CM_ SG_ 1208 DET_MH_CYCLE_COUNTER_225_228 "Detection Alive Counter";
CM_ SG_ 1209 DET_RANGE_229 " measured position  of the detection";
CM_ SG_ 1209 DET_RANGE_ERR_229 "RMSE or standard deviation of the measured angle  of the detection";
CM_ SG_ 1209 DET_RANGE_VELOCITY_229 "Radial velocity of the detection positive in direction to the sensor";
CM_ SG_ 1209 DET_RANGE_VELOCITY_ERR_229 "RMSE or standard deviation of the measure radial velocity of the detection";
CM_ SG_ 1209 DET_AZIMUTH_229 "Measured angle  of the detection";
CM_ SG_ 1209 DET_AZIMUTH_ERR_229 "RMSE or standard deviation of the measured angle  of the detection";
CM_ SG_ 1209 DET_ELEVATION_229 "measured elevation of the detection";
CM_ SG_ 1209 DET_ELEVATION_ERR_229 "RMSE or standard deviation of the measured elevation  of the detection";
CM_ SG_ 1209 DET_RCS_229 "Radar Cross Section or Amplitude, is a measure of how detectable an object is by radar. A larger RCS indicates that an object is more easily detected.";
CM_ SG_ 1209 DET_VALID_FLAG_229 "is set if the measured detection is valid";
CM_ SG_ 1209 DET_BI_STATIC_FLAG_229 "1 if detection is bi-static 0 otherwise";
CM_ SG_ 1209 DET_SUPER_RES_TARGET_229 "flasg is set if the detection is super resolution target";
CM_ SG_ 1209 DET_SNR_229 "The signal to noise ratio (SNR) of the radar detection";
CM_ SG_ 1209 DET_POINT_TARGET_PROB_229 "Describes the possibility if more than one real-world object has led to this detection. 0[%] := 100[%] Multi target probability";
CM_ SG_ 1209 DET_EXISTENCE_PROB_229 "Existence probability of the detection not based on history. Value does  not depend on any past experience with similar detections.
\note Use as confidence measure where a low value means less confidence
and a high value indicates strong confidence.";
CM_ SG_ 1209 DET_OUTSIDE_SECTOR_229 "Flag to indicate detections outside the sector, set if the wrong sector calibration matrix was used";
CM_ SG_ 1209 DET_HVC_FLAG_229 "Core2 Vehicle clutter flag";
CM_ SG_ 1209 DET_CONFD_AZIMUTH_229 "Define the Confidence of Azimuth for Detection ";
CM_ SG_ 1209 DET_CONFD_ELEVATION_229 "Define the Confidence of Elevation for the Detection ";
CM_ SG_ 1209 DET_BI_STATIC_FLAG_230 "1 if detection is bi-static 0 otherwise";
CM_ SG_ 1209 DET_BI_STATIC_FLAG_231 "1 if detection is bi-static 0 otherwise";
CM_ SG_ 1209 DET_BI_STATIC_FLAG_232 "1 if detection is bi-static 0 otherwise";
CM_ SG_ 1209 DET_MH_SCAN_INDEX_4LSB_229_232 "Scan index of the measured detection";
CM_ SG_ 1209 DET_MH_CYCLE_COUNTER_229_232 "Detection Alive Counter";
CM_ SG_ 1210 DET_RANGE_233 " measured position  of the detection";
CM_ SG_ 1210 DET_RANGE_ERR_233 "RMSE or standard deviation of the measured angle  of the detection";
CM_ SG_ 1210 DET_RANGE_VELOCITY_233 "Radial velocity of the detection positive in direction to the sensor";
CM_ SG_ 1210 DET_RANGE_VELOCITY_ERR_233 "RMSE or standard deviation of the measure radial velocity of the detection";
CM_ SG_ 1210 DET_AZIMUTH_233 "Measured angle  of the detection";
CM_ SG_ 1210 DET_AZIMUTH_ERR_233 "RMSE or standard deviation of the measured angle  of the detection";
CM_ SG_ 1210 DET_ELEVATION_233 "measured elevation of the detection";
CM_ SG_ 1210 DET_ELEVATION_ERR_233 "RMSE or standard deviation of the measured elevation  of the detection";
CM_ SG_ 1210 DET_RCS_233 "Radar Cross Section or Amplitude, is a measure of how detectable an object is by radar. A larger RCS indicates that an object is more easily detected.";
CM_ SG_ 1210 DET_VALID_FLAG_233 "is set if the measured detection is valid";
CM_ SG_ 1210 DET_BI_STATIC_FLAG_233 "1 if detection is bi-static 0 otherwise";
CM_ SG_ 1210 DET_SUPER_RES_TARGET_233 "flasg is set if the detection is super resolution target";
CM_ SG_ 1210 DET_SNR_233 "The signal to noise ratio (SNR) of the radar detection";
CM_ SG_ 1210 DET_POINT_TARGET_PROB_233 "Describes the possibility if more than one real-world object has led to this detection. 0[%] := 100[%] Multi target probability";
CM_ SG_ 1210 DET_EXISTENCE_PROB_233 "Existence probability of the detection not based on history. Value does  not depend on any past experience with similar detections.
\note Use as confidence measure where a low value means less confidence
and a high value indicates strong confidence.";
CM_ SG_ 1210 DET_OUTSIDE_SECTOR_233 "Flag to indicate detections outside the sector, set if the wrong sector calibration matrix was used";
CM_ SG_ 1210 DET_HVC_FLAG_233 "Core2 Vehicle clutter flag";
CM_ SG_ 1210 DET_CONFD_AZIMUTH_233 "Define the Confidence of Azimuth for Detection ";
CM_ SG_ 1210 DET_CONFD_ELEVATION_233 "Define the Confidence of Elevation for the Detection ";
CM_ SG_ 1210 DET_BI_STATIC_FLAG_234 "1 if detection is bi-static 0 otherwise";
CM_ SG_ 1210 DET_BI_STATIC_FLAG_235 "1 if detection is bi-static 0 otherwise";
CM_ SG_ 1210 DET_BI_STATIC_FLAG_236 "1 if detection is bi-static 0 otherwise";
CM_ SG_ 1210 DET_MH_SCAN_INDEX_4LSB_233_236 "Scan index of the measured detection";
CM_ SG_ 1210 DET_MH_CYCLE_COUNTER_233_236 "Detection Alive Counter";
CM_ SG_ 1211 DET_RANGE_237 " measured position  of the detection";
CM_ SG_ 1211 DET_RANGE_ERR_237 "RMSE or standard deviation of the measured angle  of the detection";
CM_ SG_ 1211 DET_RANGE_VELOCITY_237 "Radial velocity of the detection positive in direction to the sensor";
CM_ SG_ 1211 DET_RANGE_VELOCITY_ERR_237 "RMSE or standard deviation of the measure radial velocity of the detection";
CM_ SG_ 1211 DET_AZIMUTH_237 "Measured angle  of the detection";
CM_ SG_ 1211 DET_AZIMUTH_ERR_237 "RMSE or standard deviation of the measured angle  of the detection";
CM_ SG_ 1211 DET_ELEVATION_237 "measured elevation of the detection";
CM_ SG_ 1211 DET_ELEVATION_ERR_237 "RMSE or standard deviation of the measured elevation  of the detection";
CM_ SG_ 1211 DET_RCS_237 "Radar Cross Section or Amplitude, is a measure of how detectable an object is by radar. A larger RCS indicates that an object is more easily detected.";
CM_ SG_ 1211 DET_VALID_FLAG_237 "is set if the measured detection is valid";
CM_ SG_ 1211 DET_BI_STATIC_FLAG_237 "1 if detection is bi-static 0 otherwise";
CM_ SG_ 1211 DET_SUPER_RES_TARGET_237 "flasg is set if the detection is super resolution target";
CM_ SG_ 1211 DET_SNR_237 "The signal to noise ratio (SNR) of the radar detection";
CM_ SG_ 1211 DET_POINT_TARGET_PROB_237 "Describes the possibility if more than one real-world object has led to this detection. 0[%] := 100[%] Multi target probability";
CM_ SG_ 1211 DET_EXISTENCE_PROB_237 "Existence probability of the detection not based on history. Value does  not depend on any past experience with similar detections.
\note Use as confidence measure where a low value means less confidence
and a high value indicates strong confidence.";
CM_ SG_ 1211 DET_OUTSIDE_SECTOR_237 "Flag to indicate detections outside the sector, set if the wrong sector calibration matrix was used";
CM_ SG_ 1211 DET_HVC_FLAG_237 "Core2 Vehicle clutter flag";
CM_ SG_ 1211 DET_CONFD_AZIMUTH_237 "Define the Confidence of Azimuth for Detection ";
CM_ SG_ 1211 DET_CONFD_ELEVATION_237 "Define the Confidence of Elevation for the Detection ";
CM_ SG_ 1211 DET_BI_STATIC_FLAG_238 "1 if detection is bi-static 0 otherwise";
CM_ SG_ 1211 DET_BI_STATIC_FLAG_239 "1 if detection is bi-static 0 otherwise";
CM_ SG_ 1211 DET_BI_STATIC_FLAG_240 "1 if detection is bi-static 0 otherwise";
CM_ SG_ 1211 DET_MH_SCAN_INDEX_4LSB_237_240 "Scan index of the measured detection";
CM_ SG_ 1211 DET_MH_CYCLE_COUNTER_237_240 "Detection Alive Counter";
CM_ SG_ 1212 DET_RANGE_241 " measured position  of the detection";
CM_ SG_ 1212 DET_RANGE_ERR_241 "RMSE or standard deviation of the measured angle  of the detection";
CM_ SG_ 1212 DET_RANGE_VELOCITY_241 "Radial velocity of the detection positive in direction to the sensor";
CM_ SG_ 1212 DET_RANGE_VELOCITY_ERR_241 "RMSE or standard deviation of the measure radial velocity of the detection";
CM_ SG_ 1212 DET_AZIMUTH_241 "Measured angle  of the detection";
CM_ SG_ 1212 DET_AZIMUTH_ERR_241 "RMSE or standard deviation of the measured angle  of the detection";
CM_ SG_ 1212 DET_ELEVATION_241 "measured elevation of the detection";
CM_ SG_ 1212 DET_ELEVATION_ERR_241 "RMSE or standard deviation of the measured elevation  of the detection";
CM_ SG_ 1212 DET_RCS_241 "Radar Cross Section or Amplitude, is a measure of how detectable an object is by radar. A larger RCS indicates that an object is more easily detected.";
CM_ SG_ 1212 DET_VALID_FLAG_241 "is set if the measured detection is valid";
CM_ SG_ 1212 DET_BI_STATIC_FLAG_241 "1 if detection is bi-static 0 otherwise";
CM_ SG_ 1212 DET_SUPER_RES_TARGET_241 "flasg is set if the detection is super resolution target";
CM_ SG_ 1212 DET_SNR_241 "The signal to noise ratio (SNR) of the radar detection";
CM_ SG_ 1212 DET_POINT_TARGET_PROB_241 "Describes the possibility if more than one real-world object has led to this detection. 0[%] := 100[%] Multi target probability";
CM_ SG_ 1212 DET_EXISTENCE_PROB_241 "Existence probability of the detection not based on history. Value does  not depend on any past experience with similar detections.
\note Use as confidence measure where a low value means less confidence
and a high value indicates strong confidence.";
CM_ SG_ 1212 DET_OUTSIDE_SECTOR_241 "Flag to indicate detections outside the sector, set if the wrong sector calibration matrix was used";
CM_ SG_ 1212 DET_HVC_FLAG_241 "Core2 Vehicle clutter flag";
CM_ SG_ 1212 DET_CONFD_AZIMUTH_241 "Define the Confidence of Azimuth for Detection ";
CM_ SG_ 1212 DET_CONFD_ELEVATION_241 "Define the Confidence of Elevation for the Detection ";
CM_ SG_ 1212 DET_BI_STATIC_FLAG_242 "1 if detection is bi-static 0 otherwise";
CM_ SG_ 1212 DET_BI_STATIC_FLAG_243 "1 if detection is bi-static 0 otherwise";
CM_ SG_ 1212 DET_BI_STATIC_FLAG_244 "1 if detection is bi-static 0 otherwise";
CM_ SG_ 1212 DET_MH_SCAN_INDEX_4LSB_241_244 "Scan index of the measured detection";
CM_ SG_ 1212 DET_MH_CYCLE_COUNTER_241_244 "Detection Alive Counter";
CM_ SG_ 1213 DET_RANGE_245 " measured position  of the detection";
CM_ SG_ 1213 DET_RANGE_ERR_245 "RMSE or standard deviation of the measured angle  of the detection";
CM_ SG_ 1213 DET_RANGE_VELOCITY_245 "Radial velocity of the detection positive in direction to the sensor";
CM_ SG_ 1213 DET_RANGE_VELOCITY_ERR_245 "RMSE or standard deviation of the measure radial velocity of the detection";
CM_ SG_ 1213 DET_AZIMUTH_245 "Measured angle  of the detection";
CM_ SG_ 1213 DET_AZIMUTH_ERR_245 "RMSE or standard deviation of the measured angle  of the detection";
CM_ SG_ 1213 DET_ELEVATION_245 "measured elevation of the detection";
CM_ SG_ 1213 DET_ELEVATION_ERR_245 "RMSE or standard deviation of the measured elevation  of the detection";
CM_ SG_ 1213 DET_RCS_245 "Radar Cross Section or Amplitude, is a measure of how detectable an object is by radar. A larger RCS indicates that an object is more easily detected.";
CM_ SG_ 1213 DET_VALID_FLAG_245 "is set if the measured detection is valid";
CM_ SG_ 1213 DET_BI_STATIC_FLAG_245 "1 if detection is bi-static 0 otherwise";
CM_ SG_ 1213 DET_SUPER_RES_TARGET_245 "flasg is set if the detection is super resolution target";
CM_ SG_ 1213 DET_SNR_245 "The signal to noise ratio (SNR) of the radar detection";
CM_ SG_ 1213 DET_POINT_TARGET_PROB_245 "Describes the possibility if more than one real-world object has led to this detection. 0[%] := 100[%] Multi target probability";
CM_ SG_ 1213 DET_EXISTENCE_PROB_245 "Existence probability of the detection not based on history. Value does  not depend on any past experience with similar detections.
\note Use as confidence measure where a low value means less confidence
and a high value indicates strong confidence.";
CM_ SG_ 1213 DET_OUTSIDE_SECTOR_245 "Flag to indicate detections outside the sector, set if the wrong sector calibration matrix was used";
CM_ SG_ 1213 DET_HVC_FLAG_245 "Core2 Vehicle clutter flag";
CM_ SG_ 1213 DET_CONFD_AZIMUTH_245 "Define the Confidence of Azimuth for Detection ";
CM_ SG_ 1213 DET_CONFD_ELEVATION_245 "Define the Confidence of Elevation for the Detection ";
CM_ SG_ 1213 DET_BI_STATIC_FLAG_246 "1 if detection is bi-static 0 otherwise";
CM_ SG_ 1213 DET_BI_STATIC_FLAG_247 "1 if detection is bi-static 0 otherwise";
CM_ SG_ 1213 DET_BI_STATIC_FLAG_248 "1 if detection is bi-static 0 otherwise";
CM_ SG_ 1213 DET_MH_SCAN_INDEX_4LSB_245_248 "Scan index of the measured detection";
CM_ SG_ 1213 DET_MH_CYCLE_COUNTER_245_248 "Detection Alive Counter";
CM_ SG_ 1214 DET_RANGE_249 " measured position  of the detection";
CM_ SG_ 1214 DET_RANGE_ERR_249 "RMSE or standard deviation of the measured angle  of the detection";
CM_ SG_ 1214 DET_RANGE_VELOCITY_249 "Radial velocity of the detection positive in direction to the sensor";
CM_ SG_ 1214 DET_RANGE_VELOCITY_ERR_249 "RMSE or standard deviation of the measure radial velocity of the detection";
CM_ SG_ 1214 DET_AZIMUTH_249 "Measured angle  of the detection";
CM_ SG_ 1214 DET_AZIMUTH_ERR_249 "RMSE or standard deviation of the measured angle  of the detection";
CM_ SG_ 1214 DET_ELEVATION_249 "measured elevation of the detection";
CM_ SG_ 1214 DET_ELEVATION_ERR_249 "RMSE or standard deviation of the measured elevation  of the detection";
CM_ SG_ 1214 DET_RCS_249 "Radar Cross Section or Amplitude, is a measure of how detectable an object is by radar. A larger RCS indicates that an object is more easily detected.";
CM_ SG_ 1214 DET_VALID_FLAG_249 "is set if the measured detection is valid";
CM_ SG_ 1214 DET_BI_STATIC_FLAG_249 "1 if detection is bi-static 0 otherwise";
CM_ SG_ 1214 DET_SUPER_RES_TARGET_249 "flasg is set if the detection is super resolution target";
CM_ SG_ 1214 DET_SNR_249 "The signal to noise ratio (SNR) of the radar detection";
CM_ SG_ 1214 DET_POINT_TARGET_PROB_249 "Describes the possibility if more than one real-world object has led to this detection. 0[%] := 100[%] Multi target probability";
CM_ SG_ 1214 DET_EXISTENCE_PROB_249 "Existence probability of the detection not based on history. Value does  not depend on any past experience with similar detections.
\note Use as confidence measure where a low value means less confidence
and a high value indicates strong confidence.";
CM_ SG_ 1214 DET_OUTSIDE_SECTOR_249 "Flag to indicate detections outside the sector, set if the wrong sector calibration matrix was used";
CM_ SG_ 1214 DET_HVC_FLAG_249 "Core2 Vehicle clutter flag";
CM_ SG_ 1214 DET_CONFD_AZIMUTH_249 "Define the Confidence of Azimuth for Detection ";
CM_ SG_ 1214 DET_CONFD_ELEVATION_249 "Define the Confidence of Elevation for the Detection ";
CM_ SG_ 1214 DET_BI_STATIC_FLAG_250 "1 if detection is bi-static 0 otherwise";
CM_ SG_ 1214 DET_BI_STATIC_FLAG_251 "1 if detection is bi-static 0 otherwise";
CM_ SG_ 1214 DET_BI_STATIC_FLAG_252 "1 if detection is bi-static 0 otherwise";
CM_ SG_ 1214 DET_MH_SCAN_INDEX_4LSB_249_252 "Scan index of the measured detection";
CM_ SG_ 1214 DET_MH_CYCLE_COUNTER_249_252 "Detection Alive Counter";
CM_ SG_ 1215 DET_RANGE_253 " measured position  of the detection";
CM_ SG_ 1215 DET_RANGE_ERR_253 "RMSE or standard deviation of the measured angle  of the detection";
CM_ SG_ 1215 DET_RANGE_VELOCITY_253 "Radial velocity of the detection positive in direction to the sensor";
CM_ SG_ 1215 DET_RANGE_VELOCITY_ERR_253 "RMSE or standard deviation of the measure radial velocity of the detection";
CM_ SG_ 1215 DET_AZIMUTH_253 "Measured angle  of the detection";
CM_ SG_ 1215 DET_AZIMUTH_ERR_253 "RMSE or standard deviation of the measured angle  of the detection";
CM_ SG_ 1215 DET_ELEVATION_253 "measured elevation of the detection";
CM_ SG_ 1215 DET_ELEVATION_ERR_253 "RMSE or standard deviation of the measured elevation  of the detection";
CM_ SG_ 1215 DET_RCS_253 "Radar Cross Section or Amplitude, is a measure of how detectable an object is by radar. A larger RCS indicates that an object is more easily detected.";
CM_ SG_ 1215 DET_VALID_FLAG_253 "is set if the measured detection is valid";
CM_ SG_ 1215 DET_BI_STATIC_FLAG_253 "1 if detection is bi-static 0 otherwise";
CM_ SG_ 1215 DET_SUPER_RES_TARGET_253 "flasg is set if the detection is super resolution target";
CM_ SG_ 1215 DET_SNR_253 "The signal to noise ratio (SNR) of the radar detection";
CM_ SG_ 1215 DET_POINT_TARGET_PROB_253 "Describes the possibility if more than one real-world object has led to this detection. 0[%] := 100[%] Multi target probability";
CM_ SG_ 1215 DET_EXISTENCE_PROB_253 "Existence probability of the detection not based on history. Value does  not depend on any past experience with similar detections.
\note Use as confidence measure where a low value means less confidence
and a high value indicates strong confidence.";
CM_ SG_ 1215 DET_OUTSIDE_SECTOR_253 "Flag to indicate detections outside the sector, set if the wrong sector calibration matrix was used";
CM_ SG_ 1215 DET_HVC_FLAG_253 "Core2 Vehicle clutter flag";
CM_ SG_ 1215 DET_CONFD_AZIMUTH_253 "Define the Confidence of Azimuth for Detection ";
CM_ SG_ 1215 DET_CONFD_ELEVATION_253 "Define the Confidence of Elevation for the Detection ";
CM_ SG_ 1215 DET_BI_STATIC_FLAG_254 "1 if detection is bi-static 0 otherwise";
CM_ SG_ 1215 DET_BI_STATIC_FLAG_255 "1 if detection is bi-static 0 otherwise";
CM_ SG_ 1215 DET_BI_STATIC_FLAG_256 "1 if detection is bi-static 0 otherwise";
CM_ SG_ 1215 DET_MH_SCAN_INDEX_4LSB_253_256 "Scan index of the measured detection";
CM_ SG_ 1215 DET_MH_CYCLE_COUNTER_253_256 "Detection Alive Counter";

BA_DEF_ BO_ "CanTpBs" INT 0 255;
BA_DEF_ BO_ "DiagRequest" ENUM  "No","Yes";
BA_DEF_ BO_ "DiagResponse" ENUM  "No","Yes";
BA_DEF_ BO_ "EventRateOfChange" INT 10 10000;
BA_DEF_ BO_ "GenMsgCycleTime" INT 0 100000;
BA_DEF_ BO_ "GenMsgILSupport" ENUM  "No","Yes";
BA_DEF_ BO_ "GenMsgNrOfRepetition" INT 0 100;
BA_DEF_ BO_ "GenMsgSendType" ENUM  "FixedPeriodic","Event","EnabledPeriodic","NotUsed","NotUsed","EventPeriodic","NotUsed","NotUsed","NoMsgSendType";
BA_DEF_ BO_ "NetworkInitialization" ENUM  "No","Yes";
BA_DEF_ BO_ "NmAsrMessage" ENUM  "No","Yes";
BA_DEF_ BO_ "NmMessage" ENUM  "No","Yes";
BA_DEF_ BO_ "VFrameFormat" ENUM  "StandardCAN","ExtendedCAN","reserved","reserved","reserved","reserved","reserved","reserved","reserved","reserved","reserved","reserved","reserved","reserved","StandardCAN_FD","ExtendedCAN_FD";
BA_DEF_ SG_ "GenSigCmt" STRING;
BA_DEF_ SG_ "GenSigCycleTime" INT 0 0;
BA_DEF_ SG_ "GenSigSendType" ENUM  "Cyclic","OnWrite","vector_leerstring","OnChange","vector_leerstring","IfActive","vector_leerstring","NoSigSendType";
BA_DEF_ SG_ "GenSigStartValue" INT 0 1000000000;
BA_DEF_ SG_ "GenSigTimeoutTime" INT 0 0;
BA_DEF_ SG_ "GenSigVtEn" STRING;
BA_DEF_ SG_ "GenSigVtName" STRING;
BA_DEF_ SG_ "InvalidValue" STRING;
BA_DEF_DEF_ "CanTpBs" 255;
BA_DEF_DEF_ "DiagRequest" "No";
BA_DEF_DEF_ "DiagResponse" "No";
BA_DEF_DEF_ "EventRateOfChange" 10000;
BA_DEF_DEF_ "GenMsgCycleTime" 0;
BA_DEF_DEF_ "GenMsgILSupport" "Yes";
BA_DEF_DEF_ "GenMsgNrOfRepetition" 0;
BA_DEF_DEF_ "GenMsgSendType" "NoMsgSendType";
BA_DEF_DEF_ "GenSigCmt" "";
BA_DEF_DEF_ "GenSigCycleTime" 0;
BA_DEF_DEF_ "GenSigSendType" "NoSigSendType";
BA_DEF_DEF_ "GenSigStartValue" 0;
BA_DEF_DEF_ "GenSigTimeoutTime" 0;
BA_DEF_DEF_ "GenSigVtEn" "";
BA_DEF_DEF_ "GenSigVtName" "";
BA_DEF_DEF_ "InvalidValue" "";
BA_DEF_DEF_ "NetworkInitialization" "Yes";
BA_DEF_DEF_ "NmAsrMessage" "No";
BA_DEF_DEF_ "NmMessage" "No";
BA_DEF_DEF_ "VFrameFormat" "StandardCAN_FD";
BA_ "GenMsgSendType" BO_ 1198 1;
BA_ "GenMsgSendType" BO_ 1199 1;
BA_ "GenMsgSendType" BO_ 1200 1;
BA_ "GenMsgSendType" BO_ 1201 1;
BA_ "GenMsgSendType" BO_ 1202 1;
BA_ "GenMsgSendType" BO_ 1203 1;
BA_ "GenMsgSendType" BO_ 1204 1;
BA_ "GenMsgSendType" BO_ 1205 1;
BA_ "GenMsgSendType" BO_ 1206 1;
BA_ "GenMsgSendType" BO_ 1207 1;
BA_ "GenMsgSendType" BO_ 1208 1;
BA_ "GenMsgSendType" BO_ 1209 1;
BA_ "GenMsgSendType" BO_ 1210 1;
BA_ "GenMsgSendType" BO_ 1211 1;
BA_ "GenMsgSendType" BO_ 1212 1;
BA_ "GenMsgSendType" BO_ 1213 1;
BA_ "GenMsgSendType" BO_ 1214 1;
BA_ "GenMsgSendType" BO_ 1215 1;
BA_ "GenSigStartValue" SG_ 1198 DET_RANGE_VELOCITY_185 16384;
BA_ "GenSigStartValue" SG_ 1198 DET_RCS_185 128;
BA_ "GenSigStartValue" SG_ 1198 DET_RANGE_VELOCITY_186 16384;
BA_ "GenSigStartValue" SG_ 1198 DET_RCS_186 128;
BA_ "GenSigStartValue" SG_ 1198 DET_RANGE_VELOCITY_187 16384;
BA_ "GenSigStartValue" SG_ 1198 DET_RCS_187 128;
BA_ "GenSigStartValue" SG_ 1198 DET_RANGE_VELOCITY_188 16384;
BA_ "GenSigStartValue" SG_ 1198 DET_RCS_188 128;
BA_ "GenSigStartValue" SG_ 1199 DET_RANGE_VELOCITY_189 16384;
BA_ "GenSigStartValue" SG_ 1199 DET_RCS_189 128;
BA_ "GenSigStartValue" SG_ 1199 DET_RANGE_VELOCITY_190 16384;
BA_ "GenSigStartValue" SG_ 1199 DET_RCS_190 128;
BA_ "GenSigStartValue" SG_ 1199 DET_RANGE_VELOCITY_191 16384;
BA_ "GenSigStartValue" SG_ 1199 DET_RCS_191 128;
BA_ "GenSigStartValue" SG_ 1199 DET_RANGE_VELOCITY_192 16384;
BA_ "GenSigStartValue" SG_ 1199 DET_RCS_192 128;
BA_ "GenSigStartValue" SG_ 1200 DET_RANGE_VELOCITY_193 16384;
BA_ "GenSigStartValue" SG_ 1200 DET_RCS_193 128;
BA_ "GenSigStartValue" SG_ 1200 DET_RANGE_VELOCITY_194 16384;
BA_ "GenSigStartValue" SG_ 1200 DET_RCS_194 128;
BA_ "GenSigStartValue" SG_ 1200 DET_RANGE_VELOCITY_195 16384;
BA_ "GenSigStartValue" SG_ 1200 DET_RCS_195 128;
BA_ "GenSigStartValue" SG_ 1200 DET_RANGE_VELOCITY_196 16384;
BA_ "GenSigStartValue" SG_ 1200 DET_RCS_196 128;
BA_ "GenSigStartValue" SG_ 1201 DET_RANGE_VELOCITY_197 16384;
BA_ "GenSigStartValue" SG_ 1201 DET_RCS_197 128;
BA_ "GenSigStartValue" SG_ 1201 DET_RANGE_VELOCITY_198 16384;
BA_ "GenSigStartValue" SG_ 1201 DET_RCS_198 128;
BA_ "GenSigStartValue" SG_ 1201 DET_RANGE_VELOCITY_199 16384;
BA_ "GenSigStartValue" SG_ 1201 DET_RCS_199 128;
BA_ "GenSigStartValue" SG_ 1201 DET_RANGE_VELOCITY_200 16384;
BA_ "GenSigStartValue" SG_ 1201 DET_RCS_200 128;
BA_ "GenSigStartValue" SG_ 1202 DET_RANGE_VELOCITY_201 16384;
BA_ "GenSigStartValue" SG_ 1202 DET_RCS_201 128;
BA_ "GenSigStartValue" SG_ 1202 DET_RANGE_VELOCITY_202 16384;
BA_ "GenSigStartValue" SG_ 1202 DET_RCS_202 128;
BA_ "GenSigStartValue" SG_ 1202 DET_RANGE_VELOCITY_203 16384;
BA_ "GenSigStartValue" SG_ 1202 DET_RCS_203 128;
BA_ "GenSigStartValue" SG_ 1202 DET_RANGE_VELOCITY_204 16384;
BA_ "GenSigStartValue" SG_ 1202 DET_RCS_204 128;
BA_ "GenSigStartValue" SG_ 1203 DET_RANGE_VELOCITY_205 16384;
BA_ "GenSigStartValue" SG_ 1203 DET_RCS_205 128;
BA_ "GenSigStartValue" SG_ 1203 DET_RANGE_VELOCITY_206 16384;
BA_ "GenSigStartValue" SG_ 1203 DET_RCS_206 128;
BA_ "GenSigStartValue" SG_ 1203 DET_RANGE_VELOCITY_207 16384;
BA_ "GenSigStartValue" SG_ 1203 DET_RCS_207 128;
BA_ "GenSigStartValue" SG_ 1203 DET_RANGE_VELOCITY_208 16384;
BA_ "GenSigStartValue" SG_ 1203 DET_RCS_208 128;
BA_ "GenSigStartValue" SG_ 1204 DET_RANGE_VELOCITY_209 16384;
BA_ "GenSigStartValue" SG_ 1204 DET_RCS_209 128;
BA_ "GenSigStartValue" SG_ 1204 DET_RANGE_VELOCITY_210 16384;
BA_ "GenSigStartValue" SG_ 1204 DET_RCS_210 128;
BA_ "GenSigStartValue" SG_ 1204 DET_RANGE_VELOCITY_211 16384;
BA_ "GenSigStartValue" SG_ 1204 DET_RCS_211 128;
BA_ "GenSigStartValue" SG_ 1204 DET_RANGE_VELOCITY_212 16384;
BA_ "GenSigStartValue" SG_ 1204 DET_RCS_212 128;
BA_ "GenSigStartValue" SG_ 1205 DET_RANGE_VELOCITY_213 16384;
BA_ "GenSigStartValue" SG_ 1205 DET_RCS_213 128;
BA_ "GenSigStartValue" SG_ 1205 DET_RANGE_VELOCITY_214 16384;
BA_ "GenSigStartValue" SG_ 1205 DET_RCS_214 128;
BA_ "GenSigStartValue" SG_ 1205 DET_RANGE_VELOCITY_215 16384;
BA_ "GenSigStartValue" SG_ 1205 DET_RCS_215 128;
BA_ "GenSigStartValue" SG_ 1205 DET_RANGE_VELOCITY_216 16384;
BA_ "GenSigStartValue" SG_ 1205 DET_RCS_216 128;
BA_ "GenSigStartValue" SG_ 1206 DET_RANGE_VELOCITY_217 16384;
BA_ "GenSigStartValue" SG_ 1206 DET_RCS_217 128;
BA_ "GenSigStartValue" SG_ 1206 DET_RANGE_VELOCITY_218 16384;
BA_ "GenSigStartValue" SG_ 1206 DET_RCS_218 128;
BA_ "GenSigStartValue" SG_ 1206 DET_RANGE_VELOCITY_219 16384;
BA_ "GenSigStartValue" SG_ 1206 DET_RCS_219 128;
BA_ "GenSigStartValue" SG_ 1206 DET_RANGE_VELOCITY_220 16384;
BA_ "GenSigStartValue" SG_ 1206 DET_RCS_220 128;
BA_ "GenSigStartValue" SG_ 1207 DET_RANGE_VELOCITY_221 16384;
BA_ "GenSigStartValue" SG_ 1207 DET_RCS_221 128;
BA_ "GenSigStartValue" SG_ 1207 DET_RANGE_VELOCITY_222 16384;
BA_ "GenSigStartValue" SG_ 1207 DET_RCS_222 128;
BA_ "GenSigStartValue" SG_ 1207 DET_RANGE_VELOCITY_223 16384;
BA_ "GenSigStartValue" SG_ 1207 DET_RCS_223 128;
BA_ "GenSigStartValue" SG_ 1207 DET_RANGE_VELOCITY_224 16384;
BA_ "GenSigStartValue" SG_ 1207 DET_RCS_224 128;
BA_ "GenSigStartValue" SG_ 1208 DET_RANGE_VELOCITY_225 16384;
BA_ "GenSigStartValue" SG_ 1208 DET_RCS_225 128;
BA_ "GenSigStartValue" SG_ 1208 DET_RANGE_VELOCITY_226 16384;
BA_ "GenSigStartValue" SG_ 1208 DET_RCS_226 128;
BA_ "GenSigStartValue" SG_ 1208 DET_RANGE_VELOCITY_227 16384;
BA_ "GenSigStartValue" SG_ 1208 DET_RCS_227 128;
BA_ "GenSigStartValue" SG_ 1208 DET_RANGE_VELOCITY_228 16384;
BA_ "GenSigStartValue" SG_ 1208 DET_RCS_228 128;
BA_ "GenSigStartValue" SG_ 1209 DET_RANGE_VELOCITY_229 16384;
BA_ "GenSigStartValue" SG_ 1209 DET_RCS_229 128;
BA_ "GenSigStartValue" SG_ 1209 DET_RANGE_VELOCITY_230 16384;
BA_ "GenSigStartValue" SG_ 1209 DET_RCS_230 128;
BA_ "GenSigStartValue" SG_ 1209 DET_RANGE_VELOCITY_231 16384;
BA_ "GenSigStartValue" SG_ 1209 DET_RCS_231 128;
BA_ "GenSigStartValue" SG_ 1209 DET_RANGE_VELOCITY_232 16384;
BA_ "GenSigStartValue" SG_ 1209 DET_RCS_232 128;
BA_ "GenSigStartValue" SG_ 1210 DET_RANGE_VELOCITY_233 16384;
BA_ "GenSigStartValue" SG_ 1210 DET_RCS_233 128;
BA_ "GenSigStartValue" SG_ 1210 DET_RANGE_VELOCITY_234 16384;
BA_ "GenSigStartValue" SG_ 1210 DET_RCS_234 128;
BA_ "GenSigStartValue" SG_ 1210 DET_RANGE_VELOCITY_235 16384;
BA_ "GenSigStartValue" SG_ 1210 DET_RCS_235 128;
BA_ "GenSigStartValue" SG_ 1210 DET_RANGE_VELOCITY_236 16384;
BA_ "GenSigStartValue" SG_ 1210 DET_RCS_236 128;
BA_ "GenSigStartValue" SG_ 1211 DET_RANGE_VELOCITY_237 16384;
BA_ "GenSigStartValue" SG_ 1211 DET_RCS_237 128;
BA_ "GenSigStartValue" SG_ 1211 DET_RANGE_VELOCITY_238 16384;
BA_ "GenSigStartValue" SG_ 1211 DET_RCS_238 128;
BA_ "GenSigStartValue" SG_ 1211 DET_RANGE_VELOCITY_239 16384;
BA_ "GenSigStartValue" SG_ 1211 DET_RCS_239 128;
BA_ "GenSigStartValue" SG_ 1211 DET_RANGE_VELOCITY_240 16384;
BA_ "GenSigStartValue" SG_ 1211 DET_RCS_240 128;
BA_ "GenSigStartValue" SG_ 1212 DET_RANGE_VELOCITY_241 16384;
BA_ "GenSigStartValue" SG_ 1212 DET_RCS_241 128;
BA_ "GenSigStartValue" SG_ 1212 DET_RANGE_VELOCITY_242 16384;
BA_ "GenSigStartValue" SG_ 1212 DET_RCS_242 128;
BA_ "GenSigStartValue" SG_ 1212 DET_RANGE_VELOCITY_243 16384;
BA_ "GenSigStartValue" SG_ 1212 DET_RCS_243 128;
BA_ "GenSigStartValue" SG_ 1212 DET_RANGE_VELOCITY_244 16384;
BA_ "GenSigStartValue" SG_ 1212 DET_RCS_244 128;
BA_ "GenSigStartValue" SG_ 1213 DET_RANGE_VELOCITY_245 16384;
BA_ "GenSigStartValue" SG_ 1213 DET_RCS_245 128;
BA_ "GenSigStartValue" SG_ 1213 DET_RANGE_VELOCITY_246 16384;
BA_ "GenSigStartValue" SG_ 1213 DET_RCS_246 128;
BA_ "GenSigStartValue" SG_ 1213 DET_RANGE_VELOCITY_247 16384;
BA_ "GenSigStartValue" SG_ 1213 DET_RCS_247 128;
BA_ "GenSigStartValue" SG_ 1213 DET_RANGE_VELOCITY_248 16384;
BA_ "GenSigStartValue" SG_ 1213 DET_RCS_248 128;
BA_ "GenSigStartValue" SG_ 1214 DET_RANGE_VELOCITY_249 16384;
BA_ "GenSigStartValue" SG_ 1214 DET_RCS_249 128;
BA_ "GenSigStartValue" SG_ 1214 DET_RANGE_VELOCITY_250 16384;
BA_ "GenSigStartValue" SG_ 1214 DET_RCS_250 128;
BA_ "GenSigStartValue" SG_ 1214 DET_RANGE_VELOCITY_251 16384;
BA_ "GenSigStartValue" SG_ 1214 DET_RCS_251 128;
BA_ "GenSigStartValue" SG_ 1214 DET_RANGE_VELOCITY_252 16384;
BA_ "GenSigStartValue" SG_ 1214 DET_RCS_252 128;
BA_ "GenSigStartValue" SG_ 1215 DET_RANGE_VELOCITY_253 16384;
BA_ "GenSigStartValue" SG_ 1215 DET_RCS_253 128;
BA_ "GenSigStartValue" SG_ 1215 DET_RANGE_VELOCITY_254 16384;
BA_ "GenSigStartValue" SG_ 1215 DET_RCS_254 128;
BA_ "GenSigStartValue" SG_ 1215 DET_RANGE_VELOCITY_255 16384;
BA_ "GenSigStartValue" SG_ 1215 DET_RCS_255 128;
BA_ "GenSigStartValue" SG_ 1215 DET_RANGE_VELOCITY_256 16384;
BA_ "GenSigStartValue" SG_ 1215 DET_RCS_256 128;
VAL_ 1198 DET_CONFD_AZIMUTH_185 0 "High" 1 "MidHigh" 2 "MidLow" 3 "Low";
VAL_ 1198 DET_CONFD_ELEVATION_185 0 "High" 1 "MidHigh" 2 "MidLow" 3 "Low";
VAL_ 1198 DET_CONFD_AZIMUTH_186 0 "High" 1 "MidHigh" 2 "MidLow" 3 "Low";
VAL_ 1198 DET_CONFD_ELEVATION_186 0 "High" 1 "MidHigh" 2 "MidLow" 3 "Low";
VAL_ 1198 DET_CONFD_AZIMUTH_187 0 "High" 1 "MidHigh" 2 "MidLow" 3 "Low";
VAL_ 1198 DET_CONFD_ELEVATION_187 0 "High" 1 "MidHigh" 2 "MidLow" 3 "Low";
VAL_ 1199 DET_CONFD_AZIMUTH_189 0 "High" 1 "MidHigh" 2 "MidLow" 3 "Low";
VAL_ 1199 DET_CONFD_ELEVATION_189 0 "High" 1 "MidHigh" 2 "MidLow" 3 "Low";
VAL_ 1199 DET_CONFD_AZIMUTH_190 0 "High" 1 "MidHigh" 2 "MidLow" 3 "Low";
VAL_ 1199 DET_CONFD_ELEVATION_190 0 "High" 1 "MidHigh" 2 "MidLow" 3 "Low";
VAL_ 1199 DET_CONFD_AZIMUTH_191 0 "High" 1 "MidHigh" 2 "MidLow" 3 "Low";
VAL_ 1199 DET_CONFD_ELEVATION_191 0 "High" 1 "MidHigh" 2 "MidLow" 3 "Low";
VAL_ 1200 DET_CONFD_AZIMUTH_193 0 "High" 1 "MidHigh" 2 "MidLow" 3 "Low";
VAL_ 1200 DET_CONFD_ELEVATION_193 0 "High" 1 "MidHigh" 2 "MidLow" 3 "Low";
VAL_ 1200 DET_CONFD_AZIMUTH_194 0 "High" 1 "MidHigh" 2 "MidLow" 3 "Low";
VAL_ 1200 DET_CONFD_ELEVATION_194 0 "High" 1 "MidHigh" 2 "MidLow" 3 "Low";
VAL_ 1200 DET_CONFD_AZIMUTH_195 0 "High" 1 "MidHigh" 2 "MidLow" 3 "Low";
VAL_ 1200 DET_CONFD_ELEVATION_195 0 "High" 1 "MidHigh" 2 "MidLow" 3 "Low";
VAL_ 1201 DET_CONFD_AZIMUTH_197 0 "High" 1 "MidHigh" 2 "MidLow" 3 "Low";
VAL_ 1201 DET_CONFD_ELEVATION_197 0 "High" 1 "MidHigh" 2 "MidLow" 3 "Low";
VAL_ 1201 DET_CONFD_AZIMUTH_198 0 "High" 1 "MidHigh" 2 "MidLow" 3 "Low";
VAL_ 1201 DET_CONFD_ELEVATION_198 0 "High" 1 "MidHigh" 2 "MidLow" 3 "Low";
VAL_ 1201 DET_CONFD_AZIMUTH_199 0 "High" 1 "MidHigh" 2 "MidLow" 3 "Low";
VAL_ 1201 DET_CONFD_ELEVATION_199 0 "High" 1 "MidHigh" 2 "MidLow" 3 "Low";
VAL_ 1202 DET_CONFD_AZIMUTH_201 0 "High" 1 "MidHigh" 2 "MidLow" 3 "Low";
VAL_ 1202 DET_CONFD_ELEVATION_201 0 "High" 1 "MidHigh" 2 "MidLow" 3 "Low";
VAL_ 1202 DET_CONFD_AZIMUTH_202 0 "High" 1 "MidHigh" 2 "MidLow" 3 "Low";
VAL_ 1202 DET_CONFD_ELEVATION_202 0 "High" 1 "MidHigh" 2 "MidLow" 3 "Low";
VAL_ 1202 DET_CONFD_AZIMUTH_203 0 "High" 1 "MidHigh" 2 "MidLow" 3 "Low";
VAL_ 1202 DET_CONFD_ELEVATION_203 0 "High" 1 "MidHigh" 2 "MidLow" 3 "Low";
VAL_ 1203 DET_CONFD_AZIMUTH_205 0 "High" 1 "MidHigh" 2 "MidLow" 3 "Low";
VAL_ 1203 DET_CONFD_ELEVATION_205 0 "High" 1 "MidHigh" 2 "MidLow" 3 "Low";
VAL_ 1203 DET_CONFD_AZIMUTH_206 0 "High" 1 "MidHigh" 2 "MidLow" 3 "Low";
VAL_ 1203 DET_CONFD_ELEVATION_206 0 "High" 1 "MidHigh" 2 "MidLow" 3 "Low";
VAL_ 1203 DET_CONFD_AZIMUTH_207 0 "High" 1 "MidHigh" 2 "MidLow" 3 "Low";
VAL_ 1203 DET_CONFD_ELEVATION_207 0 "High" 1 "MidHigh" 2 "MidLow" 3 "Low";
VAL_ 1204 DET_CONFD_AZIMUTH_209 0 "High" 1 "MidHigh" 2 "MidLow" 3 "Low";
VAL_ 1204 DET_CONFD_ELEVATION_209 0 "High" 1 "MidHigh" 2 "MidLow" 3 "Low";
VAL_ 1204 DET_CONFD_AZIMUTH_210 0 "High" 1 "MidHigh" 2 "MidLow" 3 "Low";
VAL_ 1204 DET_CONFD_ELEVATION_210 0 "High" 1 "MidHigh" 2 "MidLow" 3 "Low";
VAL_ 1204 DET_CONFD_AZIMUTH_211 0 "High" 1 "MidHigh" 2 "MidLow" 3 "Low";
VAL_ 1204 DET_CONFD_ELEVATION_211 0 "High" 1 "MidHigh" 2 "MidLow" 3 "Low";
VAL_ 1205 DET_CONFD_AZIMUTH_213 0 "High" 1 "MidHigh" 2 "MidLow" 3 "Low";
VAL_ 1205 DET_CONFD_ELEVATION_213 0 "High" 1 "MidHigh" 2 "MidLow" 3 "Low";
VAL_ 1205 DET_CONFD_AZIMUTH_214 0 "High" 1 "MidHigh" 2 "MidLow" 3 "Low";
VAL_ 1205 DET_CONFD_ELEVATION_214 0 "High" 1 "MidHigh" 2 "MidLow" 3 "Low";
VAL_ 1205 DET_CONFD_AZIMUTH_215 0 "High" 1 "MidHigh" 2 "MidLow" 3 "Low";
VAL_ 1205 DET_CONFD_ELEVATION_215 0 "High" 1 "MidHigh" 2 "MidLow" 3 "Low";
VAL_ 1206 DET_CONFD_AZIMUTH_217 0 "High" 1 "MidHigh" 2 "MidLow" 3 "Low";
VAL_ 1206 DET_CONFD_ELEVATION_217 0 "High" 1 "MidHigh" 2 "MidLow" 3 "Low";
VAL_ 1206 DET_CONFD_AZIMUTH_218 0 "High" 1 "MidHigh" 2 "MidLow" 3 "Low";
VAL_ 1206 DET_CONFD_ELEVATION_218 0 "High" 1 "MidHigh" 2 "MidLow" 3 "Low";
VAL_ 1206 DET_CONFD_AZIMUTH_219 0 "High" 1 "MidHigh" 2 "MidLow" 3 "Low";
VAL_ 1206 DET_CONFD_ELEVATION_219 0 "High" 1 "MidHigh" 2 "MidLow" 3 "Low";
VAL_ 1207 DET_CONFD_AZIMUTH_221 0 "High" 1 "MidHigh" 2 "MidLow" 3 "Low";
VAL_ 1207 DET_CONFD_ELEVATION_221 0 "High" 1 "MidHigh" 2 "MidLow" 3 "Low";
VAL_ 1207 DET_CONFD_AZIMUTH_222 0 "High" 1 "MidHigh" 2 "MidLow" 3 "Low";
VAL_ 1207 DET_CONFD_ELEVATION_222 0 "High" 1 "MidHigh" 2 "MidLow" 3 "Low";
VAL_ 1207 DET_CONFD_AZIMUTH_223 0 "High" 1 "MidHigh" 2 "MidLow" 3 "Low";
VAL_ 1207 DET_CONFD_ELEVATION_223 0 "High" 1 "MidHigh" 2 "MidLow" 3 "Low";
VAL_ 1208 DET_CONFD_AZIMUTH_225 0 "High" 1 "MidHigh" 2 "MidLow" 3 "Low";
VAL_ 1208 DET_CONFD_ELEVATION_225 0 "High" 1 "MidHigh" 2 "MidLow" 3 "Low";
VAL_ 1208 DET_CONFD_AZIMUTH_226 0 "High" 1 "MidHigh" 2 "MidLow" 3 "Low";
VAL_ 1208 DET_CONFD_ELEVATION_226 0 "High" 1 "MidHigh" 2 "MidLow" 3 "Low";
VAL_ 1208 DET_CONFD_AZIMUTH_227 0 "High" 1 "MidHigh" 2 "MidLow" 3 "Low";
VAL_ 1208 DET_CONFD_ELEVATION_227 0 "High" 1 "MidHigh" 2 "MidLow" 3 "Low";
VAL_ 1209 DET_CONFD_AZIMUTH_229 0 "High" 1 "MidHigh" 2 "MidLow" 3 "Low";
VAL_ 1209 DET_CONFD_ELEVATION_229 0 "High" 1 "MidHigh" 2 "MidLow" 3 "Low";
VAL_ 1209 DET_CONFD_AZIMUTH_230 0 "High" 1 "MidHigh" 2 "MidLow" 3 "Low";
VAL_ 1209 DET_CONFD_ELEVATION_230 0 "High" 1 "MidHigh" 2 "MidLow" 3 "Low";
VAL_ 1209 DET_CONFD_AZIMUTH_231 0 "High" 1 "MidHigh" 2 "MidLow" 3 "Low";
VAL_ 1209 DET_CONFD_ELEVATION_231 0 "High" 1 "MidHigh" 2 "MidLow" 3 "Low";
VAL_ 1210 DET_CONFD_AZIMUTH_233 0 "High" 1 "MidHigh" 2 "MidLow" 3 "Low";
VAL_ 1210 DET_CONFD_ELEVATION_233 0 "High" 1 "MidHigh" 2 "MidLow" 3 "Low";
VAL_ 1210 DET_CONFD_AZIMUTH_234 0 "High" 1 "MidHigh" 2 "MidLow" 3 "Low";
VAL_ 1210 DET_CONFD_ELEVATION_234 0 "High" 1 "MidHigh" 2 "MidLow" 3 "Low";
VAL_ 1210 DET_CONFD_AZIMUTH_235 0 "High" 1 "MidHigh" 2 "MidLow" 3 "Low";
VAL_ 1210 DET_CONFD_ELEVATION_235 0 "High" 1 "MidHigh" 2 "MidLow" 3 "Low";
VAL_ 1211 DET_CONFD_AZIMUTH_237 0 "High" 1 "MidHigh" 2 "MidLow" 3 "Low";
VAL_ 1211 DET_CONFD_ELEVATION_237 0 "High" 1 "MidHigh" 2 "MidLow" 3 "Low";
VAL_ 1211 DET_CONFD_AZIMUTH_238 0 "High" 1 "MidHigh" 2 "MidLow" 3 "Low";
VAL_ 1211 DET_CONFD_ELEVATION_238 0 "High" 1 "MidHigh" 2 "MidLow" 3 "Low";
VAL_ 1211 DET_CONFD_AZIMUTH_239 0 "High" 1 "MidHigh" 2 "MidLow" 3 "Low";
VAL_ 1211 DET_CONFD_ELEVATION_239 0 "High" 1 "MidHigh" 2 "MidLow" 3 "Low";
VAL_ 1212 DET_CONFD_AZIMUTH_241 0 "High" 1 "MidHigh" 2 "MidLow" 3 "Low";
VAL_ 1212 DET_CONFD_ELEVATION_241 0 "High" 1 "MidHigh" 2 "MidLow" 3 "Low";
VAL_ 1212 DET_CONFD_AZIMUTH_242 0 "High" 1 "MidHigh" 2 "MidLow" 3 "Low";
VAL_ 1212 DET_CONFD_ELEVATION_242 0 "High" 1 "MidHigh" 2 "MidLow" 3 "Low";
VAL_ 1212 DET_CONFD_AZIMUTH_243 0 "High" 1 "MidHigh" 2 "MidLow" 3 "Low";
VAL_ 1212 DET_CONFD_ELEVATION_243 0 "High" 1 "MidHigh" 2 "MidLow" 3 "Low";
VAL_ 1213 DET_CONFD_AZIMUTH_245 0 "High" 1 "MidHigh" 2 "MidLow" 3 "Low";
VAL_ 1213 DET_CONFD_ELEVATION_245 0 "High" 1 "MidHigh" 2 "MidLow" 3 "Low";
VAL_ 1213 DET_CONFD_AZIMUTH_246 0 "High" 1 "MidHigh" 2 "MidLow" 3 "Low";
VAL_ 1213 DET_CONFD_ELEVATION_246 0 "High" 1 "MidHigh" 2 "MidLow" 3 "Low";
VAL_ 1213 DET_CONFD_AZIMUTH_247 0 "High" 1 "MidHigh" 2 "MidLow" 3 "Low";
VAL_ 1213 DET_CONFD_ELEVATION_247 0 "High" 1 "MidHigh" 2 "MidLow" 3 "Low";
VAL_ 1214 DET_CONFD_AZIMUTH_249 0 "High" 1 "MidHigh" 2 "MidLow" 3 "Low";
VAL_ 1214 DET_CONFD_ELEVATION_249 0 "High" 1 "MidHigh" 2 "MidLow" 3 "Low";
VAL_ 1214 DET_CONFD_AZIMUTH_250 0 "High" 1 "MidHigh" 2 "MidLow" 3 "Low";
VAL_ 1214 DET_CONFD_ELEVATION_250 0 "High" 1 "MidHigh" 2 "MidLow" 3 "Low";
VAL_ 1214 DET_CONFD_AZIMUTH_251 0 "High" 1 "MidHigh" 2 "MidLow" 3 "Low";
VAL_ 1214 DET_CONFD_ELEVATION_251 0 "High" 1 "MidHigh" 2 "MidLow" 3 "Low";
VAL_ 1215 DET_CONFD_AZIMUTH_253 0 "High" 1 "MidHigh" 2 "MidLow" 3 "Low";
VAL_ 1215 DET_CONFD_ELEVATION_253 0 "High" 1 "MidHigh" 2 "MidLow" 3 "Low";
VAL_ 1215 DET_CONFD_AZIMUTH_254 0 "High" 1 "MidHigh" 2 "MidLow" 3 "Low";
VAL_ 1215 DET_CONFD_ELEVATION_254 0 "High" 1 "MidHigh" 2 "MidLow" 3 "Low";
VAL_ 1215 DET_CONFD_AZIMUTH_255 0 "High" 1 "MidHigh" 2 "MidLow" 3 "Low";
VAL_ 1215 DET_CONFD_ELEVATION_255 0 "High" 1 "MidHigh" 2 "MidLow" 3 "Low";
SIG_GROUP_ 1198 Detections_185_188 1 : DET_MH_CRC16_185_188 DET_MH_CYCLE_COUNTER_185_188 DET_MH_SCAN_INDEX_4LSB_185_188 DET_CONFD_ELEVATION_185 DET_CONFD_AZIMUTH_185 DET_HVC_FLAG_185 DET_OUTSIDE_SECTOR_185 DET_EXISTENCE_PROB_185 DET_POINT_TARGET_PROB_185 DET_SNR_185 DET_SUPER_RES_TARGET_185 DET_BI_STATIC_FLAG_185 DET_VALID_FLAG_185 DET_RCS_185 DET_ELEVATION_ERR_185 DET_ELEVATION_185 DET_AZIMUTH_ERR_185 DET_AZIMUTH_185 DET_RANGE_VELOCITY_ERR_185 DET_RANGE_VELOCITY_185 DET_RANGE_ERR_185 DET_RANGE_185 DET_CONFD_ELEVATION_186 DET_CONFD_AZIMUTH_186 DET_HVC_FLAG_186 DET_OUTSIDE_SECTOR_186 DET_EXISTENCE_PROB_186 DET_POINT_TARGET_PROB_186 DET_SNR_186 DET_SUPER_RES_TARGET_186 DET_BI_STATIC_FLAG_186 DET_VALID_FLAG_186 DET_RCS_186 DET_ELEVATION_186 DET_ELEVATION_ERR_186 DET_AZIMUTH_ERR_186 DET_AZIMUTH_186 DET_RANGE_VELOCITY_ERR_186 DET_RANGE_VELOCITY_186 DET_RANGE_ERR_186 DET_RANGE_186 DET_CONFD_ELEVATION_187 DET_CONFD_AZIMUTH_187 DET_HVC_FLAG_187 DET_OUTSIDE_SECTOR_187 DET_EXISTENCE_PROB_187 DET_POINT_TARGET_PROB_187 DET_SUPER_RES_TARGET_187 DET_BI_STATIC_FLAG_187 DET_VALID_FLAG_187 DET_RCS_187 DET_ELEVATION_187 DET_SNR_187 DET_ELEVATION_ERR_187 DET_AZIMUTH_ERR_187 DET_RANGE_VELOCITY_ERR_187 DET_AZIMUTH_187 DET_RANGE_VELOCITY_187 DET_RANGE_ERR_187 DET_RANGE_187 DET_BI_STATIC_FLAG_188 DET_CONFD_ELEVATION_188 DET_CONFD_AZIMUTH_188 DET_HVC_FLAG_188 DET_OUTSIDE_SECTOR_188 DET_EXISTENCE_PROB_188 DET_POINT_TARGET_PROB_188 DET_SNR_188 DET_SUPER_RES_TARGET_188 DET_VALID_FLAG_188 DET_RCS_188 DET_ELEVATION_ERR_188 DET_ELEVATION_188 DET_AZIMUTH_ERR_188 DET_AZIMUTH_188 DET_RANGE_VELOCITY_ERR_188 DET_RANGE_VELOCITY_188 DET_RANGE_ERR_188 DET_RANGE_188;
SIG_GROUP_ 1199 Detections_189_192 1 : DET_MH_CRC16_189_192 DET_MH_CYCLE_COUNTER_189_192 DET_MH_SCAN_INDEX_4LSB_189_192 DET_CONFD_ELEVATION_189 DET_CONFD_AZIMUTH_189 DET_HVC_FLAG_189 DET_OUTSIDE_SECTOR_189 DET_EXISTENCE_PROB_189 DET_POINT_TARGET_PROB_189 DET_SNR_189 DET_SUPER_RES_TARGET_189 DET_BI_STATIC_FLAG_189 DET_VALID_FLAG_189 DET_RCS_189 DET_ELEVATION_ERR_189 DET_ELEVATION_189 DET_AZIMUTH_ERR_189 DET_AZIMUTH_189 DET_RANGE_VELOCITY_ERR_189 DET_RANGE_VELOCITY_189 DET_RANGE_ERR_189 DET_RANGE_189 DET_CONFD_ELEVATION_190 DET_CONFD_AZIMUTH_190 DET_HVC_FLAG_190 DET_OUTSIDE_SECTOR_190 DET_EXISTENCE_PROB_190 DET_POINT_TARGET_PROB_190 DET_SNR_190 DET_SUPER_RES_TARGET_190 DET_BI_STATIC_FLAG_190 DET_VALID_FLAG_190 DET_RCS_190 DET_ELEVATION_190 DET_ELEVATION_ERR_190 DET_AZIMUTH_ERR_190 DET_AZIMUTH_190 DET_RANGE_VELOCITY_ERR_190 DET_RANGE_VELOCITY_190 DET_RANGE_ERR_190 DET_RANGE_190 DET_CONFD_ELEVATION_191 DET_CONFD_AZIMUTH_191 DET_HVC_FLAG_191 DET_OUTSIDE_SECTOR_191 DET_EXISTENCE_PROB_191 DET_POINT_TARGET_PROB_191 DET_SUPER_RES_TARGET_191 DET_BI_STATIC_FLAG_191 DET_VALID_FLAG_191 DET_RCS_191 DET_ELEVATION_191 DET_SNR_191 DET_ELEVATION_ERR_191 DET_AZIMUTH_ERR_191 DET_RANGE_VELOCITY_ERR_191 DET_AZIMUTH_191 DET_RANGE_VELOCITY_191 DET_RANGE_ERR_191 DET_RANGE_191 DET_BI_STATIC_FLAG_192 DET_CONFD_ELEVATION_192 DET_CONFD_AZIMUTH_192 DET_HVC_FLAG_192 DET_OUTSIDE_SECTOR_192 DET_EXISTENCE_PROB_192 DET_POINT_TARGET_PROB_192 DET_SNR_192 DET_SUPER_RES_TARGET_192 DET_VALID_FLAG_192 DET_RCS_192 DET_ELEVATION_ERR_192 DET_ELEVATION_192 DET_AZIMUTH_ERR_192 DET_AZIMUTH_192 DET_RANGE_VELOCITY_ERR_192 DET_RANGE_VELOCITY_192 DET_RANGE_ERR_192 DET_RANGE_192;
SIG_GROUP_ 1200 Detections_193_196 1 : DET_MH_CRC16_193_196 DET_MH_CYCLE_COUNTER_193_196 DET_MH_SCAN_INDEX_4LSB_193_196 DET_CONFD_ELEVATION_193 DET_CONFD_AZIMUTH_193 DET_HVC_FLAG_193 DET_OUTSIDE_SECTOR_193 DET_EXISTENCE_PROB_193 DET_POINT_TARGET_PROB_193 DET_SNR_193 DET_SUPER_RES_TARGET_193 DET_BI_STATIC_FLAG_193 DET_VALID_FLAG_193 DET_RCS_193 DET_ELEVATION_ERR_193 DET_ELEVATION_193 DET_AZIMUTH_ERR_193 DET_AZIMUTH_193 DET_RANGE_VELOCITY_ERR_193 DET_RANGE_VELOCITY_193 DET_RANGE_ERR_193 DET_RANGE_193 DET_CONFD_ELEVATION_194 DET_CONFD_AZIMUTH_194 DET_HVC_FLAG_194 DET_OUTSIDE_SECTOR_194 DET_EXISTENCE_PROB_194 DET_POINT_TARGET_PROB_194 DET_SNR_194 DET_SUPER_RES_TARGET_194 DET_BI_STATIC_FLAG_194 DET_VALID_FLAG_194 DET_RCS_194 DET_ELEVATION_194 DET_ELEVATION_ERR_194 DET_AZIMUTH_ERR_194 DET_AZIMUTH_194 DET_RANGE_VELOCITY_ERR_194 DET_RANGE_VELOCITY_194 DET_RANGE_ERR_194 DET_RANGE_194 DET_CONFD_ELEVATION_195 DET_CONFD_AZIMUTH_195 DET_HVC_FLAG_195 DET_OUTSIDE_SECTOR_195 DET_EXISTENCE_PROB_195 DET_POINT_TARGET_PROB_195 DET_SUPER_RES_TARGET_195 DET_BI_STATIC_FLAG_195 DET_VALID_FLAG_195 DET_RCS_195 DET_ELEVATION_195 DET_SNR_195 DET_ELEVATION_ERR_195 DET_AZIMUTH_ERR_195 DET_RANGE_VELOCITY_ERR_195 DET_AZIMUTH_195 DET_RANGE_VELOCITY_195 DET_RANGE_ERR_195 DET_RANGE_195 DET_BI_STATIC_FLAG_196 DET_CONFD_ELEVATION_196 DET_CONFD_AZIMUTH_196 DET_HVC_FLAG_196 DET_OUTSIDE_SECTOR_196 DET_EXISTENCE_PROB_196 DET_POINT_TARGET_PROB_196 DET_SNR_196 DET_SUPER_RES_TARGET_196 DET_VALID_FLAG_196 DET_RCS_196 DET_ELEVATION_ERR_196 DET_ELEVATION_196 DET_AZIMUTH_ERR_196 DET_AZIMUTH_196 DET_RANGE_VELOCITY_ERR_196 DET_RANGE_VELOCITY_196 DET_RANGE_ERR_196 DET_RANGE_196;
SIG_GROUP_ 1201 Detections_197_200 1 : DET_MH_CRC16_197_200 DET_MH_CYCLE_COUNTER_197_200 DET_MH_SCAN_INDEX_4LSB_197_200 DET_CONFD_ELEVATION_197 DET_CONFD_AZIMUTH_197 DET_HVC_FLAG_197 DET_OUTSIDE_SECTOR_197 DET_EXISTENCE_PROB_197 DET_POINT_TARGET_PROB_197 DET_SNR_197 DET_SUPER_RES_TARGET_197 DET_BI_STATIC_FLAG_197 DET_VALID_FLAG_197 DET_RCS_197 DET_ELEVATION_ERR_197 DET_ELEVATION_197 DET_AZIMUTH_ERR_197 DET_AZIMUTH_197 DET_RANGE_VELOCITY_ERR_197 DET_RANGE_VELOCITY_197 DET_RANGE_ERR_197 DET_RANGE_197 DET_CONFD_ELEVATION_198 DET_CONFD_AZIMUTH_198 DET_HVC_FLAG_198 DET_OUTSIDE_SECTOR_198 DET_EXISTENCE_PROB_198 DET_POINT_TARGET_PROB_198 DET_SNR_198 DET_SUPER_RES_TARGET_198 DET_BI_STATIC_FLAG_198 DET_VALID_FLAG_198 DET_RCS_198 DET_ELEVATION_198 DET_ELEVATION_ERR_198 DET_AZIMUTH_ERR_198 DET_AZIMUTH_198 DET_RANGE_VELOCITY_ERR_198 DET_RANGE_VELOCITY_198 DET_RANGE_ERR_198 DET_RANGE_198 DET_CONFD_ELEVATION_199 DET_CONFD_AZIMUTH_199 DET_HVC_FLAG_199 DET_OUTSIDE_SECTOR_199 DET_EXISTENCE_PROB_199 DET_POINT_TARGET_PROB_199 DET_SUPER_RES_TARGET_199 DET_BI_STATIC_FLAG_199 DET_VALID_FLAG_199 DET_RCS_199 DET_ELEVATION_199 DET_SNR_199 DET_ELEVATION_ERR_199 DET_AZIMUTH_ERR_199 DET_RANGE_VELOCITY_ERR_199 DET_AZIMUTH_199 DET_RANGE_VELOCITY_199 DET_RANGE_ERR_199 DET_RANGE_199 DET_BI_STATIC_FLAG_200 DET_CONFD_ELEVATION_200 DET_CONFD_AZIMUTH_200 DET_HVC_FLAG_200 DET_OUTSIDE_SECTOR_200 DET_EXISTENCE_PROB_200 DET_POINT_TARGET_PROB_200 DET_SNR_200 DET_SUPER_RES_TARGET_200 DET_VALID_FLAG_200 DET_RCS_200 DET_ELEVATION_ERR_200 DET_ELEVATION_200 DET_AZIMUTH_ERR_200 DET_AZIMUTH_200 DET_RANGE_VELOCITY_ERR_200 DET_RANGE_VELOCITY_200 DET_RANGE_ERR_200 DET_RANGE_200;
SIG_GROUP_ 1202 Detections_201_204 1 : DET_MH_CRC16_201_204 DET_MH_CYCLE_COUNTER_201_204 DET_MH_SCAN_INDEX_4LSB_201_204 DET_CONFD_ELEVATION_201 DET_CONFD_AZIMUTH_201 DET_HVC_FLAG_201 DET_OUTSIDE_SECTOR_201 DET_EXISTENCE_PROB_201 DET_POINT_TARGET_PROB_201 DET_SNR_201 DET_SUPER_RES_TARGET_201 DET_BI_STATIC_FLAG_201 DET_VALID_FLAG_201 DET_RCS_201 DET_ELEVATION_ERR_201 DET_ELEVATION_201 DET_AZIMUTH_ERR_201 DET_AZIMUTH_201 DET_RANGE_VELOCITY_ERR_201 DET_RANGE_VELOCITY_201 DET_RANGE_ERR_201 DET_RANGE_201 DET_CONFD_ELEVATION_202 DET_CONFD_AZIMUTH_202 DET_HVC_FLAG_202 DET_OUTSIDE_SECTOR_202 DET_EXISTENCE_PROB_202 DET_POINT_TARGET_PROB_202 DET_SNR_202 DET_SUPER_RES_TARGET_202 DET_BI_STATIC_FLAG_202 DET_VALID_FLAG_202 DET_RCS_202 DET_ELEVATION_202 DET_ELEVATION_ERR_202 DET_AZIMUTH_ERR_202 DET_AZIMUTH_202 DET_RANGE_VELOCITY_ERR_202 DET_RANGE_VELOCITY_202 DET_RANGE_ERR_202 DET_RANGE_202 DET_CONFD_ELEVATION_203 DET_CONFD_AZIMUTH_203 DET_HVC_FLAG_203 DET_OUTSIDE_SECTOR_203 DET_EXISTENCE_PROB_203 DET_POINT_TARGET_PROB_203 DET_SUPER_RES_TARGET_203 DET_BI_STATIC_FLAG_203 DET_VALID_FLAG_203 DET_RCS_203 DET_ELEVATION_203 DET_SNR_203 DET_ELEVATION_ERR_203 DET_AZIMUTH_ERR_203 DET_RANGE_VELOCITY_ERR_203 DET_AZIMUTH_203 DET_RANGE_VELOCITY_203 DET_RANGE_ERR_203 DET_RANGE_203 DET_BI_STATIC_FLAG_204 DET_CONFD_ELEVATION_204 DET_CONFD_AZIMUTH_204 DET_HVC_FLAG_204 DET_OUTSIDE_SECTOR_204 DET_EXISTENCE_PROB_204 DET_POINT_TARGET_PROB_204 DET_SNR_204 DET_SUPER_RES_TARGET_204 DET_VALID_FLAG_204 DET_RCS_204 DET_ELEVATION_ERR_204 DET_ELEVATION_204 DET_AZIMUTH_ERR_204 DET_AZIMUTH_204 DET_RANGE_VELOCITY_ERR_204 DET_RANGE_VELOCITY_204 DET_RANGE_ERR_204 DET_RANGE_204;
SIG_GROUP_ 1203 Detections_205_208 1 : DET_MH_CRC16_205_208 DET_MH_CYCLE_COUNTER_205_208 DET_MH_SCAN_INDEX_4LSB_205_208 DET_CONFD_ELEVATION_205 DET_CONFD_AZIMUTH_205 DET_HVC_FLAG_205 DET_OUTSIDE_SECTOR_205 DET_EXISTENCE_PROB_205 DET_POINT_TARGET_PROB_205 DET_SNR_205 DET_SUPER_RES_TARGET_205 DET_BI_STATIC_FLAG_205 DET_VALID_FLAG_205 DET_RCS_205 DET_ELEVATION_ERR_205 DET_ELEVATION_205 DET_AZIMUTH_ERR_205 DET_AZIMUTH_205 DET_RANGE_VELOCITY_ERR_205 DET_RANGE_VELOCITY_205 DET_RANGE_ERR_205 DET_RANGE_205 DET_CONFD_ELEVATION_206 DET_CONFD_AZIMUTH_206 DET_HVC_FLAG_206 DET_OUTSIDE_SECTOR_206 DET_EXISTENCE_PROB_206 DET_POINT_TARGET_PROB_206 DET_SNR_206 DET_SUPER_RES_TARGET_206 DET_BI_STATIC_FLAG_206 DET_VALID_FLAG_206 DET_RCS_206 DET_ELEVATION_206 DET_ELEVATION_ERR_206 DET_AZIMUTH_ERR_206 DET_AZIMUTH_206 DET_RANGE_VELOCITY_ERR_206 DET_RANGE_VELOCITY_206 DET_RANGE_ERR_206 DET_RANGE_206 DET_CONFD_ELEVATION_207 DET_CONFD_AZIMUTH_207 DET_HVC_FLAG_207 DET_OUTSIDE_SECTOR_207 DET_EXISTENCE_PROB_207 DET_POINT_TARGET_PROB_207 DET_SUPER_RES_TARGET_207 DET_BI_STATIC_FLAG_207 DET_VALID_FLAG_207 DET_RCS_207 DET_ELEVATION_207 DET_SNR_207 DET_ELEVATION_ERR_207 DET_AZIMUTH_ERR_207 DET_RANGE_VELOCITY_ERR_207 DET_AZIMUTH_207 DET_RANGE_VELOCITY_207 DET_RANGE_ERR_207 DET_RANGE_207 DET_BI_STATIC_FLAG_208 DET_CONFD_ELEVATION_208 DET_CONFD_AZIMUTH_208 DET_HVC_FLAG_208 DET_OUTSIDE_SECTOR_208 DET_EXISTENCE_PROB_208 DET_POINT_TARGET_PROB_208 DET_SNR_208 DET_SUPER_RES_TARGET_208 DET_VALID_FLAG_208 DET_RCS_208 DET_ELEVATION_ERR_208 DET_ELEVATION_208 DET_AZIMUTH_ERR_208 DET_AZIMUTH_208 DET_RANGE_VELOCITY_ERR_208 DET_RANGE_VELOCITY_208 DET_RANGE_ERR_208 DET_RANGE_208;
SIG_GROUP_ 1204 Detections_209_212 1 : DET_MH_CRC16_209_212 DET_MH_CYCLE_COUNTER_209_212 DET_MH_SCAN_INDEX_4LSB_209_212 DET_CONFD_ELEVATION_209 DET_CONFD_AZIMUTH_209 DET_HVC_FLAG_209 DET_OUTSIDE_SECTOR_209 DET_EXISTENCE_PROB_209 DET_POINT_TARGET_PROB_209 DET_SNR_209 DET_SUPER_RES_TARGET_209 DET_BI_STATIC_FLAG_209 DET_VALID_FLAG_209 DET_RCS_209 DET_ELEVATION_ERR_209 DET_ELEVATION_209 DET_AZIMUTH_ERR_209 DET_AZIMUTH_209 DET_RANGE_VELOCITY_ERR_209 DET_RANGE_VELOCITY_209 DET_RANGE_ERR_209 DET_RANGE_209 DET_CONFD_ELEVATION_210 DET_CONFD_AZIMUTH_210 DET_HVC_FLAG_210 DET_OUTSIDE_SECTOR_210 DET_EXISTENCE_PROB_210 DET_POINT_TARGET_PROB_210 DET_SNR_210 DET_SUPER_RES_TARGET_210 DET_BI_STATIC_FLAG_210 DET_VALID_FLAG_210 DET_RCS_210 DET_ELEVATION_210 DET_ELEVATION_ERR_210 DET_AZIMUTH_ERR_210 DET_AZIMUTH_210 DET_RANGE_VELOCITY_ERR_210 DET_RANGE_VELOCITY_210 DET_RANGE_ERR_210 DET_RANGE_210 DET_CONFD_ELEVATION_211 DET_CONFD_AZIMUTH_211 DET_HVC_FLAG_211 DET_OUTSIDE_SECTOR_211 DET_EXISTENCE_PROB_211 DET_POINT_TARGET_PROB_211 DET_SUPER_RES_TARGET_211 DET_BI_STATIC_FLAG_211 DET_VALID_FLAG_211 DET_RCS_211 DET_ELEVATION_211 DET_SNR_211 DET_ELEVATION_ERR_211 DET_AZIMUTH_ERR_211 DET_RANGE_VELOCITY_ERR_211 DET_AZIMUTH_211 DET_RANGE_VELOCITY_211 DET_RANGE_ERR_211 DET_RANGE_211 DET_BI_STATIC_FLAG_212 DET_CONFD_ELEVATION_212 DET_CONFD_AZIMUTH_212 DET_HVC_FLAG_212 DET_OUTSIDE_SECTOR_212 DET_EXISTENCE_PROB_212 DET_POINT_TARGET_PROB_212 DET_SNR_212 DET_SUPER_RES_TARGET_212 DET_VALID_FLAG_212 DET_RCS_212 DET_ELEVATION_ERR_212 DET_ELEVATION_212 DET_AZIMUTH_ERR_212 DET_AZIMUTH_212 DET_RANGE_VELOCITY_ERR_212 DET_RANGE_VELOCITY_212 DET_RANGE_ERR_212 DET_RANGE_212;
SIG_GROUP_ 1205 Detections_213_216 1 : DET_MH_CRC16_213_216 DET_MH_CYCLE_COUNTER_213_216 DET_MH_SCAN_INDEX_4LSB_213_216 DET_CONFD_ELEVATION_213 DET_CONFD_AZIMUTH_213 DET_HVC_FLAG_213 DET_OUTSIDE_SECTOR_213 DET_EXISTENCE_PROB_213 DET_POINT_TARGET_PROB_213 DET_SNR_213 DET_SUPER_RES_TARGET_213 DET_BI_STATIC_FLAG_213 DET_VALID_FLAG_213 DET_RCS_213 DET_ELEVATION_ERR_213 DET_ELEVATION_213 DET_AZIMUTH_ERR_213 DET_AZIMUTH_213 DET_RANGE_VELOCITY_ERR_213 DET_RANGE_VELOCITY_213 DET_RANGE_ERR_213 DET_RANGE_213 DET_CONFD_ELEVATION_214 DET_CONFD_AZIMUTH_214 DET_HVC_FLAG_214 DET_OUTSIDE_SECTOR_214 DET_EXISTENCE_PROB_214 DET_POINT_TARGET_PROB_214 DET_SNR_214 DET_SUPER_RES_TARGET_214 DET_BI_STATIC_FLAG_214 DET_VALID_FLAG_214 DET_RCS_214 DET_ELEVATION_214 DET_ELEVATION_ERR_214 DET_AZIMUTH_ERR_214 DET_AZIMUTH_214 DET_RANGE_VELOCITY_ERR_214 DET_RANGE_VELOCITY_214 DET_RANGE_ERR_214 DET_RANGE_214 DET_CONFD_ELEVATION_215 DET_CONFD_AZIMUTH_215 DET_HVC_FLAG_215 DET_OUTSIDE_SECTOR_215 DET_EXISTENCE_PROB_215 DET_POINT_TARGET_PROB_215 DET_SUPER_RES_TARGET_215 DET_BI_STATIC_FLAG_215 DET_VALID_FLAG_215 DET_RCS_215 DET_ELEVATION_215 DET_SNR_215 DET_ELEVATION_ERR_215 DET_AZIMUTH_ERR_215 DET_RANGE_VELOCITY_ERR_215 DET_AZIMUTH_215 DET_RANGE_VELOCITY_215 DET_RANGE_ERR_215 DET_RANGE_215 DET_BI_STATIC_FLAG_216 DET_CONFD_ELEVATION_216 DET_CONFD_AZIMUTH_216 DET_HVC_FLAG_216 DET_OUTSIDE_SECTOR_216 DET_EXISTENCE_PROB_216 DET_POINT_TARGET_PROB_216 DET_SNR_216 DET_SUPER_RES_TARGET_216 DET_VALID_FLAG_216 DET_RCS_216 DET_ELEVATION_ERR_216 DET_ELEVATION_216 DET_AZIMUTH_ERR_216 DET_AZIMUTH_216 DET_RANGE_VELOCITY_ERR_216 DET_RANGE_VELOCITY_216 DET_RANGE_ERR_216 DET_RANGE_216;
SIG_GROUP_ 1206 Detections_217_220 1 : DET_MH_CRC16_217_220 DET_MH_CYCLE_COUNTER_217_220 DET_MH_SCAN_INDEX_4LSB_217_220 DET_CONFD_ELEVATION_217 DET_CONFD_AZIMUTH_217 DET_HVC_FLAG_217 DET_OUTSIDE_SECTOR_217 DET_EXISTENCE_PROB_217 DET_POINT_TARGET_PROB_217 DET_SNR_217 DET_SUPER_RES_TARGET_217 DET_BI_STATIC_FLAG_217 DET_VALID_FLAG_217 DET_RCS_217 DET_ELEVATION_ERR_217 DET_ELEVATION_217 DET_AZIMUTH_ERR_217 DET_AZIMUTH_217 DET_RANGE_VELOCITY_ERR_217 DET_RANGE_VELOCITY_217 DET_RANGE_ERR_217 DET_RANGE_217 DET_CONFD_ELEVATION_218 DET_CONFD_AZIMUTH_218 DET_HVC_FLAG_218 DET_OUTSIDE_SECTOR_218 DET_EXISTENCE_PROB_218 DET_POINT_TARGET_PROB_218 DET_SNR_218 DET_SUPER_RES_TARGET_218 DET_BI_STATIC_FLAG_218 DET_VALID_FLAG_218 DET_RCS_218 DET_ELEVATION_218 DET_ELEVATION_ERR_218 DET_AZIMUTH_ERR_218 DET_AZIMUTH_218 DET_RANGE_VELOCITY_ERR_218 DET_RANGE_VELOCITY_218 DET_RANGE_ERR_218 DET_RANGE_218 DET_CONFD_ELEVATION_219 DET_CONFD_AZIMUTH_219 DET_HVC_FLAG_219 DET_OUTSIDE_SECTOR_219 DET_EXISTENCE_PROB_219 DET_POINT_TARGET_PROB_219 DET_SUPER_RES_TARGET_219 DET_BI_STATIC_FLAG_219 DET_VALID_FLAG_219 DET_RCS_219 DET_ELEVATION_219 DET_SNR_219 DET_ELEVATION_ERR_219 DET_AZIMUTH_ERR_219 DET_RANGE_VELOCITY_ERR_219 DET_AZIMUTH_219 DET_RANGE_VELOCITY_219 DET_RANGE_ERR_219 DET_RANGE_219 DET_BI_STATIC_FLAG_220 DET_CONFD_ELEVATION_220 DET_CONFD_AZIMUTH_220 DET_HVC_FLAG_220 DET_OUTSIDE_SECTOR_220 DET_EXISTENCE_PROB_220 DET_POINT_TARGET_PROB_220 DET_SNR_220 DET_SUPER_RES_TARGET_220 DET_VALID_FLAG_220 DET_RCS_220 DET_ELEVATION_ERR_220 DET_ELEVATION_220 DET_AZIMUTH_ERR_220 DET_AZIMUTH_220 DET_RANGE_VELOCITY_ERR_220 DET_RANGE_VELOCITY_220 DET_RANGE_ERR_220 DET_RANGE_220;
SIG_GROUP_ 1207 Detections_221_224 1 : DET_MH_CRC16_221_224 DET_MH_CYCLE_COUNTER_221_224 DET_MH_SCAN_INDEX_4LSB_221_224 DET_CONFD_ELEVATION_221 DET_CONFD_AZIMUTH_221 DET_HVC_FLAG_221 DET_OUTSIDE_SECTOR_221 DET_EXISTENCE_PROB_221 DET_POINT_TARGET_PROB_221 DET_SNR_221 DET_SUPER_RES_TARGET_221 DET_BI_STATIC_FLAG_221 DET_VALID_FLAG_221 DET_RCS_221 DET_ELEVATION_ERR_221 DET_ELEVATION_221 DET_AZIMUTH_ERR_221 DET_AZIMUTH_221 DET_RANGE_VELOCITY_ERR_221 DET_RANGE_VELOCITY_221 DET_RANGE_ERR_221 DET_RANGE_221 DET_CONFD_ELEVATION_222 DET_CONFD_AZIMUTH_222 DET_HVC_FLAG_222 DET_OUTSIDE_SECTOR_222 DET_EXISTENCE_PROB_222 DET_POINT_TARGET_PROB_222 DET_SNR_222 DET_SUPER_RES_TARGET_222 DET_BI_STATIC_FLAG_222 DET_VALID_FLAG_222 DET_RCS_222 DET_ELEVATION_222 DET_ELEVATION_ERR_222 DET_AZIMUTH_ERR_222 DET_AZIMUTH_222 DET_RANGE_VELOCITY_ERR_222 DET_RANGE_VELOCITY_222 DET_RANGE_ERR_222 DET_RANGE_222 DET_CONFD_ELEVATION_223 DET_CONFD_AZIMUTH_223 DET_HVC_FLAG_223 DET_OUTSIDE_SECTOR_223 DET_EXISTENCE_PROB_223 DET_POINT_TARGET_PROB_223 DET_SUPER_RES_TARGET_223 DET_BI_STATIC_FLAG_223 DET_VALID_FLAG_223 DET_RCS_223 DET_ELEVATION_223 DET_SNR_223 DET_ELEVATION_ERR_223 DET_AZIMUTH_ERR_223 DET_RANGE_VELOCITY_ERR_223 DET_AZIMUTH_223 DET_RANGE_VELOCITY_223 DET_RANGE_ERR_223 DET_RANGE_223 DET_BI_STATIC_FLAG_224 DET_CONFD_ELEVATION_224 DET_CONFD_AZIMUTH_224 DET_HVC_FLAG_224 DET_OUTSIDE_SECTOR_224 DET_EXISTENCE_PROB_224 DET_POINT_TARGET_PROB_224 DET_SNR_224 DET_SUPER_RES_TARGET_224 DET_VALID_FLAG_224 DET_RCS_224 DET_ELEVATION_ERR_224 DET_ELEVATION_224 DET_AZIMUTH_ERR_224 DET_AZIMUTH_224 DET_RANGE_VELOCITY_ERR_224 DET_RANGE_VELOCITY_224 DET_RANGE_ERR_224 DET_RANGE_224;
SIG_GROUP_ 1208 Detections_225_228 1 : DET_MH_CRC16_225_228 DET_MH_CYCLE_COUNTER_225_228 DET_MH_SCAN_INDEX_4LSB_225_228 DET_CONFD_ELEVATION_225 DET_CONFD_AZIMUTH_225 DET_HVC_FLAG_225 DET_OUTSIDE_SECTOR_225 DET_EXISTENCE_PROB_225 DET_POINT_TARGET_PROB_225 DET_SNR_225 DET_SUPER_RES_TARGET_225 DET_BI_STATIC_FLAG_225 DET_VALID_FLAG_225 DET_RCS_225 DET_ELEVATION_ERR_225 DET_ELEVATION_225 DET_AZIMUTH_ERR_225 DET_AZIMUTH_225 DET_RANGE_VELOCITY_ERR_225 DET_RANGE_VELOCITY_225 DET_RANGE_ERR_225 DET_RANGE_225 DET_CONFD_ELEVATION_226 DET_CONFD_AZIMUTH_226 DET_HVC_FLAG_226 DET_OUTSIDE_SECTOR_226 DET_EXISTENCE_PROB_226 DET_POINT_TARGET_PROB_226 DET_SNR_226 DET_SUPER_RES_TARGET_226 DET_BI_STATIC_FLAG_226 DET_VALID_FLAG_226 DET_RCS_226 DET_ELEVATION_226 DET_ELEVATION_ERR_226 DET_AZIMUTH_ERR_226 DET_AZIMUTH_226 DET_RANGE_VELOCITY_ERR_226 DET_RANGE_VELOCITY_226 DET_RANGE_ERR_226 DET_RANGE_226 DET_CONFD_ELEVATION_227 DET_CONFD_AZIMUTH_227 DET_HVC_FLAG_227 DET_OUTSIDE_SECTOR_227 DET_EXISTENCE_PROB_227 DET_POINT_TARGET_PROB_227 DET_SUPER_RES_TARGET_227 DET_BI_STATIC_FLAG_227 DET_VALID_FLAG_227 DET_RCS_227 DET_ELEVATION_227 DET_SNR_227 DET_ELEVATION_ERR_227 DET_AZIMUTH_ERR_227 DET_RANGE_VELOCITY_ERR_227 DET_AZIMUTH_227 DET_RANGE_VELOCITY_227 DET_RANGE_ERR_227 DET_RANGE_227 DET_BI_STATIC_FLAG_228 DET_CONFD_ELEVATION_228 DET_CONFD_AZIMUTH_228 DET_HVC_FLAG_228 DET_OUTSIDE_SECTOR_228 DET_EXISTENCE_PROB_228 DET_POINT_TARGET_PROB_228 DET_SNR_228 DET_SUPER_RES_TARGET_228 DET_VALID_FLAG_228 DET_RCS_228 DET_ELEVATION_ERR_228 DET_ELEVATION_228 DET_AZIMUTH_ERR_228 DET_AZIMUTH_228 DET_RANGE_VELOCITY_ERR_228 DET_RANGE_VELOCITY_228 DET_RANGE_ERR_228 DET_RANGE_228;
SIG_GROUP_ 1209 Detections_229_232 1 : DET_MH_CRC16_229_232 DET_MH_CYCLE_COUNTER_229_232 DET_MH_SCAN_INDEX_4LSB_229_232 DET_CONFD_ELEVATION_229 DET_CONFD_AZIMUTH_229 DET_HVC_FLAG_229 DET_OUTSIDE_SECTOR_229 DET_EXISTENCE_PROB_229 DET_POINT_TARGET_PROB_229 DET_SNR_229 DET_SUPER_RES_TARGET_229 DET_BI_STATIC_FLAG_229 DET_VALID_FLAG_229 DET_RCS_229 DET_ELEVATION_ERR_229 DET_ELEVATION_229 DET_AZIMUTH_ERR_229 DET_AZIMUTH_229 DET_RANGE_VELOCITY_ERR_229 DET_RANGE_VELOCITY_229 DET_RANGE_ERR_229 DET_RANGE_229 DET_CONFD_ELEVATION_230 DET_CONFD_AZIMUTH_230 DET_HVC_FLAG_230 DET_OUTSIDE_SECTOR_230 DET_EXISTENCE_PROB_230 DET_POINT_TARGET_PROB_230 DET_SNR_230 DET_SUPER_RES_TARGET_230 DET_BI_STATIC_FLAG_230 DET_VALID_FLAG_230 DET_RCS_230 DET_ELEVATION_230 DET_ELEVATION_ERR_230 DET_AZIMUTH_ERR_230 DET_AZIMUTH_230 DET_RANGE_VELOCITY_ERR_230 DET_RANGE_VELOCITY_230 DET_RANGE_ERR_230 DET_RANGE_230 DET_CONFD_ELEVATION_231 DET_CONFD_AZIMUTH_231 DET_HVC_FLAG_231 DET_OUTSIDE_SECTOR_231 DET_EXISTENCE_PROB_231 DET_POINT_TARGET_PROB_231 DET_SUPER_RES_TARGET_231 DET_BI_STATIC_FLAG_231 DET_VALID_FLAG_231 DET_RCS_231 DET_ELEVATION_231 DET_SNR_231 DET_ELEVATION_ERR_231 DET_AZIMUTH_ERR_231 DET_RANGE_VELOCITY_ERR_231 DET_AZIMUTH_231 DET_RANGE_VELOCITY_231 DET_RANGE_ERR_231 DET_RANGE_231 DET_BI_STATIC_FLAG_232 DET_CONFD_ELEVATION_232 DET_CONFD_AZIMUTH_232 DET_HVC_FLAG_232 DET_OUTSIDE_SECTOR_232 DET_EXISTENCE_PROB_232 DET_POINT_TARGET_PROB_232 DET_SNR_232 DET_SUPER_RES_TARGET_232 DET_VALID_FLAG_232 DET_RCS_232 DET_ELEVATION_ERR_232 DET_ELEVATION_232 DET_AZIMUTH_ERR_232 DET_AZIMUTH_232 DET_RANGE_VELOCITY_ERR_232 DET_RANGE_VELOCITY_232 DET_RANGE_ERR_232 DET_RANGE_232;
SIG_GROUP_ 1210 Detections_233_236 1 : DET_MH_CRC16_233_236 DET_MH_CYCLE_COUNTER_233_236 DET_MH_SCAN_INDEX_4LSB_233_236 DET_CONFD_ELEVATION_233 DET_CONFD_AZIMUTH_233 DET_HVC_FLAG_233 DET_OUTSIDE_SECTOR_233 DET_EXISTENCE_PROB_233 DET_POINT_TARGET_PROB_233 DET_SNR_233 DET_SUPER_RES_TARGET_233 DET_BI_STATIC_FLAG_233 DET_VALID_FLAG_233 DET_RCS_233 DET_ELEVATION_ERR_233 DET_ELEVATION_233 DET_AZIMUTH_ERR_233 DET_AZIMUTH_233 DET_RANGE_VELOCITY_ERR_233 DET_RANGE_VELOCITY_233 DET_RANGE_ERR_233 DET_RANGE_233 DET_CONFD_ELEVATION_234 DET_CONFD_AZIMUTH_234 DET_HVC_FLAG_234 DET_OUTSIDE_SECTOR_234 DET_EXISTENCE_PROB_234 DET_POINT_TARGET_PROB_234 DET_SNR_234 DET_SUPER_RES_TARGET_234 DET_BI_STATIC_FLAG_234 DET_VALID_FLAG_234 DET_RCS_234 DET_ELEVATION_234 DET_ELEVATION_ERR_234 DET_AZIMUTH_ERR_234 DET_AZIMUTH_234 DET_RANGE_VELOCITY_ERR_234 DET_RANGE_VELOCITY_234 DET_RANGE_ERR_234 DET_RANGE_234 DET_CONFD_ELEVATION_235 DET_CONFD_AZIMUTH_235 DET_HVC_FLAG_235 DET_OUTSIDE_SECTOR_235 DET_EXISTENCE_PROB_235 DET_POINT_TARGET_PROB_235 DET_SUPER_RES_TARGET_235 DET_BI_STATIC_FLAG_235 DET_VALID_FLAG_235 DET_RCS_235 DET_ELEVATION_235 DET_SNR_235 DET_ELEVATION_ERR_235 DET_AZIMUTH_ERR_235 DET_RANGE_VELOCITY_ERR_235 DET_AZIMUTH_235 DET_RANGE_VELOCITY_235 DET_RANGE_ERR_235 DET_RANGE_235 DET_BI_STATIC_FLAG_236 DET_CONFD_ELEVATION_236 DET_CONFD_AZIMUTH_236 DET_HVC_FLAG_236 DET_OUTSIDE_SECTOR_236 DET_EXISTENCE_PROB_236 DET_POINT_TARGET_PROB_236 DET_SNR_236 DET_SUPER_RES_TARGET_236 DET_VALID_FLAG_236 DET_RCS_236 DET_ELEVATION_ERR_236 DET_ELEVATION_236 DET_AZIMUTH_ERR_236 DET_AZIMUTH_236 DET_RANGE_VELOCITY_ERR_236 DET_RANGE_VELOCITY_236 DET_RANGE_ERR_236 DET_RANGE_236;
SIG_GROUP_ 1211 Detections_237_240 1 : DET_MH_CRC16_237_240 DET_MH_CYCLE_COUNTER_237_240 DET_MH_SCAN_INDEX_4LSB_237_240 DET_CONFD_ELEVATION_237 DET_CONFD_AZIMUTH_237 DET_HVC_FLAG_237 DET_OUTSIDE_SECTOR_237 DET_EXISTENCE_PROB_237 DET_POINT_TARGET_PROB_237 DET_SNR_237 DET_SUPER_RES_TARGET_237 DET_BI_STATIC_FLAG_237 DET_VALID_FLAG_237 DET_RCS_237 DET_ELEVATION_ERR_237 DET_ELEVATION_237 DET_AZIMUTH_ERR_237 DET_AZIMUTH_237 DET_RANGE_VELOCITY_ERR_237 DET_RANGE_VELOCITY_237 DET_RANGE_ERR_237 DET_RANGE_237 DET_CONFD_ELEVATION_238 DET_CONFD_AZIMUTH_238 DET_HVC_FLAG_238 DET_OUTSIDE_SECTOR_238 DET_EXISTENCE_PROB_238 DET_POINT_TARGET_PROB_238 DET_SNR_238 DET_SUPER_RES_TARGET_238 DET_BI_STATIC_FLAG_238 DET_VALID_FLAG_238 DET_RCS_238 DET_ELEVATION_238 DET_ELEVATION_ERR_238 DET_AZIMUTH_ERR_238 DET_AZIMUTH_238 DET_RANGE_VELOCITY_ERR_238 DET_RANGE_VELOCITY_238 DET_RANGE_ERR_238 DET_RANGE_238 DET_CONFD_ELEVATION_239 DET_CONFD_AZIMUTH_239 DET_HVC_FLAG_239 DET_OUTSIDE_SECTOR_239 DET_EXISTENCE_PROB_239 DET_POINT_TARGET_PROB_239 DET_SUPER_RES_TARGET_239 DET_BI_STATIC_FLAG_239 DET_VALID_FLAG_239 DET_RCS_239 DET_ELEVATION_239 DET_SNR_239 DET_ELEVATION_ERR_239 DET_AZIMUTH_ERR_239 DET_RANGE_VELOCITY_ERR_239 DET_AZIMUTH_239 DET_RANGE_VELOCITY_239 DET_RANGE_ERR_239 DET_RANGE_239 DET_BI_STATIC_FLAG_240 DET_CONFD_ELEVATION_240 DET_CONFD_AZIMUTH_240 DET_HVC_FLAG_240 DET_OUTSIDE_SECTOR_240 DET_EXISTENCE_PROB_240 DET_POINT_TARGET_PROB_240 DET_SNR_240 DET_SUPER_RES_TARGET_240 DET_VALID_FLAG_240 DET_RCS_240 DET_ELEVATION_ERR_240 DET_ELEVATION_240 DET_AZIMUTH_ERR_240 DET_AZIMUTH_240 DET_RANGE_VELOCITY_ERR_240 DET_RANGE_VELOCITY_240 DET_RANGE_ERR_240 DET_RANGE_240;
SIG_GROUP_ 1212 Detections_241_244 1 : DET_MH_CRC16_241_244 DET_MH_CYCLE_COUNTER_241_244 DET_MH_SCAN_INDEX_4LSB_241_244 DET_CONFD_ELEVATION_241 DET_CONFD_AZIMUTH_241 DET_HVC_FLAG_241 DET_OUTSIDE_SECTOR_241 DET_EXISTENCE_PROB_241 DET_POINT_TARGET_PROB_241 DET_SNR_241 DET_SUPER_RES_TARGET_241 DET_BI_STATIC_FLAG_241 DET_VALID_FLAG_241 DET_RCS_241 DET_ELEVATION_ERR_241 DET_ELEVATION_241 DET_AZIMUTH_ERR_241 DET_AZIMUTH_241 DET_RANGE_VELOCITY_ERR_241 DET_RANGE_VELOCITY_241 DET_RANGE_ERR_241 DET_RANGE_241 DET_CONFD_ELEVATION_242 DET_CONFD_AZIMUTH_242 DET_HVC_FLAG_242 DET_OUTSIDE_SECTOR_242 DET_EXISTENCE_PROB_242 DET_POINT_TARGET_PROB_242 DET_SNR_242 DET_SUPER_RES_TARGET_242 DET_BI_STATIC_FLAG_242 DET_VALID_FLAG_242 DET_RCS_242 DET_ELEVATION_242 DET_ELEVATION_ERR_242 DET_AZIMUTH_ERR_242 DET_AZIMUTH_242 DET_RANGE_VELOCITY_ERR_242 DET_RANGE_VELOCITY_242 DET_RANGE_ERR_242 DET_RANGE_242 DET_CONFD_ELEVATION_243 DET_CONFD_AZIMUTH_243 DET_HVC_FLAG_243 DET_OUTSIDE_SECTOR_243 DET_EXISTENCE_PROB_243 DET_POINT_TARGET_PROB_243 DET_SUPER_RES_TARGET_243 DET_BI_STATIC_FLAG_243 DET_VALID_FLAG_243 DET_RCS_243 DET_ELEVATION_243 DET_SNR_243 DET_ELEVATION_ERR_243 DET_AZIMUTH_ERR_243 DET_RANGE_VELOCITY_ERR_243 DET_AZIMUTH_243 DET_RANGE_VELOCITY_243 DET_RANGE_ERR_243 DET_RANGE_243 DET_BI_STATIC_FLAG_244 DET_CONFD_ELEVATION_244 DET_CONFD_AZIMUTH_244 DET_HVC_FLAG_244 DET_OUTSIDE_SECTOR_244 DET_EXISTENCE_PROB_244 DET_POINT_TARGET_PROB_244 DET_SNR_244 DET_SUPER_RES_TARGET_244 DET_VALID_FLAG_244 DET_RCS_244 DET_ELEVATION_ERR_244 DET_ELEVATION_244 DET_AZIMUTH_ERR_244 DET_AZIMUTH_244 DET_RANGE_VELOCITY_ERR_244 DET_RANGE_VELOCITY_244 DET_RANGE_ERR_244 DET_RANGE_244;
SIG_GROUP_ 1213 Detections_245_248 1 : DET_MH_CRC16_245_248 DET_MH_CYCLE_COUNTER_245_248 DET_MH_SCAN_INDEX_4LSB_245_248 DET_CONFD_ELEVATION_245 DET_CONFD_AZIMUTH_245 DET_HVC_FLAG_245 DET_OUTSIDE_SECTOR_245 DET_EXISTENCE_PROB_245 DET_POINT_TARGET_PROB_245 DET_SNR_245 DET_SUPER_RES_TARGET_245 DET_BI_STATIC_FLAG_245 DET_VALID_FLAG_245 DET_RCS_245 DET_ELEVATION_ERR_245 DET_ELEVATION_245 DET_AZIMUTH_ERR_245 DET_AZIMUTH_245 DET_RANGE_VELOCITY_ERR_245 DET_RANGE_VELOCITY_245 DET_RANGE_ERR_245 DET_RANGE_245 DET_CONFD_ELEVATION_246 DET_CONFD_AZIMUTH_246 DET_HVC_FLAG_246 DET_OUTSIDE_SECTOR_246 DET_EXISTENCE_PROB_246 DET_POINT_TARGET_PROB_246 DET_SNR_246 DET_SUPER_RES_TARGET_246 DET_BI_STATIC_FLAG_246 DET_VALID_FLAG_246 DET_RCS_246 DET_ELEVATION_246 DET_ELEVATION_ERR_246 DET_AZIMUTH_ERR_246 DET_AZIMUTH_246 DET_RANGE_VELOCITY_ERR_246 DET_RANGE_VELOCITY_246 DET_RANGE_ERR_246 DET_RANGE_246 DET_CONFD_ELEVATION_247 DET_CONFD_AZIMUTH_247 DET_HVC_FLAG_247 DET_OUTSIDE_SECTOR_247 DET_EXISTENCE_PROB_247 DET_POINT_TARGET_PROB_247 DET_SUPER_RES_TARGET_247 DET_BI_STATIC_FLAG_247 DET_VALID_FLAG_247 DET_RCS_247 DET_ELEVATION_247 DET_SNR_247 DET_ELEVATION_ERR_247 DET_AZIMUTH_ERR_247 DET_RANGE_VELOCITY_ERR_247 DET_AZIMUTH_247 DET_RANGE_VELOCITY_247 DET_RANGE_ERR_247 DET_RANGE_247 DET_BI_STATIC_FLAG_248 DET_CONFD_ELEVATION_248 DET_CONFD_AZIMUTH_248 DET_HVC_FLAG_248 DET_OUTSIDE_SECTOR_248 DET_EXISTENCE_PROB_248 DET_POINT_TARGET_PROB_248 DET_SNR_248 DET_SUPER_RES_TARGET_248 DET_VALID_FLAG_248 DET_RCS_248 DET_ELEVATION_ERR_248 DET_ELEVATION_248 DET_AZIMUTH_ERR_248 DET_AZIMUTH_248 DET_RANGE_VELOCITY_ERR_248 DET_RANGE_VELOCITY_248 DET_RANGE_ERR_248 DET_RANGE_248;
SIG_GROUP_ 1214 Detections_249_252 1 : DET_MH_CRC16_249_252 DET_MH_CYCLE_COUNTER_249_252 DET_MH_SCAN_INDEX_4LSB_249_252 DET_CONFD_ELEVATION_249 DET_CONFD_AZIMUTH_249 DET_HVC_FLAG_249 DET_OUTSIDE_SECTOR_249 DET_EXISTENCE_PROB_249 DET_POINT_TARGET_PROB_249 DET_SNR_249 DET_SUPER_RES_TARGET_249 DET_BI_STATIC_FLAG_249 DET_VALID_FLAG_249 DET_RCS_249 DET_ELEVATION_ERR_249 DET_ELEVATION_249 DET_AZIMUTH_ERR_249 DET_AZIMUTH_249 DET_RANGE_VELOCITY_ERR_249 DET_RANGE_VELOCITY_249 DET_RANGE_ERR_249 DET_RANGE_249 DET_CONFD_ELEVATION_250 DET_CONFD_AZIMUTH_250 DET_HVC_FLAG_250 DET_OUTSIDE_SECTOR_250 DET_EXISTENCE_PROB_250 DET_POINT_TARGET_PROB_250 DET_SNR_250 DET_SUPER_RES_TARGET_250 DET_BI_STATIC_FLAG_250 DET_VALID_FLAG_250 DET_RCS_250 DET_ELEVATION_250 DET_ELEVATION_ERR_250 DET_AZIMUTH_ERR_250 DET_AZIMUTH_250 DET_RANGE_VELOCITY_ERR_250 DET_RANGE_VELOCITY_250 DET_RANGE_ERR_250 DET_RANGE_250 DET_CONFD_ELEVATION_251 DET_CONFD_AZIMUTH_251 DET_HVC_FLAG_251 DET_OUTSIDE_SECTOR_251 DET_EXISTENCE_PROB_251 DET_POINT_TARGET_PROB_251 DET_SUPER_RES_TARGET_251 DET_BI_STATIC_FLAG_251 DET_VALID_FLAG_251 DET_RCS_251 DET_ELEVATION_251 DET_SNR_251 DET_ELEVATION_ERR_251 DET_AZIMUTH_ERR_251 DET_RANGE_VELOCITY_ERR_251 DET_AZIMUTH_251 DET_RANGE_VELOCITY_251 DET_RANGE_ERR_251 DET_RANGE_251 DET_BI_STATIC_FLAG_252 DET_CONFD_ELEVATION_252 DET_CONFD_AZIMUTH_252 DET_HVC_FLAG_252 DET_OUTSIDE_SECTOR_252 DET_EXISTENCE_PROB_252 DET_POINT_TARGET_PROB_252 DET_SNR_252 DET_SUPER_RES_TARGET_252 DET_VALID_FLAG_252 DET_RCS_252 DET_ELEVATION_ERR_252 DET_ELEVATION_252 DET_AZIMUTH_ERR_252 DET_AZIMUTH_252 DET_RANGE_VELOCITY_ERR_252 DET_RANGE_VELOCITY_252 DET_RANGE_ERR_252 DET_RANGE_252;
SIG_GROUP_ 1215 Detections_253_256 1 : DET_MH_CRC16_253_256 DET_MH_CYCLE_COUNTER_253_256 DET_MH_SCAN_INDEX_4LSB_253_256 DET_CONFD_ELEVATION_253 DET_CONFD_AZIMUTH_253 DET_HVC_FLAG_253 DET_OUTSIDE_SECTOR_253 DET_EXISTENCE_PROB_253 DET_POINT_TARGET_PROB_253 DET_SNR_253 DET_SUPER_RES_TARGET_253 DET_BI_STATIC_FLAG_253 DET_VALID_FLAG_253 DET_RCS_253 DET_ELEVATION_ERR_253 DET_ELEVATION_253 DET_AZIMUTH_ERR_253 DET_AZIMUTH_253 DET_RANGE_VELOCITY_ERR_253 DET_RANGE_VELOCITY_253 DET_RANGE_ERR_253 DET_RANGE_253 DET_CONFD_ELEVATION_254 DET_CONFD_AZIMUTH_254 DET_HVC_FLAG_254 DET_OUTSIDE_SECTOR_254 DET_EXISTENCE_PROB_254 DET_POINT_TARGET_PROB_254 DET_SNR_254 DET_SUPER_RES_TARGET_254 DET_BI_STATIC_FLAG_254 DET_VALID_FLAG_254 DET_RCS_254 DET_ELEVATION_254 DET_ELEVATION_ERR_254 DET_AZIMUTH_ERR_254 DET_AZIMUTH_254 DET_RANGE_VELOCITY_ERR_254 DET_RANGE_VELOCITY_254 DET_RANGE_ERR_254 DET_RANGE_254 DET_CONFD_ELEVATION_255 DET_CONFD_AZIMUTH_255 DET_HVC_FLAG_255 DET_OUTSIDE_SECTOR_255 DET_EXISTENCE_PROB_255 DET_POINT_TARGET_PROB_255 DET_SUPER_RES_TARGET_255 DET_BI_STATIC_FLAG_255 DET_VALID_FLAG_255 DET_RCS_255 DET_ELEVATION_255 DET_SNR_255 DET_ELEVATION_ERR_255 DET_AZIMUTH_ERR_255 DET_RANGE_VELOCITY_ERR_255 DET_AZIMUTH_255 DET_RANGE_VELOCITY_255 DET_RANGE_ERR_255 DET_RANGE_255 DET_BI_STATIC_FLAG_256 DET_CONFD_ELEVATION_256 DET_CONFD_AZIMUTH_256 DET_HVC_FLAG_256 DET_OUTSIDE_SECTOR_256 DET_EXISTENCE_PROB_256 DET_POINT_TARGET_PROB_256 DET_SNR_256 DET_SUPER_RES_TARGET_256 DET_VALID_FLAG_256 DET_RCS_256 DET_ELEVATION_ERR_256 DET_ELEVATION_256 DET_AZIMUTH_ERR_256 DET_AZIMUTH_256 DET_RANGE_VELOCITY_ERR_256 DET_RANGE_VELOCITY_256 DET_RANGE_ERR_256 DET_RANGE_256;

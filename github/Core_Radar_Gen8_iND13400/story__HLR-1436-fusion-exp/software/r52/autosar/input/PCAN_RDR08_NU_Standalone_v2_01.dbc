VERSION "created by canmatrix"

NS_ :

BS_:

BU_: External_Tool ADAS RDR08

BO_ 1745 RDR_TRACKER_OBJ_002: 64 RDR08
 SG_ OBJ_ALIVE_TIME_002 : 255|16@0+ (1,0) [0|65535] "ms" ADAS
 SG_ OBJ_ACCELERATION_LONG_ERR_002 : 215|8@0+ (0.025,0) [0|6.375] "m/s^2" ADAS
 SG_ OBJ_ACCELERATION_LAT_ERR_002 : 223|8@0+ (0.025,0) [0|6.375] "m/s^2" ADAS
 SG_ OBJ_VELOCITY_LONG_ERR_002 : 143|8@0+ (0.05,0) [0|12.75] "m/s" ADAS
 SG_ OBJ_VELOCITY_LAT_ERR_002 : 151|8@0+ (0.05,0) [0|12.75] "m/s" ADAS
 SG_ OBJ_POS_LONG_ERR_002 : 95|8@0+ (0.025,0) [0|6.375] "m" ADAS
 SG_ OBJ_POS_LAT_ERR_002 : 103|8@0+ (0.025,0) [0|6.375] "m" ADAS
 SG_ OBJ_TRACK_MOTION_MODEL_002 : 9|2@0+ (1,0) [1|3] "NA" ADAS
 SG_ OBJ_DIMENSION_WIDTH_002 : 17|10@0+ (0.01,0) [0|10.23] "m" ADAS
 SG_ OBJ_DIMENSION_LENGTH_002 : 37|12@0+ (0.01,0) [0|40.95] "m" ADAS
 SG_ OBJ_EXISTENCE_PROB_002 : 229|14@0+ (0.0001,0) [0|1] "NA" ADAS
 SG_ OBJ_YAW_ANGLE_002 : 155|12@0+ (0.005,-10) [-10|10.475] "rad" ADAS
 SG_ OBJ_YAW_ANGLE_ERR_002 : 175|7@0+ (0.01,0) [0|1.27] "rad" ADAS
 SG_ OBJ_ID_002 : 7|8@0+ (1,0) [0|255] "NA" ADAS
 SG_ OBJ_MOVEMENT_STATUS_002 : 196|3@0+ (1,0) [0|3] "NA" ADAS
 SG_ OBJ_MEASUREMENT_STATUS_002 : 14|3@0+ (1,0) [0|7] "NA" ADAS
 SG_ OBJ_POS_LONG_002 : 63|16@0+ (0.01,-327) [-327|327] "m" ADAS
 SG_ OBJ_POS_LAT_002 : 79|16@0+ (0.01,-327) [-327|327] "m" ADAS
 SG_ OBJ_VELOCITY_LONG_002 : 110|15@0+ (0.01,-163) [-163|163] "m/s" ADAS
 SG_ OBJ_VELOCITY_LAT_002 : 126|15@0+ (0.01,-163) [-163|163] "m/s" ADAS
 SG_ OBJ_ACCELERATION_LONG_002 : 193|10@0+ (0.05,-20) [-20|20] "m/s^2" ADAS
 SG_ OBJ_ACCELERATION_LAT_002 : 177|10@0+ (0.05,-20) [-20|20] "m/s^2" ADAS
 SG_ OBJ_VEH_TRACK_FLAG_002 : 10|1@0+ (1,0) [0|1] "NA" ADAS
 SG_ OBJ_MH_CYCLE_COUNTER_002 : 487|8@0+ (1,0) [0|255] "NA" ADAS
 SG_ OBJ_MH_CRC16_002 : 495|16@0+ (1,0) [0|65535] "NA" ADAS
 SG_ OBJ_TIMESTAMP_OFFSET_002 : 247|8@0+ (1,-127) [-127|128] "ms" ADAS
 SG_ OBJ_DIMENSION_WIDTH_ERR_002 : 23|6@0+ (0.01,0) [0|0.63] "m" ADAS
 SG_ OBJ_DIMENSION_LENGTH_ERR_002 : 41|10@0+ (0.01,0) [0|10.23] "m" ADAS
 SG_ OBJ_CLS_TYPE1_002 : 271|4@0+ (1,0) [0|15] "NA" ADAS
 SG_ OBJ_CLS_TYPE1_PROB_002 : 303|8@0+ (0.004,0) [0|1] "NA" ADAS
 SG_ OBJ_CLS_TYPE2_002 : 267|4@0+ (1,0) [0|15] "NA" ADAS
 SG_ OBJ_CLS_TYPE2_PROB_002 : 311|8@0+ (0.004,0) [0|1] "NA" ADAS
 SG_ OBJ_CLS_TYPE3_002 : 279|4@0+ (1,0) [0|15] "NA" ADAS
 SG_ OBJ_CLS_TYPE3_PROB_002 : 319|8@0+ (0.004,0) [0|1] "NA" ADAS
 SG_ OBJ_CLS_TYPE4_002 : 275|4@0+ (1,0) [0|15] "NA" ADAS
 SG_ OBJ_CLS_TYPE4_PROB_002 : 327|8@0+ (0.004,0) [0|1] "NA" ADAS
 SG_ OBJ_CLS_TYPE5_002 : 287|4@0+ (1,0) [0|15] "NA" ADAS
 SG_ OBJ_CLS_TYPE5_PROB_002 : 335|8@0+ (0.004,0) [0|1] "NA" ADAS
 SG_ OBJ_CLS_TYPE6_002 : 282|4@0+ (1,0) [0|15] "NA" ADAS
 SG_ OBJ_CLS_TYPE6_PROB_002 : 343|8@0+ (0.004,0) [0|1] "NA" ADAS
 SG_ OBJ_RCS_002 : 351|7@0+ (1,-64) [-64|63] "dBsm" ADAS
 SG_ OBJ_REF_PT_LONG_OFFSET_002 : 357|14@0+ (0.0001,0) [0|1] "NA" ADAS
 SG_ OBJ_REF_PT_LAT_OFFSET_002 : 370|14@0+ (0.0001,0) [0|1] "NA" ADAS
 SG_ OBJ_YAW_RATE_002 : 399|10@0+ (0.005,-2.24) [-2.24|2.24] "rad/s" ADAS
 SG_ OBJ_YAW_RATE_ERR_002 : 388|5@0+ (0.025,0) [0|0.775] "rad/s" ADAS
 SG_ OBJ_GROUP_ID_002 : 405|6@0+ (1,0) [0|63] "NA" ADAS
 SG_ OBJ_POS_ERR_CRR_COEF_002 : 415|8@0+ (0.01,-1.2) [-1.2|1] "NA" ADAS
 SG_ OBJ_VELOCITY_ERR_CRR_COEF_002 : 423|8@0+ (0.01,-1.2) [-1.2|1] "NA" ADAS
 SG_ OBJ_ACCEL_ERR_CRR_COEF_002 : 431|8@0+ (0.01,-1.2) [-1.2|1] "NA" ADAS

BO_ 1746 RDR_TRACKER_OBJ_003: 64 RDR08
 SG_ OBJ_ALIVE_TIME_003 : 255|16@0+ (1,0) [0|65535] "ms" ADAS
 SG_ OBJ_ACCELERATION_LONG_ERR_003 : 215|8@0+ (0.025,0) [0|6.375] "m/s^2" ADAS
 SG_ OBJ_ACCELERATION_LAT_ERR_003 : 223|8@0+ (0.025,0) [0|6.375] "m/s^2" ADAS
 SG_ OBJ_VELOCITY_LONG_ERR_003 : 143|8@0+ (0.05,0) [0|12.75] "m/s" ADAS
 SG_ OBJ_VELOCITY_LAT_ERR_003 : 151|8@0+ (0.05,0) [0|12.75] "m/s" ADAS
 SG_ OBJ_POS_LONG_ERR_003 : 95|8@0+ (0.025,0) [0|6.375] "m" ADAS
 SG_ OBJ_POS_LAT_ERR_003 : 103|8@0+ (0.025,0) [0|6.375] "m" ADAS
 SG_ OBJ_TRACK_MOTION_MODEL_003 : 9|2@0+ (1,0) [1|3] "NA" ADAS
 SG_ OBJ_DIMENSION_WIDTH_003 : 17|10@0+ (0.01,0) [0|10.23] "m" ADAS
 SG_ OBJ_DIMENSION_LENGTH_003 : 37|12@0+ (0.01,0) [0|40.95] "m" ADAS
 SG_ OBJ_EXISTENCE_PROB_003 : 229|14@0+ (0.0001,0) [0|1] "NA" ADAS
 SG_ OBJ_YAW_ANGLE_003 : 155|12@0+ (0.005,-10) [-10|10.475] "rad" ADAS
 SG_ OBJ_YAW_ANGLE_ERR_003 : 175|7@0+ (0.01,0) [0|1.27] "rad" ADAS
 SG_ OBJ_ID_003 : 7|8@0+ (1,0) [0|255] "NA" ADAS
 SG_ OBJ_MOVEMENT_STATUS_003 : 196|3@0+ (1,0) [0|3] "NA" ADAS
 SG_ OBJ_MEASUREMENT_STATUS_003 : 14|3@0+ (1,0) [0|7] "NA" ADAS
 SG_ OBJ_POS_LONG_003 : 63|16@0+ (0.01,-327) [-327|327] "m" ADAS
 SG_ OBJ_POS_LAT_003 : 79|16@0+ (0.01,-327) [-327|327] "m" ADAS
 SG_ OBJ_VELOCITY_LONG_003 : 110|15@0+ (0.01,-163) [-163|163] "m/s" ADAS
 SG_ OBJ_VELOCITY_LAT_003 : 126|15@0+ (0.01,-163) [-163|163] "m/s" ADAS
 SG_ OBJ_ACCELERATION_LONG_003 : 193|10@0+ (0.05,-20) [-20|20] "m/s^2" ADAS
 SG_ OBJ_ACCELERATION_LAT_003 : 177|10@0+ (0.05,-20) [-20|20] "m/s^2" ADAS
 SG_ OBJ_VEH_TRACK_FLAG_003 : 10|1@0+ (1,0) [0|1] "NA" ADAS
 SG_ OBJ_MH_CYCLE_COUNTER_003 : 487|8@0+ (1,0) [0|255] "NA" ADAS
 SG_ OBJ_MH_CRC16_003 : 495|16@0+ (1,0) [0|65535] "NA" ADAS
 SG_ OBJ_TIMESTAMP_OFFSET_003 : 247|8@0+ (1,-127) [-127|128] "ms" ADAS
 SG_ OBJ_DIMENSION_WIDTH_ERR_003 : 23|6@0+ (0.01,0) [0|0.63] "m" ADAS
 SG_ OBJ_DIMENSION_LENGTH_ERR_003 : 41|10@0+ (0.01,0) [0|10.23] "m" ADAS
 SG_ OBJ_CLS_TYPE1_003 : 271|4@0+ (1,0) [0|15] "NA" ADAS
 SG_ OBJ_CLS_TYPE1_PROB_003 : 303|8@0+ (0.004,0) [0|1] "NA" ADAS
 SG_ OBJ_CLS_TYPE2_003 : 267|4@0+ (1,0) [0|15] "NA" ADAS
 SG_ OBJ_CLS_TYPE2_PROB_003 : 311|8@0+ (0.004,0) [0|1] "NA" ADAS
 SG_ OBJ_CLS_TYPE3_003 : 279|4@0+ (1,0) [0|15] "NA" ADAS
 SG_ OBJ_CLS_TYPE3_PROB_003 : 319|8@0+ (0.004,0) [0|1] "NA" ADAS
 SG_ OBJ_CLS_TYPE4_003 : 275|4@0+ (1,0) [0|15] "NA" ADAS
 SG_ OBJ_CLS_TYPE4_PROB_003 : 327|8@0+ (0.004,0) [0|1] "NA" ADAS
 SG_ OBJ_CLS_TYPE5_003 : 287|4@0+ (1,0) [0|15] "NA" ADAS
 SG_ OBJ_CLS_TYPE5_PROB_003 : 335|8@0+ (0.004,0) [0|1] "NA" ADAS
 SG_ OBJ_CLS_TYPE6_003 : 282|4@0+ (1,0) [0|15] "NA" ADAS
 SG_ OBJ_CLS_TYPE6_PROB_003 : 343|8@0+ (0.004,0) [0|1] "NA" ADAS
 SG_ OBJ_RCS_003 : 351|7@0+ (1,-64) [-64|63] "dBsm" ADAS
 SG_ OBJ_REF_PT_LONG_OFFSET_003 : 357|14@0+ (0.0001,0) [0|1] "NA" ADAS
 SG_ OBJ_REF_PT_LAT_OFFSET_003 : 370|14@0+ (0.0001,0) [0|1] "NA" ADAS
 SG_ OBJ_YAW_RATE_003 : 399|10@0+ (0.005,-2.24) [-2.24|2.24] "rad/s" ADAS
 SG_ OBJ_YAW_RATE_ERR_003 : 388|5@0+ (0.025,0) [0|0.775] "rad/s" ADAS
 SG_ OBJ_GROUP_ID_003 : 405|6@0+ (1,0) [0|63] "NA" ADAS
 SG_ OBJ_POS_ERR_CRR_COEF_003 : 415|8@0+ (0.01,-1.2) [-1.2|1] "NA" ADAS
 SG_ OBJ_VELOCITY_ERR_CRR_COEF_003 : 423|8@0+ (0.01,-1.2) [-1.2|1] "NA" ADAS
 SG_ OBJ_ACCEL_ERR_CRR_COEF_003 : 431|8@0+ (0.01,-1.2) [-1.2|1] "NA" ADAS

BO_ 1747 RDR_TRACKER_OBJ_004: 64 RDR08
 SG_ OBJ_ALIVE_TIME_004 : 255|16@0+ (1,0) [0|65535] "ms" ADAS
 SG_ OBJ_ACCELERATION_LONG_ERR_004 : 215|8@0+ (0.025,0) [0|6.375] "m/s^2" ADAS
 SG_ OBJ_ACCELERATION_LAT_ERR_004 : 223|8@0+ (0.025,0) [0|6.375] "m/s^2" ADAS
 SG_ OBJ_VELOCITY_LONG_ERR_004 : 143|8@0+ (0.05,0) [0|12.75] "m/s" ADAS
 SG_ OBJ_VELOCITY_LAT_ERR_004 : 151|8@0+ (0.05,0) [0|12.75] "m/s" ADAS
 SG_ OBJ_POS_LONG_ERR_004 : 95|8@0+ (0.025,0) [0|6.375] "m" ADAS
 SG_ OBJ_POS_LAT_ERR_004 : 103|8@0+ (0.025,0) [0|6.375] "m" ADAS
 SG_ OBJ_TRACK_MOTION_MODEL_004 : 9|2@0+ (1,0) [1|3] "NA" ADAS
 SG_ OBJ_DIMENSION_WIDTH_004 : 17|10@0+ (0.01,0) [0|10.23] "m" ADAS
 SG_ OBJ_DIMENSION_LENGTH_004 : 37|12@0+ (0.01,0) [0|40.95] "m" ADAS
 SG_ OBJ_EXISTENCE_PROB_004 : 229|14@0+ (0.0001,0) [0|1] "NA" ADAS
 SG_ OBJ_YAW_ANGLE_004 : 155|12@0+ (0.005,-10) [-10|10.475] "rad" ADAS
 SG_ OBJ_YAW_ANGLE_ERR_004 : 175|7@0+ (0.01,0) [0|1.27] "rad" ADAS
 SG_ OBJ_ID_004 : 7|8@0+ (1,0) [0|255] "NA" ADAS
 SG_ OBJ_MOVEMENT_STATUS_004 : 196|3@0+ (1,0) [0|3] "NA" ADAS
 SG_ OBJ_MEASUREMENT_STATUS_004 : 14|3@0+ (1,0) [0|7] "NA" ADAS
 SG_ OBJ_POS_LONG_004 : 63|16@0+ (0.01,-327) [-327|327] "m" ADAS
 SG_ OBJ_POS_LAT_004 : 79|16@0+ (0.01,-327) [-327|327] "m" ADAS
 SG_ OBJ_VELOCITY_LONG_004 : 110|15@0+ (0.01,-163) [-163|163] "m/s" ADAS
 SG_ OBJ_VELOCITY_LAT_004 : 126|15@0+ (0.01,-163) [-163|163] "m/s" ADAS
 SG_ OBJ_ACCELERATION_LONG_004 : 193|10@0+ (0.05,-20) [-20|20] "m/s^2" ADAS
 SG_ OBJ_ACCELERATION_LAT_004 : 177|10@0+ (0.05,-20) [-20|20] "m/s^2" ADAS
 SG_ OBJ_VEH_TRACK_FLAG_004 : 10|1@0+ (1,0) [0|1] "NA" ADAS
 SG_ OBJ_MH_CYCLE_COUNTER_004 : 487|8@0+ (1,0) [0|255] "NA" ADAS
 SG_ OBJ_MH_CRC16_004 : 495|16@0+ (1,0) [0|65535] "NA" ADAS
 SG_ OBJ_TIMESTAMP_OFFSET_004 : 247|8@0+ (1,-127) [-127|128] "ms" ADAS
 SG_ OBJ_DIMENSION_WIDTH_ERR_004 : 23|6@0+ (0.01,0) [0|0.63] "m" ADAS
 SG_ OBJ_DIMENSION_LENGTH_ERR_004 : 41|10@0+ (0.01,0) [0|10.23] "m" ADAS
 SG_ OBJ_CLS_TYPE1_004 : 271|4@0+ (1,0) [0|15] "NA" ADAS
 SG_ OBJ_CLS_TYPE1_PROB_004 : 303|8@0+ (0.004,0) [0|1] "NA" ADAS
 SG_ OBJ_CLS_TYPE2_004 : 267|4@0+ (1,0) [0|15] "NA" ADAS
 SG_ OBJ_CLS_TYPE2_PROB_004 : 311|8@0+ (0.004,0) [0|1] "NA" ADAS
 SG_ OBJ_CLS_TYPE3_004 : 279|4@0+ (1,0) [0|15] "NA" ADAS
 SG_ OBJ_CLS_TYPE3_PROB_004 : 319|8@0+ (0.004,0) [0|1] "NA" ADAS
 SG_ OBJ_CLS_TYPE4_004 : 275|4@0+ (1,0) [0|15] "NA" ADAS
 SG_ OBJ_CLS_TYPE4_PROB_004 : 327|8@0+ (0.004,0) [0|1] "NA" ADAS
 SG_ OBJ_CLS_TYPE5_004 : 287|4@0+ (1,0) [0|15] "NA" ADAS
 SG_ OBJ_CLS_TYPE5_PROB_004 : 335|8@0+ (0.004,0) [0|1] "NA" ADAS
 SG_ OBJ_CLS_TYPE6_004 : 282|4@0+ (1,0) [0|15] "NA" ADAS
 SG_ OBJ_CLS_TYPE6_PROB_004 : 343|8@0+ (0.004,0) [0|1] "NA" ADAS
 SG_ OBJ_RCS_004 : 351|7@0+ (1,-64) [-64|63] "dBsm" ADAS
 SG_ OBJ_REF_PT_LONG_OFFSET_004 : 357|14@0+ (0.0001,0) [0|1] "NA" ADAS
 SG_ OBJ_REF_PT_LAT_OFFSET_004 : 370|14@0+ (0.0001,0) [0|1] "NA" ADAS
 SG_ OBJ_YAW_RATE_004 : 399|10@0+ (0.005,-2.24) [-2.24|2.24] "rad/s" ADAS
 SG_ OBJ_YAW_RATE_ERR_004 : 388|5@0+ (0.025,0) [0|0.775] "rad/s" ADAS
 SG_ OBJ_GROUP_ID_004 : 405|6@0+ (1,0) [0|63] "NA" ADAS
 SG_ OBJ_POS_ERR_CRR_COEF_004 : 415|8@0+ (0.01,-1.2) [-1.2|1] "NA" ADAS
 SG_ OBJ_VELOCITY_ERR_CRR_COEF_004 : 423|8@0+ (0.01,-1.2) [-1.2|1] "NA" ADAS
 SG_ OBJ_ACCEL_ERR_CRR_COEF_004 : 431|8@0+ (0.01,-1.2) [-1.2|1] "NA" ADAS

BO_ 1748 RDR_TRACKER_OBJ_005: 64 RDR08
 SG_ OBJ_ALIVE_TIME_005 : 255|16@0+ (1,0) [0|65535] "ms" ADAS
 SG_ OBJ_ACCELERATION_LONG_ERR_005 : 215|8@0+ (0.025,0) [0|6.375] "m/s^2" ADAS
 SG_ OBJ_ACCELERATION_LAT_ERR_005 : 223|8@0+ (0.025,0) [0|6.375] "m/s^2" ADAS
 SG_ OBJ_VELOCITY_LONG_ERR_005 : 143|8@0+ (0.05,0) [0|12.75] "m/s" ADAS
 SG_ OBJ_VELOCITY_LAT_ERR_005 : 151|8@0+ (0.05,0) [0|12.75] "m/s" ADAS
 SG_ OBJ_POS_LONG_ERR_005 : 95|8@0+ (0.025,0) [0|6.375] "m" ADAS
 SG_ OBJ_POS_LAT_ERR_005 : 103|8@0+ (0.025,0) [0|6.375] "m" ADAS
 SG_ OBJ_TRACK_MOTION_MODEL_005 : 9|2@0+ (1,0) [1|3] "NA" ADAS
 SG_ OBJ_DIMENSION_WIDTH_005 : 17|10@0+ (0.01,0) [0|10.23] "m" ADAS
 SG_ OBJ_DIMENSION_LENGTH_005 : 37|12@0+ (0.01,0) [0|40.95] "m" ADAS
 SG_ OBJ_EXISTENCE_PROB_005 : 229|14@0+ (0.0001,0) [0|1] "NA" ADAS
 SG_ OBJ_YAW_ANGLE_005 : 155|12@0+ (0.005,-10) [-10|10.475] "rad" ADAS
 SG_ OBJ_YAW_ANGLE_ERR_005 : 175|7@0+ (0.01,0) [0|1.27] "rad" ADAS
 SG_ OBJ_ID_005 : 7|8@0+ (1,0) [0|255] "NA" ADAS
 SG_ OBJ_MOVEMENT_STATUS_005 : 196|3@0+ (1,0) [0|3] "NA" ADAS
 SG_ OBJ_MEASUREMENT_STATUS_005 : 14|3@0+ (1,0) [0|7] "NA" ADAS
 SG_ OBJ_POS_LONG_005 : 63|16@0+ (0.01,-327) [-327|327] "m" ADAS
 SG_ OBJ_POS_LAT_005 : 79|16@0+ (0.01,-327) [-327|327] "m" ADAS
 SG_ OBJ_VELOCITY_LONG_005 : 110|15@0+ (0.01,-163) [-163|163] "m/s" ADAS
 SG_ OBJ_VELOCITY_LAT_005 : 126|15@0+ (0.01,-163) [-163|163] "m/s" ADAS
 SG_ OBJ_ACCELERATION_LONG_005 : 193|10@0+ (0.05,-20) [-20|20] "m/s^2" ADAS
 SG_ OBJ_ACCELERATION_LAT_005 : 177|10@0+ (0.05,-20) [-20|20] "m/s^2" ADAS
 SG_ OBJ_VEH_TRACK_FLAG_005 : 10|1@0+ (1,0) [0|1] "NA" ADAS
 SG_ OBJ_MH_CYCLE_COUNTER_005 : 487|8@0+ (1,0) [0|255] "NA" ADAS
 SG_ OBJ_MH_CRC16_005 : 495|16@0+ (1,0) [0|65535] "NA" ADAS
 SG_ OBJ_TIMESTAMP_OFFSET_005 : 247|8@0+ (1,-127) [-127|128] "ms" ADAS
 SG_ OBJ_DIMENSION_WIDTH_ERR_005 : 23|6@0+ (0.01,0) [0|0.63] "m" ADAS
 SG_ OBJ_DIMENSION_LENGTH_ERR_005 : 41|10@0+ (0.01,0) [0|10.23] "m" ADAS
 SG_ OBJ_CLS_TYPE1_005 : 271|4@0+ (1,0) [0|15] "NA" ADAS
 SG_ OBJ_CLS_TYPE1_PROB_005 : 303|8@0+ (0.004,0) [0|1] "NA" ADAS
 SG_ OBJ_CLS_TYPE2_005 : 267|4@0+ (1,0) [0|15] "NA" ADAS
 SG_ OBJ_CLS_TYPE2_PROB_005 : 311|8@0+ (0.004,0) [0|1] "NA" ADAS
 SG_ OBJ_CLS_TYPE3_005 : 279|4@0+ (1,0) [0|15] "NA" ADAS
 SG_ OBJ_CLS_TYPE3_PROB_005 : 319|8@0+ (0.004,0) [0|1] "NA" ADAS
 SG_ OBJ_CLS_TYPE4_005 : 275|4@0+ (1,0) [0|15] "NA" ADAS
 SG_ OBJ_CLS_TYPE4_PROB_005 : 327|8@0+ (0.004,0) [0|1] "NA" ADAS
 SG_ OBJ_CLS_TYPE5_005 : 287|4@0+ (1,0) [0|15] "NA" ADAS
 SG_ OBJ_CLS_TYPE5_PROB_005 : 335|8@0+ (0.004,0) [0|1] "NA" ADAS
 SG_ OBJ_CLS_TYPE6_005 : 282|4@0+ (1,0) [0|15] "NA" ADAS
 SG_ OBJ_CLS_TYPE6_PROB_005 : 343|8@0+ (0.004,0) [0|1] "NA" ADAS
 SG_ OBJ_RCS_005 : 351|7@0+ (1,-64) [-64|63] "dBsm" ADAS
 SG_ OBJ_REF_PT_LONG_OFFSET_005 : 357|14@0+ (0.0001,0) [0|1] "NA" ADAS
 SG_ OBJ_REF_PT_LAT_OFFSET_005 : 370|14@0+ (0.0001,0) [0|1] "NA" ADAS
 SG_ OBJ_YAW_RATE_005 : 399|10@0+ (0.005,-2.24) [-2.24|2.24] "rad/s" ADAS
 SG_ OBJ_YAW_RATE_ERR_005 : 388|5@0+ (0.025,0) [0|0.775] "rad/s" ADAS
 SG_ OBJ_GROUP_ID_005 : 405|6@0+ (1,0) [0|63] "NA" ADAS
 SG_ OBJ_POS_ERR_CRR_COEF_005 : 415|8@0+ (0.01,-1.2) [-1.2|1] "NA" ADAS
 SG_ OBJ_VELOCITY_ERR_CRR_COEF_005 : 423|8@0+ (0.01,-1.2) [-1.2|1] "NA" ADAS
 SG_ OBJ_ACCEL_ERR_CRR_COEF_005 : 431|8@0+ (0.01,-1.2) [-1.2|1] "NA" ADAS

BO_ 1749 RDR_TRACKER_OBJ_006: 64 RDR08
 SG_ OBJ_ALIVE_TIME_006 : 255|16@0+ (1,0) [0|65535] "ms" ADAS
 SG_ OBJ_ACCELERATION_LONG_ERR_006 : 215|8@0+ (0.025,0) [0|6.375] "m/s^2" ADAS
 SG_ OBJ_ACCELERATION_LAT_ERR_006 : 223|8@0+ (0.025,0) [0|6.375] "m/s^2" ADAS
 SG_ OBJ_VELOCITY_LONG_ERR_006 : 143|8@0+ (0.05,0) [0|12.75] "m/s" ADAS
 SG_ OBJ_VELOCITY_LAT_ERR_006 : 151|8@0+ (0.05,0) [0|12.75] "m/s" ADAS
 SG_ OBJ_POS_LONG_ERR_006 : 95|8@0+ (0.025,0) [0|6.375] "m" ADAS
 SG_ OBJ_POS_LAT_ERR_006 : 103|8@0+ (0.025,0) [0|6.375] "m" ADAS
 SG_ OBJ_TRACK_MOTION_MODEL_006 : 9|2@0+ (1,0) [1|3] "NA" ADAS
 SG_ OBJ_DIMENSION_WIDTH_006 : 17|10@0+ (0.01,0) [0|10.23] "m" ADAS
 SG_ OBJ_DIMENSION_LENGTH_006 : 37|12@0+ (0.01,0) [0|40.95] "m" ADAS
 SG_ OBJ_EXISTENCE_PROB_006 : 229|14@0+ (0.0001,0) [0|1] "NA" ADAS
 SG_ OBJ_YAW_ANGLE_006 : 155|12@0+ (0.005,-10) [-10|10.475] "rad" ADAS
 SG_ OBJ_YAW_ANGLE_ERR_006 : 175|7@0+ (0.01,0) [0|1.27] "rad" ADAS
 SG_ OBJ_ID_006 : 7|8@0+ (1,0) [0|255] "NA" ADAS
 SG_ OBJ_MOVEMENT_STATUS_006 : 196|3@0+ (1,0) [0|3] "NA" ADAS
 SG_ OBJ_MEASUREMENT_STATUS_006 : 14|3@0+ (1,0) [0|7] "NA" ADAS
 SG_ OBJ_POS_LONG_006 : 63|16@0+ (0.01,-327) [-327|327] "m" ADAS
 SG_ OBJ_POS_LAT_006 : 79|16@0+ (0.01,-327) [-327|327] "m" ADAS
 SG_ OBJ_VELOCITY_LONG_006 : 110|15@0+ (0.01,-163) [-163|163] "m/s" ADAS
 SG_ OBJ_VELOCITY_LAT_006 : 126|15@0+ (0.01,-163) [-163|163] "m/s" ADAS
 SG_ OBJ_ACCELERATION_LONG_006 : 193|10@0+ (0.05,-20) [-20|20] "m/s^2" ADAS
 SG_ OBJ_ACCELERATION_LAT_006 : 177|10@0+ (0.05,-20) [-20|20] "m/s^2" ADAS
 SG_ OBJ_VEH_TRACK_FLAG_006 : 10|1@0+ (1,0) [0|1] "NA" ADAS
 SG_ OBJ_MH_CYCLE_COUNTER_006 : 487|8@0+ (1,0) [0|255] "NA" ADAS
 SG_ OBJ_MH_CRC16_006 : 495|16@0+ (1,0) [0|65535] "NA" ADAS
 SG_ OBJ_TIMESTAMP_OFFSET_006 : 247|8@0+ (1,-127) [-127|128] "ms" ADAS
 SG_ OBJ_DIMENSION_WIDTH_ERR_006 : 23|6@0+ (0.01,0) [0|0.63] "m" ADAS
 SG_ OBJ_DIMENSION_LENGTH_ERR_006 : 41|10@0+ (0.01,0) [0|10.23] "m" ADAS
 SG_ OBJ_CLS_TYPE1_006 : 271|4@0+ (1,0) [0|15] "NA" ADAS
 SG_ OBJ_CLS_TYPE1_PROB_006 : 303|8@0+ (0.004,0) [0|1] "NA" ADAS
 SG_ OBJ_CLS_TYPE2_006 : 267|4@0+ (1,0) [0|15] "NA" ADAS
 SG_ OBJ_CLS_TYPE2_PROB_006 : 311|8@0+ (0.004,0) [0|1] "NA" ADAS
 SG_ OBJ_CLS_TYPE3_006 : 279|4@0+ (1,0) [0|15] "NA" ADAS
 SG_ OBJ_CLS_TYPE3_PROB_006 : 319|8@0+ (0.004,0) [0|1] "NA" ADAS
 SG_ OBJ_CLS_TYPE4_006 : 275|4@0+ (1,0) [0|15] "NA" ADAS
 SG_ OBJ_CLS_TYPE4_PROB_006 : 327|8@0+ (0.004,0) [0|1] "NA" ADAS
 SG_ OBJ_CLS_TYPE5_006 : 287|4@0+ (1,0) [0|15] "NA" ADAS
 SG_ OBJ_CLS_TYPE5_PROB_006 : 335|8@0+ (0.004,0) [0|1] "NA" ADAS
 SG_ OBJ_CLS_TYPE6_006 : 282|4@0+ (1,0) [0|15] "NA" ADAS
 SG_ OBJ_CLS_TYPE6_PROB_006 : 343|8@0+ (0.004,0) [0|1] "NA" ADAS
 SG_ OBJ_RCS_006 : 351|7@0+ (1,-64) [-64|63] "dBsm" ADAS
 SG_ OBJ_REF_PT_LONG_OFFSET_006 : 357|14@0+ (0.0001,0) [0|1] "NA" ADAS
 SG_ OBJ_REF_PT_LAT_OFFSET_006 : 370|14@0+ (0.0001,0) [0|1] "NA" ADAS
 SG_ OBJ_YAW_RATE_006 : 399|10@0+ (0.005,-2.24) [-2.24|2.24] "rad/s" ADAS
 SG_ OBJ_YAW_RATE_ERR_006 : 388|5@0+ (0.025,0) [0|0.775] "rad/s" ADAS
 SG_ OBJ_GROUP_ID_006 : 405|6@0+ (1,0) [0|63] "NA" ADAS
 SG_ OBJ_POS_ERR_CRR_COEF_006 : 415|8@0+ (0.01,-1.2) [-1.2|1] "NA" ADAS
 SG_ OBJ_VELOCITY_ERR_CRR_COEF_006 : 423|8@0+ (0.01,-1.2) [-1.2|1] "NA" ADAS
 SG_ OBJ_ACCEL_ERR_CRR_COEF_006 : 431|8@0+ (0.01,-1.2) [-1.2|1] "NA" ADAS

BO_ 1750 RDR_TRACKER_OBJ_007: 64 RDR08
 SG_ OBJ_ALIVE_TIME_007 : 255|16@0+ (1,0) [0|65535] "ms" ADAS
 SG_ OBJ_ACCELERATION_LONG_ERR_007 : 215|8@0+ (0.025,0) [0|6.375] "m/s^2" ADAS
 SG_ OBJ_ACCELERATION_LAT_ERR_007 : 223|8@0+ (0.025,0) [0|6.375] "m/s^2" ADAS
 SG_ OBJ_VELOCITY_LONG_ERR_007 : 143|8@0+ (0.05,0) [0|12.75] "m/s" ADAS
 SG_ OBJ_VELOCITY_LAT_ERR_007 : 151|8@0+ (0.05,0) [0|12.75] "m/s" ADAS
 SG_ OBJ_POS_LONG_ERR_007 : 95|8@0+ (0.025,0) [0|6.375] "m" ADAS
 SG_ OBJ_POS_LAT_ERR_007 : 103|8@0+ (0.025,0) [0|6.375] "m" ADAS
 SG_ OBJ_TRACK_MOTION_MODEL_007 : 9|2@0+ (1,0) [1|3] "NA" ADAS
 SG_ OBJ_DIMENSION_WIDTH_007 : 17|10@0+ (0.01,0) [0|10.23] "m" ADAS
 SG_ OBJ_DIMENSION_LENGTH_007 : 37|12@0+ (0.01,0) [0|40.95] "m" ADAS
 SG_ OBJ_EXISTENCE_PROB_007 : 229|14@0+ (0.0001,0) [0|1] "NA" ADAS
 SG_ OBJ_YAW_ANGLE_007 : 155|12@0+ (0.005,-10) [-10|10.475] "rad" ADAS
 SG_ OBJ_YAW_ANGLE_ERR_007 : 175|7@0+ (0.01,0) [0|1.27] "rad" ADAS
 SG_ OBJ_ID_007 : 7|8@0+ (1,0) [0|255] "NA" ADAS
 SG_ OBJ_MOVEMENT_STATUS_007 : 196|3@0+ (1,0) [0|3] "NA" ADAS
 SG_ OBJ_MEASUREMENT_STATUS_007 : 14|3@0+ (1,0) [0|7] "NA" ADAS
 SG_ OBJ_POS_LONG_007 : 63|16@0+ (0.01,-327) [-327|327] "m" ADAS
 SG_ OBJ_POS_LAT_007 : 79|16@0+ (0.01,-327) [-327|327] "m" ADAS
 SG_ OBJ_VELOCITY_LONG_007 : 110|15@0+ (0.01,-163) [-163|163] "m/s" ADAS
 SG_ OBJ_VELOCITY_LAT_007 : 126|15@0+ (0.01,-163) [-163|163] "m/s" ADAS
 SG_ OBJ_ACCELERATION_LONG_007 : 193|10@0+ (0.05,-20) [-20|20] "m/s^2" ADAS
 SG_ OBJ_ACCELERATION_LAT_007 : 177|10@0+ (0.05,-20) [-20|20] "m/s^2" ADAS
 SG_ OBJ_VEH_TRACK_FLAG_007 : 10|1@0+ (1,0) [0|1] "NA" ADAS
 SG_ OBJ_MH_CYCLE_COUNTER_007 : 487|8@0+ (1,0) [0|255] "NA" ADAS
 SG_ OBJ_MH_CRC16_007 : 495|16@0+ (1,0) [0|65535] "NA" ADAS
 SG_ OBJ_TIMESTAMP_OFFSET_007 : 247|8@0+ (1,-127) [-127|128] "ms" ADAS
 SG_ OBJ_DIMENSION_WIDTH_ERR_007 : 23|6@0+ (0.01,0) [0|0.63] "m" ADAS
 SG_ OBJ_DIMENSION_LENGTH_ERR_007 : 41|10@0+ (0.01,0) [0|10.23] "m" ADAS
 SG_ OBJ_CLS_TYPE1_007 : 271|4@0+ (1,0) [0|15] "NA" ADAS
 SG_ OBJ_CLS_TYPE1_PROB_007 : 303|8@0+ (0.004,0) [0|1] "NA" ADAS
 SG_ OBJ_CLS_TYPE2_007 : 267|4@0+ (1,0) [0|15] "NA" ADAS
 SG_ OBJ_CLS_TYPE2_PROB_007 : 311|8@0+ (0.004,0) [0|1] "NA" ADAS
 SG_ OBJ_CLS_TYPE3_007 : 279|4@0+ (1,0) [0|15] "NA" ADAS
 SG_ OBJ_CLS_TYPE3_PROB_007 : 319|8@0+ (0.004,0) [0|1] "NA" ADAS
 SG_ OBJ_CLS_TYPE4_007 : 275|4@0+ (1,0) [0|15] "NA" ADAS
 SG_ OBJ_CLS_TYPE4_PROB_007 : 327|8@0+ (0.004,0) [0|1] "NA" ADAS
 SG_ OBJ_CLS_TYPE5_007 : 287|4@0+ (1,0) [0|15] "NA" ADAS
 SG_ OBJ_CLS_TYPE5_PROB_007 : 335|8@0+ (0.004,0) [0|1] "NA" ADAS
 SG_ OBJ_CLS_TYPE6_007 : 282|4@0+ (1,0) [0|15] "NA" ADAS
 SG_ OBJ_CLS_TYPE6_PROB_007 : 343|8@0+ (0.004,0) [0|1] "NA" ADAS
 SG_ OBJ_RCS_007 : 351|7@0+ (1,-64) [-64|63] "dBsm" ADAS
 SG_ OBJ_REF_PT_LONG_OFFSET_007 : 357|14@0+ (0.0001,0) [0|1] "NA" ADAS
 SG_ OBJ_REF_PT_LAT_OFFSET_007 : 370|14@0+ (0.0001,0) [0|1] "NA" ADAS
 SG_ OBJ_YAW_RATE_007 : 399|10@0+ (0.005,-2.24) [-2.24|2.24] "rad/s" ADAS
 SG_ OBJ_YAW_RATE_ERR_007 : 388|5@0+ (0.025,0) [0|0.775] "rad/s" ADAS
 SG_ OBJ_GROUP_ID_007 : 405|6@0+ (1,0) [0|63] "NA" ADAS
 SG_ OBJ_POS_ERR_CRR_COEF_007 : 415|8@0+ (0.01,-1.2) [-1.2|1] "NA" ADAS
 SG_ OBJ_VELOCITY_ERR_CRR_COEF_007 : 423|8@0+ (0.01,-1.2) [-1.2|1] "NA" ADAS
 SG_ OBJ_ACCEL_ERR_CRR_COEF_007 : 431|8@0+ (0.01,-1.2) [-1.2|1] "NA" ADAS

BO_ 1751 RDR_TRACKER_OBJ_008: 64 RDR08
 SG_ OBJ_ALIVE_TIME_008 : 255|16@0+ (1,0) [0|65535] "ms" ADAS
 SG_ OBJ_ACCELERATION_LONG_ERR_008 : 215|8@0+ (0.025,0) [0|6.375] "m/s^2" ADAS
 SG_ OBJ_ACCELERATION_LAT_ERR_008 : 223|8@0+ (0.025,0) [0|6.375] "m/s^2" ADAS
 SG_ OBJ_VELOCITY_LONG_ERR_008 : 143|8@0+ (0.05,0) [0|12.75] "m/s" ADAS
 SG_ OBJ_VELOCITY_LAT_ERR_008 : 151|8@0+ (0.05,0) [0|12.75] "m/s" ADAS
 SG_ OBJ_POS_LONG_ERR_008 : 95|8@0+ (0.025,0) [0|6.375] "m" ADAS
 SG_ OBJ_POS_LAT_ERR_008 : 103|8@0+ (0.025,0) [0|6.375] "m" ADAS
 SG_ OBJ_TRACK_MOTION_MODEL_008 : 9|2@0+ (1,0) [1|3] "NA" ADAS
 SG_ OBJ_DIMENSION_WIDTH_008 : 17|10@0+ (0.01,0) [0|10.23] "m" ADAS
 SG_ OBJ_DIMENSION_LENGTH_008 : 37|12@0+ (0.01,0) [0|40.95] "m" ADAS
 SG_ OBJ_EXISTENCE_PROB_008 : 229|14@0+ (0.0001,0) [0|1] "NA" ADAS
 SG_ OBJ_YAW_ANGLE_008 : 155|12@0+ (0.005,-10) [-10|10.475] "rad" ADAS
 SG_ OBJ_YAW_ANGLE_ERR_008 : 175|7@0+ (0.01,0) [0|1.27] "rad" ADAS
 SG_ OBJ_ID_008 : 7|8@0+ (1,0) [0|255] "NA" ADAS
 SG_ OBJ_MOVEMENT_STATUS_008 : 196|3@0+ (1,0) [0|3] "NA" ADAS
 SG_ OBJ_MEASUREMENT_STATUS_008 : 14|3@0+ (1,0) [0|7] "NA" ADAS
 SG_ OBJ_POS_LONG_008 : 63|16@0+ (0.01,-327) [-327|327] "m" ADAS
 SG_ OBJ_POS_LAT_008 : 79|16@0+ (0.01,-327) [-327|327] "m" ADAS
 SG_ OBJ_VELOCITY_LONG_008 : 110|15@0+ (0.01,-163) [-163|163] "m/s" ADAS
 SG_ OBJ_VELOCITY_LAT_008 : 126|15@0+ (0.01,-163) [-163|163] "m/s" ADAS
 SG_ OBJ_ACCELERATION_LONG_008 : 193|10@0+ (0.05,-20) [-20|20] "m/s^2" ADAS
 SG_ OBJ_ACCELERATION_LAT_008 : 177|10@0+ (0.05,-20) [-20|20] "m/s^2" ADAS
 SG_ OBJ_VEH_TRACK_FLAG_008 : 10|1@0+ (1,0) [0|1] "NA" ADAS
 SG_ OBJ_MH_CYCLE_COUNTER_008 : 487|8@0+ (1,0) [0|255] "NA" ADAS
 SG_ OBJ_MH_CRC16_008 : 495|16@0+ (1,0) [0|65535] "NA" ADAS
 SG_ OBJ_TIMESTAMP_OFFSET_008 : 247|8@0+ (1,-127) [-127|128] "ms" ADAS
 SG_ OBJ_DIMENSION_WIDTH_ERR_008 : 23|6@0+ (0.01,0) [0|0.63] "m" ADAS
 SG_ OBJ_DIMENSION_LENGTH_ERR_008 : 41|10@0+ (0.01,0) [0|10.23] "m" ADAS
 SG_ OBJ_CLS_TYPE1_008 : 271|4@0+ (1,0) [0|15] "NA" ADAS
 SG_ OBJ_CLS_TYPE1_PROB_008 : 303|8@0+ (0.004,0) [0|1] "NA" ADAS
 SG_ OBJ_CLS_TYPE2_008 : 267|4@0+ (1,0) [0|15] "NA" ADAS
 SG_ OBJ_CLS_TYPE2_PROB_008 : 311|8@0+ (0.004,0) [0|1] "NA" ADAS
 SG_ OBJ_CLS_TYPE3_008 : 279|4@0+ (1,0) [0|15] "NA" ADAS
 SG_ OBJ_CLS_TYPE3_PROB_008 : 319|8@0+ (0.004,0) [0|1] "NA" ADAS
 SG_ OBJ_CLS_TYPE4_008 : 275|4@0+ (1,0) [0|15] "NA" ADAS
 SG_ OBJ_CLS_TYPE4_PROB_008 : 327|8@0+ (0.004,0) [0|1] "NA" ADAS
 SG_ OBJ_CLS_TYPE5_008 : 287|4@0+ (1,0) [0|15] "NA" ADAS
 SG_ OBJ_CLS_TYPE5_PROB_008 : 335|8@0+ (0.004,0) [0|1] "NA" ADAS
 SG_ OBJ_CLS_TYPE6_008 : 282|4@0+ (1,0) [0|15] "NA" ADAS
 SG_ OBJ_CLS_TYPE6_PROB_008 : 343|8@0+ (0.004,0) [0|1] "NA" ADAS
 SG_ OBJ_RCS_008 : 351|7@0+ (1,-64) [-64|63] "dBsm" ADAS
 SG_ OBJ_REF_PT_LONG_OFFSET_008 : 357|14@0+ (0.0001,0) [0|1] "NA" ADAS
 SG_ OBJ_REF_PT_LAT_OFFSET_008 : 370|14@0+ (0.0001,0) [0|1] "NA" ADAS
 SG_ OBJ_YAW_RATE_008 : 399|10@0+ (0.005,-2.24) [-2.24|2.24] "rad/s" ADAS
 SG_ OBJ_YAW_RATE_ERR_008 : 388|5@0+ (0.025,0) [0|0.775] "rad/s" ADAS
 SG_ OBJ_GROUP_ID_008 : 405|6@0+ (1,0) [0|63] "NA" ADAS
 SG_ OBJ_POS_ERR_CRR_COEF_008 : 415|8@0+ (0.01,-1.2) [-1.2|1] "NA" ADAS
 SG_ OBJ_VELOCITY_ERR_CRR_COEF_008 : 423|8@0+ (0.01,-1.2) [-1.2|1] "NA" ADAS
 SG_ OBJ_ACCEL_ERR_CRR_COEF_008 : 431|8@0+ (0.01,-1.2) [-1.2|1] "NA" ADAS

BO_ 1752 RDR_TRACKER_OBJ_009: 64 RDR08
 SG_ OBJ_ALIVE_TIME_009 : 255|16@0+ (1,0) [0|65535] "ms" ADAS
 SG_ OBJ_ACCELERATION_LONG_ERR_009 : 215|8@0+ (0.025,0) [0|6.375] "m/s^2" ADAS
 SG_ OBJ_ACCELERATION_LAT_ERR_009 : 223|8@0+ (0.025,0) [0|6.375] "m/s^2" ADAS
 SG_ OBJ_VELOCITY_LONG_ERR_009 : 143|8@0+ (0.05,0) [0|12.75] "m/s" ADAS
 SG_ OBJ_VELOCITY_LAT_ERR_009 : 151|8@0+ (0.05,0) [0|12.75] "m/s" ADAS
 SG_ OBJ_POS_LONG_ERR_009 : 95|8@0+ (0.025,0) [0|6.375] "m" ADAS
 SG_ OBJ_POS_LAT_ERR_009 : 103|8@0+ (0.025,0) [0|6.375] "m" ADAS
 SG_ OBJ_TRACK_MOTION_MODEL_009 : 9|2@0+ (1,0) [1|3] "NA" ADAS
 SG_ OBJ_DIMENSION_WIDTH_009 : 17|10@0+ (0.01,0) [0|10.23] "m" ADAS
 SG_ OBJ_DIMENSION_LENGTH_009 : 37|12@0+ (0.01,0) [0|40.95] "m" ADAS
 SG_ OBJ_EXISTENCE_PROB_009 : 229|14@0+ (0.0001,0) [0|1] "NA" ADAS
 SG_ OBJ_YAW_ANGLE_009 : 155|12@0+ (0.005,-10) [-10|10.475] "rad" ADAS
 SG_ OBJ_YAW_ANGLE_ERR_009 : 175|7@0+ (0.01,0) [0|1.27] "rad" ADAS
 SG_ OBJ_ID_009 : 7|8@0+ (1,0) [0|255] "NA" ADAS
 SG_ OBJ_MOVEMENT_STATUS_009 : 196|3@0+ (1,0) [0|3] "NA" ADAS
 SG_ OBJ_MEASUREMENT_STATUS_009 : 14|3@0+ (1,0) [0|7] "NA" ADAS
 SG_ OBJ_POS_LONG_009 : 63|16@0+ (0.01,-327) [-327|327] "m" ADAS
 SG_ OBJ_POS_LAT_009 : 79|16@0+ (0.01,-327) [-327|327] "m" ADAS
 SG_ OBJ_VELOCITY_LONG_009 : 110|15@0+ (0.01,-163) [-163|163] "m/s" ADAS
 SG_ OBJ_VELOCITY_LAT_009 : 126|15@0+ (0.01,-163) [-163|163] "m/s" ADAS
 SG_ OBJ_ACCELERATION_LONG_009 : 193|10@0+ (0.05,-20) [-20|20] "m/s^2" ADAS
 SG_ OBJ_ACCELERATION_LAT_009 : 177|10@0+ (0.05,-20) [-20|20] "m/s^2" ADAS
 SG_ OBJ_VEH_TRACK_FLAG_009 : 10|1@0+ (1,0) [0|1] "NA" ADAS
 SG_ OBJ_MH_CYCLE_COUNTER_009 : 487|8@0+ (1,0) [0|255] "NA" ADAS
 SG_ OBJ_MH_CRC16_009 : 495|16@0+ (1,0) [0|65535] "NA" ADAS
 SG_ OBJ_TIMESTAMP_OFFSET_009 : 247|8@0+ (1,-127) [-127|128] "ms" ADAS
 SG_ OBJ_DIMENSION_WIDTH_ERR_009 : 23|6@0+ (0.01,0) [0|0.63] "m" ADAS
 SG_ OBJ_DIMENSION_LENGTH_ERR_009 : 41|10@0+ (0.01,0) [0|10.23] "m" ADAS
 SG_ OBJ_CLS_TYPE1_009 : 271|4@0+ (1,0) [0|15] "NA" ADAS
 SG_ OBJ_CLS_TYPE1_PROB_009 : 303|8@0+ (0.004,0) [0|1] "NA" ADAS
 SG_ OBJ_CLS_TYPE2_009 : 267|4@0+ (1,0) [0|15] "NA" ADAS
 SG_ OBJ_CLS_TYPE2_PROB_009 : 311|8@0+ (0.004,0) [0|1] "NA" ADAS
 SG_ OBJ_CLS_TYPE3_009 : 279|4@0+ (1,0) [0|15] "NA" ADAS
 SG_ OBJ_CLS_TYPE3_PROB_009 : 319|8@0+ (0.004,0) [0|1] "NA" ADAS
 SG_ OBJ_CLS_TYPE4_009 : 275|4@0+ (1,0) [0|15] "NA" ADAS
 SG_ OBJ_CLS_TYPE4_PROB_009 : 327|8@0+ (0.004,0) [0|1] "NA" ADAS
 SG_ OBJ_CLS_TYPE5_009 : 287|4@0+ (1,0) [0|15] "NA" ADAS
 SG_ OBJ_CLS_TYPE5_PROB_009 : 335|8@0+ (0.004,0) [0|1] "NA" ADAS
 SG_ OBJ_CLS_TYPE6_009 : 282|4@0+ (1,0) [0|15] "NA" ADAS
 SG_ OBJ_CLS_TYPE6_PROB_009 : 343|8@0+ (0.004,0) [0|1] "NA" ADAS
 SG_ OBJ_RCS_009 : 351|7@0+ (1,-64) [-64|63] "dBsm" ADAS
 SG_ OBJ_REF_PT_LONG_OFFSET_009 : 357|14@0+ (0.0001,0) [0|1] "NA" ADAS
 SG_ OBJ_REF_PT_LAT_OFFSET_009 : 370|14@0+ (0.0001,0) [0|1] "NA" ADAS
 SG_ OBJ_YAW_RATE_009 : 399|10@0+ (0.005,-2.24) [-2.24|2.24] "rad/s" ADAS
 SG_ OBJ_YAW_RATE_ERR_009 : 388|5@0+ (0.025,0) [0|0.775] "rad/s" ADAS
 SG_ OBJ_GROUP_ID_009 : 405|6@0+ (1,0) [0|63] "NA" ADAS
 SG_ OBJ_POS_ERR_CRR_COEF_009 : 415|8@0+ (0.01,-1.2) [-1.2|1] "NA" ADAS
 SG_ OBJ_VELOCITY_ERR_CRR_COEF_009 : 423|8@0+ (0.01,-1.2) [-1.2|1] "NA" ADAS
 SG_ OBJ_ACCEL_ERR_CRR_COEF_009 : 431|8@0+ (0.01,-1.2) [-1.2|1] "NA" ADAS

BO_ 1753 RDR_TRACKER_OBJ_010: 64 RDR08
 SG_ OBJ_ALIVE_TIME_010 : 255|16@0+ (1,0) [0|65535] "ms" ADAS
 SG_ OBJ_ACCELERATION_LONG_ERR_010 : 215|8@0+ (0.025,0) [0|6.375] "m/s^2" ADAS
 SG_ OBJ_ACCELERATION_LAT_ERR_010 : 223|8@0+ (0.025,0) [0|6.375] "m/s^2" ADAS
 SG_ OBJ_VELOCITY_LONG_ERR_010 : 143|8@0+ (0.05,0) [0|12.75] "m/s" ADAS
 SG_ OBJ_VELOCITY_LAT_ERR_010 : 151|8@0+ (0.05,0) [0|12.75] "m/s" ADAS
 SG_ OBJ_POS_LONG_ERR_010 : 95|8@0+ (0.025,0) [0|6.375] "m" ADAS
 SG_ OBJ_POS_LAT_ERR_010 : 103|8@0+ (0.025,0) [0|6.375] "m" ADAS
 SG_ OBJ_TRACK_MOTION_MODEL_010 : 9|2@0+ (1,0) [1|3] "NA" ADAS
 SG_ OBJ_DIMENSION_WIDTH_010 : 17|10@0+ (0.01,0) [0|10.23] "m" ADAS
 SG_ OBJ_DIMENSION_LENGTH_010 : 37|12@0+ (0.01,0) [0|40.95] "m" ADAS
 SG_ OBJ_EXISTENCE_PROB_010 : 229|14@0+ (0.0001,0) [0|1] "NA" ADAS
 SG_ OBJ_YAW_ANGLE_010 : 155|12@0+ (0.005,-10) [-10|10.475] "rad" ADAS
 SG_ OBJ_YAW_ANGLE_ERR_010 : 175|7@0+ (0.01,0) [0|1.27] "rad" ADAS
 SG_ OBJ_ID_010 : 7|8@0+ (1,0) [0|255] "NA" ADAS
 SG_ OBJ_MOVEMENT_STATUS_010 : 196|3@0+ (1,0) [0|3] "NA" ADAS
 SG_ OBJ_MEASUREMENT_STATUS_010 : 14|3@0+ (1,0) [0|7] "NA" ADAS
 SG_ OBJ_POS_LONG_010 : 63|16@0+ (0.01,-327) [-327|327] "m" ADAS
 SG_ OBJ_POS_LAT_010 : 79|16@0+ (0.01,-327) [-327|327] "m" ADAS
 SG_ OBJ_VELOCITY_LONG_010 : 110|15@0+ (0.01,-163) [-163|163] "m/s" ADAS
 SG_ OBJ_VELOCITY_LAT_010 : 126|15@0+ (0.01,-163) [-163|163] "m/s" ADAS
 SG_ OBJ_ACCELERATION_LONG_010 : 193|10@0+ (0.05,-20) [-20|20] "m/s^2" ADAS
 SG_ OBJ_ACCELERATION_LAT_010 : 177|10@0+ (0.05,-20) [-20|20] "m/s^2" ADAS
 SG_ OBJ_VEH_TRACK_FLAG_010 : 10|1@0+ (1,0) [0|1] "NA" ADAS
 SG_ OBJ_MH_CYCLE_COUNTER_010 : 487|8@0+ (1,0) [0|255] "NA" ADAS
 SG_ OBJ_MH_CRC16_010 : 495|16@0+ (1,0) [0|65535] "NA" ADAS
 SG_ OBJ_TIMESTAMP_OFFSET_010 : 247|8@0+ (1,-127) [-127|128] "ms" ADAS
 SG_ OBJ_DIMENSION_WIDTH_ERR_010 : 23|6@0+ (0.01,0) [0|0.63] "m" ADAS
 SG_ OBJ_DIMENSION_LENGTH_ERR_010 : 41|10@0+ (0.01,0) [0|10.23] "m" ADAS
 SG_ OBJ_CLS_TYPE1_010 : 271|4@0+ (1,0) [0|15] "NA" ADAS
 SG_ OBJ_CLS_TYPE1_PROB_010 : 303|8@0+ (0.004,0) [0|1] "NA" ADAS
 SG_ OBJ_CLS_TYPE2_010 : 267|4@0+ (1,0) [0|15] "NA" ADAS
 SG_ OBJ_CLS_TYPE2_PROB_010 : 311|8@0+ (0.004,0) [0|1] "NA" ADAS
 SG_ OBJ_CLS_TYPE3_010 : 279|4@0+ (1,0) [0|15] "NA" ADAS
 SG_ OBJ_CLS_TYPE3_PROB_010 : 319|8@0+ (0.004,0) [0|1] "NA" ADAS
 SG_ OBJ_CLS_TYPE4_010 : 275|4@0+ (1,0) [0|15] "NA" ADAS
 SG_ OBJ_CLS_TYPE4_PROB_010 : 327|8@0+ (0.004,0) [0|1] "NA" ADAS
 SG_ OBJ_CLS_TYPE5_010 : 287|4@0+ (1,0) [0|15] "NA" ADAS
 SG_ OBJ_CLS_TYPE5_PROB_010 : 335|8@0+ (0.004,0) [0|1] "NA" ADAS
 SG_ OBJ_CLS_TYPE6_010 : 282|4@0+ (1,0) [0|15] "NA" ADAS
 SG_ OBJ_CLS_TYPE6_PROB_010 : 343|8@0+ (0.004,0) [0|1] "NA" ADAS
 SG_ OBJ_RCS_010 : 351|7@0+ (1,-64) [-64|63] "dBsm" ADAS
 SG_ OBJ_REF_PT_LONG_OFFSET_010 : 357|14@0+ (0.0001,0) [0|1] "NA" ADAS
 SG_ OBJ_REF_PT_LAT_OFFSET_010 : 370|14@0+ (0.0001,0) [0|1] "NA" ADAS
 SG_ OBJ_YAW_RATE_010 : 399|10@0+ (0.005,-2.24) [-2.24|2.24] "rad/s" ADAS
 SG_ OBJ_YAW_RATE_ERR_010 : 388|5@0+ (0.025,0) [0|0.775] "rad/s" ADAS
 SG_ OBJ_GROUP_ID_010 : 405|6@0+ (1,0) [0|63] "NA" ADAS
 SG_ OBJ_POS_ERR_CRR_COEF_010 : 415|8@0+ (0.01,-1.2) [-1.2|1] "NA" ADAS
 SG_ OBJ_VELOCITY_ERR_CRR_COEF_010 : 423|8@0+ (0.01,-1.2) [-1.2|1] "NA" ADAS
 SG_ OBJ_ACCEL_ERR_CRR_COEF_010 : 431|8@0+ (0.01,-1.2) [-1.2|1] "NA" ADAS

BO_ 1754 RDR_TRACKER_OBJ_011: 64 RDR08
 SG_ OBJ_ALIVE_TIME_011 : 255|16@0+ (1,0) [0|65535] "ms" ADAS
 SG_ OBJ_ACCELERATION_LONG_ERR_011 : 215|8@0+ (0.025,0) [0|6.375] "m/s^2" ADAS
 SG_ OBJ_ACCELERATION_LAT_ERR_011 : 223|8@0+ (0.025,0) [0|6.375] "m/s^2" ADAS
 SG_ OBJ_VELOCITY_LONG_ERR_011 : 143|8@0+ (0.05,0) [0|12.75] "m/s" ADAS
 SG_ OBJ_VELOCITY_LAT_ERR_011 : 151|8@0+ (0.05,0) [0|12.75] "m/s" ADAS
 SG_ OBJ_POS_LONG_ERR_011 : 95|8@0+ (0.025,0) [0|6.375] "m" ADAS
 SG_ OBJ_POS_LAT_ERR_011 : 103|8@0+ (0.025,0) [0|6.375] "m" ADAS
 SG_ OBJ_TRACK_MOTION_MODEL_011 : 9|2@0+ (1,0) [1|3] "NA" ADAS
 SG_ OBJ_DIMENSION_WIDTH_011 : 17|10@0+ (0.01,0) [0|10.23] "m" ADAS
 SG_ OBJ_DIMENSION_LENGTH_011 : 37|12@0+ (0.01,0) [0|40.95] "m" ADAS
 SG_ OBJ_EXISTENCE_PROB_011 : 229|14@0+ (0.0001,0) [0|1] "NA" ADAS
 SG_ OBJ_YAW_ANGLE_011 : 155|12@0+ (0.005,-10) [-10|10.475] "rad" ADAS
 SG_ OBJ_YAW_ANGLE_ERR_011 : 175|7@0+ (0.01,0) [0|1.27] "rad" ADAS
 SG_ OBJ_ID_011 : 7|8@0+ (1,0) [0|255] "NA" ADAS
 SG_ OBJ_MOVEMENT_STATUS_011 : 196|3@0+ (1,0) [0|3] "NA" ADAS
 SG_ OBJ_MEASUREMENT_STATUS_011 : 14|3@0+ (1,0) [0|7] "NA" ADAS
 SG_ OBJ_POS_LONG_011 : 63|16@0+ (0.01,-327) [-327|327] "m" ADAS
 SG_ OBJ_POS_LAT_011 : 79|16@0+ (0.01,-327) [-327|327] "m" ADAS
 SG_ OBJ_VELOCITY_LONG_011 : 110|15@0+ (0.01,-163) [-163|163] "m/s" ADAS
 SG_ OBJ_VELOCITY_LAT_011 : 126|15@0+ (0.01,-163) [-163|163] "m/s" ADAS
 SG_ OBJ_ACCELERATION_LONG_011 : 193|10@0+ (0.05,-20) [-20|20] "m/s^2" ADAS
 SG_ OBJ_ACCELERATION_LAT_011 : 177|10@0+ (0.05,-20) [-20|20] "m/s^2" ADAS
 SG_ OBJ_VEH_TRACK_FLAG_011 : 10|1@0+ (1,0) [0|1] "NA" ADAS
 SG_ OBJ_MH_CYCLE_COUNTER_011 : 487|8@0+ (1,0) [0|255] "NA" ADAS
 SG_ OBJ_MH_CRC16_011 : 495|16@0+ (1,0) [0|65535] "NA" ADAS
 SG_ OBJ_TIMESTAMP_OFFSET_011 : 247|8@0+ (1,-127) [-127|128] "ms" ADAS
 SG_ OBJ_DIMENSION_WIDTH_ERR_011 : 23|6@0+ (0.01,0) [0|0.63] "m" ADAS
 SG_ OBJ_DIMENSION_LENGTH_ERR_011 : 41|10@0+ (0.01,0) [0|10.23] "m" ADAS
 SG_ OBJ_CLS_TYPE1_011 : 271|4@0+ (1,0) [0|15] "NA" ADAS
 SG_ OBJ_CLS_TYPE1_PROB_011 : 303|8@0+ (0.004,0) [0|1] "NA" ADAS
 SG_ OBJ_CLS_TYPE2_011 : 267|4@0+ (1,0) [0|15] "NA" ADAS
 SG_ OBJ_CLS_TYPE2_PROB_011 : 311|8@0+ (0.004,0) [0|1] "NA" ADAS
 SG_ OBJ_CLS_TYPE3_011 : 279|4@0+ (1,0) [0|15] "NA" ADAS
 SG_ OBJ_CLS_TYPE3_PROB_011 : 319|8@0+ (0.004,0) [0|1] "NA" ADAS
 SG_ OBJ_CLS_TYPE4_011 : 275|4@0+ (1,0) [0|15] "NA" ADAS
 SG_ OBJ_CLS_TYPE4_PROB_011 : 327|8@0+ (0.004,0) [0|1] "NA" ADAS
 SG_ OBJ_CLS_TYPE5_011 : 287|4@0+ (1,0) [0|15] "NA" ADAS
 SG_ OBJ_CLS_TYPE5_PROB_011 : 335|8@0+ (0.004,0) [0|1] "NA" ADAS
 SG_ OBJ_CLS_TYPE6_011 : 282|4@0+ (1,0) [0|15] "NA" ADAS
 SG_ OBJ_CLS_TYPE6_PROB_011 : 343|8@0+ (0.004,0) [0|1] "NA" ADAS
 SG_ OBJ_RCS_011 : 351|7@0+ (1,-64) [-64|63] "dBsm" ADAS
 SG_ OBJ_REF_PT_LONG_OFFSET_011 : 357|14@0+ (0.0001,0) [0|1] "NA" ADAS
 SG_ OBJ_REF_PT_LAT_OFFSET_011 : 370|14@0+ (0.0001,0) [0|1] "NA" ADAS
 SG_ OBJ_YAW_RATE_011 : 399|10@0+ (0.005,-2.24) [-2.24|2.24] "rad/s" ADAS
 SG_ OBJ_YAW_RATE_ERR_011 : 388|5@0+ (0.025,0) [0|0.775] "rad/s" ADAS
 SG_ OBJ_GROUP_ID_011 : 405|6@0+ (1,0) [0|63] "NA" ADAS
 SG_ OBJ_POS_ERR_CRR_COEF_011 : 415|8@0+ (0.01,-1.2) [-1.2|1] "NA" ADAS
 SG_ OBJ_VELOCITY_ERR_CRR_COEF_011 : 423|8@0+ (0.01,-1.2) [-1.2|1] "NA" ADAS
 SG_ OBJ_ACCEL_ERR_CRR_COEF_011 : 431|8@0+ (0.01,-1.2) [-1.2|1] "NA" ADAS

BO_ 1755 RDR_TRACKER_OBJ_012: 64 RDR08
 SG_ OBJ_ALIVE_TIME_012 : 255|16@0+ (1,0) [0|65535] "ms" ADAS
 SG_ OBJ_ACCELERATION_LONG_ERR_012 : 215|8@0+ (0.025,0) [0|6.375] "m/s^2" ADAS
 SG_ OBJ_ACCELERATION_LAT_ERR_012 : 223|8@0+ (0.025,0) [0|6.375] "m/s^2" ADAS
 SG_ OBJ_VELOCITY_LONG_ERR_012 : 143|8@0+ (0.05,0) [0|12.75] "m/s" ADAS
 SG_ OBJ_VELOCITY_LAT_ERR_012 : 151|8@0+ (0.05,0) [0|12.75] "m/s" ADAS
 SG_ OBJ_POS_LONG_ERR_012 : 95|8@0+ (0.025,0) [0|6.375] "m" ADAS
 SG_ OBJ_POS_LAT_ERR_012 : 103|8@0+ (0.025,0) [0|6.375] "m" ADAS
 SG_ OBJ_TRACK_MOTION_MODEL_012 : 9|2@0+ (1,0) [1|3] "NA" ADAS
 SG_ OBJ_DIMENSION_WIDTH_012 : 17|10@0+ (0.01,0) [0|10.23] "m" ADAS
 SG_ OBJ_DIMENSION_LENGTH_012 : 37|12@0+ (0.01,0) [0|40.95] "m" ADAS
 SG_ OBJ_EXISTENCE_PROB_012 : 229|14@0+ (0.0001,0) [0|1] "NA" ADAS
 SG_ OBJ_YAW_ANGLE_012 : 155|12@0+ (0.005,-10) [-10|10.475] "rad" ADAS
 SG_ OBJ_YAW_ANGLE_ERR_012 : 175|7@0+ (0.01,0) [0|1.27] "rad" ADAS
 SG_ OBJ_ID_012 : 7|8@0+ (1,0) [0|255] "NA" ADAS
 SG_ OBJ_MOVEMENT_STATUS_012 : 196|3@0+ (1,0) [0|3] "NA" ADAS
 SG_ OBJ_MEASUREMENT_STATUS_012 : 14|3@0+ (1,0) [0|7] "NA" ADAS
 SG_ OBJ_POS_LONG_012 : 63|16@0+ (0.01,-327) [-327|327] "m" ADAS
 SG_ OBJ_POS_LAT_012 : 79|16@0+ (0.01,-327) [-327|327] "m" ADAS
 SG_ OBJ_VELOCITY_LONG_012 : 110|15@0+ (0.01,-163) [-163|163] "m/s" ADAS
 SG_ OBJ_VELOCITY_LAT_012 : 126|15@0+ (0.01,-163) [-163|163] "m/s" ADAS
 SG_ OBJ_ACCELERATION_LONG_012 : 193|10@0+ (0.05,-20) [-20|20] "m/s^2" ADAS
 SG_ OBJ_ACCELERATION_LAT_012 : 177|10@0+ (0.05,-20) [-20|20] "m/s^2" ADAS
 SG_ OBJ_VEH_TRACK_FLAG_012 : 10|1@0+ (1,0) [0|1] "NA" ADAS
 SG_ OBJ_MH_CYCLE_COUNTER_012 : 487|8@0+ (1,0) [0|255] "NA" ADAS
 SG_ OBJ_MH_CRC16_012 : 495|16@0+ (1,0) [0|65535] "NA" ADAS
 SG_ OBJ_TIMESTAMP_OFFSET_012 : 247|8@0+ (1,-127) [-127|128] "ms" ADAS
 SG_ OBJ_DIMENSION_WIDTH_ERR_012 : 23|6@0+ (0.01,0) [0|0.63] "m" ADAS
 SG_ OBJ_DIMENSION_LENGTH_ERR_012 : 41|10@0+ (0.01,0) [0|10.23] "m" ADAS
 SG_ OBJ_CLS_TYPE1_012 : 271|4@0+ (1,0) [0|15] "NA" ADAS
 SG_ OBJ_CLS_TYPE1_PROB_012 : 303|8@0+ (0.004,0) [0|1] "NA" ADAS
 SG_ OBJ_CLS_TYPE2_012 : 267|4@0+ (1,0) [0|15] "NA" ADAS
 SG_ OBJ_CLS_TYPE2_PROB_012 : 311|8@0+ (0.004,0) [0|1] "NA" ADAS
 SG_ OBJ_CLS_TYPE3_012 : 279|4@0+ (1,0) [0|15] "NA" ADAS
 SG_ OBJ_CLS_TYPE3_PROB_012 : 319|8@0+ (0.004,0) [0|1] "NA" ADAS
 SG_ OBJ_CLS_TYPE4_012 : 275|4@0+ (1,0) [0|15] "NA" ADAS
 SG_ OBJ_CLS_TYPE4_PROB_012 : 327|8@0+ (0.004,0) [0|1] "NA" ADAS
 SG_ OBJ_CLS_TYPE5_012 : 287|4@0+ (1,0) [0|15] "NA" ADAS
 SG_ OBJ_CLS_TYPE5_PROB_012 : 335|8@0+ (0.004,0) [0|1] "NA" ADAS
 SG_ OBJ_CLS_TYPE6_012 : 282|4@0+ (1,0) [0|15] "NA" ADAS
 SG_ OBJ_CLS_TYPE6_PROB_012 : 343|8@0+ (0.004,0) [0|1] "NA" ADAS
 SG_ OBJ_RCS_012 : 351|7@0+ (1,-64) [-64|63] "dBsm" ADAS
 SG_ OBJ_REF_PT_LONG_OFFSET_012 : 357|14@0+ (0.0001,0) [0|1] "NA" ADAS
 SG_ OBJ_REF_PT_LAT_OFFSET_012 : 370|14@0+ (0.0001,0) [0|1] "NA" ADAS
 SG_ OBJ_YAW_RATE_012 : 399|10@0+ (0.005,-2.24) [-2.24|2.24] "rad/s" ADAS
 SG_ OBJ_YAW_RATE_ERR_012 : 388|5@0+ (0.025,0) [0|0.775] "rad/s" ADAS
 SG_ OBJ_GROUP_ID_012 : 405|6@0+ (1,0) [0|63] "NA" ADAS
 SG_ OBJ_POS_ERR_CRR_COEF_012 : 415|8@0+ (0.01,-1.2) [-1.2|1] "NA" ADAS
 SG_ OBJ_VELOCITY_ERR_CRR_COEF_012 : 423|8@0+ (0.01,-1.2) [-1.2|1] "NA" ADAS
 SG_ OBJ_ACCEL_ERR_CRR_COEF_012 : 431|8@0+ (0.01,-1.2) [-1.2|1] "NA" ADAS

BO_ 1756 RDR_TRACKER_OBJ_013: 64 RDR08
 SG_ OBJ_ALIVE_TIME_013 : 255|16@0+ (1,0) [0|65535] "ms" ADAS
 SG_ OBJ_ACCELERATION_LONG_ERR_013 : 215|8@0+ (0.025,0) [0|6.375] "m/s^2" ADAS
 SG_ OBJ_ACCELERATION_LAT_ERR_013 : 223|8@0+ (0.025,0) [0|6.375] "m/s^2" ADAS
 SG_ OBJ_VELOCITY_LONG_ERR_013 : 143|8@0+ (0.05,0) [0|12.75] "m/s" ADAS
 SG_ OBJ_VELOCITY_LAT_ERR_013 : 151|8@0+ (0.05,0) [0|12.75] "m/s" ADAS
 SG_ OBJ_POS_LONG_ERR_013 : 95|8@0+ (0.025,0) [0|6.375] "m" ADAS
 SG_ OBJ_POS_LAT_ERR_013 : 103|8@0+ (0.025,0) [0|6.375] "m" ADAS
 SG_ OBJ_TRACK_MOTION_MODEL_013 : 9|2@0+ (1,0) [1|3] "NA" ADAS
 SG_ OBJ_DIMENSION_WIDTH_013 : 17|10@0+ (0.01,0) [0|10.23] "m" ADAS
 SG_ OBJ_DIMENSION_LENGTH_013 : 37|12@0+ (0.01,0) [0|40.95] "m" ADAS
 SG_ OBJ_EXISTENCE_PROB_013 : 229|14@0+ (0.0001,0) [0|1] "NA" ADAS
 SG_ OBJ_YAW_ANGLE_013 : 155|12@0+ (0.005,-10) [-10|10.475] "rad" ADAS
 SG_ OBJ_YAW_ANGLE_ERR_013 : 175|7@0+ (0.01,0) [0|1.27] "rad" ADAS
 SG_ OBJ_ID_013 : 7|8@0+ (1,0) [0|255] "NA" ADAS
 SG_ OBJ_MOVEMENT_STATUS_013 : 196|3@0+ (1,0) [0|3] "NA" ADAS
 SG_ OBJ_MEASUREMENT_STATUS_013 : 14|3@0+ (1,0) [0|7] "NA" ADAS
 SG_ OBJ_POS_LONG_013 : 63|16@0+ (0.01,-327) [-327|327] "m" ADAS
 SG_ OBJ_POS_LAT_013 : 79|16@0+ (0.01,-327) [-327|327] "m" ADAS
 SG_ OBJ_VELOCITY_LONG_013 : 110|15@0+ (0.01,-163) [-163|163] "m/s" ADAS
 SG_ OBJ_VELOCITY_LAT_013 : 126|15@0+ (0.01,-163) [-163|163] "m/s" ADAS
 SG_ OBJ_ACCELERATION_LONG_013 : 193|10@0+ (0.05,-20) [-20|20] "m/s^2" ADAS
 SG_ OBJ_ACCELERATION_LAT_013 : 177|10@0+ (0.05,-20) [-20|20] "m/s^2" ADAS
 SG_ OBJ_VEH_TRACK_FLAG_013 : 10|1@0+ (1,0) [0|1] "NA" ADAS
 SG_ OBJ_MH_CYCLE_COUNTER_013 : 487|8@0+ (1,0) [0|255] "NA" ADAS
 SG_ OBJ_MH_CRC16_013 : 495|16@0+ (1,0) [0|65535] "NA" ADAS
 SG_ OBJ_TIMESTAMP_OFFSET_013 : 247|8@0+ (1,-127) [-127|128] "ms" ADAS
 SG_ OBJ_DIMENSION_WIDTH_ERR_013 : 23|6@0+ (0.01,0) [0|0.63] "m" ADAS
 SG_ OBJ_DIMENSION_LENGTH_ERR_013 : 41|10@0+ (0.01,0) [0|10.23] "m" ADAS
 SG_ OBJ_CLS_TYPE1_013 : 271|4@0+ (1,0) [0|15] "NA" ADAS
 SG_ OBJ_CLS_TYPE1_PROB_013 : 303|8@0+ (0.004,0) [0|1] "NA" ADAS
 SG_ OBJ_CLS_TYPE2_013 : 267|4@0+ (1,0) [0|15] "NA" ADAS
 SG_ OBJ_CLS_TYPE2_PROB_013 : 311|8@0+ (0.004,0) [0|1] "NA" ADAS
 SG_ OBJ_CLS_TYPE3_013 : 279|4@0+ (1,0) [0|15] "NA" ADAS
 SG_ OBJ_CLS_TYPE3_PROB_013 : 319|8@0+ (0.004,0) [0|1] "NA" ADAS
 SG_ OBJ_CLS_TYPE4_013 : 275|4@0+ (1,0) [0|15] "NA" ADAS
 SG_ OBJ_CLS_TYPE4_PROB_013 : 327|8@0+ (0.004,0) [0|1] "NA" ADAS
 SG_ OBJ_CLS_TYPE5_013 : 287|4@0+ (1,0) [0|15] "NA" ADAS
 SG_ OBJ_CLS_TYPE5_PROB_013 : 335|8@0+ (0.004,0) [0|1] "NA" ADAS
 SG_ OBJ_CLS_TYPE6_013 : 282|4@0+ (1,0) [0|15] "NA" ADAS
 SG_ OBJ_CLS_TYPE6_PROB_013 : 343|8@0+ (0.004,0) [0|1] "NA" ADAS
 SG_ OBJ_RCS_013 : 351|7@0+ (1,-64) [-64|63] "dBsm" ADAS
 SG_ OBJ_REF_PT_LONG_OFFSET_013 : 357|14@0+ (0.0001,0) [0|1] "NA" ADAS
 SG_ OBJ_REF_PT_LAT_OFFSET_013 : 370|14@0+ (0.0001,0) [0|1] "NA" ADAS
 SG_ OBJ_YAW_RATE_013 : 399|10@0+ (0.005,-2.24) [-2.24|2.24] "rad/s" ADAS
 SG_ OBJ_YAW_RATE_ERR_013 : 388|5@0+ (0.025,0) [0|0.775] "rad/s" ADAS
 SG_ OBJ_GROUP_ID_013 : 405|6@0+ (1,0) [0|63] "NA" ADAS
 SG_ OBJ_POS_ERR_CRR_COEF_013 : 415|8@0+ (0.01,-1.2) [-1.2|1] "NA" ADAS
 SG_ OBJ_VELOCITY_ERR_CRR_COEF_013 : 423|8@0+ (0.01,-1.2) [-1.2|1] "NA" ADAS
 SG_ OBJ_ACCEL_ERR_CRR_COEF_013 : 431|8@0+ (0.01,-1.2) [-1.2|1] "NA" ADAS

BO_ 1757 RDR_TRACKER_OBJ_014: 64 RDR08
 SG_ OBJ_ALIVE_TIME_014 : 255|16@0+ (1,0) [0|65535] "ms" ADAS
 SG_ OBJ_ACCELERATION_LONG_ERR_014 : 215|8@0+ (0.025,0) [0|6.375] "m/s^2" ADAS
 SG_ OBJ_ACCELERATION_LAT_ERR_014 : 223|8@0+ (0.025,0) [0|6.375] "m/s^2" ADAS
 SG_ OBJ_VELOCITY_LONG_ERR_014 : 143|8@0+ (0.05,0) [0|12.75] "m/s" ADAS
 SG_ OBJ_VELOCITY_LAT_ERR_014 : 151|8@0+ (0.05,0) [0|12.75] "m/s" ADAS
 SG_ OBJ_POS_LONG_ERR_014 : 95|8@0+ (0.025,0) [0|6.375] "m" ADAS
 SG_ OBJ_POS_LAT_ERR_014 : 103|8@0+ (0.025,0) [0|6.375] "m" ADAS
 SG_ OBJ_TRACK_MOTION_MODEL_014 : 9|2@0+ (1,0) [1|3] "NA" ADAS
 SG_ OBJ_DIMENSION_WIDTH_014 : 17|10@0+ (0.01,0) [0|10.23] "m" ADAS
 SG_ OBJ_DIMENSION_LENGTH_014 : 37|12@0+ (0.01,0) [0|40.95] "m" ADAS
 SG_ OBJ_EXISTENCE_PROB_014 : 229|14@0+ (0.0001,0) [0|1] "NA" ADAS
 SG_ OBJ_YAW_ANGLE_014 : 155|12@0+ (0.005,-10) [-10|10.475] "rad" ADAS
 SG_ OBJ_YAW_ANGLE_ERR_014 : 175|7@0+ (0.01,0) [0|1.27] "rad" ADAS
 SG_ OBJ_ID_014 : 7|8@0+ (1,0) [0|255] "NA" ADAS
 SG_ OBJ_MOVEMENT_STATUS_014 : 196|3@0+ (1,0) [0|3] "NA" ADAS
 SG_ OBJ_MEASUREMENT_STATUS_014 : 14|3@0+ (1,0) [0|7] "NA" ADAS
 SG_ OBJ_POS_LONG_014 : 63|16@0+ (0.01,-327) [-327|327] "m" ADAS
 SG_ OBJ_POS_LAT_014 : 79|16@0+ (0.01,-327) [-327|327] "m" ADAS
 SG_ OBJ_VELOCITY_LONG_014 : 110|15@0+ (0.01,-163) [-163|163] "m/s" ADAS
 SG_ OBJ_VELOCITY_LAT_014 : 126|15@0+ (0.01,-163) [-163|163] "m/s" ADAS
 SG_ OBJ_ACCELERATION_LONG_014 : 193|10@0+ (0.05,-20) [-20|20] "m/s^2" ADAS
 SG_ OBJ_ACCELERATION_LAT_014 : 177|10@0+ (0.05,-20) [-20|20] "m/s^2" ADAS
 SG_ OBJ_VEH_TRACK_FLAG_014 : 10|1@0+ (1,0) [0|1] "NA" ADAS
 SG_ OBJ_MH_CYCLE_COUNTER_014 : 487|8@0+ (1,0) [0|255] "NA" ADAS
 SG_ OBJ_MH_CRC16_014 : 495|16@0+ (1,0) [0|65535] "NA" ADAS
 SG_ OBJ_TIMESTAMP_OFFSET_014 : 247|8@0+ (1,-127) [-127|128] "ms" ADAS
 SG_ OBJ_DIMENSION_WIDTH_ERR_014 : 23|6@0+ (0.01,0) [0|0.63] "m" ADAS
 SG_ OBJ_DIMENSION_LENGTH_ERR_014 : 41|10@0+ (0.01,0) [0|10.23] "m" ADAS
 SG_ OBJ_CLS_TYPE1_014 : 271|4@0+ (1,0) [0|15] "NA" ADAS
 SG_ OBJ_CLS_TYPE1_PROB_014 : 303|8@0+ (0.004,0) [0|1] "NA" ADAS
 SG_ OBJ_CLS_TYPE2_014 : 267|4@0+ (1,0) [0|15] "NA" ADAS
 SG_ OBJ_CLS_TYPE2_PROB_014 : 311|8@0+ (0.004,0) [0|1] "NA" ADAS
 SG_ OBJ_CLS_TYPE3_014 : 279|4@0+ (1,0) [0|15] "NA" ADAS
 SG_ OBJ_CLS_TYPE3_PROB_014 : 319|8@0+ (0.004,0) [0|1] "NA" ADAS
 SG_ OBJ_CLS_TYPE4_014 : 275|4@0+ (1,0) [0|15] "NA" ADAS
 SG_ OBJ_CLS_TYPE4_PROB_014 : 327|8@0+ (0.004,0) [0|1] "NA" ADAS
 SG_ OBJ_CLS_TYPE5_014 : 287|4@0+ (1,0) [0|15] "NA" ADAS
 SG_ OBJ_CLS_TYPE5_PROB_014 : 335|8@0+ (0.004,0) [0|1] "NA" ADAS
 SG_ OBJ_CLS_TYPE6_014 : 282|4@0+ (1,0) [0|15] "NA" ADAS
 SG_ OBJ_CLS_TYPE6_PROB_014 : 343|8@0+ (0.004,0) [0|1] "NA" ADAS
 SG_ OBJ_RCS_014 : 351|7@0+ (1,-64) [-64|63] "dBsm" ADAS
 SG_ OBJ_REF_PT_LONG_OFFSET_014 : 357|14@0+ (0.0001,0) [0|1] "NA" ADAS
 SG_ OBJ_REF_PT_LAT_OFFSET_014 : 370|14@0+ (0.0001,0) [0|1] "NA" ADAS
 SG_ OBJ_YAW_RATE_014 : 399|10@0+ (0.005,-2.24) [-2.24|2.24] "rad/s" ADAS
 SG_ OBJ_YAW_RATE_ERR_014 : 388|5@0+ (0.025,0) [0|0.775] "rad/s" ADAS
 SG_ OBJ_GROUP_ID_014 : 405|6@0+ (1,0) [0|63] "NA" ADAS
 SG_ OBJ_POS_ERR_CRR_COEF_014 : 415|8@0+ (0.01,-1.2) [-1.2|1] "NA" ADAS
 SG_ OBJ_VELOCITY_ERR_CRR_COEF_014 : 423|8@0+ (0.01,-1.2) [-1.2|1] "NA" ADAS
 SG_ OBJ_ACCEL_ERR_CRR_COEF_014 : 431|8@0+ (0.01,-1.2) [-1.2|1] "NA" ADAS

BO_ 1758 RDR_TRACKER_OBJ_015: 64 RDR08
 SG_ OBJ_ALIVE_TIME_015 : 255|16@0+ (1,0) [0|65535] "ms" ADAS
 SG_ OBJ_ACCELERATION_LONG_ERR_015 : 215|8@0+ (0.025,0) [0|6.375] "m/s^2" ADAS
 SG_ OBJ_ACCELERATION_LAT_ERR_015 : 223|8@0+ (0.025,0) [0|6.375] "m/s^2" ADAS
 SG_ OBJ_VELOCITY_LONG_ERR_015 : 143|8@0+ (0.05,0) [0|12.75] "m/s" ADAS
 SG_ OBJ_VELOCITY_LAT_ERR_015 : 151|8@0+ (0.05,0) [0|12.75] "m/s" ADAS
 SG_ OBJ_POS_LONG_ERR_015 : 95|8@0+ (0.025,0) [0|6.375] "m" ADAS
 SG_ OBJ_POS_LAT_ERR_015 : 103|8@0+ (0.025,0) [0|6.375] "m" ADAS
 SG_ OBJ_TRACK_MOTION_MODEL_015 : 9|2@0+ (1,0) [1|3] "NA" ADAS
 SG_ OBJ_DIMENSION_WIDTH_015 : 17|10@0+ (0.01,0) [0|10.23] "m" ADAS
 SG_ OBJ_DIMENSION_LENGTH_015 : 37|12@0+ (0.01,0) [0|40.95] "m" ADAS
 SG_ OBJ_EXISTENCE_PROB_015 : 229|14@0+ (0.0001,0) [0|1] "NA" ADAS
 SG_ OBJ_YAW_ANGLE_015 : 155|12@0+ (0.005,-10) [-10|10.475] "rad" ADAS
 SG_ OBJ_YAW_ANGLE_ERR_015 : 175|7@0+ (0.01,0) [0|1.27] "rad" ADAS
 SG_ OBJ_ID_015 : 7|8@0+ (1,0) [0|255] "NA" ADAS
 SG_ OBJ_MOVEMENT_STATUS_015 : 196|3@0+ (1,0) [0|3] "NA" ADAS
 SG_ OBJ_MEASUREMENT_STATUS_015 : 14|3@0+ (1,0) [0|7] "NA" ADAS
 SG_ OBJ_POS_LONG_015 : 63|16@0+ (0.01,-327) [-327|327] "m" ADAS
 SG_ OBJ_POS_LAT_015 : 79|16@0+ (0.01,-327) [-327|327] "m" ADAS
 SG_ OBJ_VELOCITY_LONG_015 : 110|15@0+ (0.01,-163) [-163|163] "m/s" ADAS
 SG_ OBJ_VELOCITY_LAT_015 : 126|15@0+ (0.01,-163) [-163|163] "m/s" ADAS
 SG_ OBJ_ACCELERATION_LONG_015 : 193|10@0+ (0.05,-20) [-20|20] "m/s^2" ADAS
 SG_ OBJ_ACCELERATION_LAT_015 : 177|10@0+ (0.05,-20) [-20|20] "m/s^2" ADAS
 SG_ OBJ_VEH_TRACK_FLAG_015 : 10|1@0+ (1,0) [0|1] "NA" ADAS
 SG_ OBJ_MH_CYCLE_COUNTER_015 : 487|8@0+ (1,0) [0|255] "NA" ADAS
 SG_ OBJ_MH_CRC16_015 : 495|16@0+ (1,0) [0|65535] "NA" ADAS
 SG_ OBJ_TIMESTAMP_OFFSET_015 : 247|8@0+ (1,-127) [-127|128] "ms" ADAS
 SG_ OBJ_DIMENSION_WIDTH_ERR_015 : 23|6@0+ (0.01,0) [0|0.63] "m" ADAS
 SG_ OBJ_DIMENSION_LENGTH_ERR_015 : 41|10@0+ (0.01,0) [0|10.23] "m" ADAS
 SG_ OBJ_CLS_TYPE1_015 : 271|4@0+ (1,0) [0|15] "NA" ADAS
 SG_ OBJ_CLS_TYPE1_PROB_015 : 303|8@0+ (0.004,0) [0|1] "NA" ADAS
 SG_ OBJ_CLS_TYPE2_015 : 267|4@0+ (1,0) [0|15] "NA" ADAS
 SG_ OBJ_CLS_TYPE2_PROB_015 : 311|8@0+ (0.004,0) [0|1] "NA" ADAS
 SG_ OBJ_CLS_TYPE3_015 : 279|4@0+ (1,0) [0|15] "NA" ADAS
 SG_ OBJ_CLS_TYPE3_PROB_015 : 319|8@0+ (0.004,0) [0|1] "NA" ADAS
 SG_ OBJ_CLS_TYPE4_015 : 275|4@0+ (1,0) [0|15] "NA" ADAS
 SG_ OBJ_CLS_TYPE4_PROB_015 : 327|8@0+ (0.004,0) [0|1] "NA" ADAS
 SG_ OBJ_CLS_TYPE5_015 : 287|4@0+ (1,0) [0|15] "NA" ADAS
 SG_ OBJ_CLS_TYPE5_PROB_015 : 335|8@0+ (0.004,0) [0|1] "NA" ADAS
 SG_ OBJ_CLS_TYPE6_015 : 282|4@0+ (1,0) [0|15] "NA" ADAS
 SG_ OBJ_CLS_TYPE6_PROB_015 : 343|8@0+ (0.004,0) [0|1] "NA" ADAS
 SG_ OBJ_RCS_015 : 351|7@0+ (1,-64) [-64|63] "dBsm" ADAS
 SG_ OBJ_REF_PT_LONG_OFFSET_015 : 357|14@0+ (0.0001,0) [0|1] "NA" ADAS
 SG_ OBJ_REF_PT_LAT_OFFSET_015 : 370|14@0+ (0.0001,0) [0|1] "NA" ADAS
 SG_ OBJ_YAW_RATE_015 : 399|10@0+ (0.005,-2.24) [-2.24|2.24] "rad/s" ADAS
 SG_ OBJ_YAW_RATE_ERR_015 : 388|5@0+ (0.025,0) [0|0.775] "rad/s" ADAS
 SG_ OBJ_GROUP_ID_015 : 405|6@0+ (1,0) [0|63] "NA" ADAS
 SG_ OBJ_POS_ERR_CRR_COEF_015 : 415|8@0+ (0.01,-1.2) [-1.2|1] "NA" ADAS
 SG_ OBJ_VELOCITY_ERR_CRR_COEF_015 : 423|8@0+ (0.01,-1.2) [-1.2|1] "NA" ADAS
 SG_ OBJ_ACCEL_ERR_CRR_COEF_015 : 431|8@0+ (0.01,-1.2) [-1.2|1] "NA" ADAS

BO_ 1759 RDR_TRACKER_OBJ_016: 64 RDR08
 SG_ OBJ_ALIVE_TIME_016 : 255|16@0+ (1,0) [0|65535] "ms" ADAS
 SG_ OBJ_ACCELERATION_LONG_ERR_016 : 215|8@0+ (0.025,0) [0|6.375] "m/s^2" ADAS
 SG_ OBJ_ACCELERATION_LAT_ERR_016 : 223|8@0+ (0.025,0) [0|6.375] "m/s^2" ADAS
 SG_ OBJ_VELOCITY_LONG_ERR_016 : 143|8@0+ (0.05,0) [0|12.75] "m/s" ADAS
 SG_ OBJ_VELOCITY_LAT_ERR_016 : 151|8@0+ (0.05,0) [0|12.75] "m/s" ADAS
 SG_ OBJ_POS_LONG_ERR_016 : 95|8@0+ (0.025,0) [0|6.375] "m" ADAS
 SG_ OBJ_POS_LAT_ERR_016 : 103|8@0+ (0.025,0) [0|6.375] "m" ADAS
 SG_ OBJ_TRACK_MOTION_MODEL_016 : 9|2@0+ (1,0) [1|3] "NA" ADAS
 SG_ OBJ_DIMENSION_WIDTH_016 : 17|10@0+ (0.01,0) [0|10.23] "m" ADAS
 SG_ OBJ_DIMENSION_LENGTH_016 : 37|12@0+ (0.01,0) [0|40.95] "m" ADAS
 SG_ OBJ_EXISTENCE_PROB_016 : 229|14@0+ (0.0001,0) [0|1] "NA" ADAS
 SG_ OBJ_YAW_ANGLE_016 : 155|12@0+ (0.005,-10) [-10|10.475] "rad" ADAS
 SG_ OBJ_YAW_ANGLE_ERR_016 : 175|7@0+ (0.01,0) [0|1.27] "rad" ADAS
 SG_ OBJ_ID_016 : 7|8@0+ (1,0) [0|255] "NA" ADAS
 SG_ OBJ_MOVEMENT_STATUS_016 : 196|3@0+ (1,0) [0|3] "NA" ADAS
 SG_ OBJ_MEASUREMENT_STATUS_016 : 14|3@0+ (1,0) [0|7] "NA" ADAS
 SG_ OBJ_POS_LONG_016 : 63|16@0+ (0.01,-327) [-327|327] "m" ADAS
 SG_ OBJ_POS_LAT_016 : 79|16@0+ (0.01,-327) [-327|327] "m" ADAS
 SG_ OBJ_VELOCITY_LONG_016 : 110|15@0+ (0.01,-163) [-163|163] "m/s" ADAS
 SG_ OBJ_VELOCITY_LAT_016 : 126|15@0+ (0.01,-163) [-163|163] "m/s" ADAS
 SG_ OBJ_ACCELERATION_LONG_016 : 193|10@0+ (0.05,-20) [-20|20] "m/s^2" ADAS
 SG_ OBJ_ACCELERATION_LAT_016 : 177|10@0+ (0.05,-20) [-20|20] "m/s^2" ADAS
 SG_ OBJ_VEH_TRACK_FLAG_016 : 10|1@0+ (1,0) [0|1] "NA" ADAS
 SG_ OBJ_MH_CYCLE_COUNTER_016 : 487|8@0+ (1,0) [0|255] "NA" ADAS
 SG_ OBJ_MH_CRC16_016 : 495|16@0+ (1,0) [0|65535] "NA" ADAS
 SG_ OBJ_TIMESTAMP_OFFSET_016 : 247|8@0+ (1,-127) [-127|128] "ms" ADAS
 SG_ OBJ_DIMENSION_WIDTH_ERR_016 : 23|6@0+ (0.01,0) [0|0.63] "m" ADAS
 SG_ OBJ_DIMENSION_LENGTH_ERR_016 : 41|10@0+ (0.01,0) [0|10.23] "m" ADAS
 SG_ OBJ_CLS_TYPE1_016 : 271|4@0+ (1,0) [0|15] "NA" ADAS
 SG_ OBJ_CLS_TYPE1_PROB_016 : 303|8@0+ (0.004,0) [0|1] "NA" ADAS
 SG_ OBJ_CLS_TYPE2_016 : 267|4@0+ (1,0) [0|15] "NA" ADAS
 SG_ OBJ_CLS_TYPE2_PROB_016 : 311|8@0+ (0.004,0) [0|1] "NA" ADAS
 SG_ OBJ_CLS_TYPE3_016 : 279|4@0+ (1,0) [0|15] "NA" ADAS
 SG_ OBJ_CLS_TYPE3_PROB_016 : 319|8@0+ (0.004,0) [0|1] "NA" ADAS
 SG_ OBJ_CLS_TYPE4_016 : 275|4@0+ (1,0) [0|15] "NA" ADAS
 SG_ OBJ_CLS_TYPE4_PROB_016 : 327|8@0+ (0.004,0) [0|1] "NA" ADAS
 SG_ OBJ_CLS_TYPE5_016 : 287|4@0+ (1,0) [0|15] "NA" ADAS
 SG_ OBJ_CLS_TYPE5_PROB_016 : 335|8@0+ (0.004,0) [0|1] "NA" ADAS
 SG_ OBJ_CLS_TYPE6_016 : 282|4@0+ (1,0) [0|15] "NA" ADAS
 SG_ OBJ_CLS_TYPE6_PROB_016 : 343|8@0+ (0.004,0) [0|1] "NA" ADAS
 SG_ OBJ_RCS_016 : 351|7@0+ (1,-64) [-64|63] "dBsm" ADAS
 SG_ OBJ_REF_PT_LONG_OFFSET_016 : 357|14@0+ (0.0001,0) [0|1] "NA" ADAS
 SG_ OBJ_REF_PT_LAT_OFFSET_016 : 370|14@0+ (0.0001,0) [0|1] "NA" ADAS
 SG_ OBJ_YAW_RATE_016 : 399|10@0+ (0.005,-2.24) [-2.24|2.24] "rad/s" ADAS
 SG_ OBJ_YAW_RATE_ERR_016 : 388|5@0+ (0.025,0) [0|0.775] "rad/s" ADAS
 SG_ OBJ_GROUP_ID_016 : 405|6@0+ (1,0) [0|63] "NA" ADAS
 SG_ OBJ_POS_ERR_CRR_COEF_016 : 415|8@0+ (0.01,-1.2) [-1.2|1] "NA" ADAS
 SG_ OBJ_VELOCITY_ERR_CRR_COEF_016 : 423|8@0+ (0.01,-1.2) [-1.2|1] "NA" ADAS
 SG_ OBJ_ACCEL_ERR_CRR_COEF_016 : 431|8@0+ (0.01,-1.2) [-1.2|1] "NA" ADAS

BO_ 1760 RDR_TRACKER_OBJ_017: 64 RDR08
 SG_ OBJ_ALIVE_TIME_017 : 255|16@0+ (1,0) [0|65535] "ms" ADAS
 SG_ OBJ_ACCELERATION_LONG_ERR_017 : 215|8@0+ (0.025,0) [0|6.375] "m/s^2" ADAS
 SG_ OBJ_ACCELERATION_LAT_ERR_017 : 223|8@0+ (0.025,0) [0|6.375] "m/s^2" ADAS
 SG_ OBJ_VELOCITY_LONG_ERR_017 : 143|8@0+ (0.05,0) [0|12.75] "m/s" ADAS
 SG_ OBJ_VELOCITY_LAT_ERR_017 : 151|8@0+ (0.05,0) [0|12.75] "m/s" ADAS
 SG_ OBJ_POS_LONG_ERR_017 : 95|8@0+ (0.025,0) [0|6.375] "m" ADAS
 SG_ OBJ_POS_LAT_ERR_017 : 103|8@0+ (0.025,0) [0|6.375] "m" ADAS
 SG_ OBJ_TRACK_MOTION_MODEL_017 : 9|2@0+ (1,0) [1|3] "NA" ADAS
 SG_ OBJ_DIMENSION_WIDTH_017 : 17|10@0+ (0.01,0) [0|10.23] "m" ADAS
 SG_ OBJ_DIMENSION_LENGTH_017 : 37|12@0+ (0.01,0) [0|40.95] "m" ADAS
 SG_ OBJ_EXISTENCE_PROB_017 : 229|14@0+ (0.0001,0) [0|1] "NA" ADAS
 SG_ OBJ_YAW_ANGLE_017 : 155|12@0+ (0.005,-10) [-10|10.475] "rad" ADAS
 SG_ OBJ_YAW_ANGLE_ERR_017 : 175|7@0+ (0.01,0) [0|1.27] "rad" ADAS
 SG_ OBJ_ID_017 : 7|8@0+ (1,0) [0|255] "NA" ADAS
 SG_ OBJ_MOVEMENT_STATUS_017 : 196|3@0+ (1,0) [0|3] "NA" ADAS
 SG_ OBJ_MEASUREMENT_STATUS_017 : 14|3@0+ (1,0) [0|7] "NA" ADAS
 SG_ OBJ_POS_LONG_017 : 63|16@0+ (0.01,-327) [-327|327] "m" ADAS
 SG_ OBJ_POS_LAT_017 : 79|16@0+ (0.01,-327) [-327|327] "m" ADAS
 SG_ OBJ_VELOCITY_LONG_017 : 110|15@0+ (0.01,-163) [-163|163] "m/s" ADAS
 SG_ OBJ_VELOCITY_LAT_017 : 126|15@0+ (0.01,-163) [-163|163] "m/s" ADAS
 SG_ OBJ_ACCELERATION_LONG_017 : 193|10@0+ (0.05,-20) [-20|20] "m/s^2" ADAS
 SG_ OBJ_ACCELERATION_LAT_017 : 177|10@0+ (0.05,-20) [-20|20] "m/s^2" ADAS
 SG_ OBJ_VEH_TRACK_FLAG_017 : 10|1@0+ (1,0) [0|1] "NA" ADAS
 SG_ OBJ_MH_CYCLE_COUNTER_017 : 487|8@0+ (1,0) [0|255] "NA" ADAS
 SG_ OBJ_MH_CRC16_017 : 495|16@0+ (1,0) [0|65535] "NA" ADAS
 SG_ OBJ_TIMESTAMP_OFFSET_017 : 247|8@0+ (1,-127) [-127|128] "ms" ADAS
 SG_ OBJ_DIMENSION_WIDTH_ERR_017 : 23|6@0+ (0.01,0) [0|0.63] "m" ADAS
 SG_ OBJ_DIMENSION_LENGTH_ERR_017 : 41|10@0+ (0.01,0) [0|10.23] "m" ADAS
 SG_ OBJ_CLS_TYPE1_017 : 271|4@0+ (1,0) [0|15] "NA" ADAS
 SG_ OBJ_CLS_TYPE1_PROB_017 : 303|8@0+ (0.004,0) [0|1] "NA" ADAS
 SG_ OBJ_CLS_TYPE2_017 : 267|4@0+ (1,0) [0|15] "NA" ADAS
 SG_ OBJ_CLS_TYPE2_PROB_017 : 311|8@0+ (0.004,0) [0|1] "NA" ADAS
 SG_ OBJ_CLS_TYPE3_017 : 279|4@0+ (1,0) [0|15] "NA" ADAS
 SG_ OBJ_CLS_TYPE3_PROB_017 : 319|8@0+ (0.004,0) [0|1] "NA" ADAS
 SG_ OBJ_CLS_TYPE4_017 : 275|4@0+ (1,0) [0|15] "NA" ADAS
 SG_ OBJ_CLS_TYPE4_PROB_017 : 327|8@0+ (0.004,0) [0|1] "NA" ADAS
 SG_ OBJ_CLS_TYPE5_017 : 287|4@0+ (1,0) [0|15] "NA" ADAS
 SG_ OBJ_CLS_TYPE5_PROB_017 : 335|8@0+ (0.004,0) [0|1] "NA" ADAS
 SG_ OBJ_CLS_TYPE6_017 : 282|4@0+ (1,0) [0|15] "NA" ADAS
 SG_ OBJ_CLS_TYPE6_PROB_017 : 343|8@0+ (0.004,0) [0|1] "NA" ADAS
 SG_ OBJ_RCS_017 : 351|7@0+ (1,-64) [-64|63] "dBsm" ADAS
 SG_ OBJ_REF_PT_LONG_OFFSET_017 : 357|14@0+ (0.0001,0) [0|1] "NA" ADAS
 SG_ OBJ_REF_PT_LAT_OFFSET_017 : 370|14@0+ (0.0001,0) [0|1] "NA" ADAS
 SG_ OBJ_YAW_RATE_017 : 399|10@0+ (0.005,-2.24) [-2.24|2.24] "rad/s" ADAS
 SG_ OBJ_YAW_RATE_ERR_017 : 388|5@0+ (0.025,0) [0|0.775] "rad/s" ADAS
 SG_ OBJ_GROUP_ID_017 : 405|6@0+ (1,0) [0|63] "NA" ADAS
 SG_ OBJ_POS_ERR_CRR_COEF_017 : 415|8@0+ (0.01,-1.2) [-1.2|1] "NA" ADAS
 SG_ OBJ_VELOCITY_ERR_CRR_COEF_017 : 423|8@0+ (0.01,-1.2) [-1.2|1] "NA" ADAS
 SG_ OBJ_ACCEL_ERR_CRR_COEF_017 : 431|8@0+ (0.01,-1.2) [-1.2|1] "NA" ADAS

CM_ SG_ 1745 OBJ_ALIVE_TIME_002 "Time since object initialization in msec. Tracker internal may have bigger values. On the output interface, we should saturate the signal in that case.";
CM_ SG_ 1745 OBJ_ACCELERATION_LONG_ERR_002 "acceleration along Longi  direction";
CM_ SG_ 1745 OBJ_ACCELERATION_LAT_ERR_002 "acceleration along Lat direction error";
CM_ SG_ 1745 OBJ_POS_LONG_ERR_002 "Lat-position error of object track's centroid in VCS coordinate";
CM_ SG_ 1745 OBJ_POS_LAT_ERR_002 "Lat-position error of object track's centroid in VCS coordinate";
CM_ SG_ 1745 OBJ_TRACK_MOTION_MODEL_002 "Object tracking uses a motion model for tracking moving items";
CM_ SG_ 1745 OBJ_DIMENSION_WIDTH_002 "Lat distance from centroid to edge of bounding box.";
CM_ SG_ 1745 OBJ_DIMENSION_LENGTH_002 "Longi distance from centroid to edge of bounding box.";
CM_ SG_ 1745 OBJ_EXISTENCE_PROB_002 "Probability that the target is an actual target";
CM_ SG_ 1745 OBJ_YAW_ANGLE_002 "Orientation of track's bounding box in VCS coordinate";
CM_ SG_ 1745 OBJ_ID_002 "ID of object tracks, zero-ID represents an inactive track";
CM_ SG_ 1745 OBJ_MOVEMENT_STATUS_002 "Information about a possible movement of the object during tracking";
CM_ SG_ 1745 OBJ_MEASUREMENT_STATUS_002 "Objects should be sent out as fast as possible, even if not all statuses are observed and the object’s
signals might not be fully filled.";
CM_ SG_ 1745 OBJ_POS_LONG_002 "Long-position of object track's centroid in VCS coordinate";
CM_ SG_ 1745 OBJ_POS_LAT_002 "Lat-position of object track's centroid in VCS coordinate";
CM_ SG_ 1745 OBJ_VELOCITY_LONG_002 "Over-the-ground velocity of object track's centroid along Long direction (in VCS coordinate)";
CM_ SG_ 1745 OBJ_VELOCITY_LAT_002 "Over-the-ground velocity of object track's centroid along Lat direction (in VCS coordinate)";
CM_ SG_ 1745 OBJ_ACCELERATION_LONG_002 "Over-the-ground track acceleration along Longi direction (in VCS coordinate)";
CM_ SG_ 1745 OBJ_ACCELERATION_LAT_002 "Over-the-ground track acceleration along Lat direction (in VCS coordinate)";
CM_ SG_ 1745 OBJ_VEH_TRACK_FLAG_002 "Indicates if current track is a vehicle";
CM_ SG_ 1745 OBJ_TIMESTAMP_OFFSET_002 "A timestamp offset from the object list header timestamp for each object as we have different timestamps from different sensors leading to different timestamps on each object";
CM_ SG_ 1745 OBJ_DIMENSION_WIDTH_ERR_002 "Lat distance or length error";
CM_ SG_ 1745 OBJ_DIMENSION_LENGTH_ERR_002 "Longi distance or length error";
CM_ SG_ 1745 OBJ_CLS_TYPE1_002 "Classification Type 1(Highest Prob), selected from ENUM list";
CM_ SG_ 1745 OBJ_CLS_TYPE1_PROB_002 "Classification Type 1 probablity";
CM_ SG_ 1745 OBJ_CLS_TYPE6_002 "Classification Type 6(Lowest Prob), selected from ENUM list";
CM_ SG_ 1745 OBJ_CLS_TYPE6_PROB_002 "Classification Type 1 probablity";
CM_ SG_ 1745 OBJ_RCS_002 "Representative RCS of the complete recognized object, Not implemented";
CM_ SG_ 1745 OBJ_REF_PT_LONG_OFFSET_002 "Outer edges of the recognized object’s bounding box in Y axis";
CM_ SG_ 1745 OBJ_REF_PT_LAT_OFFSET_002 "Outer edges of the recognized object’s bounding box in X axis";
CM_ SG_ 1745 OBJ_YAW_RATE_002 "Orientation rate of track's bounding box in VCS coordinate";
CM_ SG_ 1745 OBJ_GROUP_ID_002 "Objects which are linked together shall have same group ID";
CM_ SG_ 1745 OBJ_POS_ERR_CRR_COEF_002 "vx-vy correlation due to small error in radial direction and big in cross radial - position Correlation Coefficient Error";
CM_ SG_ 1745 OBJ_VELOCITY_ERR_CRR_COEF_002 "vx-vy correlation due to small error in radial direction and big in cross radial - velocity Correlation Coefficient Error";
CM_ SG_ 1745 OBJ_ACCEL_ERR_CRR_COEF_002 "vx-vy correlation due to small error in radial direction and big in cross radial - Acceleration Correlation Coefficient Error";
CM_ SG_ 1746 OBJ_ALIVE_TIME_003 "Time since object initialization in msec. Tracker internal may have bigger values. On the output interface, we should saturate the signal in that case.";
CM_ SG_ 1746 OBJ_ACCELERATION_LONG_ERR_003 "acceleration along Longi  direction";
CM_ SG_ 1746 OBJ_ACCELERATION_LAT_ERR_003 "acceleration along Lat direction error";
CM_ SG_ 1746 OBJ_POS_LONG_ERR_003 "Lat-position error of object track's centroid in VCS coordinate";
CM_ SG_ 1746 OBJ_POS_LAT_ERR_003 "Lat-position error of object track's centroid in VCS coordinate";
CM_ SG_ 1746 OBJ_TRACK_MOTION_MODEL_003 "Object tracking uses a motion model for tracking moving items";
CM_ SG_ 1746 OBJ_DIMENSION_WIDTH_003 "Lat distance from centroid to edge of bounding box.";
CM_ SG_ 1746 OBJ_DIMENSION_LENGTH_003 "Longi distance from centroid to edge of bounding box.";
CM_ SG_ 1746 OBJ_EXISTENCE_PROB_003 "Probability that the target is an actual target";
CM_ SG_ 1746 OBJ_YAW_ANGLE_003 "Orientation of track's bounding box in VCS coordinate";
CM_ SG_ 1746 OBJ_ID_003 "ID of object tracks, zero-ID represents an inactive track";
CM_ SG_ 1746 OBJ_MOVEMENT_STATUS_003 "Information about a possible movement of the object during tracking";
CM_ SG_ 1746 OBJ_MEASUREMENT_STATUS_003 "Objects should be sent out as fast as possible, even if not all statuses are observed and the object’s
signals might not be fully filled.";
CM_ SG_ 1746 OBJ_POS_LONG_003 "Long-position of object track's centroid in VCS coordinate";
CM_ SG_ 1746 OBJ_POS_LAT_003 "Lat-position of object track's centroid in VCS coordinate";
CM_ SG_ 1746 OBJ_VELOCITY_LONG_003 "Over-the-ground velocity of object track's centroid along Long direction (in VCS coordinate)";
CM_ SG_ 1746 OBJ_VELOCITY_LAT_003 "Over-the-ground velocity of object track's centroid along Lat direction (in VCS coordinate)";
CM_ SG_ 1746 OBJ_ACCELERATION_LONG_003 "Over-the-ground track acceleration along Longi direction (in VCS coordinate)";
CM_ SG_ 1746 OBJ_ACCELERATION_LAT_003 "Over-the-ground track acceleration along Lat direction (in VCS coordinate)";
CM_ SG_ 1746 OBJ_VEH_TRACK_FLAG_003 "Indicates if current track is a vehicle";
CM_ SG_ 1746 OBJ_TIMESTAMP_OFFSET_003 "A timestamp offset from the object list header timestamp for each object as we have different timestamps from different sensors leading to different timestamps on each object";
CM_ SG_ 1746 OBJ_DIMENSION_WIDTH_ERR_003 "Lat distance or length error";
CM_ SG_ 1746 OBJ_DIMENSION_LENGTH_ERR_003 "Longi distance or length error";
CM_ SG_ 1746 OBJ_CLS_TYPE1_003 "Classification Type 1(Highest Prob), selected from ENUM list";
CM_ SG_ 1746 OBJ_CLS_TYPE1_PROB_003 "Classification Type 1 probablity";
CM_ SG_ 1746 OBJ_CLS_TYPE6_003 "Classification Type 6(Lowest Prob), selected from ENUM list";
CM_ SG_ 1746 OBJ_CLS_TYPE6_PROB_003 "Classification Type 1 probablity";
CM_ SG_ 1746 OBJ_RCS_003 "Representative RCS of the complete recognized object, Not implemented";
CM_ SG_ 1746 OBJ_REF_PT_LONG_OFFSET_003 "Outer edges of the recognized object’s bounding box in Y axis";
CM_ SG_ 1746 OBJ_REF_PT_LAT_OFFSET_003 "Outer edges of the recognized object’s bounding box in X axis";
CM_ SG_ 1746 OBJ_YAW_RATE_003 "Orientation rate of track's bounding box in VCS coordinate";
CM_ SG_ 1746 OBJ_GROUP_ID_003 "Objects which are linked together shall have same group ID";
CM_ SG_ 1746 OBJ_POS_ERR_CRR_COEF_003 "vx-vy correlation due to small error in radial direction and big in cross radial - position Correlation Coefficient Error";
CM_ SG_ 1746 OBJ_VELOCITY_ERR_CRR_COEF_003 "vx-vy correlation due to small error in radial direction and big in cross radial - velocity Correlation Coefficient Error";
CM_ SG_ 1746 OBJ_ACCEL_ERR_CRR_COEF_003 "vx-vy correlation due to small error in radial direction and big in cross radial - Acceleration Correlation Coefficient Error";
CM_ SG_ 1747 OBJ_ALIVE_TIME_004 "Time since object initialization in msec. Tracker internal may have bigger values. On the output interface, we should saturate the signal in that case.";
CM_ SG_ 1747 OBJ_ACCELERATION_LONG_ERR_004 "acceleration along Longi  direction";
CM_ SG_ 1747 OBJ_ACCELERATION_LAT_ERR_004 "acceleration along Lat direction error";
CM_ SG_ 1747 OBJ_POS_LONG_ERR_004 "Lat-position error of object track's centroid in VCS coordinate";
CM_ SG_ 1747 OBJ_POS_LAT_ERR_004 "Lat-position error of object track's centroid in VCS coordinate";
CM_ SG_ 1747 OBJ_TRACK_MOTION_MODEL_004 "Object tracking uses a motion model for tracking moving items";
CM_ SG_ 1747 OBJ_DIMENSION_WIDTH_004 "Lat distance from centroid to edge of bounding box.";
CM_ SG_ 1747 OBJ_DIMENSION_LENGTH_004 "Longi distance from centroid to edge of bounding box.";
CM_ SG_ 1747 OBJ_EXISTENCE_PROB_004 "Probability that the target is an actual target";
CM_ SG_ 1747 OBJ_YAW_ANGLE_004 "Orientation of track's bounding box in VCS coordinate";
CM_ SG_ 1747 OBJ_ID_004 "ID of object tracks, zero-ID represents an inactive track";
CM_ SG_ 1747 OBJ_MOVEMENT_STATUS_004 "Information about a possible movement of the object during tracking";
CM_ SG_ 1747 OBJ_MEASUREMENT_STATUS_004 "Objects should be sent out as fast as possible, even if not all statuses are observed and the object’s
signals might not be fully filled.";
CM_ SG_ 1747 OBJ_POS_LONG_004 "Long-position of object track's centroid in VCS coordinate";
CM_ SG_ 1747 OBJ_POS_LAT_004 "Lat-position of object track's centroid in VCS coordinate";
CM_ SG_ 1747 OBJ_VELOCITY_LONG_004 "Over-the-ground velocity of object track's centroid along Long direction (in VCS coordinate)";
CM_ SG_ 1747 OBJ_VELOCITY_LAT_004 "Over-the-ground velocity of object track's centroid along Lat direction (in VCS coordinate)";
CM_ SG_ 1747 OBJ_ACCELERATION_LONG_004 "Over-the-ground track acceleration along Longi direction (in VCS coordinate)";
CM_ SG_ 1747 OBJ_ACCELERATION_LAT_004 "Over-the-ground track acceleration along Lat direction (in VCS coordinate)";
CM_ SG_ 1747 OBJ_VEH_TRACK_FLAG_004 "Indicates if current track is a vehicle";
CM_ SG_ 1747 OBJ_TIMESTAMP_OFFSET_004 "A timestamp offset from the object list header timestamp for each object as we have different timestamps from different sensors leading to different timestamps on each object";
CM_ SG_ 1747 OBJ_DIMENSION_WIDTH_ERR_004 "Lat distance or length error";
CM_ SG_ 1747 OBJ_DIMENSION_LENGTH_ERR_004 "Longi distance or length error";
CM_ SG_ 1747 OBJ_CLS_TYPE1_004 "Classification Type 1(Highest Prob), selected from ENUM list";
CM_ SG_ 1747 OBJ_CLS_TYPE1_PROB_004 "Classification Type 1 probablity";
CM_ SG_ 1747 OBJ_CLS_TYPE6_004 "Classification Type 6(Lowest Prob), selected from ENUM list";
CM_ SG_ 1747 OBJ_CLS_TYPE6_PROB_004 "Classification Type 1 probablity";
CM_ SG_ 1747 OBJ_RCS_004 "Representative RCS of the complete recognized object, Not implemented";
CM_ SG_ 1747 OBJ_REF_PT_LONG_OFFSET_004 "Outer edges of the recognized object’s bounding box in Y axis";
CM_ SG_ 1747 OBJ_REF_PT_LAT_OFFSET_004 "Outer edges of the recognized object’s bounding box in X axis";
CM_ SG_ 1747 OBJ_YAW_RATE_004 "Orientation rate of track's bounding box in VCS coordinate";
CM_ SG_ 1747 OBJ_GROUP_ID_004 "Objects which are linked together shall have same group ID";
CM_ SG_ 1747 OBJ_POS_ERR_CRR_COEF_004 "vx-vy correlation due to small error in radial direction and big in cross radial - position Correlation Coefficient Error";
CM_ SG_ 1747 OBJ_VELOCITY_ERR_CRR_COEF_004 "vx-vy correlation due to small error in radial direction and big in cross radial - velocity Correlation Coefficient Error";
CM_ SG_ 1747 OBJ_ACCEL_ERR_CRR_COEF_004 "vx-vy correlation due to small error in radial direction and big in cross radial - Acceleration Correlation Coefficient Error";
CM_ SG_ 1748 OBJ_ALIVE_TIME_005 "Time since object initialization in msec. Tracker internal may have bigger values. On the output interface, we should saturate the signal in that case.";
CM_ SG_ 1748 OBJ_ACCELERATION_LONG_ERR_005 "acceleration along Longi  direction";
CM_ SG_ 1748 OBJ_ACCELERATION_LAT_ERR_005 "acceleration along Lat direction error";
CM_ SG_ 1748 OBJ_POS_LONG_ERR_005 "Lat-position error of object track's centroid in VCS coordinate";
CM_ SG_ 1748 OBJ_POS_LAT_ERR_005 "Lat-position error of object track's centroid in VCS coordinate";
CM_ SG_ 1748 OBJ_TRACK_MOTION_MODEL_005 "Object tracking uses a motion model for tracking moving items";
CM_ SG_ 1748 OBJ_DIMENSION_WIDTH_005 "Lat distance from centroid to edge of bounding box.";
CM_ SG_ 1748 OBJ_DIMENSION_LENGTH_005 "Longi distance from centroid to edge of bounding box.";
CM_ SG_ 1748 OBJ_EXISTENCE_PROB_005 "Probability that the target is an actual target";
CM_ SG_ 1748 OBJ_YAW_ANGLE_005 "Orientation of track's bounding box in VCS coordinate";
CM_ SG_ 1748 OBJ_ID_005 "ID of object tracks, zero-ID represents an inactive track";
CM_ SG_ 1748 OBJ_MOVEMENT_STATUS_005 "Information about a possible movement of the object during tracking";
CM_ SG_ 1748 OBJ_MEASUREMENT_STATUS_005 "Objects should be sent out as fast as possible, even if not all statuses are observed and the object’s
signals might not be fully filled.";
CM_ SG_ 1748 OBJ_POS_LONG_005 "Long-position of object track's centroid in VCS coordinate";
CM_ SG_ 1748 OBJ_POS_LAT_005 "Lat-position of object track's centroid in VCS coordinate";
CM_ SG_ 1748 OBJ_VELOCITY_LONG_005 "Over-the-ground velocity of object track's centroid along Long direction (in VCS coordinate)";
CM_ SG_ 1748 OBJ_VELOCITY_LAT_005 "Over-the-ground velocity of object track's centroid along Lat direction (in VCS coordinate)";
CM_ SG_ 1748 OBJ_ACCELERATION_LONG_005 "Over-the-ground track acceleration along Longi direction (in VCS coordinate)";
CM_ SG_ 1748 OBJ_ACCELERATION_LAT_005 "Over-the-ground track acceleration along Lat direction (in VCS coordinate)";
CM_ SG_ 1748 OBJ_VEH_TRACK_FLAG_005 "Indicates if current track is a vehicle";
CM_ SG_ 1748 OBJ_TIMESTAMP_OFFSET_005 "A timestamp offset from the object list header timestamp for each object as we have different timestamps from different sensors leading to different timestamps on each object";
CM_ SG_ 1748 OBJ_DIMENSION_WIDTH_ERR_005 "Lat distance or length error";
CM_ SG_ 1748 OBJ_DIMENSION_LENGTH_ERR_005 "Longi distance or length error";
CM_ SG_ 1748 OBJ_CLS_TYPE1_005 "Classification Type 1(Highest Prob), selected from ENUM list";
CM_ SG_ 1748 OBJ_CLS_TYPE1_PROB_005 "Classification Type 1 probablity";
CM_ SG_ 1748 OBJ_CLS_TYPE6_005 "Classification Type 6(Lowest Prob), selected from ENUM list";
CM_ SG_ 1748 OBJ_CLS_TYPE6_PROB_005 "Classification Type 1 probablity";
CM_ SG_ 1748 OBJ_RCS_005 "Representative RCS of the complete recognized object, Not implemented";
CM_ SG_ 1748 OBJ_REF_PT_LONG_OFFSET_005 "Outer edges of the recognized object’s bounding box in Y axis";
CM_ SG_ 1748 OBJ_REF_PT_LAT_OFFSET_005 "Outer edges of the recognized object’s bounding box in X axis";
CM_ SG_ 1748 OBJ_YAW_RATE_005 "Orientation rate of track's bounding box in VCS coordinate";
CM_ SG_ 1748 OBJ_GROUP_ID_005 "Objects which are linked together shall have same group ID";
CM_ SG_ 1748 OBJ_POS_ERR_CRR_COEF_005 "vx-vy correlation due to small error in radial direction and big in cross radial - position Correlation Coefficient Error";
CM_ SG_ 1748 OBJ_VELOCITY_ERR_CRR_COEF_005 "vx-vy correlation due to small error in radial direction and big in cross radial - velocity Correlation Coefficient Error";
CM_ SG_ 1748 OBJ_ACCEL_ERR_CRR_COEF_005 "vx-vy correlation due to small error in radial direction and big in cross radial - Acceleration Correlation Coefficient Error";
CM_ SG_ 1749 OBJ_ALIVE_TIME_006 "Time since object initialization in msec. Tracker internal may have bigger values. On the output interface, we should saturate the signal in that case.";
CM_ SG_ 1749 OBJ_ACCELERATION_LONG_ERR_006 "acceleration along Longi  direction";
CM_ SG_ 1749 OBJ_ACCELERATION_LAT_ERR_006 "acceleration along Lat direction error";
CM_ SG_ 1749 OBJ_POS_LONG_ERR_006 "Lat-position error of object track's centroid in VCS coordinate";
CM_ SG_ 1749 OBJ_POS_LAT_ERR_006 "Lat-position error of object track's centroid in VCS coordinate";
CM_ SG_ 1749 OBJ_TRACK_MOTION_MODEL_006 "Object tracking uses a motion model for tracking moving items";
CM_ SG_ 1749 OBJ_DIMENSION_WIDTH_006 "Lat distance from centroid to edge of bounding box.";
CM_ SG_ 1749 OBJ_DIMENSION_LENGTH_006 "Longi distance from centroid to edge of bounding box.";
CM_ SG_ 1749 OBJ_EXISTENCE_PROB_006 "Probability that the target is an actual target";
CM_ SG_ 1749 OBJ_YAW_ANGLE_006 "Orientation of track's bounding box in VCS coordinate";
CM_ SG_ 1749 OBJ_ID_006 "ID of object tracks, zero-ID represents an inactive track";
CM_ SG_ 1749 OBJ_MOVEMENT_STATUS_006 "Information about a possible movement of the object during tracking";
CM_ SG_ 1749 OBJ_MEASUREMENT_STATUS_006 "Objects should be sent out as fast as possible, even if not all statuses are observed and the object’s
signals might not be fully filled.";
CM_ SG_ 1749 OBJ_POS_LONG_006 "Long-position of object track's centroid in VCS coordinate";
CM_ SG_ 1749 OBJ_POS_LAT_006 "Lat-position of object track's centroid in VCS coordinate";
CM_ SG_ 1749 OBJ_VELOCITY_LONG_006 "Over-the-ground velocity of object track's centroid along Long direction (in VCS coordinate)";
CM_ SG_ 1749 OBJ_VELOCITY_LAT_006 "Over-the-ground velocity of object track's centroid along Lat direction (in VCS coordinate)";
CM_ SG_ 1749 OBJ_ACCELERATION_LONG_006 "Over-the-ground track acceleration along Longi direction (in VCS coordinate)";
CM_ SG_ 1749 OBJ_ACCELERATION_LAT_006 "Over-the-ground track acceleration along Lat direction (in VCS coordinate)";
CM_ SG_ 1749 OBJ_VEH_TRACK_FLAG_006 "Indicates if current track is a vehicle";
CM_ SG_ 1749 OBJ_TIMESTAMP_OFFSET_006 "A timestamp offset from the object list header timestamp for each object as we have different timestamps from different sensors leading to different timestamps on each object";
CM_ SG_ 1749 OBJ_DIMENSION_WIDTH_ERR_006 "Lat distance or length error";
CM_ SG_ 1749 OBJ_DIMENSION_LENGTH_ERR_006 "Longi distance or length error";
CM_ SG_ 1749 OBJ_CLS_TYPE1_006 "Classification Type 1(Highest Prob), selected from ENUM list";
CM_ SG_ 1749 OBJ_CLS_TYPE1_PROB_006 "Classification Type 1 probablity";
CM_ SG_ 1749 OBJ_CLS_TYPE6_006 "Classification Type 6(Lowest Prob), selected from ENUM list";
CM_ SG_ 1749 OBJ_CLS_TYPE6_PROB_006 "Classification Type 1 probablity";
CM_ SG_ 1749 OBJ_RCS_006 "Representative RCS of the complete recognized object, Not implemented";
CM_ SG_ 1749 OBJ_REF_PT_LONG_OFFSET_006 "Outer edges of the recognized object’s bounding box in Y axis";
CM_ SG_ 1749 OBJ_REF_PT_LAT_OFFSET_006 "Outer edges of the recognized object’s bounding box in X axis";
CM_ SG_ 1749 OBJ_YAW_RATE_006 "Orientation rate of track's bounding box in VCS coordinate";
CM_ SG_ 1749 OBJ_GROUP_ID_006 "Objects which are linked together shall have same group ID";
CM_ SG_ 1749 OBJ_POS_ERR_CRR_COEF_006 "vx-vy correlation due to small error in radial direction and big in cross radial - position Correlation Coefficient Error";
CM_ SG_ 1749 OBJ_VELOCITY_ERR_CRR_COEF_006 "vx-vy correlation due to small error in radial direction and big in cross radial - velocity Correlation Coefficient Error";
CM_ SG_ 1749 OBJ_ACCEL_ERR_CRR_COEF_006 "vx-vy correlation due to small error in radial direction and big in cross radial - Acceleration Correlation Coefficient Error";
CM_ SG_ 1750 OBJ_ALIVE_TIME_007 "Time since object initialization in msec. Tracker internal may have bigger values. On the output interface, we should saturate the signal in that case.";
CM_ SG_ 1750 OBJ_ACCELERATION_LONG_ERR_007 "acceleration along Longi  direction";
CM_ SG_ 1750 OBJ_ACCELERATION_LAT_ERR_007 "acceleration along Lat direction error";
CM_ SG_ 1750 OBJ_POS_LONG_ERR_007 "Lat-position error of object track's centroid in VCS coordinate";
CM_ SG_ 1750 OBJ_POS_LAT_ERR_007 "Lat-position error of object track's centroid in VCS coordinate";
CM_ SG_ 1750 OBJ_TRACK_MOTION_MODEL_007 "Object tracking uses a motion model for tracking moving items";
CM_ SG_ 1750 OBJ_DIMENSION_WIDTH_007 "Lat distance from centroid to edge of bounding box.";
CM_ SG_ 1750 OBJ_DIMENSION_LENGTH_007 "Longi distance from centroid to edge of bounding box.";
CM_ SG_ 1750 OBJ_EXISTENCE_PROB_007 "Probability that the target is an actual target";
CM_ SG_ 1750 OBJ_YAW_ANGLE_007 "Orientation of track's bounding box in VCS coordinate";
CM_ SG_ 1750 OBJ_ID_007 "ID of object tracks, zero-ID represents an inactive track";
CM_ SG_ 1750 OBJ_MOVEMENT_STATUS_007 "Information about a possible movement of the object during tracking";
CM_ SG_ 1750 OBJ_MEASUREMENT_STATUS_007 "Objects should be sent out as fast as possible, even if not all statuses are observed and the object’s
signals might not be fully filled.";
CM_ SG_ 1750 OBJ_POS_LONG_007 "Long-position of object track's centroid in VCS coordinate";
CM_ SG_ 1750 OBJ_POS_LAT_007 "Lat-position of object track's centroid in VCS coordinate";
CM_ SG_ 1750 OBJ_VELOCITY_LONG_007 "Over-the-ground velocity of object track's centroid along Long direction (in VCS coordinate)";
CM_ SG_ 1750 OBJ_VELOCITY_LAT_007 "Over-the-ground velocity of object track's centroid along Lat direction (in VCS coordinate)";
CM_ SG_ 1750 OBJ_ACCELERATION_LONG_007 "Over-the-ground track acceleration along Longi direction (in VCS coordinate)";
CM_ SG_ 1750 OBJ_ACCELERATION_LAT_007 "Over-the-ground track acceleration along Lat direction (in VCS coordinate)";
CM_ SG_ 1750 OBJ_VEH_TRACK_FLAG_007 "Indicates if current track is a vehicle";
CM_ SG_ 1750 OBJ_TIMESTAMP_OFFSET_007 "A timestamp offset from the object list header timestamp for each object as we have different timestamps from different sensors leading to different timestamps on each object";
CM_ SG_ 1750 OBJ_DIMENSION_WIDTH_ERR_007 "Lat distance or length error";
CM_ SG_ 1750 OBJ_DIMENSION_LENGTH_ERR_007 "Longi distance or length error";
CM_ SG_ 1750 OBJ_CLS_TYPE1_007 "Classification Type 1(Highest Prob), selected from ENUM list";
CM_ SG_ 1750 OBJ_CLS_TYPE1_PROB_007 "Classification Type 1 probablity";
CM_ SG_ 1750 OBJ_CLS_TYPE6_007 "Classification Type 6(Lowest Prob), selected from ENUM list";
CM_ SG_ 1750 OBJ_CLS_TYPE6_PROB_007 "Classification Type 1 probablity";
CM_ SG_ 1750 OBJ_RCS_007 "Representative RCS of the complete recognized object, Not implemented";
CM_ SG_ 1750 OBJ_REF_PT_LONG_OFFSET_007 "Outer edges of the recognized object’s bounding box in Y axis";
CM_ SG_ 1750 OBJ_REF_PT_LAT_OFFSET_007 "Outer edges of the recognized object’s bounding box in X axis";
CM_ SG_ 1750 OBJ_YAW_RATE_007 "Orientation rate of track's bounding box in VCS coordinate";
CM_ SG_ 1750 OBJ_GROUP_ID_007 "Objects which are linked together shall have same group ID";
CM_ SG_ 1750 OBJ_POS_ERR_CRR_COEF_007 "vx-vy correlation due to small error in radial direction and big in cross radial - position Correlation Coefficient Error";
CM_ SG_ 1750 OBJ_VELOCITY_ERR_CRR_COEF_007 "vx-vy correlation due to small error in radial direction and big in cross radial - velocity Correlation Coefficient Error";
CM_ SG_ 1750 OBJ_ACCEL_ERR_CRR_COEF_007 "vx-vy correlation due to small error in radial direction and big in cross radial - Acceleration Correlation Coefficient Error";
CM_ SG_ 1751 OBJ_ALIVE_TIME_008 "Time since object initialization in msec. Tracker internal may have bigger values. On the output interface, we should saturate the signal in that case.";
CM_ SG_ 1751 OBJ_ACCELERATION_LONG_ERR_008 "acceleration along Longi  direction";
CM_ SG_ 1751 OBJ_ACCELERATION_LAT_ERR_008 "acceleration along Lat direction error";
CM_ SG_ 1751 OBJ_POS_LONG_ERR_008 "Lat-position error of object track's centroid in VCS coordinate";
CM_ SG_ 1751 OBJ_POS_LAT_ERR_008 "Lat-position error of object track's centroid in VCS coordinate";
CM_ SG_ 1751 OBJ_TRACK_MOTION_MODEL_008 "Object tracking uses a motion model for tracking moving items";
CM_ SG_ 1751 OBJ_DIMENSION_WIDTH_008 "Lat distance from centroid to edge of bounding box.";
CM_ SG_ 1751 OBJ_DIMENSION_LENGTH_008 "Longi distance from centroid to edge of bounding box.";
CM_ SG_ 1751 OBJ_EXISTENCE_PROB_008 "Probability that the target is an actual target";
CM_ SG_ 1751 OBJ_YAW_ANGLE_008 "Orientation of track's bounding box in VCS coordinate";
CM_ SG_ 1751 OBJ_ID_008 "ID of object tracks, zero-ID represents an inactive track";
CM_ SG_ 1751 OBJ_MOVEMENT_STATUS_008 "Information about a possible movement of the object during tracking";
CM_ SG_ 1751 OBJ_MEASUREMENT_STATUS_008 "Objects should be sent out as fast as possible, even if not all statuses are observed and the object’s
signals might not be fully filled.";
CM_ SG_ 1751 OBJ_POS_LONG_008 "Long-position of object track's centroid in VCS coordinate";
CM_ SG_ 1751 OBJ_POS_LAT_008 "Lat-position of object track's centroid in VCS coordinate";
CM_ SG_ 1751 OBJ_VELOCITY_LONG_008 "Over-the-ground velocity of object track's centroid along Long direction (in VCS coordinate)";
CM_ SG_ 1751 OBJ_VELOCITY_LAT_008 "Over-the-ground velocity of object track's centroid along Lat direction (in VCS coordinate)";
CM_ SG_ 1751 OBJ_ACCELERATION_LONG_008 "Over-the-ground track acceleration along Longi direction (in VCS coordinate)";
CM_ SG_ 1751 OBJ_ACCELERATION_LAT_008 "Over-the-ground track acceleration along Lat direction (in VCS coordinate)";
CM_ SG_ 1751 OBJ_VEH_TRACK_FLAG_008 "Indicates if current track is a vehicle";
CM_ SG_ 1751 OBJ_TIMESTAMP_OFFSET_008 "A timestamp offset from the object list header timestamp for each object as we have different timestamps from different sensors leading to different timestamps on each object";
CM_ SG_ 1751 OBJ_DIMENSION_WIDTH_ERR_008 "Lat distance or length error";
CM_ SG_ 1751 OBJ_DIMENSION_LENGTH_ERR_008 "Longi distance or length error";
CM_ SG_ 1751 OBJ_CLS_TYPE1_008 "Classification Type 1(Highest Prob), selected from ENUM list";
CM_ SG_ 1751 OBJ_CLS_TYPE1_PROB_008 "Classification Type 1 probablity";
CM_ SG_ 1751 OBJ_CLS_TYPE6_008 "Classification Type 6(Lowest Prob), selected from ENUM list";
CM_ SG_ 1751 OBJ_CLS_TYPE6_PROB_008 "Classification Type 1 probablity";
CM_ SG_ 1751 OBJ_RCS_008 "Representative RCS of the complete recognized object, Not implemented";
CM_ SG_ 1751 OBJ_REF_PT_LONG_OFFSET_008 "Outer edges of the recognized object’s bounding box in Y axis";
CM_ SG_ 1751 OBJ_REF_PT_LAT_OFFSET_008 "Outer edges of the recognized object’s bounding box in X axis";
CM_ SG_ 1751 OBJ_YAW_RATE_008 "Orientation rate of track's bounding box in VCS coordinate";
CM_ SG_ 1751 OBJ_GROUP_ID_008 "Objects which are linked together shall have same group ID";
CM_ SG_ 1751 OBJ_POS_ERR_CRR_COEF_008 "vx-vy correlation due to small error in radial direction and big in cross radial - position Correlation Coefficient Error";
CM_ SG_ 1751 OBJ_VELOCITY_ERR_CRR_COEF_008 "vx-vy correlation due to small error in radial direction and big in cross radial - velocity Correlation Coefficient Error";
CM_ SG_ 1751 OBJ_ACCEL_ERR_CRR_COEF_008 "vx-vy correlation due to small error in radial direction and big in cross radial - Acceleration Correlation Coefficient Error";
CM_ SG_ 1752 OBJ_ALIVE_TIME_009 "Time since object initialization in msec. Tracker internal may have bigger values. On the output interface, we should saturate the signal in that case.";
CM_ SG_ 1752 OBJ_ACCELERATION_LONG_ERR_009 "acceleration along Longi  direction";
CM_ SG_ 1752 OBJ_ACCELERATION_LAT_ERR_009 "acceleration along Lat direction error";
CM_ SG_ 1752 OBJ_POS_LONG_ERR_009 "Lat-position error of object track's centroid in VCS coordinate";
CM_ SG_ 1752 OBJ_POS_LAT_ERR_009 "Lat-position error of object track's centroid in VCS coordinate";
CM_ SG_ 1752 OBJ_TRACK_MOTION_MODEL_009 "Object tracking uses a motion model for tracking moving items";
CM_ SG_ 1752 OBJ_DIMENSION_WIDTH_009 "Lat distance from centroid to edge of bounding box.";
CM_ SG_ 1752 OBJ_DIMENSION_LENGTH_009 "Longi distance from centroid to edge of bounding box.";
CM_ SG_ 1752 OBJ_EXISTENCE_PROB_009 "Probability that the target is an actual target";
CM_ SG_ 1752 OBJ_YAW_ANGLE_009 "Orientation of track's bounding box in VCS coordinate";
CM_ SG_ 1752 OBJ_ID_009 "ID of object tracks, zero-ID represents an inactive track";
CM_ SG_ 1752 OBJ_MOVEMENT_STATUS_009 "Information about a possible movement of the object during tracking";
CM_ SG_ 1752 OBJ_MEASUREMENT_STATUS_009 "Objects should be sent out as fast as possible, even if not all statuses are observed and the object’s
signals might not be fully filled.";
CM_ SG_ 1752 OBJ_POS_LONG_009 "Long-position of object track's centroid in VCS coordinate";
CM_ SG_ 1752 OBJ_POS_LAT_009 "Lat-position of object track's centroid in VCS coordinate";
CM_ SG_ 1752 OBJ_VELOCITY_LONG_009 "Over-the-ground velocity of object track's centroid along Long direction (in VCS coordinate)";
CM_ SG_ 1752 OBJ_VELOCITY_LAT_009 "Over-the-ground velocity of object track's centroid along Lat direction (in VCS coordinate)";
CM_ SG_ 1752 OBJ_ACCELERATION_LONG_009 "Over-the-ground track acceleration along Longi direction (in VCS coordinate)";
CM_ SG_ 1752 OBJ_ACCELERATION_LAT_009 "Over-the-ground track acceleration along Lat direction (in VCS coordinate)";
CM_ SG_ 1752 OBJ_VEH_TRACK_FLAG_009 "Indicates if current track is a vehicle";
CM_ SG_ 1752 OBJ_TIMESTAMP_OFFSET_009 "A timestamp offset from the object list header timestamp for each object as we have different timestamps from different sensors leading to different timestamps on each object";
CM_ SG_ 1752 OBJ_DIMENSION_WIDTH_ERR_009 "Lat distance or length error";
CM_ SG_ 1752 OBJ_DIMENSION_LENGTH_ERR_009 "Longi distance or length error";
CM_ SG_ 1752 OBJ_CLS_TYPE1_009 "Classification Type 1(Highest Prob), selected from ENUM list";
CM_ SG_ 1752 OBJ_CLS_TYPE1_PROB_009 "Classification Type 1 probablity";
CM_ SG_ 1752 OBJ_CLS_TYPE6_009 "Classification Type 6(Lowest Prob), selected from ENUM list";
CM_ SG_ 1752 OBJ_CLS_TYPE6_PROB_009 "Classification Type 1 probablity";
CM_ SG_ 1752 OBJ_RCS_009 "Representative RCS of the complete recognized object, Not implemented";
CM_ SG_ 1752 OBJ_REF_PT_LONG_OFFSET_009 "Outer edges of the recognized object’s bounding box in Y axis";
CM_ SG_ 1752 OBJ_REF_PT_LAT_OFFSET_009 "Outer edges of the recognized object’s bounding box in X axis";
CM_ SG_ 1752 OBJ_YAW_RATE_009 "Orientation rate of track's bounding box in VCS coordinate";
CM_ SG_ 1752 OBJ_GROUP_ID_009 "Objects which are linked together shall have same group ID";
CM_ SG_ 1752 OBJ_POS_ERR_CRR_COEF_009 "vx-vy correlation due to small error in radial direction and big in cross radial - position Correlation Coefficient Error";
CM_ SG_ 1752 OBJ_VELOCITY_ERR_CRR_COEF_009 "vx-vy correlation due to small error in radial direction and big in cross radial - velocity Correlation Coefficient Error";
CM_ SG_ 1752 OBJ_ACCEL_ERR_CRR_COEF_009 "vx-vy correlation due to small error in radial direction and big in cross radial - Acceleration Correlation Coefficient Error";
CM_ SG_ 1753 OBJ_ALIVE_TIME_010 "Time since object initialization in msec. Tracker internal may have bigger values. On the output interface, we should saturate the signal in that case.";
CM_ SG_ 1753 OBJ_ACCELERATION_LONG_ERR_010 "acceleration along Longi  direction";
CM_ SG_ 1753 OBJ_ACCELERATION_LAT_ERR_010 "acceleration along Lat direction error";
CM_ SG_ 1753 OBJ_POS_LONG_ERR_010 "Lat-position error of object track's centroid in VCS coordinate";
CM_ SG_ 1753 OBJ_POS_LAT_ERR_010 "Lat-position error of object track's centroid in VCS coordinate";
CM_ SG_ 1753 OBJ_TRACK_MOTION_MODEL_010 "Object tracking uses a motion model for tracking moving items";
CM_ SG_ 1753 OBJ_DIMENSION_WIDTH_010 "Lat distance from centroid to edge of bounding box.";
CM_ SG_ 1753 OBJ_DIMENSION_LENGTH_010 "Longi distance from centroid to edge of bounding box.";
CM_ SG_ 1753 OBJ_EXISTENCE_PROB_010 "Probability that the target is an actual target";
CM_ SG_ 1753 OBJ_YAW_ANGLE_010 "Orientation of track's bounding box in VCS coordinate";
CM_ SG_ 1753 OBJ_ID_010 "ID of object tracks, zero-ID represents an inactive track";
CM_ SG_ 1753 OBJ_MOVEMENT_STATUS_010 "Information about a possible movement of the object during tracking";
CM_ SG_ 1753 OBJ_MEASUREMENT_STATUS_010 "Objects should be sent out as fast as possible, even if not all statuses are observed and the object’s
signals might not be fully filled.";
CM_ SG_ 1753 OBJ_POS_LONG_010 "Long-position of object track's centroid in VCS coordinate";
CM_ SG_ 1753 OBJ_POS_LAT_010 "Lat-position of object track's centroid in VCS coordinate";
CM_ SG_ 1753 OBJ_VELOCITY_LONG_010 "Over-the-ground velocity of object track's centroid along Long direction (in VCS coordinate)";
CM_ SG_ 1753 OBJ_VELOCITY_LAT_010 "Over-the-ground velocity of object track's centroid along Lat direction (in VCS coordinate)";
CM_ SG_ 1753 OBJ_ACCELERATION_LONG_010 "Over-the-ground track acceleration along Longi direction (in VCS coordinate)";
CM_ SG_ 1753 OBJ_ACCELERATION_LAT_010 "Over-the-ground track acceleration along Lat direction (in VCS coordinate)";
CM_ SG_ 1753 OBJ_VEH_TRACK_FLAG_010 "Indicates if current track is a vehicle";
CM_ SG_ 1753 OBJ_TIMESTAMP_OFFSET_010 "A timestamp offset from the object list header timestamp for each object as we have different timestamps from different sensors leading to different timestamps on each object";
CM_ SG_ 1753 OBJ_DIMENSION_WIDTH_ERR_010 "Lat distance or length error";
CM_ SG_ 1753 OBJ_DIMENSION_LENGTH_ERR_010 "Longi distance or length error";
CM_ SG_ 1753 OBJ_CLS_TYPE1_010 "Classification Type 1(Highest Prob), selected from ENUM list";
CM_ SG_ 1753 OBJ_CLS_TYPE1_PROB_010 "Classification Type 1 probablity";
CM_ SG_ 1753 OBJ_CLS_TYPE6_010 "Classification Type 6(Lowest Prob), selected from ENUM list";
CM_ SG_ 1753 OBJ_CLS_TYPE6_PROB_010 "Classification Type 1 probablity";
CM_ SG_ 1753 OBJ_RCS_010 "Representative RCS of the complete recognized object, Not implemented";
CM_ SG_ 1753 OBJ_REF_PT_LONG_OFFSET_010 "Outer edges of the recognized object’s bounding box in Y axis";
CM_ SG_ 1753 OBJ_REF_PT_LAT_OFFSET_010 "Outer edges of the recognized object’s bounding box in X axis";
CM_ SG_ 1753 OBJ_YAW_RATE_010 "Orientation rate of track's bounding box in VCS coordinate";
CM_ SG_ 1753 OBJ_GROUP_ID_010 "Objects which are linked together shall have same group ID";
CM_ SG_ 1753 OBJ_POS_ERR_CRR_COEF_010 "vx-vy correlation due to small error in radial direction and big in cross radial - position Correlation Coefficient Error";
CM_ SG_ 1753 OBJ_VELOCITY_ERR_CRR_COEF_010 "vx-vy correlation due to small error in radial direction and big in cross radial - velocity Correlation Coefficient Error";
CM_ SG_ 1753 OBJ_ACCEL_ERR_CRR_COEF_010 "vx-vy correlation due to small error in radial direction and big in cross radial - Acceleration Correlation Coefficient Error";
CM_ SG_ 1754 OBJ_ALIVE_TIME_011 "Time since object initialization in msec. Tracker internal may have bigger values. On the output interface, we should saturate the signal in that case.";
CM_ SG_ 1754 OBJ_ACCELERATION_LONG_ERR_011 "acceleration along Longi  direction";
CM_ SG_ 1754 OBJ_ACCELERATION_LAT_ERR_011 "acceleration along Lat direction error";
CM_ SG_ 1754 OBJ_POS_LONG_ERR_011 "Lat-position error of object track's centroid in VCS coordinate";
CM_ SG_ 1754 OBJ_POS_LAT_ERR_011 "Lat-position error of object track's centroid in VCS coordinate";
CM_ SG_ 1754 OBJ_TRACK_MOTION_MODEL_011 "Object tracking uses a motion model for tracking moving items";
CM_ SG_ 1754 OBJ_DIMENSION_WIDTH_011 "Lat distance from centroid to edge of bounding box.";
CM_ SG_ 1754 OBJ_DIMENSION_LENGTH_011 "Longi distance from centroid to edge of bounding box.";
CM_ SG_ 1754 OBJ_EXISTENCE_PROB_011 "Probability that the target is an actual target";
CM_ SG_ 1754 OBJ_YAW_ANGLE_011 "Orientation of track's bounding box in VCS coordinate";
CM_ SG_ 1754 OBJ_ID_011 "ID of object tracks, zero-ID represents an inactive track";
CM_ SG_ 1754 OBJ_MOVEMENT_STATUS_011 "Information about a possible movement of the object during tracking";
CM_ SG_ 1754 OBJ_MEASUREMENT_STATUS_011 "Objects should be sent out as fast as possible, even if not all statuses are observed and the object’s
signals might not be fully filled.";
CM_ SG_ 1754 OBJ_POS_LONG_011 "Long-position of object track's centroid in VCS coordinate";
CM_ SG_ 1754 OBJ_POS_LAT_011 "Lat-position of object track's centroid in VCS coordinate";
CM_ SG_ 1754 OBJ_VELOCITY_LONG_011 "Over-the-ground velocity of object track's centroid along Long direction (in VCS coordinate)";
CM_ SG_ 1754 OBJ_VELOCITY_LAT_011 "Over-the-ground velocity of object track's centroid along Lat direction (in VCS coordinate)";
CM_ SG_ 1754 OBJ_ACCELERATION_LONG_011 "Over-the-ground track acceleration along Longi direction (in VCS coordinate)";
CM_ SG_ 1754 OBJ_ACCELERATION_LAT_011 "Over-the-ground track acceleration along Lat direction (in VCS coordinate)";
CM_ SG_ 1754 OBJ_VEH_TRACK_FLAG_011 "Indicates if current track is a vehicle";
CM_ SG_ 1754 OBJ_TIMESTAMP_OFFSET_011 "A timestamp offset from the object list header timestamp for each object as we have different timestamps from different sensors leading to different timestamps on each object";
CM_ SG_ 1754 OBJ_DIMENSION_WIDTH_ERR_011 "Lat distance or length error";
CM_ SG_ 1754 OBJ_DIMENSION_LENGTH_ERR_011 "Longi distance or length error";
CM_ SG_ 1754 OBJ_CLS_TYPE1_011 "Classification Type 1(Highest Prob), selected from ENUM list";
CM_ SG_ 1754 OBJ_CLS_TYPE1_PROB_011 "Classification Type 1 probablity";
CM_ SG_ 1754 OBJ_CLS_TYPE6_011 "Classification Type 6(Lowest Prob), selected from ENUM list";
CM_ SG_ 1754 OBJ_CLS_TYPE6_PROB_011 "Classification Type 1 probablity";
CM_ SG_ 1754 OBJ_RCS_011 "Representative RCS of the complete recognized object, Not implemented";
CM_ SG_ 1754 OBJ_REF_PT_LONG_OFFSET_011 "Outer edges of the recognized object’s bounding box in Y axis";
CM_ SG_ 1754 OBJ_REF_PT_LAT_OFFSET_011 "Outer edges of the recognized object’s bounding box in X axis";
CM_ SG_ 1754 OBJ_YAW_RATE_011 "Orientation rate of track's bounding box in VCS coordinate";
CM_ SG_ 1754 OBJ_GROUP_ID_011 "Objects which are linked together shall have same group ID";
CM_ SG_ 1754 OBJ_POS_ERR_CRR_COEF_011 "vx-vy correlation due to small error in radial direction and big in cross radial - position Correlation Coefficient Error";
CM_ SG_ 1754 OBJ_VELOCITY_ERR_CRR_COEF_011 "vx-vy correlation due to small error in radial direction and big in cross radial - velocity Correlation Coefficient Error";
CM_ SG_ 1754 OBJ_ACCEL_ERR_CRR_COEF_011 "vx-vy correlation due to small error in radial direction and big in cross radial - Acceleration Correlation Coefficient Error";
CM_ SG_ 1755 OBJ_ALIVE_TIME_012 "Time since object initialization in msec. Tracker internal may have bigger values. On the output interface, we should saturate the signal in that case.";
CM_ SG_ 1755 OBJ_ACCELERATION_LONG_ERR_012 "acceleration along Longi  direction";
CM_ SG_ 1755 OBJ_ACCELERATION_LAT_ERR_012 "acceleration along Lat direction error";
CM_ SG_ 1755 OBJ_POS_LONG_ERR_012 "Lat-position error of object track's centroid in VCS coordinate";
CM_ SG_ 1755 OBJ_POS_LAT_ERR_012 "Lat-position error of object track's centroid in VCS coordinate";
CM_ SG_ 1755 OBJ_TRACK_MOTION_MODEL_012 "Object tracking uses a motion model for tracking moving items";
CM_ SG_ 1755 OBJ_DIMENSION_WIDTH_012 "Lat distance from centroid to edge of bounding box.";
CM_ SG_ 1755 OBJ_DIMENSION_LENGTH_012 "Longi distance from centroid to edge of bounding box.";
CM_ SG_ 1755 OBJ_EXISTENCE_PROB_012 "Probability that the target is an actual target";
CM_ SG_ 1755 OBJ_YAW_ANGLE_012 "Orientation of track's bounding box in VCS coordinate";
CM_ SG_ 1755 OBJ_ID_012 "ID of object tracks, zero-ID represents an inactive track";
CM_ SG_ 1755 OBJ_MOVEMENT_STATUS_012 "Information about a possible movement of the object during tracking";
CM_ SG_ 1755 OBJ_MEASUREMENT_STATUS_012 "Objects should be sent out as fast as possible, even if not all statuses are observed and the object’s
signals might not be fully filled.";
CM_ SG_ 1755 OBJ_POS_LONG_012 "Long-position of object track's centroid in VCS coordinate";
CM_ SG_ 1755 OBJ_POS_LAT_012 "Lat-position of object track's centroid in VCS coordinate";
CM_ SG_ 1755 OBJ_VELOCITY_LONG_012 "Over-the-ground velocity of object track's centroid along Long direction (in VCS coordinate)";
CM_ SG_ 1755 OBJ_VELOCITY_LAT_012 "Over-the-ground velocity of object track's centroid along Lat direction (in VCS coordinate)";
CM_ SG_ 1755 OBJ_ACCELERATION_LONG_012 "Over-the-ground track acceleration along Longi direction (in VCS coordinate)";
CM_ SG_ 1755 OBJ_ACCELERATION_LAT_012 "Over-the-ground track acceleration along Lat direction (in VCS coordinate)";
CM_ SG_ 1755 OBJ_VEH_TRACK_FLAG_012 "Indicates if current track is a vehicle";
CM_ SG_ 1755 OBJ_TIMESTAMP_OFFSET_012 "A timestamp offset from the object list header timestamp for each object as we have different timestamps from different sensors leading to different timestamps on each object";
CM_ SG_ 1755 OBJ_DIMENSION_WIDTH_ERR_012 "Lat distance or length error";
CM_ SG_ 1755 OBJ_DIMENSION_LENGTH_ERR_012 "Longi distance or length error";
CM_ SG_ 1755 OBJ_CLS_TYPE1_012 "Classification Type 1(Highest Prob), selected from ENUM list";
CM_ SG_ 1755 OBJ_CLS_TYPE1_PROB_012 "Classification Type 1 probablity";
CM_ SG_ 1755 OBJ_CLS_TYPE6_012 "Classification Type 6(Lowest Prob), selected from ENUM list";
CM_ SG_ 1755 OBJ_CLS_TYPE6_PROB_012 "Classification Type 1 probablity";
CM_ SG_ 1755 OBJ_RCS_012 "Representative RCS of the complete recognized object, Not implemented";
CM_ SG_ 1755 OBJ_REF_PT_LONG_OFFSET_012 "Outer edges of the recognized object’s bounding box in Y axis";
CM_ SG_ 1755 OBJ_REF_PT_LAT_OFFSET_012 "Outer edges of the recognized object’s bounding box in X axis";
CM_ SG_ 1755 OBJ_YAW_RATE_012 "Orientation rate of track's bounding box in VCS coordinate";
CM_ SG_ 1755 OBJ_GROUP_ID_012 "Objects which are linked together shall have same group ID";
CM_ SG_ 1755 OBJ_POS_ERR_CRR_COEF_012 "vx-vy correlation due to small error in radial direction and big in cross radial - position Correlation Coefficient Error";
CM_ SG_ 1755 OBJ_VELOCITY_ERR_CRR_COEF_012 "vx-vy correlation due to small error in radial direction and big in cross radial - velocity Correlation Coefficient Error";
CM_ SG_ 1755 OBJ_ACCEL_ERR_CRR_COEF_012 "vx-vy correlation due to small error in radial direction and big in cross radial - Acceleration Correlation Coefficient Error";
CM_ SG_ 1756 OBJ_ALIVE_TIME_013 "Time since object initialization in msec. Tracker internal may have bigger values. On the output interface, we should saturate the signal in that case.";
CM_ SG_ 1756 OBJ_ACCELERATION_LONG_ERR_013 "acceleration along Longi  direction";
CM_ SG_ 1756 OBJ_ACCELERATION_LAT_ERR_013 "acceleration along Lat direction error";
CM_ SG_ 1756 OBJ_POS_LONG_ERR_013 "Lat-position error of object track's centroid in VCS coordinate";
CM_ SG_ 1756 OBJ_POS_LAT_ERR_013 "Lat-position error of object track's centroid in VCS coordinate";
CM_ SG_ 1756 OBJ_TRACK_MOTION_MODEL_013 "Object tracking uses a motion model for tracking moving items";
CM_ SG_ 1756 OBJ_DIMENSION_WIDTH_013 "Lat distance from centroid to edge of bounding box.";
CM_ SG_ 1756 OBJ_DIMENSION_LENGTH_013 "Longi distance from centroid to edge of bounding box.";
CM_ SG_ 1756 OBJ_EXISTENCE_PROB_013 "Probability that the target is an actual target";
CM_ SG_ 1756 OBJ_YAW_ANGLE_013 "Orientation of track's bounding box in VCS coordinate";
CM_ SG_ 1756 OBJ_ID_013 "ID of object tracks, zero-ID represents an inactive track";
CM_ SG_ 1756 OBJ_MOVEMENT_STATUS_013 "Information about a possible movement of the object during tracking";
CM_ SG_ 1756 OBJ_MEASUREMENT_STATUS_013 "Objects should be sent out as fast as possible, even if not all statuses are observed and the object’s
signals might not be fully filled.";
CM_ SG_ 1756 OBJ_POS_LONG_013 "Long-position of object track's centroid in VCS coordinate";
CM_ SG_ 1756 OBJ_POS_LAT_013 "Lat-position of object track's centroid in VCS coordinate";
CM_ SG_ 1756 OBJ_VELOCITY_LONG_013 "Over-the-ground velocity of object track's centroid along Long direction (in VCS coordinate)";
CM_ SG_ 1756 OBJ_VELOCITY_LAT_013 "Over-the-ground velocity of object track's centroid along Lat direction (in VCS coordinate)";
CM_ SG_ 1756 OBJ_ACCELERATION_LONG_013 "Over-the-ground track acceleration along Longi direction (in VCS coordinate)";
CM_ SG_ 1756 OBJ_ACCELERATION_LAT_013 "Over-the-ground track acceleration along Lat direction (in VCS coordinate)";
CM_ SG_ 1756 OBJ_VEH_TRACK_FLAG_013 "Indicates if current track is a vehicle";
CM_ SG_ 1756 OBJ_TIMESTAMP_OFFSET_013 "A timestamp offset from the object list header timestamp for each object as we have different timestamps from different sensors leading to different timestamps on each object";
CM_ SG_ 1756 OBJ_DIMENSION_WIDTH_ERR_013 "Lat distance or length error";
CM_ SG_ 1756 OBJ_DIMENSION_LENGTH_ERR_013 "Longi distance or length error";
CM_ SG_ 1756 OBJ_CLS_TYPE1_013 "Classification Type 1(Highest Prob), selected from ENUM list";
CM_ SG_ 1756 OBJ_CLS_TYPE1_PROB_013 "Classification Type 1 probablity";
CM_ SG_ 1756 OBJ_CLS_TYPE6_013 "Classification Type 6(Lowest Prob), selected from ENUM list";
CM_ SG_ 1756 OBJ_CLS_TYPE6_PROB_013 "Classification Type 1 probablity";
CM_ SG_ 1756 OBJ_RCS_013 "Representative RCS of the complete recognized object, Not implemented";
CM_ SG_ 1756 OBJ_REF_PT_LONG_OFFSET_013 "Outer edges of the recognized object’s bounding box in Y axis";
CM_ SG_ 1756 OBJ_REF_PT_LAT_OFFSET_013 "Outer edges of the recognized object’s bounding box in X axis";
CM_ SG_ 1756 OBJ_YAW_RATE_013 "Orientation rate of track's bounding box in VCS coordinate";
CM_ SG_ 1756 OBJ_GROUP_ID_013 "Objects which are linked together shall have same group ID";
CM_ SG_ 1756 OBJ_POS_ERR_CRR_COEF_013 "vx-vy correlation due to small error in radial direction and big in cross radial - position Correlation Coefficient Error";
CM_ SG_ 1756 OBJ_VELOCITY_ERR_CRR_COEF_013 "vx-vy correlation due to small error in radial direction and big in cross radial - velocity Correlation Coefficient Error";
CM_ SG_ 1756 OBJ_ACCEL_ERR_CRR_COEF_013 "vx-vy correlation due to small error in radial direction and big in cross radial - Acceleration Correlation Coefficient Error";
CM_ SG_ 1757 OBJ_ALIVE_TIME_014 "Time since object initialization in msec. Tracker internal may have bigger values. On the output interface, we should saturate the signal in that case.";
CM_ SG_ 1757 OBJ_ACCELERATION_LONG_ERR_014 "acceleration along Longi  direction";
CM_ SG_ 1757 OBJ_ACCELERATION_LAT_ERR_014 "acceleration along Lat direction error";
CM_ SG_ 1757 OBJ_POS_LONG_ERR_014 "Lat-position error of object track's centroid in VCS coordinate";
CM_ SG_ 1757 OBJ_POS_LAT_ERR_014 "Lat-position error of object track's centroid in VCS coordinate";
CM_ SG_ 1757 OBJ_TRACK_MOTION_MODEL_014 "Object tracking uses a motion model for tracking moving items";
CM_ SG_ 1757 OBJ_DIMENSION_WIDTH_014 "Lat distance from centroid to edge of bounding box.";
CM_ SG_ 1757 OBJ_DIMENSION_LENGTH_014 "Longi distance from centroid to edge of bounding box.";
CM_ SG_ 1757 OBJ_EXISTENCE_PROB_014 "Probability that the target is an actual target";
CM_ SG_ 1757 OBJ_YAW_ANGLE_014 "Orientation of track's bounding box in VCS coordinate";
CM_ SG_ 1757 OBJ_ID_014 "ID of object tracks, zero-ID represents an inactive track";
CM_ SG_ 1757 OBJ_MOVEMENT_STATUS_014 "Information about a possible movement of the object during tracking";
CM_ SG_ 1757 OBJ_MEASUREMENT_STATUS_014 "Objects should be sent out as fast as possible, even if not all statuses are observed and the object’s
signals might not be fully filled.";
CM_ SG_ 1757 OBJ_POS_LONG_014 "Long-position of object track's centroid in VCS coordinate";
CM_ SG_ 1757 OBJ_POS_LAT_014 "Lat-position of object track's centroid in VCS coordinate";
CM_ SG_ 1757 OBJ_VELOCITY_LONG_014 "Over-the-ground velocity of object track's centroid along Long direction (in VCS coordinate)";
CM_ SG_ 1757 OBJ_VELOCITY_LAT_014 "Over-the-ground velocity of object track's centroid along Lat direction (in VCS coordinate)";
CM_ SG_ 1757 OBJ_ACCELERATION_LONG_014 "Over-the-ground track acceleration along Longi direction (in VCS coordinate)";
CM_ SG_ 1757 OBJ_ACCELERATION_LAT_014 "Over-the-ground track acceleration along Lat direction (in VCS coordinate)";
CM_ SG_ 1757 OBJ_VEH_TRACK_FLAG_014 "Indicates if current track is a vehicle";
CM_ SG_ 1757 OBJ_TIMESTAMP_OFFSET_014 "A timestamp offset from the object list header timestamp for each object as we have different timestamps from different sensors leading to different timestamps on each object";
CM_ SG_ 1757 OBJ_DIMENSION_WIDTH_ERR_014 "Lat distance or length error";
CM_ SG_ 1757 OBJ_DIMENSION_LENGTH_ERR_014 "Longi distance or length error";
CM_ SG_ 1757 OBJ_CLS_TYPE1_014 "Classification Type 1(Highest Prob), selected from ENUM list";
CM_ SG_ 1757 OBJ_CLS_TYPE1_PROB_014 "Classification Type 1 probablity";
CM_ SG_ 1757 OBJ_CLS_TYPE6_014 "Classification Type 6(Lowest Prob), selected from ENUM list";
CM_ SG_ 1757 OBJ_CLS_TYPE6_PROB_014 "Classification Type 1 probablity";
CM_ SG_ 1757 OBJ_RCS_014 "Representative RCS of the complete recognized object, Not implemented";
CM_ SG_ 1757 OBJ_REF_PT_LONG_OFFSET_014 "Outer edges of the recognized object’s bounding box in Y axis";
CM_ SG_ 1757 OBJ_REF_PT_LAT_OFFSET_014 "Outer edges of the recognized object’s bounding box in X axis";
CM_ SG_ 1757 OBJ_YAW_RATE_014 "Orientation rate of track's bounding box in VCS coordinate";
CM_ SG_ 1757 OBJ_GROUP_ID_014 "Objects which are linked together shall have same group ID";
CM_ SG_ 1757 OBJ_POS_ERR_CRR_COEF_014 "vx-vy correlation due to small error in radial direction and big in cross radial - position Correlation Coefficient Error";
CM_ SG_ 1757 OBJ_VELOCITY_ERR_CRR_COEF_014 "vx-vy correlation due to small error in radial direction and big in cross radial - velocity Correlation Coefficient Error";
CM_ SG_ 1757 OBJ_ACCEL_ERR_CRR_COEF_014 "vx-vy correlation due to small error in radial direction and big in cross radial - Acceleration Correlation Coefficient Error";
CM_ SG_ 1758 OBJ_ALIVE_TIME_015 "Time since object initialization in msec. Tracker internal may have bigger values. On the output interface, we should saturate the signal in that case.";
CM_ SG_ 1758 OBJ_ACCELERATION_LONG_ERR_015 "acceleration along Longi  direction";
CM_ SG_ 1758 OBJ_ACCELERATION_LAT_ERR_015 "acceleration along Lat direction error";
CM_ SG_ 1758 OBJ_POS_LONG_ERR_015 "Lat-position error of object track's centroid in VCS coordinate";
CM_ SG_ 1758 OBJ_POS_LAT_ERR_015 "Lat-position error of object track's centroid in VCS coordinate";
CM_ SG_ 1758 OBJ_TRACK_MOTION_MODEL_015 "Object tracking uses a motion model for tracking moving items";
CM_ SG_ 1758 OBJ_DIMENSION_WIDTH_015 "Lat distance from centroid to edge of bounding box.";
CM_ SG_ 1758 OBJ_DIMENSION_LENGTH_015 "Longi distance from centroid to edge of bounding box.";
CM_ SG_ 1758 OBJ_EXISTENCE_PROB_015 "Probability that the target is an actual target";
CM_ SG_ 1758 OBJ_YAW_ANGLE_015 "Orientation of track's bounding box in VCS coordinate";
CM_ SG_ 1758 OBJ_ID_015 "ID of object tracks, zero-ID represents an inactive track";
CM_ SG_ 1758 OBJ_MOVEMENT_STATUS_015 "Information about a possible movement of the object during tracking";
CM_ SG_ 1758 OBJ_MEASUREMENT_STATUS_015 "Objects should be sent out as fast as possible, even if not all statuses are observed and the object’s
signals might not be fully filled.";
CM_ SG_ 1758 OBJ_POS_LONG_015 "Long-position of object track's centroid in VCS coordinate";
CM_ SG_ 1758 OBJ_POS_LAT_015 "Lat-position of object track's centroid in VCS coordinate";
CM_ SG_ 1758 OBJ_VELOCITY_LONG_015 "Over-the-ground velocity of object track's centroid along Long direction (in VCS coordinate)";
CM_ SG_ 1758 OBJ_VELOCITY_LAT_015 "Over-the-ground velocity of object track's centroid along Lat direction (in VCS coordinate)";
CM_ SG_ 1758 OBJ_ACCELERATION_LONG_015 "Over-the-ground track acceleration along Longi direction (in VCS coordinate)";
CM_ SG_ 1758 OBJ_ACCELERATION_LAT_015 "Over-the-ground track acceleration along Lat direction (in VCS coordinate)";
CM_ SG_ 1758 OBJ_VEH_TRACK_FLAG_015 "Indicates if current track is a vehicle";
CM_ SG_ 1758 OBJ_TIMESTAMP_OFFSET_015 "A timestamp offset from the object list header timestamp for each object as we have different timestamps from different sensors leading to different timestamps on each object";
CM_ SG_ 1758 OBJ_DIMENSION_WIDTH_ERR_015 "Lat distance or length error";
CM_ SG_ 1758 OBJ_DIMENSION_LENGTH_ERR_015 "Longi distance or length error";
CM_ SG_ 1758 OBJ_CLS_TYPE1_015 "Classification Type 1(Highest Prob), selected from ENUM list";
CM_ SG_ 1758 OBJ_CLS_TYPE1_PROB_015 "Classification Type 1 probablity";
CM_ SG_ 1758 OBJ_CLS_TYPE6_015 "Classification Type 6(Lowest Prob), selected from ENUM list";
CM_ SG_ 1758 OBJ_CLS_TYPE6_PROB_015 "Classification Type 1 probablity";
CM_ SG_ 1758 OBJ_RCS_015 "Representative RCS of the complete recognized object, Not implemented";
CM_ SG_ 1758 OBJ_REF_PT_LONG_OFFSET_015 "Outer edges of the recognized object’s bounding box in Y axis";
CM_ SG_ 1758 OBJ_REF_PT_LAT_OFFSET_015 "Outer edges of the recognized object’s bounding box in X axis";
CM_ SG_ 1758 OBJ_YAW_RATE_015 "Orientation rate of track's bounding box in VCS coordinate";
CM_ SG_ 1758 OBJ_GROUP_ID_015 "Objects which are linked together shall have same group ID";
CM_ SG_ 1758 OBJ_POS_ERR_CRR_COEF_015 "vx-vy correlation due to small error in radial direction and big in cross radial - position Correlation Coefficient Error";
CM_ SG_ 1758 OBJ_VELOCITY_ERR_CRR_COEF_015 "vx-vy correlation due to small error in radial direction and big in cross radial - velocity Correlation Coefficient Error";
CM_ SG_ 1758 OBJ_ACCEL_ERR_CRR_COEF_015 "vx-vy correlation due to small error in radial direction and big in cross radial - Acceleration Correlation Coefficient Error";
CM_ SG_ 1759 OBJ_ALIVE_TIME_016 "Time since object initialization in msec. Tracker internal may have bigger values. On the output interface, we should saturate the signal in that case.";
CM_ SG_ 1759 OBJ_ACCELERATION_LONG_ERR_016 "acceleration along Longi  direction";
CM_ SG_ 1759 OBJ_ACCELERATION_LAT_ERR_016 "acceleration along Lat direction error";
CM_ SG_ 1759 OBJ_POS_LONG_ERR_016 "Lat-position error of object track's centroid in VCS coordinate";
CM_ SG_ 1759 OBJ_POS_LAT_ERR_016 "Lat-position error of object track's centroid in VCS coordinate";
CM_ SG_ 1759 OBJ_TRACK_MOTION_MODEL_016 "Object tracking uses a motion model for tracking moving items";
CM_ SG_ 1759 OBJ_DIMENSION_WIDTH_016 "Lat distance from centroid to edge of bounding box.";
CM_ SG_ 1759 OBJ_DIMENSION_LENGTH_016 "Longi distance from centroid to edge of bounding box.";
CM_ SG_ 1759 OBJ_EXISTENCE_PROB_016 "Probability that the target is an actual target";
CM_ SG_ 1759 OBJ_YAW_ANGLE_016 "Orientation of track's bounding box in VCS coordinate";
CM_ SG_ 1759 OBJ_ID_016 "ID of object tracks, zero-ID represents an inactive track";
CM_ SG_ 1759 OBJ_MOVEMENT_STATUS_016 "Information about a possible movement of the object during tracking";
CM_ SG_ 1759 OBJ_MEASUREMENT_STATUS_016 "Objects should be sent out as fast as possible, even if not all statuses are observed and the object’s
signals might not be fully filled.";
CM_ SG_ 1759 OBJ_POS_LONG_016 "Long-position of object track's centroid in VCS coordinate";
CM_ SG_ 1759 OBJ_POS_LAT_016 "Lat-position of object track's centroid in VCS coordinate";
CM_ SG_ 1759 OBJ_VELOCITY_LONG_016 "Over-the-ground velocity of object track's centroid along Long direction (in VCS coordinate)";
CM_ SG_ 1759 OBJ_VELOCITY_LAT_016 "Over-the-ground velocity of object track's centroid along Lat direction (in VCS coordinate)";
CM_ SG_ 1759 OBJ_ACCELERATION_LONG_016 "Over-the-ground track acceleration along Longi direction (in VCS coordinate)";
CM_ SG_ 1759 OBJ_ACCELERATION_LAT_016 "Over-the-ground track acceleration along Lat direction (in VCS coordinate)";
CM_ SG_ 1759 OBJ_VEH_TRACK_FLAG_016 "Indicates if current track is a vehicle";
CM_ SG_ 1759 OBJ_TIMESTAMP_OFFSET_016 "A timestamp offset from the object list header timestamp for each object as we have different timestamps from different sensors leading to different timestamps on each object";
CM_ SG_ 1759 OBJ_DIMENSION_WIDTH_ERR_016 "Lat distance or length error";
CM_ SG_ 1759 OBJ_DIMENSION_LENGTH_ERR_016 "Longi distance or length error";
CM_ SG_ 1759 OBJ_CLS_TYPE1_016 "Classification Type 1(Highest Prob), selected from ENUM list";
CM_ SG_ 1759 OBJ_CLS_TYPE1_PROB_016 "Classification Type 1 probablity";
CM_ SG_ 1759 OBJ_CLS_TYPE6_016 "Classification Type 6(Lowest Prob), selected from ENUM list";
CM_ SG_ 1759 OBJ_CLS_TYPE6_PROB_016 "Classification Type 1 probablity";
CM_ SG_ 1759 OBJ_RCS_016 "Representative RCS of the complete recognized object, Not implemented";
CM_ SG_ 1759 OBJ_REF_PT_LONG_OFFSET_016 "Outer edges of the recognized object’s bounding box in Y axis";
CM_ SG_ 1759 OBJ_REF_PT_LAT_OFFSET_016 "Outer edges of the recognized object’s bounding box in X axis";
CM_ SG_ 1759 OBJ_YAW_RATE_016 "Orientation rate of track's bounding box in VCS coordinate";
CM_ SG_ 1759 OBJ_GROUP_ID_016 "Objects which are linked together shall have same group ID";
CM_ SG_ 1759 OBJ_POS_ERR_CRR_COEF_016 "vx-vy correlation due to small error in radial direction and big in cross radial - position Correlation Coefficient Error";
CM_ SG_ 1759 OBJ_VELOCITY_ERR_CRR_COEF_016 "vx-vy correlation due to small error in radial direction and big in cross radial - velocity Correlation Coefficient Error";
CM_ SG_ 1759 OBJ_ACCEL_ERR_CRR_COEF_016 "vx-vy correlation due to small error in radial direction and big in cross radial - Acceleration Correlation Coefficient Error";
CM_ SG_ 1760 OBJ_ALIVE_TIME_017 "Time since object initialization in msec. Tracker internal may have bigger values. On the output interface, we should saturate the signal in that case.";
CM_ SG_ 1760 OBJ_ACCELERATION_LONG_ERR_017 "acceleration along Longi  direction";
CM_ SG_ 1760 OBJ_ACCELERATION_LAT_ERR_017 "acceleration along Lat direction error";
CM_ SG_ 1760 OBJ_POS_LONG_ERR_017 "Lat-position error of object track's centroid in VCS coordinate";
CM_ SG_ 1760 OBJ_POS_LAT_ERR_017 "Lat-position error of object track's centroid in VCS coordinate";
CM_ SG_ 1760 OBJ_TRACK_MOTION_MODEL_017 "Object tracking uses a motion model for tracking moving items";
CM_ SG_ 1760 OBJ_DIMENSION_WIDTH_017 "Lat distance from centroid to edge of bounding box.";
CM_ SG_ 1760 OBJ_DIMENSION_LENGTH_017 "Longi distance from centroid to edge of bounding box.";
CM_ SG_ 1760 OBJ_EXISTENCE_PROB_017 "Probability that the target is an actual target";
CM_ SG_ 1760 OBJ_YAW_ANGLE_017 "Orientation of track's bounding box in VCS coordinate";
CM_ SG_ 1760 OBJ_ID_017 "ID of object tracks, zero-ID represents an inactive track";
CM_ SG_ 1760 OBJ_MOVEMENT_STATUS_017 "Information about a possible movement of the object during tracking";
CM_ SG_ 1760 OBJ_MEASUREMENT_STATUS_017 "Objects should be sent out as fast as possible, even if not all statuses are observed and the object’s
signals might not be fully filled.";
CM_ SG_ 1760 OBJ_POS_LONG_017 "Long-position of object track's centroid in VCS coordinate";
CM_ SG_ 1760 OBJ_POS_LAT_017 "Lat-position of object track's centroid in VCS coordinate";
CM_ SG_ 1760 OBJ_VELOCITY_LONG_017 "Over-the-ground velocity of object track's centroid along Long direction (in VCS coordinate)";
CM_ SG_ 1760 OBJ_VELOCITY_LAT_017 "Over-the-ground velocity of object track's centroid along Lat direction (in VCS coordinate)";
CM_ SG_ 1760 OBJ_ACCELERATION_LONG_017 "Over-the-ground track acceleration along Longi direction (in VCS coordinate)";
CM_ SG_ 1760 OBJ_ACCELERATION_LAT_017 "Over-the-ground track acceleration along Lat direction (in VCS coordinate)";
CM_ SG_ 1760 OBJ_VEH_TRACK_FLAG_017 "Indicates if current track is a vehicle";
CM_ SG_ 1760 OBJ_TIMESTAMP_OFFSET_017 "A timestamp offset from the object list header timestamp for each object as we have different timestamps from different sensors leading to different timestamps on each object";
CM_ SG_ 1760 OBJ_DIMENSION_WIDTH_ERR_017 "Lat distance or length error";
CM_ SG_ 1760 OBJ_DIMENSION_LENGTH_ERR_017 "Longi distance or length error";
CM_ SG_ 1760 OBJ_CLS_TYPE1_017 "Classification Type 1(Highest Prob), selected from ENUM list";
CM_ SG_ 1760 OBJ_CLS_TYPE1_PROB_017 "Classification Type 1 probablity";
CM_ SG_ 1760 OBJ_CLS_TYPE6_017 "Classification Type 6(Lowest Prob), selected from ENUM list";
CM_ SG_ 1760 OBJ_CLS_TYPE6_PROB_017 "Classification Type 1 probablity";
CM_ SG_ 1760 OBJ_RCS_017 "Representative RCS of the complete recognized object, Not implemented";
CM_ SG_ 1760 OBJ_REF_PT_LONG_OFFSET_017 "Outer edges of the recognized object’s bounding box in Y axis";
CM_ SG_ 1760 OBJ_REF_PT_LAT_OFFSET_017 "Outer edges of the recognized object’s bounding box in X axis";
CM_ SG_ 1760 OBJ_YAW_RATE_017 "Orientation rate of track's bounding box in VCS coordinate";
CM_ SG_ 1760 OBJ_GROUP_ID_017 "Objects which are linked together shall have same group ID";
CM_ SG_ 1760 OBJ_POS_ERR_CRR_COEF_017 "vx-vy correlation due to small error in radial direction and big in cross radial - position Correlation Coefficient Error";
CM_ SG_ 1760 OBJ_VELOCITY_ERR_CRR_COEF_017 "vx-vy correlation due to small error in radial direction and big in cross radial - velocity Correlation Coefficient Error";
CM_ SG_ 1760 OBJ_ACCEL_ERR_CRR_COEF_017 "vx-vy correlation due to small error in radial direction and big in cross radial - Acceleration Correlation Coefficient Error";

BA_DEF_ BO_ "CanTpBs" INT 0 255;
BA_DEF_ BO_ "DiagRequest" ENUM  "No","Yes";
BA_DEF_ BO_ "DiagResponse" ENUM  "No","Yes";
BA_DEF_ BO_ "EventRateOfChange" INT 10 10000;
BA_DEF_ BO_ "GenMsgCycleTime" INT 0 100000;
BA_DEF_ BO_ "GenMsgILSupport" ENUM  "No","Yes";
BA_DEF_ BO_ "GenMsgNrOfRepetition" INT 0 100;
BA_DEF_ BO_ "GenMsgSendType" ENUM  "FixedPeriodic","Event","EnabledPeriodic","NotUsed","NotUsed","EventPeriodic","NotUsed","NotUsed","NoMsgSendType";
BA_DEF_ BO_ "NetworkInitialization" ENUM  "No","Yes";
BA_DEF_ BO_ "NmAsrMessage" ENUM  "No","Yes";
BA_DEF_ BO_ "NmMessage" ENUM  "No","Yes";
BA_DEF_ BO_ "VFrameFormat" ENUM  "StandardCAN","ExtendedCAN","reserved","reserved","reserved","reserved","reserved","reserved","reserved","reserved","reserved","reserved","reserved","reserved","StandardCAN_FD","ExtendedCAN_FD";
BA_DEF_ SG_ "GenSigCmt" STRING;
BA_DEF_ SG_ "GenSigCycleTime" INT 0 0;
BA_DEF_ SG_ "GenSigSendType" ENUM  "Cyclic","OnWrite","vector_leerstring","OnChange","vector_leerstring","IfActive","vector_leerstring","NoSigSendType";
BA_DEF_ SG_ "GenSigStartValue" INT 0 1000000000;
BA_DEF_ SG_ "GenSigTimeoutTime" INT 0 0;
BA_DEF_ SG_ "GenSigVtEn" STRING;
BA_DEF_ SG_ "GenSigVtName" STRING;
BA_DEF_ SG_ "InvalidValue" STRING;
BA_DEF_DEF_ "CanTpBs" 255;
BA_DEF_DEF_ "DiagRequest" "No";
BA_DEF_DEF_ "DiagResponse" "No";
BA_DEF_DEF_ "EventRateOfChange" 10000;
BA_DEF_DEF_ "GenMsgCycleTime" 0;
BA_DEF_DEF_ "GenMsgILSupport" "Yes";
BA_DEF_DEF_ "GenMsgNrOfRepetition" 0;
BA_DEF_DEF_ "GenMsgSendType" "NoMsgSendType";
BA_DEF_DEF_ "GenSigCmt" "";
BA_DEF_DEF_ "GenSigCycleTime" 0;
BA_DEF_DEF_ "GenSigSendType" "NoSigSendType";
BA_DEF_DEF_ "GenSigStartValue" 0;
BA_DEF_DEF_ "GenSigTimeoutTime" 0;
BA_DEF_DEF_ "GenSigVtEn" "";
BA_DEF_DEF_ "GenSigVtName" "";
BA_DEF_DEF_ "InvalidValue" "";
BA_DEF_DEF_ "NetworkInitialization" "Yes";
BA_DEF_DEF_ "NmAsrMessage" "No";
BA_DEF_DEF_ "NmMessage" "No";
BA_DEF_DEF_ "VFrameFormat" "StandardCAN_FD";
BA_ "GenMsgSendType" BO_ 1745 1;
BA_ "GenMsgSendType" BO_ 1746 1;
BA_ "GenMsgSendType" BO_ 1747 1;
BA_ "GenMsgSendType" BO_ 1748 1;
BA_ "GenMsgSendType" BO_ 1749 1;
BA_ "GenMsgSendType" BO_ 1750 1;
BA_ "GenMsgSendType" BO_ 1751 1;
BA_ "GenMsgSendType" BO_ 1752 1;
BA_ "GenMsgSendType" BO_ 1753 1;
BA_ "GenMsgSendType" BO_ 1754 1;
BA_ "GenMsgSendType" BO_ 1755 1;
BA_ "GenMsgSendType" BO_ 1756 1;
BA_ "GenMsgSendType" BO_ 1757 1;
BA_ "GenMsgSendType" BO_ 1758 1;
BA_ "GenMsgSendType" BO_ 1759 1;
BA_ "GenMsgSendType" BO_ 1760 1;
BA_ "GenSigStartValue" SG_ 1745 OBJ_YAW_ANGLE_002 2000;
BA_ "GenSigStartValue" SG_ 1745 OBJ_POS_LONG_002 32700;
BA_ "GenSigStartValue" SG_ 1745 OBJ_POS_LAT_002 32700;
BA_ "GenSigStartValue" SG_ 1745 OBJ_VELOCITY_LONG_002 16300;
BA_ "GenSigStartValue" SG_ 1745 OBJ_VELOCITY_LAT_002 16300;
BA_ "GenSigStartValue" SG_ 1745 OBJ_ACCELERATION_LONG_002 400;
BA_ "GenSigStartValue" SG_ 1745 OBJ_ACCELERATION_LAT_002 400;
BA_ "GenSigStartValue" SG_ 1745 OBJ_TIMESTAMP_OFFSET_002 127;
BA_ "GenSigStartValue" SG_ 1745 OBJ_RCS_002 64;
BA_ "GenSigStartValue" SG_ 1745 OBJ_YAW_RATE_002 448;
BA_ "GenSigStartValue" SG_ 1745 OBJ_POS_ERR_CRR_COEF_002 120;
BA_ "GenSigStartValue" SG_ 1745 OBJ_VELOCITY_ERR_CRR_COEF_002 120;
BA_ "GenSigStartValue" SG_ 1745 OBJ_ACCEL_ERR_CRR_COEF_002 120;
BA_ "GenSigStartValue" SG_ 1746 OBJ_YAW_ANGLE_003 2000;
BA_ "GenSigStartValue" SG_ 1746 OBJ_POS_LONG_003 32700;
BA_ "GenSigStartValue" SG_ 1746 OBJ_POS_LAT_003 32700;
BA_ "GenSigStartValue" SG_ 1746 OBJ_VELOCITY_LONG_003 16300;
BA_ "GenSigStartValue" SG_ 1746 OBJ_VELOCITY_LAT_003 16300;
BA_ "GenSigStartValue" SG_ 1746 OBJ_ACCELERATION_LONG_003 400;
BA_ "GenSigStartValue" SG_ 1746 OBJ_ACCELERATION_LAT_003 400;
BA_ "GenSigStartValue" SG_ 1746 OBJ_TIMESTAMP_OFFSET_003 127;
BA_ "GenSigStartValue" SG_ 1746 OBJ_RCS_003 64;
BA_ "GenSigStartValue" SG_ 1746 OBJ_YAW_RATE_003 448;
BA_ "GenSigStartValue" SG_ 1746 OBJ_POS_ERR_CRR_COEF_003 120;
BA_ "GenSigStartValue" SG_ 1746 OBJ_VELOCITY_ERR_CRR_COEF_003 120;
BA_ "GenSigStartValue" SG_ 1746 OBJ_ACCEL_ERR_CRR_COEF_003 120;
BA_ "GenSigStartValue" SG_ 1747 OBJ_YAW_ANGLE_004 2000;
BA_ "GenSigStartValue" SG_ 1747 OBJ_POS_LONG_004 32700;
BA_ "GenSigStartValue" SG_ 1747 OBJ_POS_LAT_004 32700;
BA_ "GenSigStartValue" SG_ 1747 OBJ_VELOCITY_LONG_004 16300;
BA_ "GenSigStartValue" SG_ 1747 OBJ_VELOCITY_LAT_004 16300;
BA_ "GenSigStartValue" SG_ 1747 OBJ_ACCELERATION_LONG_004 400;
BA_ "GenSigStartValue" SG_ 1747 OBJ_ACCELERATION_LAT_004 400;
BA_ "GenSigStartValue" SG_ 1747 OBJ_TIMESTAMP_OFFSET_004 127;
BA_ "GenSigStartValue" SG_ 1747 OBJ_RCS_004 64;
BA_ "GenSigStartValue" SG_ 1747 OBJ_YAW_RATE_004 448;
BA_ "GenSigStartValue" SG_ 1747 OBJ_POS_ERR_CRR_COEF_004 120;
BA_ "GenSigStartValue" SG_ 1747 OBJ_VELOCITY_ERR_CRR_COEF_004 120;
BA_ "GenSigStartValue" SG_ 1747 OBJ_ACCEL_ERR_CRR_COEF_004 120;
BA_ "GenSigStartValue" SG_ 1748 OBJ_YAW_ANGLE_005 2000;
BA_ "GenSigStartValue" SG_ 1748 OBJ_POS_LONG_005 32700;
BA_ "GenSigStartValue" SG_ 1748 OBJ_POS_LAT_005 32700;
BA_ "GenSigStartValue" SG_ 1748 OBJ_VELOCITY_LONG_005 16300;
BA_ "GenSigStartValue" SG_ 1748 OBJ_VELOCITY_LAT_005 16300;
BA_ "GenSigStartValue" SG_ 1748 OBJ_ACCELERATION_LONG_005 400;
BA_ "GenSigStartValue" SG_ 1748 OBJ_ACCELERATION_LAT_005 400;
BA_ "GenSigStartValue" SG_ 1748 OBJ_TIMESTAMP_OFFSET_005 127;
BA_ "GenSigStartValue" SG_ 1748 OBJ_RCS_005 64;
BA_ "GenSigStartValue" SG_ 1748 OBJ_YAW_RATE_005 448;
BA_ "GenSigStartValue" SG_ 1748 OBJ_POS_ERR_CRR_COEF_005 120;
BA_ "GenSigStartValue" SG_ 1748 OBJ_VELOCITY_ERR_CRR_COEF_005 120;
BA_ "GenSigStartValue" SG_ 1748 OBJ_ACCEL_ERR_CRR_COEF_005 120;
BA_ "GenSigStartValue" SG_ 1749 OBJ_YAW_ANGLE_006 2000;
BA_ "GenSigStartValue" SG_ 1749 OBJ_POS_LONG_006 32700;
BA_ "GenSigStartValue" SG_ 1749 OBJ_POS_LAT_006 32700;
BA_ "GenSigStartValue" SG_ 1749 OBJ_VELOCITY_LONG_006 16300;
BA_ "GenSigStartValue" SG_ 1749 OBJ_VELOCITY_LAT_006 16300;
BA_ "GenSigStartValue" SG_ 1749 OBJ_ACCELERATION_LONG_006 400;
BA_ "GenSigStartValue" SG_ 1749 OBJ_ACCELERATION_LAT_006 400;
BA_ "GenSigStartValue" SG_ 1749 OBJ_TIMESTAMP_OFFSET_006 127;
BA_ "GenSigStartValue" SG_ 1749 OBJ_RCS_006 64;
BA_ "GenSigStartValue" SG_ 1749 OBJ_YAW_RATE_006 448;
BA_ "GenSigStartValue" SG_ 1749 OBJ_POS_ERR_CRR_COEF_006 120;
BA_ "GenSigStartValue" SG_ 1749 OBJ_VELOCITY_ERR_CRR_COEF_006 120;
BA_ "GenSigStartValue" SG_ 1749 OBJ_ACCEL_ERR_CRR_COEF_006 120;
BA_ "GenSigStartValue" SG_ 1750 OBJ_YAW_ANGLE_007 2000;
BA_ "GenSigStartValue" SG_ 1750 OBJ_POS_LONG_007 32700;
BA_ "GenSigStartValue" SG_ 1750 OBJ_POS_LAT_007 32700;
BA_ "GenSigStartValue" SG_ 1750 OBJ_VELOCITY_LONG_007 16300;
BA_ "GenSigStartValue" SG_ 1750 OBJ_VELOCITY_LAT_007 16300;
BA_ "GenSigStartValue" SG_ 1750 OBJ_ACCELERATION_LONG_007 400;
BA_ "GenSigStartValue" SG_ 1750 OBJ_ACCELERATION_LAT_007 400;
BA_ "GenSigStartValue" SG_ 1750 OBJ_TIMESTAMP_OFFSET_007 127;
BA_ "GenSigStartValue" SG_ 1750 OBJ_RCS_007 64;
BA_ "GenSigStartValue" SG_ 1750 OBJ_YAW_RATE_007 448;
BA_ "GenSigStartValue" SG_ 1750 OBJ_POS_ERR_CRR_COEF_007 120;
BA_ "GenSigStartValue" SG_ 1750 OBJ_VELOCITY_ERR_CRR_COEF_007 120;
BA_ "GenSigStartValue" SG_ 1750 OBJ_ACCEL_ERR_CRR_COEF_007 120;
BA_ "GenSigStartValue" SG_ 1751 OBJ_YAW_ANGLE_008 2000;
BA_ "GenSigStartValue" SG_ 1751 OBJ_POS_LONG_008 32700;
BA_ "GenSigStartValue" SG_ 1751 OBJ_POS_LAT_008 32700;
BA_ "GenSigStartValue" SG_ 1751 OBJ_VELOCITY_LONG_008 16300;
BA_ "GenSigStartValue" SG_ 1751 OBJ_VELOCITY_LAT_008 16300;
BA_ "GenSigStartValue" SG_ 1751 OBJ_ACCELERATION_LONG_008 400;
BA_ "GenSigStartValue" SG_ 1751 OBJ_ACCELERATION_LAT_008 400;
BA_ "GenSigStartValue" SG_ 1751 OBJ_TIMESTAMP_OFFSET_008 127;
BA_ "GenSigStartValue" SG_ 1751 OBJ_RCS_008 64;
BA_ "GenSigStartValue" SG_ 1751 OBJ_YAW_RATE_008 448;
BA_ "GenSigStartValue" SG_ 1751 OBJ_POS_ERR_CRR_COEF_008 120;
BA_ "GenSigStartValue" SG_ 1751 OBJ_VELOCITY_ERR_CRR_COEF_008 120;
BA_ "GenSigStartValue" SG_ 1751 OBJ_ACCEL_ERR_CRR_COEF_008 120;
BA_ "GenSigStartValue" SG_ 1752 OBJ_YAW_ANGLE_009 2000;
BA_ "GenSigStartValue" SG_ 1752 OBJ_POS_LONG_009 32700;
BA_ "GenSigStartValue" SG_ 1752 OBJ_POS_LAT_009 32700;
BA_ "GenSigStartValue" SG_ 1752 OBJ_VELOCITY_LONG_009 16300;
BA_ "GenSigStartValue" SG_ 1752 OBJ_VELOCITY_LAT_009 16300;
BA_ "GenSigStartValue" SG_ 1752 OBJ_ACCELERATION_LONG_009 400;
BA_ "GenSigStartValue" SG_ 1752 OBJ_ACCELERATION_LAT_009 400;
BA_ "GenSigStartValue" SG_ 1752 OBJ_TIMESTAMP_OFFSET_009 127;
BA_ "GenSigStartValue" SG_ 1752 OBJ_RCS_009 64;
BA_ "GenSigStartValue" SG_ 1752 OBJ_YAW_RATE_009 448;
BA_ "GenSigStartValue" SG_ 1752 OBJ_POS_ERR_CRR_COEF_009 120;
BA_ "GenSigStartValue" SG_ 1752 OBJ_VELOCITY_ERR_CRR_COEF_009 120;
BA_ "GenSigStartValue" SG_ 1752 OBJ_ACCEL_ERR_CRR_COEF_009 120;
BA_ "GenSigStartValue" SG_ 1753 OBJ_YAW_ANGLE_010 2000;
BA_ "GenSigStartValue" SG_ 1753 OBJ_POS_LONG_010 32700;
BA_ "GenSigStartValue" SG_ 1753 OBJ_POS_LAT_010 32700;
BA_ "GenSigStartValue" SG_ 1753 OBJ_VELOCITY_LONG_010 16300;
BA_ "GenSigStartValue" SG_ 1753 OBJ_VELOCITY_LAT_010 16300;
BA_ "GenSigStartValue" SG_ 1753 OBJ_ACCELERATION_LONG_010 400;
BA_ "GenSigStartValue" SG_ 1753 OBJ_ACCELERATION_LAT_010 400;
BA_ "GenSigStartValue" SG_ 1753 OBJ_TIMESTAMP_OFFSET_010 127;
BA_ "GenSigStartValue" SG_ 1753 OBJ_RCS_010 64;
BA_ "GenSigStartValue" SG_ 1753 OBJ_YAW_RATE_010 448;
BA_ "GenSigStartValue" SG_ 1753 OBJ_POS_ERR_CRR_COEF_010 120;
BA_ "GenSigStartValue" SG_ 1753 OBJ_VELOCITY_ERR_CRR_COEF_010 120;
BA_ "GenSigStartValue" SG_ 1753 OBJ_ACCEL_ERR_CRR_COEF_010 120;
BA_ "GenSigStartValue" SG_ 1754 OBJ_YAW_ANGLE_011 2000;
BA_ "GenSigStartValue" SG_ 1754 OBJ_POS_LONG_011 32700;
BA_ "GenSigStartValue" SG_ 1754 OBJ_POS_LAT_011 32700;
BA_ "GenSigStartValue" SG_ 1754 OBJ_VELOCITY_LONG_011 16300;
BA_ "GenSigStartValue" SG_ 1754 OBJ_VELOCITY_LAT_011 16300;
BA_ "GenSigStartValue" SG_ 1754 OBJ_ACCELERATION_LONG_011 400;
BA_ "GenSigStartValue" SG_ 1754 OBJ_ACCELERATION_LAT_011 400;
BA_ "GenSigStartValue" SG_ 1754 OBJ_TIMESTAMP_OFFSET_011 127;
BA_ "GenSigStartValue" SG_ 1754 OBJ_RCS_011 64;
BA_ "GenSigStartValue" SG_ 1754 OBJ_YAW_RATE_011 448;
BA_ "GenSigStartValue" SG_ 1754 OBJ_POS_ERR_CRR_COEF_011 120;
BA_ "GenSigStartValue" SG_ 1754 OBJ_VELOCITY_ERR_CRR_COEF_011 120;
BA_ "GenSigStartValue" SG_ 1754 OBJ_ACCEL_ERR_CRR_COEF_011 120;
BA_ "GenSigStartValue" SG_ 1755 OBJ_YAW_ANGLE_012 2000;
BA_ "GenSigStartValue" SG_ 1755 OBJ_POS_LONG_012 32700;
BA_ "GenSigStartValue" SG_ 1755 OBJ_POS_LAT_012 32700;
BA_ "GenSigStartValue" SG_ 1755 OBJ_VELOCITY_LONG_012 16300;
BA_ "GenSigStartValue" SG_ 1755 OBJ_VELOCITY_LAT_012 16300;
BA_ "GenSigStartValue" SG_ 1755 OBJ_ACCELERATION_LONG_012 400;
BA_ "GenSigStartValue" SG_ 1755 OBJ_ACCELERATION_LAT_012 400;
BA_ "GenSigStartValue" SG_ 1755 OBJ_TIMESTAMP_OFFSET_012 127;
BA_ "GenSigStartValue" SG_ 1755 OBJ_RCS_012 64;
BA_ "GenSigStartValue" SG_ 1755 OBJ_YAW_RATE_012 448;
BA_ "GenSigStartValue" SG_ 1755 OBJ_POS_ERR_CRR_COEF_012 120;
BA_ "GenSigStartValue" SG_ 1755 OBJ_VELOCITY_ERR_CRR_COEF_012 120;
BA_ "GenSigStartValue" SG_ 1755 OBJ_ACCEL_ERR_CRR_COEF_012 120;
BA_ "GenSigStartValue" SG_ 1756 OBJ_YAW_ANGLE_013 2000;
BA_ "GenSigStartValue" SG_ 1756 OBJ_POS_LONG_013 32700;
BA_ "GenSigStartValue" SG_ 1756 OBJ_POS_LAT_013 32700;
BA_ "GenSigStartValue" SG_ 1756 OBJ_VELOCITY_LONG_013 16300;
BA_ "GenSigStartValue" SG_ 1756 OBJ_VELOCITY_LAT_013 16300;
BA_ "GenSigStartValue" SG_ 1756 OBJ_ACCELERATION_LONG_013 400;
BA_ "GenSigStartValue" SG_ 1756 OBJ_ACCELERATION_LAT_013 400;
BA_ "GenSigStartValue" SG_ 1756 OBJ_TIMESTAMP_OFFSET_013 127;
BA_ "GenSigStartValue" SG_ 1756 OBJ_RCS_013 64;
BA_ "GenSigStartValue" SG_ 1756 OBJ_YAW_RATE_013 448;
BA_ "GenSigStartValue" SG_ 1756 OBJ_POS_ERR_CRR_COEF_013 120;
BA_ "GenSigStartValue" SG_ 1756 OBJ_VELOCITY_ERR_CRR_COEF_013 120;
BA_ "GenSigStartValue" SG_ 1756 OBJ_ACCEL_ERR_CRR_COEF_013 120;
BA_ "GenSigStartValue" SG_ 1757 OBJ_YAW_ANGLE_014 2000;
BA_ "GenSigStartValue" SG_ 1757 OBJ_POS_LONG_014 32700;
BA_ "GenSigStartValue" SG_ 1757 OBJ_POS_LAT_014 32700;
BA_ "GenSigStartValue" SG_ 1757 OBJ_VELOCITY_LONG_014 16300;
BA_ "GenSigStartValue" SG_ 1757 OBJ_VELOCITY_LAT_014 16300;
BA_ "GenSigStartValue" SG_ 1757 OBJ_ACCELERATION_LONG_014 400;
BA_ "GenSigStartValue" SG_ 1757 OBJ_ACCELERATION_LAT_014 400;
BA_ "GenSigStartValue" SG_ 1757 OBJ_TIMESTAMP_OFFSET_014 127;
BA_ "GenSigStartValue" SG_ 1757 OBJ_RCS_014 64;
BA_ "GenSigStartValue" SG_ 1757 OBJ_YAW_RATE_014 448;
BA_ "GenSigStartValue" SG_ 1757 OBJ_POS_ERR_CRR_COEF_014 120;
BA_ "GenSigStartValue" SG_ 1757 OBJ_VELOCITY_ERR_CRR_COEF_014 120;
BA_ "GenSigStartValue" SG_ 1757 OBJ_ACCEL_ERR_CRR_COEF_014 120;
BA_ "GenSigStartValue" SG_ 1758 OBJ_YAW_ANGLE_015 2000;
BA_ "GenSigStartValue" SG_ 1758 OBJ_POS_LONG_015 32700;
BA_ "GenSigStartValue" SG_ 1758 OBJ_POS_LAT_015 32700;
BA_ "GenSigStartValue" SG_ 1758 OBJ_VELOCITY_LONG_015 16300;
BA_ "GenSigStartValue" SG_ 1758 OBJ_VELOCITY_LAT_015 16300;
BA_ "GenSigStartValue" SG_ 1758 OBJ_ACCELERATION_LONG_015 400;
BA_ "GenSigStartValue" SG_ 1758 OBJ_ACCELERATION_LAT_015 400;
BA_ "GenSigStartValue" SG_ 1758 OBJ_TIMESTAMP_OFFSET_015 127;
BA_ "GenSigStartValue" SG_ 1758 OBJ_RCS_015 64;
BA_ "GenSigStartValue" SG_ 1758 OBJ_YAW_RATE_015 448;
BA_ "GenSigStartValue" SG_ 1758 OBJ_POS_ERR_CRR_COEF_015 120;
BA_ "GenSigStartValue" SG_ 1758 OBJ_VELOCITY_ERR_CRR_COEF_015 120;
BA_ "GenSigStartValue" SG_ 1758 OBJ_ACCEL_ERR_CRR_COEF_015 120;
BA_ "GenSigStartValue" SG_ 1759 OBJ_YAW_ANGLE_016 2000;
BA_ "GenSigStartValue" SG_ 1759 OBJ_POS_LONG_016 32700;
BA_ "GenSigStartValue" SG_ 1759 OBJ_POS_LAT_016 32700;
BA_ "GenSigStartValue" SG_ 1759 OBJ_VELOCITY_LONG_016 16300;
BA_ "GenSigStartValue" SG_ 1759 OBJ_VELOCITY_LAT_016 16300;
BA_ "GenSigStartValue" SG_ 1759 OBJ_ACCELERATION_LONG_016 400;
BA_ "GenSigStartValue" SG_ 1759 OBJ_ACCELERATION_LAT_016 400;
BA_ "GenSigStartValue" SG_ 1759 OBJ_TIMESTAMP_OFFSET_016 127;
BA_ "GenSigStartValue" SG_ 1759 OBJ_RCS_016 64;
BA_ "GenSigStartValue" SG_ 1759 OBJ_YAW_RATE_016 448;
BA_ "GenSigStartValue" SG_ 1759 OBJ_POS_ERR_CRR_COEF_016 120;
BA_ "GenSigStartValue" SG_ 1759 OBJ_VELOCITY_ERR_CRR_COEF_016 120;
BA_ "GenSigStartValue" SG_ 1759 OBJ_ACCEL_ERR_CRR_COEF_016 120;
BA_ "GenSigStartValue" SG_ 1760 OBJ_YAW_ANGLE_017 2000;
BA_ "GenSigStartValue" SG_ 1760 OBJ_POS_LONG_017 32700;
BA_ "GenSigStartValue" SG_ 1760 OBJ_POS_LAT_017 32700;
BA_ "GenSigStartValue" SG_ 1760 OBJ_VELOCITY_LONG_017 16300;
BA_ "GenSigStartValue" SG_ 1760 OBJ_VELOCITY_LAT_017 16300;
BA_ "GenSigStartValue" SG_ 1760 OBJ_ACCELERATION_LONG_017 400;
BA_ "GenSigStartValue" SG_ 1760 OBJ_ACCELERATION_LAT_017 400;
BA_ "GenSigStartValue" SG_ 1760 OBJ_TIMESTAMP_OFFSET_017 127;
BA_ "GenSigStartValue" SG_ 1760 OBJ_RCS_017 64;
BA_ "GenSigStartValue" SG_ 1760 OBJ_YAW_RATE_017 448;
BA_ "GenSigStartValue" SG_ 1760 OBJ_POS_ERR_CRR_COEF_017 120;
BA_ "GenSigStartValue" SG_ 1760 OBJ_VELOCITY_ERR_CRR_COEF_017 120;
BA_ "GenSigStartValue" SG_ 1760 OBJ_ACCEL_ERR_CRR_COEF_017 120;
VAL_ 1745 OBJ_TRACK_MOTION_MODEL_002 0 "INVALID" 1 "CCV" 2 "CTCA" 3 "CCA";
VAL_ 1745 OBJ_MOVEMENT_STATUS_002 0 "UNKNOWN" 1 "MOVING" 2 "SLOW_MOVING" 3 "FAST_MOVING" 4 "STATIONARY" 5 "STOPPED" 6 "RESERVED1" 7 "RESERVED2";
VAL_ 1745 OBJ_MEASUREMENT_STATUS_002 0 "Invalid" 1 "New" 2 "Predicted" 3 "PartlyMeasured" 4 "Measured" 5 "Occluded";
VAL_ 1745 OBJ_CLS_TYPE1_002 0 "UNKNOWN_MOVING_OBJ" 1 "CAR" 2 "TRUCK" 3 "MOTOR_BIKE" 4 "BICYCLE" 5 "PEDESTRIAN" 6 "ROAD_BOUNDRY" 7 "STATIC_OBJECT" 8 "TRAFFIC_LIGHT" 9 "TRAFFIC_SIGN" 10 "TWO_WHEELERS" 11 "RESERVED" 12 "RESERVED" 14 "OBJECT_UNDETERMIND" 15 "VEHICLE_UNDETERMIND";
VAL_ 1745 OBJ_CLS_TYPE2_002 0 "UNKNOWN_MOVING_OBJ" 1 "CAR" 2 "TRUCK" 3 "MOTOR_BIKE" 4 "BICYCLE" 5 "PEDESTRIAN" 6 "ROAD_BOUNDRY" 7 "STATIC_OBJECT" 8 "TRAFFIC_LIGHT" 9 "TRAFFIC_SIGN" 10 "TWO_WHEELERS" 11 "RESERVED" 12 "RESERVED" 14 "OBJECT_UNDETERMIND" 15 "VEHICLE_UNDETERMIND";
VAL_ 1745 OBJ_CLS_TYPE3_002 0 "UNKNOWN_MOVING_OBJ" 1 "CAR" 2 "TRUCK" 3 "MOTOR_BIKE" 4 "BICYCLE" 5 "PEDESTRIAN" 6 "ROAD_BOUNDRY" 7 "STATIC_OBJECT" 8 "TRAFFIC_LIGHT" 9 "TRAFFIC_SIGN" 10 "TWO_WHEELERS" 11 "RESERVED" 12 "RESERVED" 14 "OBJECT_UNDETERMIND" 15 "VEHICLE_UNDETERMIND";
VAL_ 1745 OBJ_CLS_TYPE4_002 0 "UNKNOWN_MOVING_OBJ" 1 "CAR" 2 "TRUCK" 3 "MOTOR_BIKE" 4 "BICYCLE" 5 "PEDESTRIAN" 6 "ROAD_BOUNDRY" 7 "STATIC_OBJECT" 8 "TRAFFIC_LIGHT" 9 "TRAFFIC_SIGN" 10 "TWO_WHEELERS" 11 "RESERVED" 12 "RESERVED" 14 "OBJECT_UNDETERMIND" 15 "VEHICLE_UNDETERMIND";
VAL_ 1745 OBJ_CLS_TYPE5_002 0 "UNKNOWN_MOVING_OBJ" 1 "CAR" 2 "TRUCK" 3 "MOTOR_BIKE" 4 "BICYCLE" 5 "PEDESTRIAN" 6 "ROAD_BOUNDRY" 7 "STATIC_OBJECT" 8 "TRAFFIC_LIGHT" 9 "TRAFFIC_SIGN" 10 "TWO_WHEELERS" 11 "RESERVED" 12 "RESERVED" 14 "OBJECT_UNDETERMIND" 15 "VEHICLE_UNDETERMIND";
VAL_ 1745 OBJ_CLS_TYPE6_002 0 "UNKNOWN_MOVING_OBJ" 1 "CAR" 2 "TRUCK" 3 "MOTOR_BIKE" 4 "BICYCLE" 5 "PEDESTRIAN" 6 "ROAD_BOUNDRY" 7 "STATIC_OBJECT" 8 "TRAFFIC_LIGHT" 9 "TRAFFIC_SIGN" 10 "TWO_WHEELERS" 11 "RESERVED" 12 "RESERVED" 14 "OBJECT_UNDETERMIND" 15 "VEHICLE_UNDETERMIND";
VAL_ 1746 OBJ_TRACK_MOTION_MODEL_003 0 "INVALID" 1 "CCV" 2 "CTCA" 3 "CCA";
VAL_ 1746 OBJ_MOVEMENT_STATUS_003 0 "UNKNOWN" 1 "MOVING" 2 "SLOW_MOVING" 3 "FAST_MOVING" 4 "STATIONARY" 5 "STOPPED" 6 "RESERVED1" 7 "RESERVED2";
VAL_ 1746 OBJ_MEASUREMENT_STATUS_003 0 "Invalid" 1 "New" 2 "Predicted" 3 "PartlyMeasured" 4 "Measured" 5 "Occluded";
VAL_ 1746 OBJ_CLS_TYPE1_003 0 "UNKNOWN_MOVING_OBJ" 1 "CAR" 2 "TRUCK" 3 "MOTOR_BIKE" 4 "BICYCLE" 5 "PEDESTRIAN" 6 "ROAD_BOUNDRY" 7 "STATIC_OBJECT" 8 "TRAFFIC_LIGHT" 9 "TRAFFIC_SIGN" 10 "TWO_WHEELERS" 11 "RESERVED" 12 "RESERVED" 14 "OBJECT_UNDETERMIND" 15 "VEHICLE_UNDETERMIND";
VAL_ 1746 OBJ_CLS_TYPE2_003 0 "UNKNOWN_MOVING_OBJ" 1 "CAR" 2 "TRUCK" 3 "MOTOR_BIKE" 4 "BICYCLE" 5 "PEDESTRIAN" 6 "ROAD_BOUNDRY" 7 "STATIC_OBJECT" 8 "TRAFFIC_LIGHT" 9 "TRAFFIC_SIGN" 10 "TWO_WHEELERS" 11 "RESERVED" 12 "RESERVED" 14 "OBJECT_UNDETERMIND" 15 "VEHICLE_UNDETERMIND";
VAL_ 1746 OBJ_CLS_TYPE3_003 0 "UNKNOWN_MOVING_OBJ" 1 "CAR" 2 "TRUCK" 3 "MOTOR_BIKE" 4 "BICYCLE" 5 "PEDESTRIAN" 6 "ROAD_BOUNDRY" 7 "STATIC_OBJECT" 8 "TRAFFIC_LIGHT" 9 "TRAFFIC_SIGN" 10 "TWO_WHEELERS" 11 "RESERVED" 12 "RESERVED" 14 "OBJECT_UNDETERMIND" 15 "VEHICLE_UNDETERMIND";
VAL_ 1746 OBJ_CLS_TYPE4_003 0 "UNKNOWN_MOVING_OBJ" 1 "CAR" 2 "TRUCK" 3 "MOTOR_BIKE" 4 "BICYCLE" 5 "PEDESTRIAN" 6 "ROAD_BOUNDRY" 7 "STATIC_OBJECT" 8 "TRAFFIC_LIGHT" 9 "TRAFFIC_SIGN" 10 "TWO_WHEELERS" 11 "RESERVED" 12 "RESERVED" 14 "OBJECT_UNDETERMIND" 15 "VEHICLE_UNDETERMIND";
VAL_ 1746 OBJ_CLS_TYPE5_003 0 "UNKNOWN_MOVING_OBJ" 1 "CAR" 2 "TRUCK" 3 "MOTOR_BIKE" 4 "BICYCLE" 5 "PEDESTRIAN" 6 "ROAD_BOUNDRY" 7 "STATIC_OBJECT" 8 "TRAFFIC_LIGHT" 9 "TRAFFIC_SIGN" 10 "TWO_WHEELERS" 11 "RESERVED" 12 "RESERVED" 14 "OBJECT_UNDETERMIND" 15 "VEHICLE_UNDETERMIND";
VAL_ 1746 OBJ_CLS_TYPE6_003 0 "UNKNOWN_MOVING_OBJ" 1 "CAR" 2 "TRUCK" 3 "MOTOR_BIKE" 4 "BICYCLE" 5 "PEDESTRIAN" 6 "ROAD_BOUNDRY" 7 "STATIC_OBJECT" 8 "TRAFFIC_LIGHT" 9 "TRAFFIC_SIGN" 10 "TWO_WHEELERS" 11 "RESERVED" 12 "RESERVED" 14 "OBJECT_UNDETERMIND" 15 "VEHICLE_UNDETERMIND";
VAL_ 1747 OBJ_TRACK_MOTION_MODEL_004 0 "INVALID" 1 "CCV" 2 "CTCA" 3 "CCA";
VAL_ 1747 OBJ_MOVEMENT_STATUS_004 0 "UNKNOWN" 1 "MOVING" 2 "SLOW_MOVING" 3 "FAST_MOVING" 4 "STATIONARY" 5 "STOPPED" 6 "RESERVED1" 7 "RESERVED2";
VAL_ 1747 OBJ_MEASUREMENT_STATUS_004 0 "Invalid" 1 "New" 2 "Predicted" 3 "PartlyMeasured" 4 "Measured" 5 "Occluded";
VAL_ 1747 OBJ_CLS_TYPE1_004 0 "UNKNOWN_MOVING_OBJ" 1 "CAR" 2 "TRUCK" 3 "MOTOR_BIKE" 4 "BICYCLE" 5 "PEDESTRIAN" 6 "ROAD_BOUNDRY" 7 "STATIC_OBJECT" 8 "TRAFFIC_LIGHT" 9 "TRAFFIC_SIGN" 10 "TWO_WHEELERS" 11 "RESERVED" 12 "RESERVED" 14 "OBJECT_UNDETERMIND" 15 "VEHICLE_UNDETERMIND";
VAL_ 1747 OBJ_CLS_TYPE2_004 0 "UNKNOWN_MOVING_OBJ" 1 "CAR" 2 "TRUCK" 3 "MOTOR_BIKE" 4 "BICYCLE" 5 "PEDESTRIAN" 6 "ROAD_BOUNDRY" 7 "STATIC_OBJECT" 8 "TRAFFIC_LIGHT" 9 "TRAFFIC_SIGN" 10 "TWO_WHEELERS" 11 "RESERVED" 12 "RESERVED" 14 "OBJECT_UNDETERMIND" 15 "VEHICLE_UNDETERMIND";
VAL_ 1747 OBJ_CLS_TYPE3_004 0 "UNKNOWN_MOVING_OBJ" 1 "CAR" 2 "TRUCK" 3 "MOTOR_BIKE" 4 "BICYCLE" 5 "PEDESTRIAN" 6 "ROAD_BOUNDRY" 7 "STATIC_OBJECT" 8 "TRAFFIC_LIGHT" 9 "TRAFFIC_SIGN" 10 "TWO_WHEELERS" 11 "RESERVED" 12 "RESERVED" 14 "OBJECT_UNDETERMIND" 15 "VEHICLE_UNDETERMIND";
VAL_ 1747 OBJ_CLS_TYPE4_004 0 "UNKNOWN_MOVING_OBJ" 1 "CAR" 2 "TRUCK" 3 "MOTOR_BIKE" 4 "BICYCLE" 5 "PEDESTRIAN" 6 "ROAD_BOUNDRY" 7 "STATIC_OBJECT" 8 "TRAFFIC_LIGHT" 9 "TRAFFIC_SIGN" 10 "TWO_WHEELERS" 11 "RESERVED" 12 "RESERVED" 14 "OBJECT_UNDETERMIND" 15 "VEHICLE_UNDETERMIND";
VAL_ 1747 OBJ_CLS_TYPE5_004 0 "UNKNOWN_MOVING_OBJ" 1 "CAR" 2 "TRUCK" 3 "MOTOR_BIKE" 4 "BICYCLE" 5 "PEDESTRIAN" 6 "ROAD_BOUNDRY" 7 "STATIC_OBJECT" 8 "TRAFFIC_LIGHT" 9 "TRAFFIC_SIGN" 10 "TWO_WHEELERS" 11 "RESERVED" 12 "RESERVED" 14 "OBJECT_UNDETERMIND" 15 "VEHICLE_UNDETERMIND";
VAL_ 1747 OBJ_CLS_TYPE6_004 0 "UNKNOWN_MOVING_OBJ" 1 "CAR" 2 "TRUCK" 3 "MOTOR_BIKE" 4 "BICYCLE" 5 "PEDESTRIAN" 6 "ROAD_BOUNDRY" 7 "STATIC_OBJECT" 8 "TRAFFIC_LIGHT" 9 "TRAFFIC_SIGN" 10 "TWO_WHEELERS" 11 "RESERVED" 12 "RESERVED" 14 "OBJECT_UNDETERMIND" 15 "VEHICLE_UNDETERMIND";
VAL_ 1748 OBJ_TRACK_MOTION_MODEL_005 0 "INVALID" 1 "CCV" 2 "CTCA" 3 "CCA";
VAL_ 1748 OBJ_MOVEMENT_STATUS_005 0 "UNKNOWN" 1 "MOVING" 2 "SLOW_MOVING" 3 "FAST_MOVING" 4 "STATIONARY" 5 "STOPPED" 6 "RESERVED1" 7 "RESERVED2";
VAL_ 1748 OBJ_MEASUREMENT_STATUS_005 0 "Invalid" 1 "New" 2 "Predicted" 3 "PartlyMeasured" 4 "Measured" 5 "Occluded";
VAL_ 1748 OBJ_CLS_TYPE1_005 0 "UNKNOWN_MOVING_OBJ" 1 "CAR" 2 "TRUCK" 3 "MOTOR_BIKE" 4 "BICYCLE" 5 "PEDESTRIAN" 6 "ROAD_BOUNDRY" 7 "STATIC_OBJECT" 8 "TRAFFIC_LIGHT" 9 "TRAFFIC_SIGN" 10 "TWO_WHEELERS" 11 "RESERVED" 12 "RESERVED" 14 "OBJECT_UNDETERMIND" 15 "VEHICLE_UNDETERMIND";
VAL_ 1748 OBJ_CLS_TYPE2_005 0 "UNKNOWN_MOVING_OBJ" 1 "CAR" 2 "TRUCK" 3 "MOTOR_BIKE" 4 "BICYCLE" 5 "PEDESTRIAN" 6 "ROAD_BOUNDRY" 7 "STATIC_OBJECT" 8 "TRAFFIC_LIGHT" 9 "TRAFFIC_SIGN" 10 "TWO_WHEELERS" 11 "RESERVED" 12 "RESERVED" 14 "OBJECT_UNDETERMIND" 15 "VEHICLE_UNDETERMIND";
VAL_ 1748 OBJ_CLS_TYPE3_005 0 "UNKNOWN_MOVING_OBJ" 1 "CAR" 2 "TRUCK" 3 "MOTOR_BIKE" 4 "BICYCLE" 5 "PEDESTRIAN" 6 "ROAD_BOUNDRY" 7 "STATIC_OBJECT" 8 "TRAFFIC_LIGHT" 9 "TRAFFIC_SIGN" 10 "TWO_WHEELERS" 11 "RESERVED" 12 "RESERVED" 14 "OBJECT_UNDETERMIND" 15 "VEHICLE_UNDETERMIND";
VAL_ 1748 OBJ_CLS_TYPE4_005 0 "UNKNOWN_MOVING_OBJ" 1 "CAR" 2 "TRUCK" 3 "MOTOR_BIKE" 4 "BICYCLE" 5 "PEDESTRIAN" 6 "ROAD_BOUNDRY" 7 "STATIC_OBJECT" 8 "TRAFFIC_LIGHT" 9 "TRAFFIC_SIGN" 10 "TWO_WHEELERS" 11 "RESERVED" 12 "RESERVED" 14 "OBJECT_UNDETERMIND" 15 "VEHICLE_UNDETERMIND";
VAL_ 1748 OBJ_CLS_TYPE5_005 0 "UNKNOWN_MOVING_OBJ" 1 "CAR" 2 "TRUCK" 3 "MOTOR_BIKE" 4 "BICYCLE" 5 "PEDESTRIAN" 6 "ROAD_BOUNDRY" 7 "STATIC_OBJECT" 8 "TRAFFIC_LIGHT" 9 "TRAFFIC_SIGN" 10 "TWO_WHEELERS" 11 "RESERVED" 12 "RESERVED" 14 "OBJECT_UNDETERMIND" 15 "VEHICLE_UNDETERMIND";
VAL_ 1748 OBJ_CLS_TYPE6_005 0 "UNKNOWN_MOVING_OBJ" 1 "CAR" 2 "TRUCK" 3 "MOTOR_BIKE" 4 "BICYCLE" 5 "PEDESTRIAN" 6 "ROAD_BOUNDRY" 7 "STATIC_OBJECT" 8 "TRAFFIC_LIGHT" 9 "TRAFFIC_SIGN" 10 "TWO_WHEELERS" 11 "RESERVED" 12 "RESERVED" 14 "OBJECT_UNDETERMIND" 15 "VEHICLE_UNDETERMIND";
VAL_ 1749 OBJ_TRACK_MOTION_MODEL_006 0 "INVALID" 1 "CCV" 2 "CTCA" 3 "CCA";
VAL_ 1749 OBJ_MOVEMENT_STATUS_006 0 "UNKNOWN" 1 "MOVING" 2 "SLOW_MOVING" 3 "FAST_MOVING" 4 "STATIONARY" 5 "STOPPED" 6 "RESERVED1" 7 "RESERVED2";
VAL_ 1749 OBJ_MEASUREMENT_STATUS_006 0 "Invalid" 1 "New" 2 "Predicted" 3 "PartlyMeasured" 4 "Measured" 5 "Occluded";
VAL_ 1749 OBJ_CLS_TYPE1_006 0 "UNKNOWN_MOVING_OBJ" 1 "CAR" 2 "TRUCK" 3 "MOTOR_BIKE" 4 "BICYCLE" 5 "PEDESTRIAN" 6 "ROAD_BOUNDRY" 7 "STATIC_OBJECT" 8 "TRAFFIC_LIGHT" 9 "TRAFFIC_SIGN" 10 "TWO_WHEELERS" 11 "RESERVED" 12 "RESERVED" 14 "OBJECT_UNDETERMIND" 15 "VEHICLE_UNDETERMIND";
VAL_ 1749 OBJ_CLS_TYPE2_006 0 "UNKNOWN_MOVING_OBJ" 1 "CAR" 2 "TRUCK" 3 "MOTOR_BIKE" 4 "BICYCLE" 5 "PEDESTRIAN" 6 "ROAD_BOUNDRY" 7 "STATIC_OBJECT" 8 "TRAFFIC_LIGHT" 9 "TRAFFIC_SIGN" 10 "TWO_WHEELERS" 11 "RESERVED" 12 "RESERVED" 14 "OBJECT_UNDETERMIND" 15 "VEHICLE_UNDETERMIND";
VAL_ 1749 OBJ_CLS_TYPE3_006 0 "UNKNOWN_MOVING_OBJ" 1 "CAR" 2 "TRUCK" 3 "MOTOR_BIKE" 4 "BICYCLE" 5 "PEDESTRIAN" 6 "ROAD_BOUNDRY" 7 "STATIC_OBJECT" 8 "TRAFFIC_LIGHT" 9 "TRAFFIC_SIGN" 10 "TWO_WHEELERS" 11 "RESERVED" 12 "RESERVED" 14 "OBJECT_UNDETERMIND" 15 "VEHICLE_UNDETERMIND";
VAL_ 1749 OBJ_CLS_TYPE4_006 0 "UNKNOWN_MOVING_OBJ" 1 "CAR" 2 "TRUCK" 3 "MOTOR_BIKE" 4 "BICYCLE" 5 "PEDESTRIAN" 6 "ROAD_BOUNDRY" 7 "STATIC_OBJECT" 8 "TRAFFIC_LIGHT" 9 "TRAFFIC_SIGN" 10 "TWO_WHEELERS" 11 "RESERVED" 12 "RESERVED" 14 "OBJECT_UNDETERMIND" 15 "VEHICLE_UNDETERMIND";
VAL_ 1749 OBJ_CLS_TYPE5_006 0 "UNKNOWN_MOVING_OBJ" 1 "CAR" 2 "TRUCK" 3 "MOTOR_BIKE" 4 "BICYCLE" 5 "PEDESTRIAN" 6 "ROAD_BOUNDRY" 7 "STATIC_OBJECT" 8 "TRAFFIC_LIGHT" 9 "TRAFFIC_SIGN" 10 "TWO_WHEELERS" 11 "RESERVED" 12 "RESERVED" 14 "OBJECT_UNDETERMIND" 15 "VEHICLE_UNDETERMIND";
VAL_ 1749 OBJ_CLS_TYPE6_006 0 "UNKNOWN_MOVING_OBJ" 1 "CAR" 2 "TRUCK" 3 "MOTOR_BIKE" 4 "BICYCLE" 5 "PEDESTRIAN" 6 "ROAD_BOUNDRY" 7 "STATIC_OBJECT" 8 "TRAFFIC_LIGHT" 9 "TRAFFIC_SIGN" 10 "TWO_WHEELERS" 11 "RESERVED" 12 "RESERVED" 14 "OBJECT_UNDETERMIND" 15 "VEHICLE_UNDETERMIND";
VAL_ 1750 OBJ_TRACK_MOTION_MODEL_007 0 "INVALID" 1 "CCV" 2 "CTCA" 3 "CCA";
VAL_ 1750 OBJ_MOVEMENT_STATUS_007 0 "UNKNOWN" 1 "MOVING" 2 "SLOW_MOVING" 3 "FAST_MOVING" 4 "STATIONARY" 5 "STOPPED" 6 "RESERVED1" 7 "RESERVED2";
VAL_ 1750 OBJ_MEASUREMENT_STATUS_007 0 "Invalid" 1 "New" 2 "Predicted" 3 "PartlyMeasured" 4 "Measured" 5 "Occluded";
VAL_ 1750 OBJ_CLS_TYPE1_007 0 "UNKNOWN_MOVING_OBJ" 1 "CAR" 2 "TRUCK" 3 "MOTOR_BIKE" 4 "BICYCLE" 5 "PEDESTRIAN" 6 "ROAD_BOUNDRY" 7 "STATIC_OBJECT" 8 "TRAFFIC_LIGHT" 9 "TRAFFIC_SIGN" 10 "TWO_WHEELERS" 11 "RESERVED" 12 "RESERVED" 14 "OBJECT_UNDETERMIND" 15 "VEHICLE_UNDETERMIND";
VAL_ 1750 OBJ_CLS_TYPE2_007 0 "UNKNOWN_MOVING_OBJ" 1 "CAR" 2 "TRUCK" 3 "MOTOR_BIKE" 4 "BICYCLE" 5 "PEDESTRIAN" 6 "ROAD_BOUNDRY" 7 "STATIC_OBJECT" 8 "TRAFFIC_LIGHT" 9 "TRAFFIC_SIGN" 10 "TWO_WHEELERS" 11 "RESERVED" 12 "RESERVED" 14 "OBJECT_UNDETERMIND" 15 "VEHICLE_UNDETERMIND";
VAL_ 1750 OBJ_CLS_TYPE3_007 0 "UNKNOWN_MOVING_OBJ" 1 "CAR" 2 "TRUCK" 3 "MOTOR_BIKE" 4 "BICYCLE" 5 "PEDESTRIAN" 6 "ROAD_BOUNDRY" 7 "STATIC_OBJECT" 8 "TRAFFIC_LIGHT" 9 "TRAFFIC_SIGN" 10 "TWO_WHEELERS" 11 "RESERVED" 12 "RESERVED" 14 "OBJECT_UNDETERMIND" 15 "VEHICLE_UNDETERMIND";
VAL_ 1750 OBJ_CLS_TYPE4_007 0 "UNKNOWN_MOVING_OBJ" 1 "CAR" 2 "TRUCK" 3 "MOTOR_BIKE" 4 "BICYCLE" 5 "PEDESTRIAN" 6 "ROAD_BOUNDRY" 7 "STATIC_OBJECT" 8 "TRAFFIC_LIGHT" 9 "TRAFFIC_SIGN" 10 "TWO_WHEELERS" 11 "RESERVED" 12 "RESERVED" 14 "OBJECT_UNDETERMIND" 15 "VEHICLE_UNDETERMIND";
VAL_ 1750 OBJ_CLS_TYPE5_007 0 "UNKNOWN_MOVING_OBJ" 1 "CAR" 2 "TRUCK" 3 "MOTOR_BIKE" 4 "BICYCLE" 5 "PEDESTRIAN" 6 "ROAD_BOUNDRY" 7 "STATIC_OBJECT" 8 "TRAFFIC_LIGHT" 9 "TRAFFIC_SIGN" 10 "TWO_WHEELERS" 11 "RESERVED" 12 "RESERVED" 14 "OBJECT_UNDETERMIND" 15 "VEHICLE_UNDETERMIND";
VAL_ 1750 OBJ_CLS_TYPE6_007 0 "UNKNOWN_MOVING_OBJ" 1 "CAR" 2 "TRUCK" 3 "MOTOR_BIKE" 4 "BICYCLE" 5 "PEDESTRIAN" 6 "ROAD_BOUNDRY" 7 "STATIC_OBJECT" 8 "TRAFFIC_LIGHT" 9 "TRAFFIC_SIGN" 10 "TWO_WHEELERS" 11 "RESERVED" 12 "RESERVED" 14 "OBJECT_UNDETERMIND" 15 "VEHICLE_UNDETERMIND";
VAL_ 1751 OBJ_TRACK_MOTION_MODEL_008 0 "INVALID" 1 "CCV" 2 "CTCA" 3 "CCA";
VAL_ 1751 OBJ_MOVEMENT_STATUS_008 0 "UNKNOWN" 1 "MOVING" 2 "SLOW_MOVING" 3 "FAST_MOVING" 4 "STATIONARY" 5 "STOPPED" 6 "RESERVED1" 7 "RESERVED2";
VAL_ 1751 OBJ_MEASUREMENT_STATUS_008 0 "Invalid" 1 "New" 2 "Predicted" 3 "PartlyMeasured" 4 "Measured" 5 "Occluded";
VAL_ 1751 OBJ_CLS_TYPE1_008 0 "UNKNOWN_MOVING_OBJ" 1 "CAR" 2 "TRUCK" 3 "MOTOR_BIKE" 4 "BICYCLE" 5 "PEDESTRIAN" 6 "ROAD_BOUNDRY" 7 "STATIC_OBJECT" 8 "TRAFFIC_LIGHT" 9 "TRAFFIC_SIGN" 10 "TWO_WHEELERS" 11 "RESERVED" 12 "RESERVED" 14 "OBJECT_UNDETERMIND" 15 "VEHICLE_UNDETERMIND";
VAL_ 1751 OBJ_CLS_TYPE2_008 0 "UNKNOWN_MOVING_OBJ" 1 "CAR" 2 "TRUCK" 3 "MOTOR_BIKE" 4 "BICYCLE" 5 "PEDESTRIAN" 6 "ROAD_BOUNDRY" 7 "STATIC_OBJECT" 8 "TRAFFIC_LIGHT" 9 "TRAFFIC_SIGN" 10 "TWO_WHEELERS" 11 "RESERVED" 12 "RESERVED" 14 "OBJECT_UNDETERMIND" 15 "VEHICLE_UNDETERMIND";
VAL_ 1751 OBJ_CLS_TYPE3_008 0 "UNKNOWN_MOVING_OBJ" 1 "CAR" 2 "TRUCK" 3 "MOTOR_BIKE" 4 "BICYCLE" 5 "PEDESTRIAN" 6 "ROAD_BOUNDRY" 7 "STATIC_OBJECT" 8 "TRAFFIC_LIGHT" 9 "TRAFFIC_SIGN" 10 "TWO_WHEELERS" 11 "RESERVED" 12 "RESERVED" 14 "OBJECT_UNDETERMIND" 15 "VEHICLE_UNDETERMIND";
VAL_ 1751 OBJ_CLS_TYPE4_008 0 "UNKNOWN_MOVING_OBJ" 1 "CAR" 2 "TRUCK" 3 "MOTOR_BIKE" 4 "BICYCLE" 5 "PEDESTRIAN" 6 "ROAD_BOUNDRY" 7 "STATIC_OBJECT" 8 "TRAFFIC_LIGHT" 9 "TRAFFIC_SIGN" 10 "TWO_WHEELERS" 11 "RESERVED" 12 "RESERVED" 14 "OBJECT_UNDETERMIND" 15 "VEHICLE_UNDETERMIND";
VAL_ 1751 OBJ_CLS_TYPE5_008 0 "UNKNOWN_MOVING_OBJ" 1 "CAR" 2 "TRUCK" 3 "MOTOR_BIKE" 4 "BICYCLE" 5 "PEDESTRIAN" 6 "ROAD_BOUNDRY" 7 "STATIC_OBJECT" 8 "TRAFFIC_LIGHT" 9 "TRAFFIC_SIGN" 10 "TWO_WHEELERS" 11 "RESERVED" 12 "RESERVED" 14 "OBJECT_UNDETERMIND" 15 "VEHICLE_UNDETERMIND";
VAL_ 1751 OBJ_CLS_TYPE6_008 0 "UNKNOWN_MOVING_OBJ" 1 "CAR" 2 "TRUCK" 3 "MOTOR_BIKE" 4 "BICYCLE" 5 "PEDESTRIAN" 6 "ROAD_BOUNDRY" 7 "STATIC_OBJECT" 8 "TRAFFIC_LIGHT" 9 "TRAFFIC_SIGN" 10 "TWO_WHEELERS" 11 "RESERVED" 12 "RESERVED" 14 "OBJECT_UNDETERMIND" 15 "VEHICLE_UNDETERMIND";
VAL_ 1752 OBJ_TRACK_MOTION_MODEL_009 0 "INVALID" 1 "CCV" 2 "CTCA" 3 "CCA";
VAL_ 1752 OBJ_MOVEMENT_STATUS_009 0 "UNKNOWN" 1 "MOVING" 2 "SLOW_MOVING" 3 "FAST_MOVING" 4 "STATIONARY" 5 "STOPPED" 6 "RESERVED1" 7 "RESERVED2";
VAL_ 1752 OBJ_MEASUREMENT_STATUS_009 0 "Invalid" 1 "New" 2 "Predicted" 3 "PartlyMeasured" 4 "Measured" 5 "Occluded";
VAL_ 1752 OBJ_CLS_TYPE1_009 0 "UNKNOWN_MOVING_OBJ" 1 "CAR" 2 "TRUCK" 3 "MOTOR_BIKE" 4 "BICYCLE" 5 "PEDESTRIAN" 6 "ROAD_BOUNDRY" 7 "STATIC_OBJECT" 8 "TRAFFIC_LIGHT" 9 "TRAFFIC_SIGN" 10 "TWO_WHEELERS" 11 "RESERVED" 12 "RESERVED" 14 "OBJECT_UNDETERMIND" 15 "VEHICLE_UNDETERMIND";
VAL_ 1752 OBJ_CLS_TYPE2_009 0 "UNKNOWN_MOVING_OBJ" 1 "CAR" 2 "TRUCK" 3 "MOTOR_BIKE" 4 "BICYCLE" 5 "PEDESTRIAN" 6 "ROAD_BOUNDRY" 7 "STATIC_OBJECT" 8 "TRAFFIC_LIGHT" 9 "TRAFFIC_SIGN" 10 "TWO_WHEELERS" 11 "RESERVED" 12 "RESERVED" 14 "OBJECT_UNDETERMIND" 15 "VEHICLE_UNDETERMIND";
VAL_ 1752 OBJ_CLS_TYPE3_009 0 "UNKNOWN_MOVING_OBJ" 1 "CAR" 2 "TRUCK" 3 "MOTOR_BIKE" 4 "BICYCLE" 5 "PEDESTRIAN" 6 "ROAD_BOUNDRY" 7 "STATIC_OBJECT" 8 "TRAFFIC_LIGHT" 9 "TRAFFIC_SIGN" 10 "TWO_WHEELERS" 11 "RESERVED" 12 "RESERVED" 14 "OBJECT_UNDETERMIND" 15 "VEHICLE_UNDETERMIND";
VAL_ 1752 OBJ_CLS_TYPE4_009 0 "UNKNOWN_MOVING_OBJ" 1 "CAR" 2 "TRUCK" 3 "MOTOR_BIKE" 4 "BICYCLE" 5 "PEDESTRIAN" 6 "ROAD_BOUNDRY" 7 "STATIC_OBJECT" 8 "TRAFFIC_LIGHT" 9 "TRAFFIC_SIGN" 10 "TWO_WHEELERS" 11 "RESERVED" 12 "RESERVED" 14 "OBJECT_UNDETERMIND" 15 "VEHICLE_UNDETERMIND";
VAL_ 1752 OBJ_CLS_TYPE5_009 0 "UNKNOWN_MOVING_OBJ" 1 "CAR" 2 "TRUCK" 3 "MOTOR_BIKE" 4 "BICYCLE" 5 "PEDESTRIAN" 6 "ROAD_BOUNDRY" 7 "STATIC_OBJECT" 8 "TRAFFIC_LIGHT" 9 "TRAFFIC_SIGN" 10 "TWO_WHEELERS" 11 "RESERVED" 12 "RESERVED" 14 "OBJECT_UNDETERMIND" 15 "VEHICLE_UNDETERMIND";
VAL_ 1752 OBJ_CLS_TYPE6_009 0 "UNKNOWN_MOVING_OBJ" 1 "CAR" 2 "TRUCK" 3 "MOTOR_BIKE" 4 "BICYCLE" 5 "PEDESTRIAN" 6 "ROAD_BOUNDRY" 7 "STATIC_OBJECT" 8 "TRAFFIC_LIGHT" 9 "TRAFFIC_SIGN" 10 "TWO_WHEELERS" 11 "RESERVED" 12 "RESERVED" 14 "OBJECT_UNDETERMIND" 15 "VEHICLE_UNDETERMIND";
VAL_ 1753 OBJ_TRACK_MOTION_MODEL_010 0 "INVALID" 1 "CCV" 2 "CTCA" 3 "CCA";
VAL_ 1753 OBJ_MOVEMENT_STATUS_010 0 "UNKNOWN" 1 "MOVING" 2 "SLOW_MOVING" 3 "FAST_MOVING" 4 "STATIONARY" 5 "STOPPED" 6 "RESERVED1" 7 "RESERVED2";
VAL_ 1753 OBJ_MEASUREMENT_STATUS_010 0 "Invalid" 1 "New" 2 "Predicted" 3 "PartlyMeasured" 4 "Measured" 5 "Occluded";
VAL_ 1753 OBJ_CLS_TYPE1_010 0 "UNKNOWN_MOVING_OBJ" 1 "CAR" 2 "TRUCK" 3 "MOTOR_BIKE" 4 "BICYCLE" 5 "PEDESTRIAN" 6 "ROAD_BOUNDRY" 7 "STATIC_OBJECT" 8 "TRAFFIC_LIGHT" 9 "TRAFFIC_SIGN" 10 "TWO_WHEELERS" 11 "RESERVED" 12 "RESERVED" 14 "OBJECT_UNDETERMIND" 15 "VEHICLE_UNDETERMIND";
VAL_ 1753 OBJ_CLS_TYPE2_010 0 "UNKNOWN_MOVING_OBJ" 1 "CAR" 2 "TRUCK" 3 "MOTOR_BIKE" 4 "BICYCLE" 5 "PEDESTRIAN" 6 "ROAD_BOUNDRY" 7 "STATIC_OBJECT" 8 "TRAFFIC_LIGHT" 9 "TRAFFIC_SIGN" 10 "TWO_WHEELERS" 11 "RESERVED" 12 "RESERVED" 14 "OBJECT_UNDETERMIND" 15 "VEHICLE_UNDETERMIND";
VAL_ 1753 OBJ_CLS_TYPE3_010 0 "UNKNOWN_MOVING_OBJ" 1 "CAR" 2 "TRUCK" 3 "MOTOR_BIKE" 4 "BICYCLE" 5 "PEDESTRIAN" 6 "ROAD_BOUNDRY" 7 "STATIC_OBJECT" 8 "TRAFFIC_LIGHT" 9 "TRAFFIC_SIGN" 10 "TWO_WHEELERS" 11 "RESERVED" 12 "RESERVED" 14 "OBJECT_UNDETERMIND" 15 "VEHICLE_UNDETERMIND";
VAL_ 1753 OBJ_CLS_TYPE4_010 0 "UNKNOWN_MOVING_OBJ" 1 "CAR" 2 "TRUCK" 3 "MOTOR_BIKE" 4 "BICYCLE" 5 "PEDESTRIAN" 6 "ROAD_BOUNDRY" 7 "STATIC_OBJECT" 8 "TRAFFIC_LIGHT" 9 "TRAFFIC_SIGN" 10 "TWO_WHEELERS" 11 "RESERVED" 12 "RESERVED" 14 "OBJECT_UNDETERMIND" 15 "VEHICLE_UNDETERMIND";
VAL_ 1753 OBJ_CLS_TYPE5_010 0 "UNKNOWN_MOVING_OBJ" 1 "CAR" 2 "TRUCK" 3 "MOTOR_BIKE" 4 "BICYCLE" 5 "PEDESTRIAN" 6 "ROAD_BOUNDRY" 7 "STATIC_OBJECT" 8 "TRAFFIC_LIGHT" 9 "TRAFFIC_SIGN" 10 "TWO_WHEELERS" 11 "RESERVED" 12 "RESERVED" 14 "OBJECT_UNDETERMIND" 15 "VEHICLE_UNDETERMIND";
VAL_ 1753 OBJ_CLS_TYPE6_010 0 "UNKNOWN_MOVING_OBJ" 1 "CAR" 2 "TRUCK" 3 "MOTOR_BIKE" 4 "BICYCLE" 5 "PEDESTRIAN" 6 "ROAD_BOUNDRY" 7 "STATIC_OBJECT" 8 "TRAFFIC_LIGHT" 9 "TRAFFIC_SIGN" 10 "TWO_WHEELERS" 11 "RESERVED" 12 "RESERVED" 14 "OBJECT_UNDETERMIND" 15 "VEHICLE_UNDETERMIND";
VAL_ 1754 OBJ_TRACK_MOTION_MODEL_011 0 "INVALID" 1 "CCV" 2 "CTCA" 3 "CCA";
VAL_ 1754 OBJ_MOVEMENT_STATUS_011 0 "UNKNOWN" 1 "MOVING" 2 "SLOW_MOVING" 3 "FAST_MOVING" 4 "STATIONARY" 5 "STOPPED" 6 "RESERVED1" 7 "RESERVED2";
VAL_ 1754 OBJ_MEASUREMENT_STATUS_011 0 "Invalid" 1 "New" 2 "Predicted" 3 "PartlyMeasured" 4 "Measured" 5 "Occluded";
VAL_ 1754 OBJ_CLS_TYPE1_011 0 "UNKNOWN_MOVING_OBJ" 1 "CAR" 2 "TRUCK" 3 "MOTOR_BIKE" 4 "BICYCLE" 5 "PEDESTRIAN" 6 "ROAD_BOUNDRY" 7 "STATIC_OBJECT" 8 "TRAFFIC_LIGHT" 9 "TRAFFIC_SIGN" 10 "TWO_WHEELERS" 11 "RESERVED" 12 "RESERVED" 14 "OBJECT_UNDETERMIND" 15 "VEHICLE_UNDETERMIND";
VAL_ 1754 OBJ_CLS_TYPE2_011 0 "UNKNOWN_MOVING_OBJ" 1 "CAR" 2 "TRUCK" 3 "MOTOR_BIKE" 4 "BICYCLE" 5 "PEDESTRIAN" 6 "ROAD_BOUNDRY" 7 "STATIC_OBJECT" 8 "TRAFFIC_LIGHT" 9 "TRAFFIC_SIGN" 10 "TWO_WHEELERS" 11 "RESERVED" 12 "RESERVED" 14 "OBJECT_UNDETERMIND" 15 "VEHICLE_UNDETERMIND";
VAL_ 1754 OBJ_CLS_TYPE3_011 0 "UNKNOWN_MOVING_OBJ" 1 "CAR" 2 "TRUCK" 3 "MOTOR_BIKE" 4 "BICYCLE" 5 "PEDESTRIAN" 6 "ROAD_BOUNDRY" 7 "STATIC_OBJECT" 8 "TRAFFIC_LIGHT" 9 "TRAFFIC_SIGN" 10 "TWO_WHEELERS" 11 "RESERVED" 12 "RESERVED" 14 "OBJECT_UNDETERMIND" 15 "VEHICLE_UNDETERMIND";
VAL_ 1754 OBJ_CLS_TYPE4_011 0 "UNKNOWN_MOVING_OBJ" 1 "CAR" 2 "TRUCK" 3 "MOTOR_BIKE" 4 "BICYCLE" 5 "PEDESTRIAN" 6 "ROAD_BOUNDRY" 7 "STATIC_OBJECT" 8 "TRAFFIC_LIGHT" 9 "TRAFFIC_SIGN" 10 "TWO_WHEELERS" 11 "RESERVED" 12 "RESERVED" 14 "OBJECT_UNDETERMIND" 15 "VEHICLE_UNDETERMIND";
VAL_ 1754 OBJ_CLS_TYPE5_011 0 "UNKNOWN_MOVING_OBJ" 1 "CAR" 2 "TRUCK" 3 "MOTOR_BIKE" 4 "BICYCLE" 5 "PEDESTRIAN" 6 "ROAD_BOUNDRY" 7 "STATIC_OBJECT" 8 "TRAFFIC_LIGHT" 9 "TRAFFIC_SIGN" 10 "TWO_WHEELERS" 11 "RESERVED" 12 "RESERVED" 14 "OBJECT_UNDETERMIND" 15 "VEHICLE_UNDETERMIND";
VAL_ 1754 OBJ_CLS_TYPE6_011 0 "UNKNOWN_MOVING_OBJ" 1 "CAR" 2 "TRUCK" 3 "MOTOR_BIKE" 4 "BICYCLE" 5 "PEDESTRIAN" 6 "ROAD_BOUNDRY" 7 "STATIC_OBJECT" 8 "TRAFFIC_LIGHT" 9 "TRAFFIC_SIGN" 10 "TWO_WHEELERS" 11 "RESERVED" 12 "RESERVED" 14 "OBJECT_UNDETERMIND" 15 "VEHICLE_UNDETERMIND";
VAL_ 1755 OBJ_TRACK_MOTION_MODEL_012 0 "INVALID" 1 "CCV" 2 "CTCA" 3 "CCA";
VAL_ 1755 OBJ_MOVEMENT_STATUS_012 0 "UNKNOWN" 1 "MOVING" 2 "SLOW_MOVING" 3 "FAST_MOVING" 4 "STATIONARY" 5 "STOPPED" 6 "RESERVED1" 7 "RESERVED2";
VAL_ 1755 OBJ_MEASUREMENT_STATUS_012 0 "Invalid" 1 "New" 2 "Predicted" 3 "PartlyMeasured" 4 "Measured" 5 "Occluded";
VAL_ 1755 OBJ_CLS_TYPE1_012 0 "UNKNOWN_MOVING_OBJ" 1 "CAR" 2 "TRUCK" 3 "MOTOR_BIKE" 4 "BICYCLE" 5 "PEDESTRIAN" 6 "ROAD_BOUNDRY" 7 "STATIC_OBJECT" 8 "TRAFFIC_LIGHT" 9 "TRAFFIC_SIGN" 10 "TWO_WHEELERS" 11 "RESERVED" 12 "RESERVED" 14 "OBJECT_UNDETERMIND" 15 "VEHICLE_UNDETERMIND";
VAL_ 1755 OBJ_CLS_TYPE2_012 0 "UNKNOWN_MOVING_OBJ" 1 "CAR" 2 "TRUCK" 3 "MOTOR_BIKE" 4 "BICYCLE" 5 "PEDESTRIAN" 6 "ROAD_BOUNDRY" 7 "STATIC_OBJECT" 8 "TRAFFIC_LIGHT" 9 "TRAFFIC_SIGN" 10 "TWO_WHEELERS" 11 "RESERVED" 12 "RESERVED" 14 "OBJECT_UNDETERMIND" 15 "VEHICLE_UNDETERMIND";
VAL_ 1755 OBJ_CLS_TYPE3_012 0 "UNKNOWN_MOVING_OBJ" 1 "CAR" 2 "TRUCK" 3 "MOTOR_BIKE" 4 "BICYCLE" 5 "PEDESTRIAN" 6 "ROAD_BOUNDRY" 7 "STATIC_OBJECT" 8 "TRAFFIC_LIGHT" 9 "TRAFFIC_SIGN" 10 "TWO_WHEELERS" 11 "RESERVED" 12 "RESERVED" 14 "OBJECT_UNDETERMIND" 15 "VEHICLE_UNDETERMIND";
VAL_ 1755 OBJ_CLS_TYPE4_012 0 "UNKNOWN_MOVING_OBJ" 1 "CAR" 2 "TRUCK" 3 "MOTOR_BIKE" 4 "BICYCLE" 5 "PEDESTRIAN" 6 "ROAD_BOUNDRY" 7 "STATIC_OBJECT" 8 "TRAFFIC_LIGHT" 9 "TRAFFIC_SIGN" 10 "TWO_WHEELERS" 11 "RESERVED" 12 "RESERVED" 14 "OBJECT_UNDETERMIND" 15 "VEHICLE_UNDETERMIND";
VAL_ 1755 OBJ_CLS_TYPE5_012 0 "UNKNOWN_MOVING_OBJ" 1 "CAR" 2 "TRUCK" 3 "MOTOR_BIKE" 4 "BICYCLE" 5 "PEDESTRIAN" 6 "ROAD_BOUNDRY" 7 "STATIC_OBJECT" 8 "TRAFFIC_LIGHT" 9 "TRAFFIC_SIGN" 10 "TWO_WHEELERS" 11 "RESERVED" 12 "RESERVED" 14 "OBJECT_UNDETERMIND" 15 "VEHICLE_UNDETERMIND";
VAL_ 1755 OBJ_CLS_TYPE6_012 0 "UNKNOWN_MOVING_OBJ" 1 "CAR" 2 "TRUCK" 3 "MOTOR_BIKE" 4 "BICYCLE" 5 "PEDESTRIAN" 6 "ROAD_BOUNDRY" 7 "STATIC_OBJECT" 8 "TRAFFIC_LIGHT" 9 "TRAFFIC_SIGN" 10 "TWO_WHEELERS" 11 "RESERVED" 12 "RESERVED" 14 "OBJECT_UNDETERMIND" 15 "VEHICLE_UNDETERMIND";
VAL_ 1756 OBJ_TRACK_MOTION_MODEL_013 0 "INVALID" 1 "CCV" 2 "CTCA" 3 "CCA";
VAL_ 1756 OBJ_MOVEMENT_STATUS_013 0 "UNKNOWN" 1 "MOVING" 2 "SLOW_MOVING" 3 "FAST_MOVING" 4 "STATIONARY" 5 "STOPPED" 6 "RESERVED1" 7 "RESERVED2";
VAL_ 1756 OBJ_MEASUREMENT_STATUS_013 0 "Invalid" 1 "New" 2 "Predicted" 3 "PartlyMeasured" 4 "Measured" 5 "Occluded";
VAL_ 1756 OBJ_CLS_TYPE1_013 0 "UNKNOWN_MOVING_OBJ" 1 "CAR" 2 "TRUCK" 3 "MOTOR_BIKE" 4 "BICYCLE" 5 "PEDESTRIAN" 6 "ROAD_BOUNDRY" 7 "STATIC_OBJECT" 8 "TRAFFIC_LIGHT" 9 "TRAFFIC_SIGN" 10 "TWO_WHEELERS" 11 "RESERVED" 12 "RESERVED" 14 "OBJECT_UNDETERMIND" 15 "VEHICLE_UNDETERMIND";
VAL_ 1756 OBJ_CLS_TYPE2_013 0 "UNKNOWN_MOVING_OBJ" 1 "CAR" 2 "TRUCK" 3 "MOTOR_BIKE" 4 "BICYCLE" 5 "PEDESTRIAN" 6 "ROAD_BOUNDRY" 7 "STATIC_OBJECT" 8 "TRAFFIC_LIGHT" 9 "TRAFFIC_SIGN" 10 "TWO_WHEELERS" 11 "RESERVED" 12 "RESERVED" 14 "OBJECT_UNDETERMIND" 15 "VEHICLE_UNDETERMIND";
VAL_ 1756 OBJ_CLS_TYPE3_013 0 "UNKNOWN_MOVING_OBJ" 1 "CAR" 2 "TRUCK" 3 "MOTOR_BIKE" 4 "BICYCLE" 5 "PEDESTRIAN" 6 "ROAD_BOUNDRY" 7 "STATIC_OBJECT" 8 "TRAFFIC_LIGHT" 9 "TRAFFIC_SIGN" 10 "TWO_WHEELERS" 11 "RESERVED" 12 "RESERVED" 14 "OBJECT_UNDETERMIND" 15 "VEHICLE_UNDETERMIND";
VAL_ 1756 OBJ_CLS_TYPE4_013 0 "UNKNOWN_MOVING_OBJ" 1 "CAR" 2 "TRUCK" 3 "MOTOR_BIKE" 4 "BICYCLE" 5 "PEDESTRIAN" 6 "ROAD_BOUNDRY" 7 "STATIC_OBJECT" 8 "TRAFFIC_LIGHT" 9 "TRAFFIC_SIGN" 10 "TWO_WHEELERS" 11 "RESERVED" 12 "RESERVED" 14 "OBJECT_UNDETERMIND" 15 "VEHICLE_UNDETERMIND";
VAL_ 1756 OBJ_CLS_TYPE5_013 0 "UNKNOWN_MOVING_OBJ" 1 "CAR" 2 "TRUCK" 3 "MOTOR_BIKE" 4 "BICYCLE" 5 "PEDESTRIAN" 6 "ROAD_BOUNDRY" 7 "STATIC_OBJECT" 8 "TRAFFIC_LIGHT" 9 "TRAFFIC_SIGN" 10 "TWO_WHEELERS" 11 "RESERVED" 12 "RESERVED" 14 "OBJECT_UNDETERMIND" 15 "VEHICLE_UNDETERMIND";
VAL_ 1756 OBJ_CLS_TYPE6_013 0 "UNKNOWN_MOVING_OBJ" 1 "CAR" 2 "TRUCK" 3 "MOTOR_BIKE" 4 "BICYCLE" 5 "PEDESTRIAN" 6 "ROAD_BOUNDRY" 7 "STATIC_OBJECT" 8 "TRAFFIC_LIGHT" 9 "TRAFFIC_SIGN" 10 "TWO_WHEELERS" 11 "RESERVED" 12 "RESERVED" 14 "OBJECT_UNDETERMIND" 15 "VEHICLE_UNDETERMIND";
VAL_ 1757 OBJ_TRACK_MOTION_MODEL_014 0 "INVALID" 1 "CCV" 2 "CTCA" 3 "CCA";
VAL_ 1757 OBJ_MOVEMENT_STATUS_014 0 "UNKNOWN" 1 "MOVING" 2 "SLOW_MOVING" 3 "FAST_MOVING" 4 "STATIONARY" 5 "STOPPED" 6 "RESERVED1" 7 "RESERVED2";
VAL_ 1757 OBJ_MEASUREMENT_STATUS_014 0 "Invalid" 1 "New" 2 "Predicted" 3 "PartlyMeasured" 4 "Measured" 5 "Occluded";
VAL_ 1757 OBJ_CLS_TYPE1_014 0 "UNKNOWN_MOVING_OBJ" 1 "CAR" 2 "TRUCK" 3 "MOTOR_BIKE" 4 "BICYCLE" 5 "PEDESTRIAN" 6 "ROAD_BOUNDRY" 7 "STATIC_OBJECT" 8 "TRAFFIC_LIGHT" 9 "TRAFFIC_SIGN" 10 "TWO_WHEELERS" 11 "RESERVED" 12 "RESERVED" 14 "OBJECT_UNDETERMIND" 15 "VEHICLE_UNDETERMIND";
VAL_ 1757 OBJ_CLS_TYPE2_014 0 "UNKNOWN_MOVING_OBJ" 1 "CAR" 2 "TRUCK" 3 "MOTOR_BIKE" 4 "BICYCLE" 5 "PEDESTRIAN" 6 "ROAD_BOUNDRY" 7 "STATIC_OBJECT" 8 "TRAFFIC_LIGHT" 9 "TRAFFIC_SIGN" 10 "TWO_WHEELERS" 11 "RESERVED" 12 "RESERVED" 14 "OBJECT_UNDETERMIND" 15 "VEHICLE_UNDETERMIND";
VAL_ 1757 OBJ_CLS_TYPE3_014 0 "UNKNOWN_MOVING_OBJ" 1 "CAR" 2 "TRUCK" 3 "MOTOR_BIKE" 4 "BICYCLE" 5 "PEDESTRIAN" 6 "ROAD_BOUNDRY" 7 "STATIC_OBJECT" 8 "TRAFFIC_LIGHT" 9 "TRAFFIC_SIGN" 10 "TWO_WHEELERS" 11 "RESERVED" 12 "RESERVED" 14 "OBJECT_UNDETERMIND" 15 "VEHICLE_UNDETERMIND";
VAL_ 1757 OBJ_CLS_TYPE4_014 0 "UNKNOWN_MOVING_OBJ" 1 "CAR" 2 "TRUCK" 3 "MOTOR_BIKE" 4 "BICYCLE" 5 "PEDESTRIAN" 6 "ROAD_BOUNDRY" 7 "STATIC_OBJECT" 8 "TRAFFIC_LIGHT" 9 "TRAFFIC_SIGN" 10 "TWO_WHEELERS" 11 "RESERVED" 12 "RESERVED" 14 "OBJECT_UNDETERMIND" 15 "VEHICLE_UNDETERMIND";
VAL_ 1757 OBJ_CLS_TYPE5_014 0 "UNKNOWN_MOVING_OBJ" 1 "CAR" 2 "TRUCK" 3 "MOTOR_BIKE" 4 "BICYCLE" 5 "PEDESTRIAN" 6 "ROAD_BOUNDRY" 7 "STATIC_OBJECT" 8 "TRAFFIC_LIGHT" 9 "TRAFFIC_SIGN" 10 "TWO_WHEELERS" 11 "RESERVED" 12 "RESERVED" 14 "OBJECT_UNDETERMIND" 15 "VEHICLE_UNDETERMIND";
VAL_ 1757 OBJ_CLS_TYPE6_014 0 "UNKNOWN_MOVING_OBJ" 1 "CAR" 2 "TRUCK" 3 "MOTOR_BIKE" 4 "BICYCLE" 5 "PEDESTRIAN" 6 "ROAD_BOUNDRY" 7 "STATIC_OBJECT" 8 "TRAFFIC_LIGHT" 9 "TRAFFIC_SIGN" 10 "TWO_WHEELERS" 11 "RESERVED" 12 "RESERVED" 14 "OBJECT_UNDETERMIND" 15 "VEHICLE_UNDETERMIND";
VAL_ 1758 OBJ_TRACK_MOTION_MODEL_015 0 "INVALID" 1 "CCV" 2 "CTCA" 3 "CCA";
VAL_ 1758 OBJ_MOVEMENT_STATUS_015 0 "UNKNOWN" 1 "MOVING" 2 "SLOW_MOVING" 3 "FAST_MOVING" 4 "STATIONARY" 5 "STOPPED" 6 "RESERVED1" 7 "RESERVED2";
VAL_ 1758 OBJ_MEASUREMENT_STATUS_015 0 "Invalid" 1 "New" 2 "Predicted" 3 "PartlyMeasured" 4 "Measured" 5 "Occluded";
VAL_ 1758 OBJ_CLS_TYPE1_015 0 "UNKNOWN_MOVING_OBJ" 1 "CAR" 2 "TRUCK" 3 "MOTOR_BIKE" 4 "BICYCLE" 5 "PEDESTRIAN" 6 "ROAD_BOUNDRY" 7 "STATIC_OBJECT" 8 "TRAFFIC_LIGHT" 9 "TRAFFIC_SIGN" 10 "TWO_WHEELERS" 11 "RESERVED" 12 "RESERVED" 14 "OBJECT_UNDETERMIND" 15 "VEHICLE_UNDETERMIND";
VAL_ 1758 OBJ_CLS_TYPE2_015 0 "UNKNOWN_MOVING_OBJ" 1 "CAR" 2 "TRUCK" 3 "MOTOR_BIKE" 4 "BICYCLE" 5 "PEDESTRIAN" 6 "ROAD_BOUNDRY" 7 "STATIC_OBJECT" 8 "TRAFFIC_LIGHT" 9 "TRAFFIC_SIGN" 10 "TWO_WHEELERS" 11 "RESERVED" 12 "RESERVED" 14 "OBJECT_UNDETERMIND" 15 "VEHICLE_UNDETERMIND";
VAL_ 1758 OBJ_CLS_TYPE3_015 0 "UNKNOWN_MOVING_OBJ" 1 "CAR" 2 "TRUCK" 3 "MOTOR_BIKE" 4 "BICYCLE" 5 "PEDESTRIAN" 6 "ROAD_BOUNDRY" 7 "STATIC_OBJECT" 8 "TRAFFIC_LIGHT" 9 "TRAFFIC_SIGN" 10 "TWO_WHEELERS" 11 "RESERVED" 12 "RESERVED" 14 "OBJECT_UNDETERMIND" 15 "VEHICLE_UNDETERMIND";
VAL_ 1758 OBJ_CLS_TYPE4_015 0 "UNKNOWN_MOVING_OBJ" 1 "CAR" 2 "TRUCK" 3 "MOTOR_BIKE" 4 "BICYCLE" 5 "PEDESTRIAN" 6 "ROAD_BOUNDRY" 7 "STATIC_OBJECT" 8 "TRAFFIC_LIGHT" 9 "TRAFFIC_SIGN" 10 "TWO_WHEELERS" 11 "RESERVED" 12 "RESERVED" 14 "OBJECT_UNDETERMIND" 15 "VEHICLE_UNDETERMIND";
VAL_ 1758 OBJ_CLS_TYPE5_015 0 "UNKNOWN_MOVING_OBJ" 1 "CAR" 2 "TRUCK" 3 "MOTOR_BIKE" 4 "BICYCLE" 5 "PEDESTRIAN" 6 "ROAD_BOUNDRY" 7 "STATIC_OBJECT" 8 "TRAFFIC_LIGHT" 9 "TRAFFIC_SIGN" 10 "TWO_WHEELERS" 11 "RESERVED" 12 "RESERVED" 14 "OBJECT_UNDETERMIND" 15 "VEHICLE_UNDETERMIND";
VAL_ 1758 OBJ_CLS_TYPE6_015 0 "UNKNOWN_MOVING_OBJ" 1 "CAR" 2 "TRUCK" 3 "MOTOR_BIKE" 4 "BICYCLE" 5 "PEDESTRIAN" 6 "ROAD_BOUNDRY" 7 "STATIC_OBJECT" 8 "TRAFFIC_LIGHT" 9 "TRAFFIC_SIGN" 10 "TWO_WHEELERS" 11 "RESERVED" 12 "RESERVED" 14 "OBJECT_UNDETERMIND" 15 "VEHICLE_UNDETERMIND";
VAL_ 1759 OBJ_TRACK_MOTION_MODEL_016 0 "INVALID" 1 "CCV" 2 "CTCA" 3 "CCA";
VAL_ 1759 OBJ_MOVEMENT_STATUS_016 0 "UNKNOWN" 1 "MOVING" 2 "SLOW_MOVING" 3 "FAST_MOVING" 4 "STATIONARY" 5 "STOPPED" 6 "RESERVED1" 7 "RESERVED2";
VAL_ 1759 OBJ_MEASUREMENT_STATUS_016 0 "Invalid" 1 "New" 2 "Predicted" 3 "PartlyMeasured" 4 "Measured" 5 "Occluded";
VAL_ 1759 OBJ_CLS_TYPE1_016 0 "UNKNOWN_MOVING_OBJ" 1 "CAR" 2 "TRUCK" 3 "MOTOR_BIKE" 4 "BICYCLE" 5 "PEDESTRIAN" 6 "ROAD_BOUNDRY" 7 "STATIC_OBJECT" 8 "TRAFFIC_LIGHT" 9 "TRAFFIC_SIGN" 10 "TWO_WHEELERS" 11 "RESERVED" 12 "RESERVED" 14 "OBJECT_UNDETERMIND" 15 "VEHICLE_UNDETERMIND";
VAL_ 1759 OBJ_CLS_TYPE2_016 0 "UNKNOWN_MOVING_OBJ" 1 "CAR" 2 "TRUCK" 3 "MOTOR_BIKE" 4 "BICYCLE" 5 "PEDESTRIAN" 6 "ROAD_BOUNDRY" 7 "STATIC_OBJECT" 8 "TRAFFIC_LIGHT" 9 "TRAFFIC_SIGN" 10 "TWO_WHEELERS" 11 "RESERVED" 12 "RESERVED" 14 "OBJECT_UNDETERMIND" 15 "VEHICLE_UNDETERMIND";
VAL_ 1759 OBJ_CLS_TYPE3_016 0 "UNKNOWN_MOVING_OBJ" 1 "CAR" 2 "TRUCK" 3 "MOTOR_BIKE" 4 "BICYCLE" 5 "PEDESTRIAN" 6 "ROAD_BOUNDRY" 7 "STATIC_OBJECT" 8 "TRAFFIC_LIGHT" 9 "TRAFFIC_SIGN" 10 "TWO_WHEELERS" 11 "RESERVED" 12 "RESERVED" 14 "OBJECT_UNDETERMIND" 15 "VEHICLE_UNDETERMIND";
VAL_ 1759 OBJ_CLS_TYPE4_016 0 "UNKNOWN_MOVING_OBJ" 1 "CAR" 2 "TRUCK" 3 "MOTOR_BIKE" 4 "BICYCLE" 5 "PEDESTRIAN" 6 "ROAD_BOUNDRY" 7 "STATIC_OBJECT" 8 "TRAFFIC_LIGHT" 9 "TRAFFIC_SIGN" 10 "TWO_WHEELERS" 11 "RESERVED" 12 "RESERVED" 14 "OBJECT_UNDETERMIND" 15 "VEHICLE_UNDETERMIND";
VAL_ 1759 OBJ_CLS_TYPE5_016 0 "UNKNOWN_MOVING_OBJ" 1 "CAR" 2 "TRUCK" 3 "MOTOR_BIKE" 4 "BICYCLE" 5 "PEDESTRIAN" 6 "ROAD_BOUNDRY" 7 "STATIC_OBJECT" 8 "TRAFFIC_LIGHT" 9 "TRAFFIC_SIGN" 10 "TWO_WHEELERS" 11 "RESERVED" 12 "RESERVED" 14 "OBJECT_UNDETERMIND" 15 "VEHICLE_UNDETERMIND";
VAL_ 1759 OBJ_CLS_TYPE6_016 0 "UNKNOWN_MOVING_OBJ" 1 "CAR" 2 "TRUCK" 3 "MOTOR_BIKE" 4 "BICYCLE" 5 "PEDESTRIAN" 6 "ROAD_BOUNDRY" 7 "STATIC_OBJECT" 8 "TRAFFIC_LIGHT" 9 "TRAFFIC_SIGN" 10 "TWO_WHEELERS" 11 "RESERVED" 12 "RESERVED" 14 "OBJECT_UNDETERMIND" 15 "VEHICLE_UNDETERMIND";
VAL_ 1760 OBJ_TRACK_MOTION_MODEL_017 0 "INVALID" 1 "CCV" 2 "CTCA" 3 "CCA";
VAL_ 1760 OBJ_MOVEMENT_STATUS_017 0 "UNKNOWN" 1 "MOVING" 2 "SLOW_MOVING" 3 "FAST_MOVING" 4 "STATIONARY" 5 "STOPPED" 6 "RESERVED1" 7 "RESERVED2";
VAL_ 1760 OBJ_MEASUREMENT_STATUS_017 0 "Invalid" 1 "New" 2 "Predicted" 3 "PartlyMeasured" 4 "Measured" 5 "Occluded";
VAL_ 1760 OBJ_CLS_TYPE1_017 0 "UNKNOWN_MOVING_OBJ" 1 "CAR" 2 "TRUCK" 3 "MOTOR_BIKE" 4 "BICYCLE" 5 "PEDESTRIAN" 6 "ROAD_BOUNDRY" 7 "STATIC_OBJECT" 8 "TRAFFIC_LIGHT" 9 "TRAFFIC_SIGN" 10 "TWO_WHEELERS" 11 "RESERVED" 12 "RESERVED" 14 "OBJECT_UNDETERMIND" 15 "VEHICLE_UNDETERMIND";
VAL_ 1760 OBJ_CLS_TYPE2_017 0 "UNKNOWN_MOVING_OBJ" 1 "CAR" 2 "TRUCK" 3 "MOTOR_BIKE" 4 "BICYCLE" 5 "PEDESTRIAN" 6 "ROAD_BOUNDRY" 7 "STATIC_OBJECT" 8 "TRAFFIC_LIGHT" 9 "TRAFFIC_SIGN" 10 "TWO_WHEELERS" 11 "RESERVED" 12 "RESERVED" 14 "OBJECT_UNDETERMIND" 15 "VEHICLE_UNDETERMIND";
VAL_ 1760 OBJ_CLS_TYPE3_017 0 "UNKNOWN_MOVING_OBJ" 1 "CAR" 2 "TRUCK" 3 "MOTOR_BIKE" 4 "BICYCLE" 5 "PEDESTRIAN" 6 "ROAD_BOUNDRY" 7 "STATIC_OBJECT" 8 "TRAFFIC_LIGHT" 9 "TRAFFIC_SIGN" 10 "TWO_WHEELERS" 11 "RESERVED" 12 "RESERVED" 14 "OBJECT_UNDETERMIND" 15 "VEHICLE_UNDETERMIND";
VAL_ 1760 OBJ_CLS_TYPE4_017 0 "UNKNOWN_MOVING_OBJ" 1 "CAR" 2 "TRUCK" 3 "MOTOR_BIKE" 4 "BICYCLE" 5 "PEDESTRIAN" 6 "ROAD_BOUNDRY" 7 "STATIC_OBJECT" 8 "TRAFFIC_LIGHT" 9 "TRAFFIC_SIGN" 10 "TWO_WHEELERS" 11 "RESERVED" 12 "RESERVED" 14 "OBJECT_UNDETERMIND" 15 "VEHICLE_UNDETERMIND";
VAL_ 1760 OBJ_CLS_TYPE5_017 0 "UNKNOWN_MOVING_OBJ" 1 "CAR" 2 "TRUCK" 3 "MOTOR_BIKE" 4 "BICYCLE" 5 "PEDESTRIAN" 6 "ROAD_BOUNDRY" 7 "STATIC_OBJECT" 8 "TRAFFIC_LIGHT" 9 "TRAFFIC_SIGN" 10 "TWO_WHEELERS" 11 "RESERVED" 12 "RESERVED" 14 "OBJECT_UNDETERMIND" 15 "VEHICLE_UNDETERMIND";
VAL_ 1760 OBJ_CLS_TYPE6_017 0 "UNKNOWN_MOVING_OBJ" 1 "CAR" 2 "TRUCK" 3 "MOTOR_BIKE" 4 "BICYCLE" 5 "PEDESTRIAN" 6 "ROAD_BOUNDRY" 7 "STATIC_OBJECT" 8 "TRAFFIC_LIGHT" 9 "TRAFFIC_SIGN" 10 "TWO_WHEELERS" 11 "RESERVED" 12 "RESERVED" 14 "OBJECT_UNDETERMIND" 15 "VEHICLE_UNDETERMIND";
SIG_GROUP_ 1745 TrackerObject002 1 : OBJ_MH_CRC16_002 OBJ_MH_CYCLE_COUNTER_002 OBJ_ACCEL_ERR_CRR_COEF_002 OBJ_VELOCITY_ERR_CRR_COEF_002 OBJ_POS_ERR_CRR_COEF_002 OBJ_YAW_RATE_002 OBJ_YAW_RATE_ERR_002 OBJ_GROUP_ID_002 OBJ_REF_PT_LAT_OFFSET_002 OBJ_REF_PT_LONG_OFFSET_002 OBJ_RCS_002 OBJ_YAW_ANGLE_ERR_002 OBJ_CLS_TYPE6_002 OBJ_CLS_TYPE6_PROB_002 OBJ_CLS_TYPE5_PROB_002 OBJ_CLS_TYPE5_002 OBJ_CLS_TYPE4_PROB_002 OBJ_CLS_TYPE4_002 OBJ_CLS_TYPE3_PROB_002 OBJ_CLS_TYPE3_002 OBJ_CLS_TYPE2_PROB_002 OBJ_CLS_TYPE2_002 OBJ_DIMENSION_WIDTH_ERR_002 OBJ_DIMENSION_LENGTH_ERR_002 OBJ_TIMESTAMP_OFFSET_002 OBJ_CLS_TYPE1_PROB_002 OBJ_VEH_TRACK_FLAG_002 OBJ_ACCELERATION_LAT_002 OBJ_ACCELERATION_LONG_002 OBJ_VELOCITY_LAT_002 OBJ_VELOCITY_LONG_002 OBJ_POS_LAT_002 OBJ_POS_LONG_002 OBJ_MEASUREMENT_STATUS_002 OBJ_MOVEMENT_STATUS_002 OBJ_CLS_TYPE1_002 OBJ_ID_002 OBJ_YAW_ANGLE_002 OBJ_EXISTENCE_PROB_002 OBJ_DIMENSION_LENGTH_002 OBJ_DIMENSION_WIDTH_002 OBJ_TRACK_MOTION_MODEL_002 OBJ_POS_LAT_ERR_002 OBJ_POS_LONG_ERR_002 OBJ_VELOCITY_LAT_ERR_002 OBJ_VELOCITY_LONG_ERR_002 OBJ_ACCELERATION_LAT_ERR_002 OBJ_ACCELERATION_LONG_ERR_002 OBJ_ALIVE_TIME_002;
SIG_GROUP_ 1746 TrackerObject003 1 : OBJ_MH_CRC16_003 OBJ_MH_CYCLE_COUNTER_003 OBJ_ACCEL_ERR_CRR_COEF_003 OBJ_VELOCITY_ERR_CRR_COEF_003 OBJ_POS_ERR_CRR_COEF_003 OBJ_YAW_RATE_003 OBJ_YAW_RATE_ERR_003 OBJ_GROUP_ID_003 OBJ_REF_PT_LAT_OFFSET_003 OBJ_REF_PT_LONG_OFFSET_003 OBJ_RCS_003 OBJ_YAW_ANGLE_ERR_003 OBJ_CLS_TYPE6_003 OBJ_CLS_TYPE6_PROB_003 OBJ_CLS_TYPE5_PROB_003 OBJ_CLS_TYPE5_003 OBJ_CLS_TYPE4_PROB_003 OBJ_CLS_TYPE4_003 OBJ_CLS_TYPE3_PROB_003 OBJ_CLS_TYPE3_003 OBJ_CLS_TYPE2_PROB_003 OBJ_CLS_TYPE2_003 OBJ_DIMENSION_WIDTH_ERR_003 OBJ_DIMENSION_LENGTH_ERR_003 OBJ_TIMESTAMP_OFFSET_003 OBJ_CLS_TYPE1_PROB_003 OBJ_VEH_TRACK_FLAG_003 OBJ_ACCELERATION_LAT_003 OBJ_ACCELERATION_LONG_003 OBJ_VELOCITY_LAT_003 OBJ_VELOCITY_LONG_003 OBJ_POS_LAT_003 OBJ_POS_LONG_003 OBJ_MEASUREMENT_STATUS_003 OBJ_MOVEMENT_STATUS_003 OBJ_CLS_TYPE1_003 OBJ_ID_003 OBJ_YAW_ANGLE_003 OBJ_EXISTENCE_PROB_003 OBJ_DIMENSION_LENGTH_003 OBJ_DIMENSION_WIDTH_003 OBJ_TRACK_MOTION_MODEL_003 OBJ_POS_LAT_ERR_003 OBJ_POS_LONG_ERR_003 OBJ_VELOCITY_LAT_ERR_003 OBJ_VELOCITY_LONG_ERR_003 OBJ_ACCELERATION_LAT_ERR_003 OBJ_ACCELERATION_LONG_ERR_003 OBJ_ALIVE_TIME_003;
SIG_GROUP_ 1747 TrackerObject004 1 : OBJ_MH_CRC16_004 OBJ_MH_CYCLE_COUNTER_004 OBJ_ACCEL_ERR_CRR_COEF_004 OBJ_VELOCITY_ERR_CRR_COEF_004 OBJ_POS_ERR_CRR_COEF_004 OBJ_YAW_RATE_004 OBJ_YAW_RATE_ERR_004 OBJ_GROUP_ID_004 OBJ_REF_PT_LAT_OFFSET_004 OBJ_REF_PT_LONG_OFFSET_004 OBJ_RCS_004 OBJ_YAW_ANGLE_ERR_004 OBJ_CLS_TYPE6_004 OBJ_CLS_TYPE6_PROB_004 OBJ_CLS_TYPE5_PROB_004 OBJ_CLS_TYPE5_004 OBJ_CLS_TYPE4_PROB_004 OBJ_CLS_TYPE4_004 OBJ_CLS_TYPE3_PROB_004 OBJ_CLS_TYPE3_004 OBJ_CLS_TYPE2_PROB_004 OBJ_CLS_TYPE2_004 OBJ_DIMENSION_WIDTH_ERR_004 OBJ_DIMENSION_LENGTH_ERR_004 OBJ_TIMESTAMP_OFFSET_004 OBJ_CLS_TYPE1_PROB_004 OBJ_VEH_TRACK_FLAG_004 OBJ_ACCELERATION_LAT_004 OBJ_ACCELERATION_LONG_004 OBJ_VELOCITY_LAT_004 OBJ_VELOCITY_LONG_004 OBJ_POS_LAT_004 OBJ_POS_LONG_004 OBJ_MEASUREMENT_STATUS_004 OBJ_MOVEMENT_STATUS_004 OBJ_CLS_TYPE1_004 OBJ_ID_004 OBJ_YAW_ANGLE_004 OBJ_EXISTENCE_PROB_004 OBJ_DIMENSION_LENGTH_004 OBJ_DIMENSION_WIDTH_004 OBJ_TRACK_MOTION_MODEL_004 OBJ_POS_LAT_ERR_004 OBJ_POS_LONG_ERR_004 OBJ_VELOCITY_LAT_ERR_004 OBJ_VELOCITY_LONG_ERR_004 OBJ_ACCELERATION_LAT_ERR_004 OBJ_ACCELERATION_LONG_ERR_004 OBJ_ALIVE_TIME_004;
SIG_GROUP_ 1748 TrackerObject005 1 : OBJ_MH_CRC16_005 OBJ_MH_CYCLE_COUNTER_005 OBJ_ACCEL_ERR_CRR_COEF_005 OBJ_VELOCITY_ERR_CRR_COEF_005 OBJ_POS_ERR_CRR_COEF_005 OBJ_YAW_RATE_005 OBJ_YAW_RATE_ERR_005 OBJ_GROUP_ID_005 OBJ_REF_PT_LAT_OFFSET_005 OBJ_REF_PT_LONG_OFFSET_005 OBJ_RCS_005 OBJ_YAW_ANGLE_ERR_005 OBJ_CLS_TYPE6_005 OBJ_CLS_TYPE6_PROB_005 OBJ_CLS_TYPE5_PROB_005 OBJ_CLS_TYPE5_005 OBJ_CLS_TYPE4_PROB_005 OBJ_CLS_TYPE4_005 OBJ_CLS_TYPE3_PROB_005 OBJ_CLS_TYPE3_005 OBJ_CLS_TYPE2_PROB_005 OBJ_CLS_TYPE2_005 OBJ_DIMENSION_WIDTH_ERR_005 OBJ_DIMENSION_LENGTH_ERR_005 OBJ_TIMESTAMP_OFFSET_005 OBJ_CLS_TYPE1_PROB_005 OBJ_VEH_TRACK_FLAG_005 OBJ_ACCELERATION_LAT_005 OBJ_ACCELERATION_LONG_005 OBJ_VELOCITY_LAT_005 OBJ_VELOCITY_LONG_005 OBJ_POS_LAT_005 OBJ_POS_LONG_005 OBJ_MEASUREMENT_STATUS_005 OBJ_MOVEMENT_STATUS_005 OBJ_CLS_TYPE1_005 OBJ_ID_005 OBJ_YAW_ANGLE_005 OBJ_EXISTENCE_PROB_005 OBJ_DIMENSION_LENGTH_005 OBJ_DIMENSION_WIDTH_005 OBJ_TRACK_MOTION_MODEL_005 OBJ_POS_LAT_ERR_005 OBJ_POS_LONG_ERR_005 OBJ_VELOCITY_LAT_ERR_005 OBJ_VELOCITY_LONG_ERR_005 OBJ_ACCELERATION_LAT_ERR_005 OBJ_ACCELERATION_LONG_ERR_005 OBJ_ALIVE_TIME_005;
SIG_GROUP_ 1749 TrackerObject006 1 : OBJ_MH_CRC16_006 OBJ_MH_CYCLE_COUNTER_006 OBJ_ACCEL_ERR_CRR_COEF_006 OBJ_VELOCITY_ERR_CRR_COEF_006 OBJ_POS_ERR_CRR_COEF_006 OBJ_YAW_RATE_006 OBJ_YAW_RATE_ERR_006 OBJ_GROUP_ID_006 OBJ_REF_PT_LAT_OFFSET_006 OBJ_REF_PT_LONG_OFFSET_006 OBJ_RCS_006 OBJ_YAW_ANGLE_ERR_006 OBJ_CLS_TYPE6_006 OBJ_CLS_TYPE6_PROB_006 OBJ_CLS_TYPE5_PROB_006 OBJ_CLS_TYPE5_006 OBJ_CLS_TYPE4_PROB_006 OBJ_CLS_TYPE4_006 OBJ_CLS_TYPE3_PROB_006 OBJ_CLS_TYPE3_006 OBJ_CLS_TYPE2_PROB_006 OBJ_CLS_TYPE2_006 OBJ_DIMENSION_WIDTH_ERR_006 OBJ_DIMENSION_LENGTH_ERR_006 OBJ_TIMESTAMP_OFFSET_006 OBJ_CLS_TYPE1_PROB_006 OBJ_VEH_TRACK_FLAG_006 OBJ_ACCELERATION_LAT_006 OBJ_ACCELERATION_LONG_006 OBJ_VELOCITY_LAT_006 OBJ_VELOCITY_LONG_006 OBJ_POS_LAT_006 OBJ_POS_LONG_006 OBJ_MEASUREMENT_STATUS_006 OBJ_MOVEMENT_STATUS_006 OBJ_CLS_TYPE1_006 OBJ_ID_006 OBJ_YAW_ANGLE_006 OBJ_EXISTENCE_PROB_006 OBJ_DIMENSION_LENGTH_006 OBJ_DIMENSION_WIDTH_006 OBJ_TRACK_MOTION_MODEL_006 OBJ_POS_LAT_ERR_006 OBJ_POS_LONG_ERR_006 OBJ_VELOCITY_LAT_ERR_006 OBJ_VELOCITY_LONG_ERR_006 OBJ_ACCELERATION_LAT_ERR_006 OBJ_ACCELERATION_LONG_ERR_006 OBJ_ALIVE_TIME_006;
SIG_GROUP_ 1750 TrackerObject007 1 : OBJ_MH_CRC16_007 OBJ_MH_CYCLE_COUNTER_007 OBJ_ACCEL_ERR_CRR_COEF_007 OBJ_VELOCITY_ERR_CRR_COEF_007 OBJ_POS_ERR_CRR_COEF_007 OBJ_YAW_RATE_007 OBJ_YAW_RATE_ERR_007 OBJ_GROUP_ID_007 OBJ_REF_PT_LAT_OFFSET_007 OBJ_REF_PT_LONG_OFFSET_007 OBJ_RCS_007 OBJ_YAW_ANGLE_ERR_007 OBJ_CLS_TYPE6_007 OBJ_CLS_TYPE6_PROB_007 OBJ_CLS_TYPE5_PROB_007 OBJ_CLS_TYPE5_007 OBJ_CLS_TYPE4_PROB_007 OBJ_CLS_TYPE4_007 OBJ_CLS_TYPE3_PROB_007 OBJ_CLS_TYPE3_007 OBJ_CLS_TYPE2_PROB_007 OBJ_CLS_TYPE2_007 OBJ_DIMENSION_WIDTH_ERR_007 OBJ_DIMENSION_LENGTH_ERR_007 OBJ_TIMESTAMP_OFFSET_007 OBJ_CLS_TYPE1_PROB_007 OBJ_VEH_TRACK_FLAG_007 OBJ_ACCELERATION_LAT_007 OBJ_ACCELERATION_LONG_007 OBJ_VELOCITY_LAT_007 OBJ_VELOCITY_LONG_007 OBJ_POS_LAT_007 OBJ_POS_LONG_007 OBJ_MEASUREMENT_STATUS_007 OBJ_MOVEMENT_STATUS_007 OBJ_CLS_TYPE1_007 OBJ_ID_007 OBJ_YAW_ANGLE_007 OBJ_EXISTENCE_PROB_007 OBJ_DIMENSION_LENGTH_007 OBJ_DIMENSION_WIDTH_007 OBJ_TRACK_MOTION_MODEL_007 OBJ_POS_LAT_ERR_007 OBJ_POS_LONG_ERR_007 OBJ_VELOCITY_LAT_ERR_007 OBJ_VELOCITY_LONG_ERR_007 OBJ_ACCELERATION_LAT_ERR_007 OBJ_ACCELERATION_LONG_ERR_007 OBJ_ALIVE_TIME_007;
SIG_GROUP_ 1751 TrackerObject008 1 : OBJ_MH_CRC16_008 OBJ_MH_CYCLE_COUNTER_008 OBJ_ACCEL_ERR_CRR_COEF_008 OBJ_VELOCITY_ERR_CRR_COEF_008 OBJ_POS_ERR_CRR_COEF_008 OBJ_YAW_RATE_008 OBJ_YAW_RATE_ERR_008 OBJ_GROUP_ID_008 OBJ_REF_PT_LAT_OFFSET_008 OBJ_REF_PT_LONG_OFFSET_008 OBJ_RCS_008 OBJ_YAW_ANGLE_ERR_008 OBJ_CLS_TYPE6_008 OBJ_CLS_TYPE6_PROB_008 OBJ_CLS_TYPE5_PROB_008 OBJ_CLS_TYPE5_008 OBJ_CLS_TYPE4_PROB_008 OBJ_CLS_TYPE4_008 OBJ_CLS_TYPE3_PROB_008 OBJ_CLS_TYPE3_008 OBJ_CLS_TYPE2_PROB_008 OBJ_CLS_TYPE2_008 OBJ_DIMENSION_WIDTH_ERR_008 OBJ_DIMENSION_LENGTH_ERR_008 OBJ_TIMESTAMP_OFFSET_008 OBJ_CLS_TYPE1_PROB_008 OBJ_VEH_TRACK_FLAG_008 OBJ_ACCELERATION_LAT_008 OBJ_ACCELERATION_LONG_008 OBJ_VELOCITY_LAT_008 OBJ_VELOCITY_LONG_008 OBJ_POS_LAT_008 OBJ_POS_LONG_008 OBJ_MEASUREMENT_STATUS_008 OBJ_MOVEMENT_STATUS_008 OBJ_CLS_TYPE1_008 OBJ_ID_008 OBJ_YAW_ANGLE_008 OBJ_EXISTENCE_PROB_008 OBJ_DIMENSION_LENGTH_008 OBJ_DIMENSION_WIDTH_008 OBJ_TRACK_MOTION_MODEL_008 OBJ_POS_LAT_ERR_008 OBJ_POS_LONG_ERR_008 OBJ_VELOCITY_LAT_ERR_008 OBJ_VELOCITY_LONG_ERR_008 OBJ_ACCELERATION_LAT_ERR_008 OBJ_ACCELERATION_LONG_ERR_008 OBJ_ALIVE_TIME_008;
SIG_GROUP_ 1752 TrackerObject009 1 : OBJ_MH_CRC16_009 OBJ_MH_CYCLE_COUNTER_009 OBJ_ACCEL_ERR_CRR_COEF_009 OBJ_VELOCITY_ERR_CRR_COEF_009 OBJ_POS_ERR_CRR_COEF_009 OBJ_YAW_RATE_009 OBJ_YAW_RATE_ERR_009 OBJ_GROUP_ID_009 OBJ_REF_PT_LAT_OFFSET_009 OBJ_REF_PT_LONG_OFFSET_009 OBJ_RCS_009 OBJ_YAW_ANGLE_ERR_009 OBJ_CLS_TYPE6_009 OBJ_CLS_TYPE6_PROB_009 OBJ_CLS_TYPE5_PROB_009 OBJ_CLS_TYPE5_009 OBJ_CLS_TYPE4_PROB_009 OBJ_CLS_TYPE4_009 OBJ_CLS_TYPE3_PROB_009 OBJ_CLS_TYPE3_009 OBJ_CLS_TYPE2_PROB_009 OBJ_CLS_TYPE2_009 OBJ_DIMENSION_WIDTH_ERR_009 OBJ_DIMENSION_LENGTH_ERR_009 OBJ_TIMESTAMP_OFFSET_009 OBJ_CLS_TYPE1_PROB_009 OBJ_VEH_TRACK_FLAG_009 OBJ_ACCELERATION_LAT_009 OBJ_ACCELERATION_LONG_009 OBJ_VELOCITY_LAT_009 OBJ_VELOCITY_LONG_009 OBJ_POS_LAT_009 OBJ_POS_LONG_009 OBJ_MEASUREMENT_STATUS_009 OBJ_MOVEMENT_STATUS_009 OBJ_CLS_TYPE1_009 OBJ_ID_009 OBJ_YAW_ANGLE_009 OBJ_EXISTENCE_PROB_009 OBJ_DIMENSION_LENGTH_009 OBJ_DIMENSION_WIDTH_009 OBJ_TRACK_MOTION_MODEL_009 OBJ_POS_LAT_ERR_009 OBJ_POS_LONG_ERR_009 OBJ_VELOCITY_LAT_ERR_009 OBJ_VELOCITY_LONG_ERR_009 OBJ_ACCELERATION_LAT_ERR_009 OBJ_ACCELERATION_LONG_ERR_009 OBJ_ALIVE_TIME_009;
SIG_GROUP_ 1753 TrackerObject010 1 : OBJ_MH_CRC16_010 OBJ_MH_CYCLE_COUNTER_010 OBJ_ACCEL_ERR_CRR_COEF_010 OBJ_VELOCITY_ERR_CRR_COEF_010 OBJ_POS_ERR_CRR_COEF_010 OBJ_YAW_RATE_010 OBJ_YAW_RATE_ERR_010 OBJ_GROUP_ID_010 OBJ_REF_PT_LAT_OFFSET_010 OBJ_REF_PT_LONG_OFFSET_010 OBJ_RCS_010 OBJ_YAW_ANGLE_ERR_010 OBJ_CLS_TYPE6_010 OBJ_CLS_TYPE6_PROB_010 OBJ_CLS_TYPE5_PROB_010 OBJ_CLS_TYPE5_010 OBJ_CLS_TYPE4_PROB_010 OBJ_CLS_TYPE4_010 OBJ_CLS_TYPE3_PROB_010 OBJ_CLS_TYPE3_010 OBJ_CLS_TYPE2_PROB_010 OBJ_CLS_TYPE2_010 OBJ_DIMENSION_WIDTH_ERR_010 OBJ_DIMENSION_LENGTH_ERR_010 OBJ_TIMESTAMP_OFFSET_010 OBJ_CLS_TYPE1_PROB_010 OBJ_VEH_TRACK_FLAG_010 OBJ_ACCELERATION_LAT_010 OBJ_ACCELERATION_LONG_010 OBJ_VELOCITY_LAT_010 OBJ_VELOCITY_LONG_010 OBJ_POS_LAT_010 OBJ_POS_LONG_010 OBJ_MEASUREMENT_STATUS_010 OBJ_MOVEMENT_STATUS_010 OBJ_CLS_TYPE1_010 OBJ_ID_010 OBJ_YAW_ANGLE_010 OBJ_EXISTENCE_PROB_010 OBJ_DIMENSION_LENGTH_010 OBJ_DIMENSION_WIDTH_010 OBJ_TRACK_MOTION_MODEL_010 OBJ_POS_LAT_ERR_010 OBJ_POS_LONG_ERR_010 OBJ_VELOCITY_LAT_ERR_010 OBJ_VELOCITY_LONG_ERR_010 OBJ_ACCELERATION_LAT_ERR_010 OBJ_ACCELERATION_LONG_ERR_010 OBJ_ALIVE_TIME_010;
SIG_GROUP_ 1754 TrackerObject011 1 : OBJ_MH_CRC16_011 OBJ_MH_CYCLE_COUNTER_011 OBJ_ACCEL_ERR_CRR_COEF_011 OBJ_VELOCITY_ERR_CRR_COEF_011 OBJ_POS_ERR_CRR_COEF_011 OBJ_YAW_RATE_011 OBJ_YAW_RATE_ERR_011 OBJ_GROUP_ID_011 OBJ_REF_PT_LAT_OFFSET_011 OBJ_REF_PT_LONG_OFFSET_011 OBJ_RCS_011 OBJ_YAW_ANGLE_ERR_011 OBJ_CLS_TYPE6_011 OBJ_CLS_TYPE6_PROB_011 OBJ_CLS_TYPE5_PROB_011 OBJ_CLS_TYPE5_011 OBJ_CLS_TYPE4_PROB_011 OBJ_CLS_TYPE4_011 OBJ_CLS_TYPE3_PROB_011 OBJ_CLS_TYPE3_011 OBJ_CLS_TYPE2_PROB_011 OBJ_CLS_TYPE2_011 OBJ_DIMENSION_WIDTH_ERR_011 OBJ_DIMENSION_LENGTH_ERR_011 OBJ_TIMESTAMP_OFFSET_011 OBJ_CLS_TYPE1_PROB_011 OBJ_VEH_TRACK_FLAG_011 OBJ_ACCELERATION_LAT_011 OBJ_ACCELERATION_LONG_011 OBJ_VELOCITY_LAT_011 OBJ_VELOCITY_LONG_011 OBJ_POS_LAT_011 OBJ_POS_LONG_011 OBJ_MEASUREMENT_STATUS_011 OBJ_MOVEMENT_STATUS_011 OBJ_CLS_TYPE1_011 OBJ_ID_011 OBJ_YAW_ANGLE_011 OBJ_EXISTENCE_PROB_011 OBJ_DIMENSION_LENGTH_011 OBJ_DIMENSION_WIDTH_011 OBJ_TRACK_MOTION_MODEL_011 OBJ_POS_LAT_ERR_011 OBJ_POS_LONG_ERR_011 OBJ_VELOCITY_LAT_ERR_011 OBJ_VELOCITY_LONG_ERR_011 OBJ_ACCELERATION_LAT_ERR_011 OBJ_ACCELERATION_LONG_ERR_011 OBJ_ALIVE_TIME_011;
SIG_GROUP_ 1755 TrackerObject012 1 : OBJ_MH_CRC16_012 OBJ_MH_CYCLE_COUNTER_012 OBJ_ACCEL_ERR_CRR_COEF_012 OBJ_VELOCITY_ERR_CRR_COEF_012 OBJ_POS_ERR_CRR_COEF_012 OBJ_YAW_RATE_012 OBJ_YAW_RATE_ERR_012 OBJ_GROUP_ID_012 OBJ_REF_PT_LAT_OFFSET_012 OBJ_REF_PT_LONG_OFFSET_012 OBJ_RCS_012 OBJ_YAW_ANGLE_ERR_012 OBJ_CLS_TYPE6_012 OBJ_CLS_TYPE6_PROB_012 OBJ_CLS_TYPE5_PROB_012 OBJ_CLS_TYPE5_012 OBJ_CLS_TYPE4_PROB_012 OBJ_CLS_TYPE4_012 OBJ_CLS_TYPE3_PROB_012 OBJ_CLS_TYPE3_012 OBJ_CLS_TYPE2_PROB_012 OBJ_CLS_TYPE2_012 OBJ_DIMENSION_WIDTH_ERR_012 OBJ_DIMENSION_LENGTH_ERR_012 OBJ_TIMESTAMP_OFFSET_012 OBJ_CLS_TYPE1_PROB_012 OBJ_VEH_TRACK_FLAG_012 OBJ_ACCELERATION_LAT_012 OBJ_ACCELERATION_LONG_012 OBJ_VELOCITY_LAT_012 OBJ_VELOCITY_LONG_012 OBJ_POS_LAT_012 OBJ_POS_LONG_012 OBJ_MEASUREMENT_STATUS_012 OBJ_MOVEMENT_STATUS_012 OBJ_CLS_TYPE1_012 OBJ_ID_012 OBJ_YAW_ANGLE_012 OBJ_EXISTENCE_PROB_012 OBJ_DIMENSION_LENGTH_012 OBJ_DIMENSION_WIDTH_012 OBJ_TRACK_MOTION_MODEL_012 OBJ_POS_LAT_ERR_012 OBJ_POS_LONG_ERR_012 OBJ_VELOCITY_LAT_ERR_012 OBJ_VELOCITY_LONG_ERR_012 OBJ_ACCELERATION_LAT_ERR_012 OBJ_ACCELERATION_LONG_ERR_012 OBJ_ALIVE_TIME_012;
SIG_GROUP_ 1756 TrackerObject013 1 : OBJ_MH_CRC16_013 OBJ_MH_CYCLE_COUNTER_013 OBJ_ACCEL_ERR_CRR_COEF_013 OBJ_VELOCITY_ERR_CRR_COEF_013 OBJ_POS_ERR_CRR_COEF_013 OBJ_YAW_RATE_013 OBJ_YAW_RATE_ERR_013 OBJ_GROUP_ID_013 OBJ_REF_PT_LAT_OFFSET_013 OBJ_REF_PT_LONG_OFFSET_013 OBJ_RCS_013 OBJ_YAW_ANGLE_ERR_013 OBJ_CLS_TYPE6_013 OBJ_CLS_TYPE6_PROB_013 OBJ_CLS_TYPE5_PROB_013 OBJ_CLS_TYPE5_013 OBJ_CLS_TYPE4_PROB_013 OBJ_CLS_TYPE4_013 OBJ_CLS_TYPE3_PROB_013 OBJ_CLS_TYPE3_013 OBJ_CLS_TYPE2_PROB_013 OBJ_CLS_TYPE2_013 OBJ_DIMENSION_WIDTH_ERR_013 OBJ_DIMENSION_LENGTH_ERR_013 OBJ_TIMESTAMP_OFFSET_013 OBJ_CLS_TYPE1_PROB_013 OBJ_VEH_TRACK_FLAG_013 OBJ_ACCELERATION_LAT_013 OBJ_ACCELERATION_LONG_013 OBJ_VELOCITY_LAT_013 OBJ_VELOCITY_LONG_013 OBJ_POS_LAT_013 OBJ_POS_LONG_013 OBJ_MEASUREMENT_STATUS_013 OBJ_MOVEMENT_STATUS_013 OBJ_CLS_TYPE1_013 OBJ_ID_013 OBJ_YAW_ANGLE_013 OBJ_EXISTENCE_PROB_013 OBJ_DIMENSION_LENGTH_013 OBJ_DIMENSION_WIDTH_013 OBJ_TRACK_MOTION_MODEL_013 OBJ_POS_LAT_ERR_013 OBJ_POS_LONG_ERR_013 OBJ_VELOCITY_LAT_ERR_013 OBJ_VELOCITY_LONG_ERR_013 OBJ_ACCELERATION_LAT_ERR_013 OBJ_ACCELERATION_LONG_ERR_013 OBJ_ALIVE_TIME_013;
SIG_GROUP_ 1757 TrackerObject014 1 : OBJ_MH_CRC16_014 OBJ_MH_CYCLE_COUNTER_014 OBJ_ACCEL_ERR_CRR_COEF_014 OBJ_VELOCITY_ERR_CRR_COEF_014 OBJ_POS_ERR_CRR_COEF_014 OBJ_YAW_RATE_014 OBJ_YAW_RATE_ERR_014 OBJ_GROUP_ID_014 OBJ_REF_PT_LAT_OFFSET_014 OBJ_REF_PT_LONG_OFFSET_014 OBJ_RCS_014 OBJ_YAW_ANGLE_ERR_014 OBJ_CLS_TYPE6_014 OBJ_CLS_TYPE6_PROB_014 OBJ_CLS_TYPE5_PROB_014 OBJ_CLS_TYPE5_014 OBJ_CLS_TYPE4_PROB_014 OBJ_CLS_TYPE4_014 OBJ_CLS_TYPE3_PROB_014 OBJ_CLS_TYPE3_014 OBJ_CLS_TYPE2_PROB_014 OBJ_CLS_TYPE2_014 OBJ_DIMENSION_WIDTH_ERR_014 OBJ_DIMENSION_LENGTH_ERR_014 OBJ_TIMESTAMP_OFFSET_014 OBJ_CLS_TYPE1_PROB_014 OBJ_VEH_TRACK_FLAG_014 OBJ_ACCELERATION_LAT_014 OBJ_ACCELERATION_LONG_014 OBJ_VELOCITY_LAT_014 OBJ_VELOCITY_LONG_014 OBJ_POS_LAT_014 OBJ_POS_LONG_014 OBJ_MEASUREMENT_STATUS_014 OBJ_MOVEMENT_STATUS_014 OBJ_CLS_TYPE1_014 OBJ_ID_014 OBJ_YAW_ANGLE_014 OBJ_EXISTENCE_PROB_014 OBJ_DIMENSION_LENGTH_014 OBJ_DIMENSION_WIDTH_014 OBJ_TRACK_MOTION_MODEL_014 OBJ_POS_LAT_ERR_014 OBJ_POS_LONG_ERR_014 OBJ_VELOCITY_LAT_ERR_014 OBJ_VELOCITY_LONG_ERR_014 OBJ_ACCELERATION_LAT_ERR_014 OBJ_ACCELERATION_LONG_ERR_014 OBJ_ALIVE_TIME_014;
SIG_GROUP_ 1758 TrackerObject015 1 : OBJ_MH_CRC16_015 OBJ_MH_CYCLE_COUNTER_015 OBJ_ACCEL_ERR_CRR_COEF_015 OBJ_VELOCITY_ERR_CRR_COEF_015 OBJ_POS_ERR_CRR_COEF_015 OBJ_YAW_RATE_015 OBJ_YAW_RATE_ERR_015 OBJ_GROUP_ID_015 OBJ_REF_PT_LAT_OFFSET_015 OBJ_REF_PT_LONG_OFFSET_015 OBJ_RCS_015 OBJ_YAW_ANGLE_ERR_015 OBJ_CLS_TYPE6_015 OBJ_CLS_TYPE6_PROB_015 OBJ_CLS_TYPE5_PROB_015 OBJ_CLS_TYPE5_015 OBJ_CLS_TYPE4_PROB_015 OBJ_CLS_TYPE4_015 OBJ_CLS_TYPE3_PROB_015 OBJ_CLS_TYPE3_015 OBJ_CLS_TYPE2_PROB_015 OBJ_CLS_TYPE2_015 OBJ_DIMENSION_WIDTH_ERR_015 OBJ_DIMENSION_LENGTH_ERR_015 OBJ_TIMESTAMP_OFFSET_015 OBJ_CLS_TYPE1_PROB_015 OBJ_VEH_TRACK_FLAG_015 OBJ_ACCELERATION_LAT_015 OBJ_ACCELERATION_LONG_015 OBJ_VELOCITY_LAT_015 OBJ_VELOCITY_LONG_015 OBJ_POS_LAT_015 OBJ_POS_LONG_015 OBJ_MEASUREMENT_STATUS_015 OBJ_MOVEMENT_STATUS_015 OBJ_CLS_TYPE1_015 OBJ_ID_015 OBJ_YAW_ANGLE_015 OBJ_EXISTENCE_PROB_015 OBJ_DIMENSION_LENGTH_015 OBJ_DIMENSION_WIDTH_015 OBJ_TRACK_MOTION_MODEL_015 OBJ_POS_LAT_ERR_015 OBJ_POS_LONG_ERR_015 OBJ_VELOCITY_LAT_ERR_015 OBJ_VELOCITY_LONG_ERR_015 OBJ_ACCELERATION_LAT_ERR_015 OBJ_ACCELERATION_LONG_ERR_015 OBJ_ALIVE_TIME_015;
SIG_GROUP_ 1759 TrackerObject016 1 : OBJ_MH_CRC16_016 OBJ_MH_CYCLE_COUNTER_016 OBJ_ACCEL_ERR_CRR_COEF_016 OBJ_VELOCITY_ERR_CRR_COEF_016 OBJ_POS_ERR_CRR_COEF_016 OBJ_YAW_RATE_016 OBJ_YAW_RATE_ERR_016 OBJ_GROUP_ID_016 OBJ_REF_PT_LAT_OFFSET_016 OBJ_REF_PT_LONG_OFFSET_016 OBJ_RCS_016 OBJ_YAW_ANGLE_ERR_016 OBJ_CLS_TYPE6_016 OBJ_CLS_TYPE6_PROB_016 OBJ_CLS_TYPE5_PROB_016 OBJ_CLS_TYPE5_016 OBJ_CLS_TYPE4_PROB_016 OBJ_CLS_TYPE4_016 OBJ_CLS_TYPE3_PROB_016 OBJ_CLS_TYPE3_016 OBJ_CLS_TYPE2_PROB_016 OBJ_CLS_TYPE2_016 OBJ_DIMENSION_WIDTH_ERR_016 OBJ_DIMENSION_LENGTH_ERR_016 OBJ_TIMESTAMP_OFFSET_016 OBJ_CLS_TYPE1_PROB_016 OBJ_VEH_TRACK_FLAG_016 OBJ_ACCELERATION_LAT_016 OBJ_ACCELERATION_LONG_016 OBJ_VELOCITY_LAT_016 OBJ_VELOCITY_LONG_016 OBJ_POS_LAT_016 OBJ_POS_LONG_016 OBJ_MEASUREMENT_STATUS_016 OBJ_MOVEMENT_STATUS_016 OBJ_CLS_TYPE1_016 OBJ_ID_016 OBJ_YAW_ANGLE_016 OBJ_EXISTENCE_PROB_016 OBJ_DIMENSION_LENGTH_016 OBJ_DIMENSION_WIDTH_016 OBJ_TRACK_MOTION_MODEL_016 OBJ_POS_LAT_ERR_016 OBJ_POS_LONG_ERR_016 OBJ_VELOCITY_LAT_ERR_016 OBJ_VELOCITY_LONG_ERR_016 OBJ_ACCELERATION_LAT_ERR_016 OBJ_ACCELERATION_LONG_ERR_016 OBJ_ALIVE_TIME_016;
SIG_GROUP_ 1760 TrackerObject017 1 : OBJ_MH_CRC16_017 OBJ_MH_CYCLE_COUNTER_017 OBJ_ACCEL_ERR_CRR_COEF_017 OBJ_VELOCITY_ERR_CRR_COEF_017 OBJ_POS_ERR_CRR_COEF_017 OBJ_YAW_RATE_017 OBJ_YAW_RATE_ERR_017 OBJ_GROUP_ID_017 OBJ_REF_PT_LAT_OFFSET_017 OBJ_REF_PT_LONG_OFFSET_017 OBJ_RCS_017 OBJ_YAW_ANGLE_ERR_017 OBJ_CLS_TYPE6_017 OBJ_CLS_TYPE6_PROB_017 OBJ_CLS_TYPE5_PROB_017 OBJ_CLS_TYPE5_017 OBJ_CLS_TYPE4_PROB_017 OBJ_CLS_TYPE4_017 OBJ_CLS_TYPE3_PROB_017 OBJ_CLS_TYPE3_017 OBJ_CLS_TYPE2_PROB_017 OBJ_CLS_TYPE2_017 OBJ_DIMENSION_WIDTH_ERR_017 OBJ_DIMENSION_LENGTH_ERR_017 OBJ_TIMESTAMP_OFFSET_017 OBJ_CLS_TYPE1_PROB_017 OBJ_VEH_TRACK_FLAG_017 OBJ_ACCELERATION_LAT_017 OBJ_ACCELERATION_LONG_017 OBJ_VELOCITY_LAT_017 OBJ_VELOCITY_LONG_017 OBJ_POS_LAT_017 OBJ_POS_LONG_017 OBJ_MEASUREMENT_STATUS_017 OBJ_MOVEMENT_STATUS_017 OBJ_CLS_TYPE1_017 OBJ_ID_017 OBJ_YAW_ANGLE_017 OBJ_EXISTENCE_PROB_017 OBJ_DIMENSION_LENGTH_017 OBJ_DIMENSION_WIDTH_017 OBJ_TRACK_MOTION_MODEL_017 OBJ_POS_LAT_ERR_017 OBJ_POS_LONG_ERR_017 OBJ_VELOCITY_LAT_ERR_017 OBJ_VELOCITY_LONG_ERR_017 OBJ_ACCELERATION_LAT_ERR_017 OBJ_ACCELERATION_LONG_ERR_017 OBJ_ALIVE_TIME_017;

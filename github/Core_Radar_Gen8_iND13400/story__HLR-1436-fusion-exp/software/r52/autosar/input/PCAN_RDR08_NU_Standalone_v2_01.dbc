VERSION "created by canmatrix"

NS_ :

BS_:

BU_: External_Tool ADAS RDR08

BO_ 1216 RDR_DETECTION_257_260: 64 RDR08
 SG_ DET_RANGE_257 : 7|15@0+ (0.015625,0) [0|500] "m" ADAS
 SG_ DET_RANGE_ERR_257 : 8|7@0+ (0.0075,0) [0|0.9525] "m" ADAS
 SG_ DET_RANGE_VELOCITY_257 : 17|15@0+ (0.0078125,-128) [-128|127.9921875] "m/s" ADAS
 SG_ DET_RANGE_VELOCITY_ERR_257 : 34|8@0+ (0.003,0) [0|0.765] "m/s" ADAS
 SG_ DET_AZIMUTH_257 : 60|13@0+ (0.0004,-1.5708) [-1.5708|1.5708] "rad" ADAS
 SG_ DET_AZIMUTH_ERR_257 : 78|7@0+ (0.00087267,0) [0|0.11082909] "rad" ADAS
 SG_ DET_ELEVATION_257 : 42|8@0+ (0.00275,-0.34925) [-0.34925|0.34925] "rad" ADAS
 SG_ DET_ELEVATION_ERR_257 : 50|6@0+ (0.00174533,0) [0|0.10995579] "rad" ADAS
 SG_ DET_RCS_257 : 119|8@0+ (0.5,-64) [-64|63.5] "dBsm" ADAS
 SG_ DET_VALID_FLAG_257 : 80|1@0+ (1,0) [0|1] "" ADAS
 SG_ DET_BI_STATIC_FLAG_257 : 487|1@0+ (1,0) [0|1] "" ADAS
 SG_ DET_SUPER_RES_TARGET_257 : 79|1@0+ (1,0) [0|1] "" ADAS
 SG_ DET_SNR_257 : 111|8@0+ (0.35156,0) [0|89.6478] "dB" ADAS
 SG_ DET_POINT_TARGET_PROB_257 : 86|4@0+ (6.67,0) [0|100] "%" ADAS
 SG_ DET_EXISTENCE_PROB_257 : 95|6@0+ (1.588,0) [0|100] "%" ADAS
 SG_ DET_OUTSIDE_SECTOR_257 : 103|1@0+ (1,0) [0|1] "" ADAS
 SG_ DET_HVC_FLAG_257 : 87|1@0+ (1,0) [0|1] "" ADAS
 SG_ DET_CONFD_AZIMUTH_257 : 89|2@0+ (1,0) [0|3] "" ADAS
 SG_ DET_CONFD_ELEVATION_257 : 82|2@0+ (1,0) [0|3] "" ADAS
 SG_ DET_RANGE_258 : 127|15@0+ (0.015625,0) [0|500] "m" ADAS
 SG_ DET_RANGE_ERR_258 : 128|7@0+ (0.0075,0) [0|0.9525] "m" ADAS
 SG_ DET_RANGE_VELOCITY_258 : 137|15@0+ (0.0078125,-128) [-128|127.9921875] "m/s" ADAS
 SG_ DET_RANGE_VELOCITY_ERR_258 : 154|8@0+ (0.003,0) [0|0.765] "m/s" ADAS
 SG_ DET_AZIMUTH_258 : 180|13@0+ (0.0004,-1.5708) [-1.5708|1.5708] "rad" ADAS
 SG_ DET_AZIMUTH_ERR_258 : 198|7@0+ (0.00087267,0) [0|0.11082909] "rad" ADAS
 SG_ DET_ELEVATION_258 : 162|8@0+ (0.00275,-0.34925) [-0.34925|0.34925] "rad" ADAS
 SG_ DET_ELEVATION_ERR_258 : 170|6@0+ (0.00174533,0) [0|0.10995579] "rad" ADAS
 SG_ DET_RCS_258 : 239|8@0+ (0.5,-64) [-64|63.5] "dBsm" ADAS
 SG_ DET_VALID_FLAG_258 : 220|1@0+ (1,0) [0|1] "" ADAS
 SG_ DET_BI_STATIC_FLAG_258 : 486|1@0+ (1,0) [0|1] "" ADAS
 SG_ DET_SUPER_RES_TARGET_258 : 199|1@0+ (1,0) [0|1] "" ADAS
 SG_ DET_SNR_258 : 231|8@0+ (0.35156,0) [0|89.6478] "dB" ADAS
 SG_ DET_POINT_TARGET_PROB_258 : 215|4@0+ (6.67,0) [0|100] "%" ADAS
 SG_ DET_EXISTENCE_PROB_258 : 211|6@0+ (1.588,0) [0|100] "%" ADAS
 SG_ DET_OUTSIDE_SECTOR_258 : 221|1@0+ (1,0) [0|1] "" ADAS
 SG_ DET_HVC_FLAG_258 : 207|1@0+ (1,0) [0|1] "" ADAS
 SG_ DET_CONFD_AZIMUTH_258 : 217|2@0+ (1,0) [0|3] "" ADAS
 SG_ DET_CONFD_ELEVATION_258 : 219|2@0+ (1,0) [0|3] "" ADAS
 SG_ DET_RANGE_259 : 247|15@0+ (0.015625,0) [0|500] "m" ADAS
 SG_ DET_RANGE_ERR_259 : 248|7@0+ (0.0075,0) [0|0.9525] "m" ADAS
 SG_ DET_RANGE_VELOCITY_259 : 257|15@0+ (0.0078125,-128) [-128|127.9921875] "m/s" ADAS
 SG_ DET_RANGE_VELOCITY_ERR_259 : 274|8@0+ (0.003,0) [0|0.765] "m/s" ADAS
 SG_ DET_AZIMUTH_259 : 300|13@0+ (0.0004,-1.5708) [-1.5708|1.5708] "rad" ADAS
 SG_ DET_AZIMUTH_ERR_259 : 318|7@0+ (0.00087267,0) [0|0.11082909] "rad" ADAS
 SG_ DET_ELEVATION_259 : 282|8@0+ (0.00275,-0.34925) [-0.34925|0.34925] "rad" ADAS
 SG_ DET_ELEVATION_ERR_259 : 290|6@0+ (0.00174533,0) [0|0.10995579] "rad" ADAS
 SG_ DET_RCS_259 : 359|8@0+ (0.5,-64) [-64|63.5] "dBsm" ADAS
 SG_ DET_VALID_FLAG_259 : 340|1@0+ (1,0) [0|1] "" ADAS
 SG_ DET_BI_STATIC_FLAG_259 : 485|1@0+ (1,0) [0|1] "" ADAS
 SG_ DET_SUPER_RES_TARGET_259 : 319|1@0+ (1,0) [0|1] "" ADAS
 SG_ DET_SNR_259 : 351|8@0+ (0.35156,0) [0|89.6478] "dB" ADAS
 SG_ DET_POINT_TARGET_PROB_259 : 335|4@0+ (6.67,0) [0|100] "%" ADAS
 SG_ DET_EXISTENCE_PROB_259 : 331|6@0+ (1.588,0) [0|100] "%" ADAS
 SG_ DET_OUTSIDE_SECTOR_259 : 341|1@0+ (1,0) [0|1] "" ADAS
 SG_ DET_HVC_FLAG_259 : 327|1@0+ (1,0) [0|1] "" ADAS
 SG_ DET_CONFD_AZIMUTH_259 : 337|2@0+ (1,0) [0|3] "" ADAS
 SG_ DET_CONFD_ELEVATION_259 : 339|2@0+ (1,0) [0|3] "" ADAS
 SG_ DET_RANGE_260 : 367|15@0+ (0.015625,0) [0|500] "m" ADAS
 SG_ DET_RANGE_ERR_260 : 368|7@0+ (0.0075,0) [0|0.9525] "m" ADAS
 SG_ DET_RANGE_VELOCITY_260 : 377|15@0+ (0.0078125,-128) [-128|127.9921875] "m/s" ADAS
 SG_ DET_RANGE_VELOCITY_ERR_260 : 394|8@0+ (0.003,0) [0|0.765] "m/s" ADAS
 SG_ DET_AZIMUTH_260 : 420|13@0+ (0.0004,-1.5708) [-1.5708|1.5708] "rad" ADAS
 SG_ DET_AZIMUTH_ERR_260 : 438|7@0+ (0.00087267,0) [0|0.11082909] "rad" ADAS
 SG_ DET_ELEVATION_260 : 402|8@0+ (0.00275,-0.34925) [-0.34925|0.34925] "rad" ADAS
 SG_ DET_ELEVATION_ERR_260 : 410|6@0+ (0.00174533,0) [0|0.10995579] "rad" ADAS
 SG_ DET_RCS_260 : 479|8@0+ (0.5,-64) [-64|63.5] "dBsm" ADAS
 SG_ DET_VALID_FLAG_260 : 460|1@0+ (1,0) [0|1] "" ADAS
 SG_ DET_BI_STATIC_FLAG_260 : 484|1@0+ (1,0) [0|1] "" ADAS
 SG_ DET_SUPER_RES_TARGET_260 : 439|1@0+ (1,0) [0|1] "" ADAS
 SG_ DET_SNR_260 : 471|8@0+ (0.35156,0) [0|89.6478] "dB" ADAS
 SG_ DET_POINT_TARGET_PROB_260 : 455|4@0+ (6.67,0) [0|100] "%" ADAS
 SG_ DET_EXISTENCE_PROB_260 : 451|6@0+ (1.588,0) [0|100] "%" ADAS
 SG_ DET_OUTSIDE_SECTOR_260 : 461|1@0+ (1,0) [0|1] "" ADAS
 SG_ DET_HVC_FLAG_260 : 447|1@0+ (1,0) [0|1] "" ADAS
 SG_ DET_CONFD_AZIMUTH_260 : 457|2@0+ (1,0) [0|3] "" ADAS
 SG_ DET_CONFD_ELEVATION_260 : 459|2@0+ (1,0) [0|3] "" ADAS
 SG_ DET_MH_SCAN_INDEX_4LSB_257_260 : 483|4@0+ (1,0) [0|15] "" ADAS
 SG_ DET_MH_CYCLE_COUNTER_257_260 : 495|8@0+ (1,0) [0|255] "" ADAS
 SG_ DET_MH_CRC16_257_260 : 503|16@0+ (1,0) [0|65535] "" ADAS

BO_ 1217 RDR_DETECTION_261_264: 64 RDR08
 SG_ DET_RANGE_261 : 7|15@0+ (0.015625,0) [0|500] "m" ADAS
 SG_ DET_RANGE_ERR_261 : 8|7@0+ (0.0075,0) [0|0.9525] "m" ADAS
 SG_ DET_RANGE_VELOCITY_261 : 17|15@0+ (0.0078125,-128) [-128|127.9921875] "m/s" ADAS
 SG_ DET_RANGE_VELOCITY_ERR_261 : 34|8@0+ (0.003,0) [0|0.765] "m/s" ADAS
 SG_ DET_AZIMUTH_261 : 60|13@0+ (0.0004,-1.5708) [-1.5708|1.5708] "rad" ADAS
 SG_ DET_AZIMUTH_ERR_261 : 78|7@0+ (0.00087267,0) [0|0.11082909] "rad" ADAS
 SG_ DET_ELEVATION_261 : 42|8@0+ (0.00275,-0.34925) [-0.34925|0.34925] "rad" ADAS
 SG_ DET_ELEVATION_ERR_261 : 50|6@0+ (0.00174533,0) [0|0.10995579] "rad" ADAS
 SG_ DET_RCS_261 : 119|8@0+ (0.5,-64) [-64|63.5] "dBsm" ADAS
 SG_ DET_VALID_FLAG_261 : 80|1@0+ (1,0) [0|1] "" ADAS
 SG_ DET_BI_STATIC_FLAG_261 : 487|1@0+ (1,0) [0|1] "" ADAS
 SG_ DET_SUPER_RES_TARGET_261 : 79|1@0+ (1,0) [0|1] "" ADAS
 SG_ DET_SNR_261 : 111|8@0+ (0.35156,0) [0|89.6478] "dB" ADAS
 SG_ DET_POINT_TARGET_PROB_261 : 86|4@0+ (6.67,0) [0|100] "%" ADAS
 SG_ DET_EXISTENCE_PROB_261 : 95|6@0+ (1.588,0) [0|100] "%" ADAS
 SG_ DET_OUTSIDE_SECTOR_261 : 103|1@0+ (1,0) [0|1] "" ADAS
 SG_ DET_HVC_FLAG_261 : 87|1@0+ (1,0) [0|1] "" ADAS
 SG_ DET_CONFD_AZIMUTH_261 : 89|2@0+ (1,0) [0|3] "" ADAS
 SG_ DET_CONFD_ELEVATION_261 : 82|2@0+ (1,0) [0|3] "" ADAS
 SG_ DET_RANGE_262 : 127|15@0+ (0.015625,0) [0|500] "m" ADAS
 SG_ DET_RANGE_ERR_262 : 128|7@0+ (0.0075,0) [0|0.9525] "m" ADAS
 SG_ DET_RANGE_VELOCITY_262 : 137|15@0+ (0.0078125,-128) [-128|127.9921875] "m/s" ADAS
 SG_ DET_RANGE_VELOCITY_ERR_262 : 154|8@0+ (0.003,0) [0|0.765] "m/s" ADAS
 SG_ DET_AZIMUTH_262 : 180|13@0+ (0.0004,-1.5708) [-1.5708|1.5708] "rad" ADAS
 SG_ DET_AZIMUTH_ERR_262 : 198|7@0+ (0.00087267,0) [0|0.11082909] "rad" ADAS
 SG_ DET_ELEVATION_262 : 162|8@0+ (0.00275,-0.34925) [-0.34925|0.34925] "rad" ADAS
 SG_ DET_ELEVATION_ERR_262 : 170|6@0+ (0.00174533,0) [0|0.10995579] "rad" ADAS
 SG_ DET_RCS_262 : 239|8@0+ (0.5,-64) [-64|63.5] "dBsm" ADAS
 SG_ DET_VALID_FLAG_262 : 220|1@0+ (1,0) [0|1] "" ADAS
 SG_ DET_BI_STATIC_FLAG_262 : 486|1@0+ (1,0) [0|1] "" ADAS
 SG_ DET_SUPER_RES_TARGET_262 : 199|1@0+ (1,0) [0|1] "" ADAS
 SG_ DET_SNR_262 : 231|8@0+ (0.35156,0) [0|89.6478] "dB" ADAS
 SG_ DET_POINT_TARGET_PROB_262 : 215|4@0+ (6.67,0) [0|100] "%" ADAS
 SG_ DET_EXISTENCE_PROB_262 : 211|6@0+ (1.588,0) [0|100] "%" ADAS
 SG_ DET_OUTSIDE_SECTOR_262 : 221|1@0+ (1,0) [0|1] "" ADAS
 SG_ DET_HVC_FLAG_262 : 207|1@0+ (1,0) [0|1] "" ADAS
 SG_ DET_CONFD_AZIMUTH_262 : 217|2@0+ (1,0) [0|3] "" ADAS
 SG_ DET_CONFD_ELEVATION_262 : 219|2@0+ (1,0) [0|3] "" ADAS
 SG_ DET_RANGE_263 : 247|15@0+ (0.015625,0) [0|500] "m" ADAS
 SG_ DET_RANGE_ERR_263 : 248|7@0+ (0.0075,0) [0|0.9525] "m" ADAS
 SG_ DET_RANGE_VELOCITY_263 : 257|15@0+ (0.0078125,-128) [-128|127.9921875] "m/s" ADAS
 SG_ DET_RANGE_VELOCITY_ERR_263 : 274|8@0+ (0.003,0) [0|0.765] "m/s" ADAS
 SG_ DET_AZIMUTH_263 : 300|13@0+ (0.0004,-1.5708) [-1.5708|1.5708] "rad" ADAS
 SG_ DET_AZIMUTH_ERR_263 : 318|7@0+ (0.00087267,0) [0|0.11082909] "rad" ADAS
 SG_ DET_ELEVATION_263 : 282|8@0+ (0.00275,-0.34925) [-0.34925|0.34925] "rad" ADAS
 SG_ DET_ELEVATION_ERR_263 : 290|6@0+ (0.00174533,0) [0|0.10995579] "rad" ADAS
 SG_ DET_RCS_263 : 359|8@0+ (0.5,-64) [-64|63.5] "dBsm" ADAS
 SG_ DET_VALID_FLAG_263 : 340|1@0+ (1,0) [0|1] "" ADAS
 SG_ DET_BI_STATIC_FLAG_263 : 485|1@0+ (1,0) [0|1] "" ADAS
 SG_ DET_SUPER_RES_TARGET_263 : 319|1@0+ (1,0) [0|1] "" ADAS
 SG_ DET_SNR_263 : 351|8@0+ (0.35156,0) [0|89.6478] "dB" ADAS
 SG_ DET_POINT_TARGET_PROB_263 : 335|4@0+ (6.67,0) [0|100] "%" ADAS
 SG_ DET_EXISTENCE_PROB_263 : 331|6@0+ (1.588,0) [0|100] "%" ADAS
 SG_ DET_OUTSIDE_SECTOR_263 : 341|1@0+ (1,0) [0|1] "" ADAS
 SG_ DET_HVC_FLAG_263 : 327|1@0+ (1,0) [0|1] "" ADAS
 SG_ DET_CONFD_AZIMUTH_263 : 337|2@0+ (1,0) [0|3] "" ADAS
 SG_ DET_CONFD_ELEVATION_263 : 339|2@0+ (1,0) [0|3] "" ADAS
 SG_ DET_RANGE_264 : 367|15@0+ (0.015625,0) [0|500] "m" ADAS
 SG_ DET_RANGE_ERR_264 : 368|7@0+ (0.0075,0) [0|0.9525] "m" ADAS
 SG_ DET_RANGE_VELOCITY_264 : 377|15@0+ (0.0078125,-128) [-128|127.9921875] "m/s" ADAS
 SG_ DET_RANGE_VELOCITY_ERR_264 : 394|8@0+ (0.003,0) [0|0.765] "m/s" ADAS
 SG_ DET_AZIMUTH_264 : 420|13@0+ (0.0004,-1.5708) [-1.5708|1.5708] "rad" ADAS
 SG_ DET_AZIMUTH_ERR_264 : 438|7@0+ (0.00087267,0) [0|0.11082909] "rad" ADAS
 SG_ DET_ELEVATION_264 : 402|8@0+ (0.00275,-0.34925) [-0.34925|0.34925] "rad" ADAS
 SG_ DET_ELEVATION_ERR_264 : 410|6@0+ (0.00174533,0) [0|0.10995579] "rad" ADAS
 SG_ DET_RCS_264 : 479|8@0+ (0.5,-64) [-64|63.5] "dBsm" ADAS
 SG_ DET_VALID_FLAG_264 : 460|1@0+ (1,0) [0|1] "" ADAS
 SG_ DET_BI_STATIC_FLAG_264 : 484|1@0+ (1,0) [0|1] "" ADAS
 SG_ DET_SUPER_RES_TARGET_264 : 439|1@0+ (1,0) [0|1] "" ADAS
 SG_ DET_SNR_264 : 471|8@0+ (0.35156,0) [0|89.6478] "dB" ADAS
 SG_ DET_POINT_TARGET_PROB_264 : 455|4@0+ (6.67,0) [0|100] "%" ADAS
 SG_ DET_EXISTENCE_PROB_264 : 451|6@0+ (1.588,0) [0|100] "%" ADAS
 SG_ DET_OUTSIDE_SECTOR_264 : 461|1@0+ (1,0) [0|1] "" ADAS
 SG_ DET_HVC_FLAG_264 : 447|1@0+ (1,0) [0|1] "" ADAS
 SG_ DET_CONFD_AZIMUTH_264 : 457|2@0+ (1,0) [0|3] "" ADAS
 SG_ DET_CONFD_ELEVATION_264 : 459|2@0+ (1,0) [0|3] "" ADAS
 SG_ DET_MH_SCAN_INDEX_4LSB_261_264 : 483|4@0+ (1,0) [0|15] "" ADAS
 SG_ DET_MH_CYCLE_COUNTER_261_264 : 495|8@0+ (1,0) [0|255] "" ADAS
 SG_ DET_MH_CRC16_261_264 : 503|16@0+ (1,0) [0|65535] "" ADAS

BO_ 1218 RDR_DETECTION_265_268: 64 RDR08
 SG_ DET_RANGE_265 : 7|15@0+ (0.015625,0) [0|500] "m" ADAS
 SG_ DET_RANGE_ERR_265 : 8|7@0+ (0.0075,0) [0|0.9525] "m" ADAS
 SG_ DET_RANGE_VELOCITY_265 : 17|15@0+ (0.0078125,-128) [-128|127.9921875] "m/s" ADAS
 SG_ DET_RANGE_VELOCITY_ERR_265 : 34|8@0+ (0.003,0) [0|0.765] "m/s" ADAS
 SG_ DET_AZIMUTH_265 : 60|13@0+ (0.0004,-1.5708) [-1.5708|1.5708] "rad" ADAS
 SG_ DET_AZIMUTH_ERR_265 : 78|7@0+ (0.00087267,0) [0|0.11082909] "rad" ADAS
 SG_ DET_ELEVATION_265 : 42|8@0+ (0.00275,-0.34925) [-0.34925|0.34925] "rad" ADAS
 SG_ DET_ELEVATION_ERR_265 : 50|6@0+ (0.00174533,0) [0|0.10995579] "rad" ADAS
 SG_ DET_RCS_265 : 119|8@0+ (0.5,-64) [-64|63.5] "dBsm" ADAS
 SG_ DET_VALID_FLAG_265 : 80|1@0+ (1,0) [0|1] "" ADAS
 SG_ DET_BI_STATIC_FLAG_265 : 487|1@0+ (1,0) [0|1] "" ADAS
 SG_ DET_SUPER_RES_TARGET_265 : 79|1@0+ (1,0) [0|1] "" ADAS
 SG_ DET_SNR_265 : 111|8@0+ (0.35156,0) [0|89.6478] "dB" ADAS
 SG_ DET_POINT_TARGET_PROB_265 : 86|4@0+ (6.67,0) [0|100] "%" ADAS
 SG_ DET_EXISTENCE_PROB_265 : 95|6@0+ (1.588,0) [0|100] "%" ADAS
 SG_ DET_OUTSIDE_SECTOR_265 : 103|1@0+ (1,0) [0|1] "" ADAS
 SG_ DET_HVC_FLAG_265 : 87|1@0+ (1,0) [0|1] "" ADAS
 SG_ DET_CONFD_AZIMUTH_265 : 89|2@0+ (1,0) [0|3] "" ADAS
 SG_ DET_CONFD_ELEVATION_265 : 82|2@0+ (1,0) [0|3] "" ADAS
 SG_ DET_RANGE_266 : 127|15@0+ (0.015625,0) [0|500] "m" ADAS
 SG_ DET_RANGE_ERR_266 : 128|7@0+ (0.0075,0) [0|0.9525] "m" ADAS
 SG_ DET_RANGE_VELOCITY_266 : 137|15@0+ (0.0078125,-128) [-128|127.9921875] "m/s" ADAS
 SG_ DET_RANGE_VELOCITY_ERR_266 : 154|8@0+ (0.003,0) [0|0.765] "m/s" ADAS
 SG_ DET_AZIMUTH_266 : 180|13@0+ (0.0004,-1.5708) [-1.5708|1.5708] "rad" ADAS
 SG_ DET_AZIMUTH_ERR_266 : 198|7@0+ (0.00087267,0) [0|0.11082909] "rad" ADAS
 SG_ DET_ELEVATION_266 : 162|8@0+ (0.00275,-0.34925) [-0.34925|0.34925] "rad" ADAS
 SG_ DET_ELEVATION_ERR_266 : 170|6@0+ (0.00174533,0) [0|0.10995579] "rad" ADAS
 SG_ DET_RCS_266 : 239|8@0+ (0.5,-64) [-64|63.5] "dBsm" ADAS
 SG_ DET_VALID_FLAG_266 : 220|1@0+ (1,0) [0|1] "" ADAS
 SG_ DET_BI_STATIC_FLAG_266 : 486|1@0+ (1,0) [0|1] "" ADAS
 SG_ DET_SUPER_RES_TARGET_266 : 199|1@0+ (1,0) [0|1] "" ADAS
 SG_ DET_SNR_266 : 231|8@0+ (0.35156,0) [0|89.6478] "dB" ADAS
 SG_ DET_POINT_TARGET_PROB_266 : 215|4@0+ (6.67,0) [0|100] "%" ADAS
 SG_ DET_EXISTENCE_PROB_266 : 211|6@0+ (1.588,0) [0|100] "%" ADAS
 SG_ DET_OUTSIDE_SECTOR_266 : 221|1@0+ (1,0) [0|1] "" ADAS
 SG_ DET_HVC_FLAG_266 : 207|1@0+ (1,0) [0|1] "" ADAS
 SG_ DET_CONFD_AZIMUTH_266 : 217|2@0+ (1,0) [0|3] "" ADAS
 SG_ DET_CONFD_ELEVATION_266 : 219|2@0+ (1,0) [0|3] "" ADAS
 SG_ DET_RANGE_267 : 247|15@0+ (0.015625,0) [0|500] "m" ADAS
 SG_ DET_RANGE_ERR_267 : 248|7@0+ (0.0075,0) [0|0.9525] "m" ADAS
 SG_ DET_RANGE_VELOCITY_267 : 257|15@0+ (0.0078125,-128) [-128|127.9921875] "m/s" ADAS
 SG_ DET_RANGE_VELOCITY_ERR_267 : 274|8@0+ (0.003,0) [0|0.765] "m/s" ADAS
 SG_ DET_AZIMUTH_267 : 300|13@0+ (0.0004,-1.5708) [-1.5708|1.5708] "rad" ADAS
 SG_ DET_AZIMUTH_ERR_267 : 318|7@0+ (0.00087267,0) [0|0.11082909] "rad" ADAS
 SG_ DET_ELEVATION_267 : 282|8@0+ (0.00275,-0.34925) [-0.34925|0.34925] "rad" ADAS
 SG_ DET_ELEVATION_ERR_267 : 290|6@0+ (0.00174533,0) [0|0.10995579] "rad" ADAS
 SG_ DET_RCS_267 : 359|8@0+ (0.5,-64) [-64|63.5] "dBsm" ADAS
 SG_ DET_VALID_FLAG_267 : 340|1@0+ (1,0) [0|1] "" ADAS
 SG_ DET_BI_STATIC_FLAG_267 : 485|1@0+ (1,0) [0|1] "" ADAS
 SG_ DET_SUPER_RES_TARGET_267 : 319|1@0+ (1,0) [0|1] "" ADAS
 SG_ DET_SNR_267 : 351|8@0+ (0.35156,0) [0|89.6478] "dB" ADAS
 SG_ DET_POINT_TARGET_PROB_267 : 335|4@0+ (6.67,0) [0|100] "%" ADAS
 SG_ DET_EXISTENCE_PROB_267 : 331|6@0+ (1.588,0) [0|100] "%" ADAS
 SG_ DET_OUTSIDE_SECTOR_267 : 341|1@0+ (1,0) [0|1] "" ADAS
 SG_ DET_HVC_FLAG_267 : 327|1@0+ (1,0) [0|1] "" ADAS
 SG_ DET_CONFD_AZIMUTH_267 : 337|2@0+ (1,0) [0|3] "" ADAS
 SG_ DET_CONFD_ELEVATION_267 : 339|2@0+ (1,0) [0|3] "" ADAS
 SG_ DET_RANGE_268 : 367|15@0+ (0.015625,0) [0|500] "m" ADAS
 SG_ DET_RANGE_ERR_268 : 368|7@0+ (0.0075,0) [0|0.9525] "m" ADAS
 SG_ DET_RANGE_VELOCITY_268 : 377|15@0+ (0.0078125,-128) [-128|127.9921875] "m/s" ADAS
 SG_ DET_RANGE_VELOCITY_ERR_268 : 394|8@0+ (0.003,0) [0|0.765] "m/s" ADAS
 SG_ DET_AZIMUTH_268 : 420|13@0+ (0.0004,-1.5708) [-1.5708|1.5708] "rad" ADAS
 SG_ DET_AZIMUTH_ERR_268 : 438|7@0+ (0.00087267,0) [0|0.11082909] "rad" ADAS
 SG_ DET_ELEVATION_268 : 402|8@0+ (0.00275,-0.34925) [-0.34925|0.34925] "rad" ADAS
 SG_ DET_ELEVATION_ERR_268 : 410|6@0+ (0.00174533,0) [0|0.10995579] "rad" ADAS
 SG_ DET_RCS_268 : 479|8@0+ (0.5,-64) [-64|63.5] "dBsm" ADAS
 SG_ DET_VALID_FLAG_268 : 460|1@0+ (1,0) [0|1] "" ADAS
 SG_ DET_BI_STATIC_FLAG_268 : 484|1@0+ (1,0) [0|1] "" ADAS
 SG_ DET_SUPER_RES_TARGET_268 : 439|1@0+ (1,0) [0|1] "" ADAS
 SG_ DET_SNR_268 : 471|8@0+ (0.35156,0) [0|89.6478] "dB" ADAS
 SG_ DET_POINT_TARGET_PROB_268 : 455|4@0+ (6.67,0) [0|100] "%" ADAS
 SG_ DET_EXISTENCE_PROB_268 : 451|6@0+ (1.588,0) [0|100] "%" ADAS
 SG_ DET_OUTSIDE_SECTOR_268 : 461|1@0+ (1,0) [0|1] "" ADAS
 SG_ DET_HVC_FLAG_268 : 447|1@0+ (1,0) [0|1] "" ADAS
 SG_ DET_CONFD_AZIMUTH_268 : 457|2@0+ (1,0) [0|3] "" ADAS
 SG_ DET_CONFD_ELEVATION_268 : 459|2@0+ (1,0) [0|3] "" ADAS
 SG_ DET_MH_SCAN_INDEX_4LSB_265_268 : 483|4@0+ (1,0) [0|15] "" ADAS
 SG_ DET_MH_CYCLE_COUNTER_265_268 : 495|8@0+ (1,0) [0|255] "" ADAS
 SG_ DET_MH_CRC16_265_268 : 503|16@0+ (1,0) [0|65535] "" ADAS

BO_ 1219 RDR_DETECTION_269_272: 64 RDR08
 SG_ DET_RANGE_269 : 7|15@0+ (0.015625,0) [0|500] "m" ADAS
 SG_ DET_RANGE_ERR_269 : 8|7@0+ (0.0075,0) [0|0.9525] "m" ADAS
 SG_ DET_RANGE_VELOCITY_269 : 17|15@0+ (0.0078125,-128) [-128|127.9921875] "m/s" ADAS
 SG_ DET_RANGE_VELOCITY_ERR_269 : 34|8@0+ (0.003,0) [0|0.765] "m/s" ADAS
 SG_ DET_AZIMUTH_269 : 60|13@0+ (0.0004,-1.5708) [-1.5708|1.5708] "rad" ADAS
 SG_ DET_AZIMUTH_ERR_269 : 78|7@0+ (0.00087267,0) [0|0.11082909] "rad" ADAS
 SG_ DET_ELEVATION_269 : 42|8@0+ (0.00275,-0.34925) [-0.34925|0.34925] "rad" ADAS
 SG_ DET_ELEVATION_ERR_269 : 50|6@0+ (0.00174533,0) [0|0.10995579] "rad" ADAS
 SG_ DET_RCS_269 : 119|8@0+ (0.5,-64) [-64|63.5] "dBsm" ADAS
 SG_ DET_VALID_FLAG_269 : 80|1@0+ (1,0) [0|1] "" ADAS
 SG_ DET_BI_STATIC_FLAG_269 : 487|1@0+ (1,0) [0|1] "" ADAS
 SG_ DET_SUPER_RES_TARGET_269 : 79|1@0+ (1,0) [0|1] "" ADAS
 SG_ DET_SNR_269 : 111|8@0+ (0.35156,0) [0|89.6478] "dB" ADAS
 SG_ DET_POINT_TARGET_PROB_269 : 86|4@0+ (6.67,0) [0|100] "%" ADAS
 SG_ DET_EXISTENCE_PROB_269 : 95|6@0+ (1.588,0) [0|100] "%" ADAS
 SG_ DET_OUTSIDE_SECTOR_269 : 103|1@0+ (1,0) [0|1] "" ADAS
 SG_ DET_HVC_FLAG_269 : 87|1@0+ (1,0) [0|1] "" ADAS
 SG_ DET_CONFD_AZIMUTH_269 : 89|2@0+ (1,0) [0|3] "" ADAS
 SG_ DET_CONFD_ELEVATION_269 : 82|2@0+ (1,0) [0|3] "" ADAS
 SG_ DET_RANGE_270 : 127|15@0+ (0.015625,0) [0|500] "m" ADAS
 SG_ DET_RANGE_ERR_270 : 128|7@0+ (0.0075,0) [0|0.9525] "m" ADAS
 SG_ DET_RANGE_VELOCITY_270 : 137|15@0+ (0.0078125,-128) [-128|127.9921875] "m/s" ADAS
 SG_ DET_RANGE_VELOCITY_ERR_270 : 154|8@0+ (0.003,0) [0|0.765] "m/s" ADAS
 SG_ DET_AZIMUTH_270 : 180|13@0+ (0.0004,-1.5708) [-1.5708|1.5708] "rad" ADAS
 SG_ DET_AZIMUTH_ERR_270 : 198|7@0+ (0.00087267,0) [0|0.11082909] "rad" ADAS
 SG_ DET_ELEVATION_270 : 162|8@0+ (0.00275,-0.34925) [-0.34925|0.34925] "rad" ADAS
 SG_ DET_ELEVATION_ERR_270 : 170|6@0+ (0.00174533,0) [0|0.10995579] "rad" ADAS
 SG_ DET_RCS_270 : 239|8@0+ (0.5,-64) [-64|63.5] "dBsm" ADAS
 SG_ DET_VALID_FLAG_270 : 220|1@0+ (1,0) [0|1] "" ADAS
 SG_ DET_BI_STATIC_FLAG_270 : 486|1@0+ (1,0) [0|1] "" ADAS
 SG_ DET_SUPER_RES_TARGET_270 : 199|1@0+ (1,0) [0|1] "" ADAS
 SG_ DET_SNR_270 : 231|8@0+ (0.35156,0) [0|89.6478] "dB" ADAS
 SG_ DET_POINT_TARGET_PROB_270 : 215|4@0+ (6.67,0) [0|100] "%" ADAS
 SG_ DET_EXISTENCE_PROB_270 : 211|6@0+ (1.588,0) [0|100] "%" ADAS
 SG_ DET_OUTSIDE_SECTOR_270 : 221|1@0+ (1,0) [0|1] "" ADAS
 SG_ DET_HVC_FLAG_270 : 207|1@0+ (1,0) [0|1] "" ADAS
 SG_ DET_CONFD_AZIMUTH_270 : 217|2@0+ (1,0) [0|3] "" ADAS
 SG_ DET_CONFD_ELEVATION_270 : 219|2@0+ (1,0) [0|3] "" ADAS
 SG_ DET_RANGE_271 : 247|15@0+ (0.015625,0) [0|500] "m" ADAS
 SG_ DET_RANGE_ERR_271 : 248|7@0+ (0.0075,0) [0|0.9525] "m" ADAS
 SG_ DET_RANGE_VELOCITY_271 : 257|15@0+ (0.0078125,-128) [-128|127.9921875] "m/s" ADAS
 SG_ DET_RANGE_VELOCITY_ERR_271 : 274|8@0+ (0.003,0) [0|0.765] "m/s" ADAS
 SG_ DET_AZIMUTH_271 : 300|13@0+ (0.0004,-1.5708) [-1.5708|1.5708] "rad" ADAS
 SG_ DET_AZIMUTH_ERR_271 : 318|7@0+ (0.00087267,0) [0|0.11082909] "rad" ADAS
 SG_ DET_ELEVATION_271 : 282|8@0+ (0.00275,-0.34925) [-0.34925|0.34925] "rad" ADAS
 SG_ DET_ELEVATION_ERR_271 : 290|6@0+ (0.00174533,0) [0|0.10995579] "rad" ADAS
 SG_ DET_RCS_271 : 359|8@0+ (0.5,-64) [-64|63.5] "dBsm" ADAS
 SG_ DET_VALID_FLAG_271 : 340|1@0+ (1,0) [0|1] "" ADAS
 SG_ DET_BI_STATIC_FLAG_271 : 485|1@0+ (1,0) [0|1] "" ADAS
 SG_ DET_SUPER_RES_TARGET_271 : 319|1@0+ (1,0) [0|1] "" ADAS
 SG_ DET_SNR_271 : 351|8@0+ (0.35156,0) [0|89.6478] "dB" ADAS
 SG_ DET_POINT_TARGET_PROB_271 : 335|4@0+ (6.67,0) [0|100] "%" ADAS
 SG_ DET_EXISTENCE_PROB_271 : 331|6@0+ (1.588,0) [0|100] "%" ADAS
 SG_ DET_OUTSIDE_SECTOR_271 : 341|1@0+ (1,0) [0|1] "" ADAS
 SG_ DET_HVC_FLAG_271 : 327|1@0+ (1,0) [0|1] "" ADAS
 SG_ DET_CONFD_AZIMUTH_271 : 337|2@0+ (1,0) [0|3] "" ADAS
 SG_ DET_CONFD_ELEVATION_271 : 339|2@0+ (1,0) [0|3] "" ADAS
 SG_ DET_RANGE_272 : 367|15@0+ (0.015625,0) [0|500] "m" ADAS
 SG_ DET_RANGE_ERR_272 : 368|7@0+ (0.0075,0) [0|0.9525] "m" ADAS
 SG_ DET_RANGE_VELOCITY_272 : 377|15@0+ (0.0078125,-128) [-128|127.9921875] "m/s" ADAS
 SG_ DET_RANGE_VELOCITY_ERR_272 : 394|8@0+ (0.003,0) [0|0.765] "m/s" ADAS
 SG_ DET_AZIMUTH_272 : 420|13@0+ (0.0004,-1.5708) [-1.5708|1.5708] "rad" ADAS
 SG_ DET_AZIMUTH_ERR_272 : 438|7@0+ (0.00087267,0) [0|0.11082909] "rad" ADAS
 SG_ DET_ELEVATION_272 : 402|8@0+ (0.00275,-0.34925) [-0.34925|0.34925] "rad" ADAS
 SG_ DET_ELEVATION_ERR_272 : 410|6@0+ (0.00174533,0) [0|0.10995579] "rad" ADAS
 SG_ DET_RCS_272 : 479|8@0+ (0.5,-64) [-64|63.5] "dBsm" ADAS
 SG_ DET_VALID_FLAG_272 : 460|1@0+ (1,0) [0|1] "" ADAS
 SG_ DET_BI_STATIC_FLAG_272 : 484|1@0+ (1,0) [0|1] "" ADAS
 SG_ DET_SUPER_RES_TARGET_272 : 439|1@0+ (1,0) [0|1] "" ADAS
 SG_ DET_SNR_272 : 471|8@0+ (0.35156,0) [0|89.6478] "dB" ADAS
 SG_ DET_POINT_TARGET_PROB_272 : 455|4@0+ (6.67,0) [0|100] "%" ADAS
 SG_ DET_EXISTENCE_PROB_272 : 451|6@0+ (1.588,0) [0|100] "%" ADAS
 SG_ DET_OUTSIDE_SECTOR_272 : 461|1@0+ (1,0) [0|1] "" ADAS
 SG_ DET_HVC_FLAG_272 : 447|1@0+ (1,0) [0|1] "" ADAS
 SG_ DET_CONFD_AZIMUTH_272 : 457|2@0+ (1,0) [0|3] "" ADAS
 SG_ DET_CONFD_ELEVATION_272 : 459|2@0+ (1,0) [0|3] "" ADAS
 SG_ DET_MH_SCAN_INDEX_4LSB_269_272 : 483|4@0+ (1,0) [0|15] "" ADAS
 SG_ DET_MH_CYCLE_COUNTER_269_272 : 495|8@0+ (1,0) [0|255] "" ADAS
 SG_ DET_MH_CRC16_269_272 : 503|16@0+ (1,0) [0|65535] "" ADAS

BO_ 1220 RDR_DETECTION_273_276: 64 RDR08
 SG_ DET_RANGE_273 : 7|15@0+ (0.015625,0) [0|500] "m" ADAS
 SG_ DET_RANGE_ERR_273 : 8|7@0+ (0.0075,0) [0|0.9525] "m" ADAS
 SG_ DET_RANGE_VELOCITY_273 : 17|15@0+ (0.0078125,-128) [-128|127.9921875] "m/s" ADAS
 SG_ DET_RANGE_VELOCITY_ERR_273 : 34|8@0+ (0.003,0) [0|0.765] "m/s" ADAS
 SG_ DET_AZIMUTH_273 : 60|13@0+ (0.0004,-1.5708) [-1.5708|1.5708] "rad" ADAS
 SG_ DET_AZIMUTH_ERR_273 : 78|7@0+ (0.00087267,0) [0|0.11082909] "rad" ADAS
 SG_ DET_ELEVATION_273 : 42|8@0+ (0.00275,-0.34925) [-0.34925|0.34925] "rad" ADAS
 SG_ DET_ELEVATION_ERR_273 : 50|6@0+ (0.00174533,0) [0|0.10995579] "rad" ADAS
 SG_ DET_RCS_273 : 119|8@0+ (0.5,-64) [-64|63.5] "dBsm" ADAS
 SG_ DET_VALID_FLAG_273 : 80|1@0+ (1,0) [0|1] "" ADAS
 SG_ DET_BI_STATIC_FLAG_273 : 487|1@0+ (1,0) [0|1] "" ADAS
 SG_ DET_SUPER_RES_TARGET_273 : 79|1@0+ (1,0) [0|1] "" ADAS
 SG_ DET_SNR_273 : 111|8@0+ (0.35156,0) [0|89.6478] "dB" ADAS
 SG_ DET_POINT_TARGET_PROB_273 : 86|4@0+ (6.67,0) [0|100] "%" ADAS
 SG_ DET_EXISTENCE_PROB_273 : 95|6@0+ (1.588,0) [0|100] "%" ADAS
 SG_ DET_OUTSIDE_SECTOR_273 : 103|1@0+ (1,0) [0|1] "" ADAS
 SG_ DET_HVC_FLAG_273 : 87|1@0+ (1,0) [0|1] "" ADAS
 SG_ DET_CONFD_AZIMUTH_273 : 89|2@0+ (1,0) [0|3] "" ADAS
 SG_ DET_CONFD_ELEVATION_273 : 82|2@0+ (1,0) [0|3] "" ADAS
 SG_ DET_RANGE_274 : 127|15@0+ (0.015625,0) [0|500] "m" ADAS
 SG_ DET_RANGE_ERR_274 : 128|7@0+ (0.0075,0) [0|0.9525] "m" ADAS
 SG_ DET_RANGE_VELOCITY_274 : 137|15@0+ (0.0078125,-128) [-128|127.9921875] "m/s" ADAS
 SG_ DET_RANGE_VELOCITY_ERR_274 : 154|8@0+ (0.003,0) [0|0.765] "m/s" ADAS
 SG_ DET_AZIMUTH_274 : 180|13@0+ (0.0004,-1.5708) [-1.5708|1.5708] "rad" ADAS
 SG_ DET_AZIMUTH_ERR_274 : 198|7@0+ (0.00087267,0) [0|0.11082909] "rad" ADAS
 SG_ DET_ELEVATION_274 : 162|8@0+ (0.00275,-0.34925) [-0.34925|0.34925] "rad" ADAS
 SG_ DET_ELEVATION_ERR_274 : 170|6@0+ (0.00174533,0) [0|0.10995579] "rad" ADAS
 SG_ DET_RCS_274 : 239|8@0+ (0.5,-64) [-64|63.5] "dBsm" ADAS
 SG_ DET_VALID_FLAG_274 : 220|1@0+ (1,0) [0|1] "" ADAS
 SG_ DET_BI_STATIC_FLAG_274 : 486|1@0+ (1,0) [0|1] "" ADAS
 SG_ DET_SUPER_RES_TARGET_274 : 199|1@0+ (1,0) [0|1] "" ADAS
 SG_ DET_SNR_274 : 231|8@0+ (0.35156,0) [0|89.6478] "dB" ADAS
 SG_ DET_POINT_TARGET_PROB_274 : 215|4@0+ (6.67,0) [0|100] "%" ADAS
 SG_ DET_EXISTENCE_PROB_274 : 211|6@0+ (1.588,0) [0|100] "%" ADAS
 SG_ DET_OUTSIDE_SECTOR_274 : 221|1@0+ (1,0) [0|1] "" ADAS
 SG_ DET_HVC_FLAG_274 : 207|1@0+ (1,0) [0|1] "" ADAS
 SG_ DET_CONFD_AZIMUTH_274 : 217|2@0+ (1,0) [0|3] "" ADAS
 SG_ DET_CONFD_ELEVATION_274 : 219|2@0+ (1,0) [0|3] "" ADAS
 SG_ DET_RANGE_275 : 247|15@0+ (0.015625,0) [0|500] "m" ADAS
 SG_ DET_RANGE_ERR_275 : 248|7@0+ (0.0075,0) [0|0.9525] "m" ADAS
 SG_ DET_RANGE_VELOCITY_275 : 257|15@0+ (0.0078125,-128) [-128|127.9921875] "m/s" ADAS
 SG_ DET_RANGE_VELOCITY_ERR_275 : 274|8@0+ (0.003,0) [0|0.765] "m/s" ADAS
 SG_ DET_AZIMUTH_275 : 300|13@0+ (0.0004,-1.5708) [-1.5708|1.5708] "rad" ADAS
 SG_ DET_AZIMUTH_ERR_275 : 318|7@0+ (0.00087267,0) [0|0.11082909] "rad" ADAS
 SG_ DET_ELEVATION_275 : 282|8@0+ (0.00275,-0.34925) [-0.34925|0.34925] "rad" ADAS
 SG_ DET_ELEVATION_ERR_275 : 290|6@0+ (0.00174533,0) [0|0.10995579] "rad" ADAS
 SG_ DET_RCS_275 : 359|8@0+ (0.5,-64) [-64|63.5] "dBsm" ADAS
 SG_ DET_VALID_FLAG_275 : 340|1@0+ (1,0) [0|1] "" ADAS
 SG_ DET_BI_STATIC_FLAG_275 : 485|1@0+ (1,0) [0|1] "" ADAS
 SG_ DET_SUPER_RES_TARGET_275 : 319|1@0+ (1,0) [0|1] "" ADAS
 SG_ DET_SNR_275 : 351|8@0+ (0.35156,0) [0|89.6478] "dB" ADAS
 SG_ DET_POINT_TARGET_PROB_275 : 335|4@0+ (6.67,0) [0|100] "%" ADAS
 SG_ DET_EXISTENCE_PROB_275 : 331|6@0+ (1.588,0) [0|100] "%" ADAS
 SG_ DET_OUTSIDE_SECTOR_275 : 341|1@0+ (1,0) [0|1] "" ADAS
 SG_ DET_HVC_FLAG_275 : 327|1@0+ (1,0) [0|1] "" ADAS
 SG_ DET_CONFD_AZIMUTH_275 : 337|2@0+ (1,0) [0|3] "" ADAS
 SG_ DET_CONFD_ELEVATION_275 : 339|2@0+ (1,0) [0|3] "" ADAS
 SG_ DET_RANGE_276 : 367|15@0+ (0.015625,0) [0|500] "m" ADAS
 SG_ DET_RANGE_ERR_276 : 368|7@0+ (0.0075,0) [0|0.9525] "m" ADAS
 SG_ DET_RANGE_VELOCITY_276 : 377|15@0+ (0.0078125,-128) [-128|127.9921875] "m/s" ADAS
 SG_ DET_RANGE_VELOCITY_ERR_276 : 394|8@0+ (0.003,0) [0|0.765] "m/s" ADAS
 SG_ DET_AZIMUTH_276 : 420|13@0+ (0.0004,-1.5708) [-1.5708|1.5708] "rad" ADAS
 SG_ DET_AZIMUTH_ERR_276 : 438|7@0+ (0.00087267,0) [0|0.11082909] "rad" ADAS
 SG_ DET_ELEVATION_276 : 402|8@0+ (0.00275,-0.34925) [-0.34925|0.34925] "rad" ADAS
 SG_ DET_ELEVATION_ERR_276 : 410|6@0+ (0.00174533,0) [0|0.10995579] "rad" ADAS
 SG_ DET_RCS_276 : 479|8@0+ (0.5,-64) [-64|63.5] "dBsm" ADAS
 SG_ DET_VALID_FLAG_276 : 460|1@0+ (1,0) [0|1] "" ADAS
 SG_ DET_BI_STATIC_FLAG_276 : 484|1@0+ (1,0) [0|1] "" ADAS
 SG_ DET_SUPER_RES_TARGET_276 : 439|1@0+ (1,0) [0|1] "" ADAS
 SG_ DET_SNR_276 : 471|8@0+ (0.35156,0) [0|89.6478] "dB" ADAS
 SG_ DET_POINT_TARGET_PROB_276 : 455|4@0+ (6.67,0) [0|100] "%" ADAS
 SG_ DET_EXISTENCE_PROB_276 : 451|6@0+ (1.588,0) [0|100] "%" ADAS
 SG_ DET_OUTSIDE_SECTOR_276 : 461|1@0+ (1,0) [0|1] "" ADAS
 SG_ DET_HVC_FLAG_276 : 447|1@0+ (1,0) [0|1] "" ADAS
 SG_ DET_CONFD_AZIMUTH_276 : 457|2@0+ (1,0) [0|3] "" ADAS
 SG_ DET_CONFD_ELEVATION_276 : 459|2@0+ (1,0) [0|3] "" ADAS
 SG_ DET_MH_SCAN_INDEX_4LSB_273_276 : 483|4@0+ (1,0) [0|15] "" ADAS
 SG_ DET_MH_CYCLE_COUNTER_273_276 : 495|8@0+ (1,0) [0|255] "" ADAS
 SG_ DET_MH_CRC16_273_276 : 503|16@0+ (1,0) [0|65535] "" ADAS

BO_ 1221 RDR_DETECTION_277_280: 64 RDR08
 SG_ DET_RANGE_277 : 7|15@0+ (0.015625,0) [0|500] "m" ADAS
 SG_ DET_RANGE_ERR_277 : 8|7@0+ (0.0075,0) [0|0.9525] "m" ADAS
 SG_ DET_RANGE_VELOCITY_277 : 17|15@0+ (0.0078125,-128) [-128|127.9921875] "m/s" ADAS
 SG_ DET_RANGE_VELOCITY_ERR_277 : 34|8@0+ (0.003,0) [0|0.765] "m/s" ADAS
 SG_ DET_AZIMUTH_277 : 60|13@0+ (0.0004,-1.5708) [-1.5708|1.5708] "rad" ADAS
 SG_ DET_AZIMUTH_ERR_277 : 78|7@0+ (0.00087267,0) [0|0.11082909] "rad" ADAS
 SG_ DET_ELEVATION_277 : 42|8@0+ (0.00275,-0.34925) [-0.34925|0.34925] "rad" ADAS
 SG_ DET_ELEVATION_ERR_277 : 50|6@0+ (0.00174533,0) [0|0.10995579] "rad" ADAS
 SG_ DET_RCS_277 : 119|8@0+ (0.5,-64) [-64|63.5] "dBsm" ADAS
 SG_ DET_VALID_FLAG_277 : 80|1@0+ (1,0) [0|1] "" ADAS
 SG_ DET_BI_STATIC_FLAG_277 : 487|1@0+ (1,0) [0|1] "" ADAS
 SG_ DET_SUPER_RES_TARGET_277 : 79|1@0+ (1,0) [0|1] "" ADAS
 SG_ DET_SNR_277 : 111|8@0+ (0.35156,0) [0|89.6478] "dB" ADAS
 SG_ DET_POINT_TARGET_PROB_277 : 86|4@0+ (6.67,0) [0|100] "%" ADAS
 SG_ DET_EXISTENCE_PROB_277 : 95|6@0+ (1.588,0) [0|100] "%" ADAS
 SG_ DET_OUTSIDE_SECTOR_277 : 103|1@0+ (1,0) [0|1] "" ADAS
 SG_ DET_HVC_FLAG_277 : 87|1@0+ (1,0) [0|1] "" ADAS
 SG_ DET_CONFD_AZIMUTH_277 : 89|2@0+ (1,0) [0|3] "" ADAS
 SG_ DET_CONFD_ELEVATION_277 : 82|2@0+ (1,0) [0|3] "" ADAS
 SG_ DET_RANGE_278 : 127|15@0+ (0.015625,0) [0|500] "m" ADAS
 SG_ DET_RANGE_ERR_278 : 128|7@0+ (0.0075,0) [0|0.9525] "m" ADAS
 SG_ DET_RANGE_VELOCITY_278 : 137|15@0+ (0.0078125,-128) [-128|127.9921875] "m/s" ADAS
 SG_ DET_RANGE_VELOCITY_ERR_278 : 154|8@0+ (0.003,0) [0|0.765] "m/s" ADAS
 SG_ DET_AZIMUTH_278 : 180|13@0+ (0.0004,-1.5708) [-1.5708|1.5708] "rad" ADAS
 SG_ DET_AZIMUTH_ERR_278 : 198|7@0+ (0.00087267,0) [0|0.11082909] "rad" ADAS
 SG_ DET_ELEVATION_278 : 162|8@0+ (0.00275,-0.34925) [-0.34925|0.34925] "rad" ADAS
 SG_ DET_ELEVATION_ERR_278 : 170|6@0+ (0.00174533,0) [0|0.10995579] "rad" ADAS
 SG_ DET_RCS_278 : 239|8@0+ (0.5,-64) [-64|63.5] "dBsm" ADAS
 SG_ DET_VALID_FLAG_278 : 220|1@0+ (1,0) [0|1] "" ADAS
 SG_ DET_BI_STATIC_FLAG_278 : 486|1@0+ (1,0) [0|1] "" ADAS
 SG_ DET_SUPER_RES_TARGET_278 : 199|1@0+ (1,0) [0|1] "" ADAS
 SG_ DET_SNR_278 : 231|8@0+ (0.35156,0) [0|89.6478] "dB" ADAS
 SG_ DET_POINT_TARGET_PROB_278 : 215|4@0+ (6.67,0) [0|100] "%" ADAS
 SG_ DET_EXISTENCE_PROB_278 : 211|6@0+ (1.588,0) [0|100] "%" ADAS
 SG_ DET_OUTSIDE_SECTOR_278 : 221|1@0+ (1,0) [0|1] "" ADAS
 SG_ DET_HVC_FLAG_278 : 207|1@0+ (1,0) [0|1] "" ADAS
 SG_ DET_CONFD_AZIMUTH_278 : 217|2@0+ (1,0) [0|3] "" ADAS
 SG_ DET_CONFD_ELEVATION_278 : 219|2@0+ (1,0) [0|3] "" ADAS
 SG_ DET_RANGE_279 : 247|15@0+ (0.015625,0) [0|500] "m" ADAS
 SG_ DET_RANGE_ERR_279 : 248|7@0+ (0.0075,0) [0|0.9525] "m" ADAS
 SG_ DET_RANGE_VELOCITY_279 : 257|15@0+ (0.0078125,-128) [-128|127.9921875] "m/s" ADAS
 SG_ DET_RANGE_VELOCITY_ERR_279 : 274|8@0+ (0.003,0) [0|0.765] "m/s" ADAS
 SG_ DET_AZIMUTH_279 : 300|13@0+ (0.0004,-1.5708) [-1.5708|1.5708] "rad" ADAS
 SG_ DET_AZIMUTH_ERR_279 : 318|7@0+ (0.00087267,0) [0|0.11082909] "rad" ADAS
 SG_ DET_ELEVATION_279 : 282|8@0+ (0.00275,-0.34925) [-0.34925|0.34925] "rad" ADAS
 SG_ DET_ELEVATION_ERR_279 : 290|6@0+ (0.00174533,0) [0|0.10995579] "rad" ADAS
 SG_ DET_RCS_279 : 359|8@0+ (0.5,-64) [-64|63.5] "dBsm" ADAS
 SG_ DET_VALID_FLAG_279 : 340|1@0+ (1,0) [0|1] "" ADAS
 SG_ DET_BI_STATIC_FLAG_279 : 485|1@0+ (1,0) [0|1] "" ADAS
 SG_ DET_SUPER_RES_TARGET_279 : 319|1@0+ (1,0) [0|1] "" ADAS
 SG_ DET_SNR_279 : 351|8@0+ (0.35156,0) [0|89.6478] "dB" ADAS
 SG_ DET_POINT_TARGET_PROB_279 : 335|4@0+ (6.67,0) [0|100] "%" ADAS
 SG_ DET_EXISTENCE_PROB_279 : 331|6@0+ (1.588,0) [0|100] "%" ADAS
 SG_ DET_OUTSIDE_SECTOR_279 : 341|1@0+ (1,0) [0|1] "" ADAS
 SG_ DET_HVC_FLAG_279 : 327|1@0+ (1,0) [0|1] "" ADAS
 SG_ DET_CONFD_AZIMUTH_279 : 337|2@0+ (1,0) [0|3] "" ADAS
 SG_ DET_CONFD_ELEVATION_279 : 339|2@0+ (1,0) [0|3] "" ADAS
 SG_ DET_RANGE_280 : 367|15@0+ (0.015625,0) [0|500] "m" ADAS
 SG_ DET_RANGE_ERR_280 : 368|7@0+ (0.0075,0) [0|0.9525] "m" ADAS
 SG_ DET_RANGE_VELOCITY_280 : 377|15@0+ (0.0078125,-128) [-128|127.9921875] "m/s" ADAS
 SG_ DET_RANGE_VELOCITY_ERR_280 : 394|8@0+ (0.003,0) [0|0.765] "m/s" ADAS
 SG_ DET_AZIMUTH_280 : 420|13@0+ (0.0004,-1.5708) [-1.5708|1.5708] "rad" ADAS
 SG_ DET_AZIMUTH_ERR_280 : 438|7@0+ (0.00087267,0) [0|0.11082909] "rad" ADAS
 SG_ DET_ELEVATION_280 : 402|8@0+ (0.00275,-0.34925) [-0.34925|0.34925] "rad" ADAS
 SG_ DET_ELEVATION_ERR_280 : 410|6@0+ (0.00174533,0) [0|0.10995579] "rad" ADAS
 SG_ DET_RCS_280 : 479|8@0+ (0.5,-64) [-64|63.5] "dBsm" ADAS
 SG_ DET_VALID_FLAG_280 : 460|1@0+ (1,0) [0|1] "" ADAS
 SG_ DET_BI_STATIC_FLAG_280 : 484|1@0+ (1,0) [0|1] "" ADAS
 SG_ DET_SUPER_RES_TARGET_280 : 439|1@0+ (1,0) [0|1] "" ADAS
 SG_ DET_SNR_280 : 471|8@0+ (0.35156,0) [0|89.6478] "dB" ADAS
 SG_ DET_POINT_TARGET_PROB_280 : 455|4@0+ (6.67,0) [0|100] "%" ADAS
 SG_ DET_EXISTENCE_PROB_280 : 451|6@0+ (1.588,0) [0|100] "%" ADAS
 SG_ DET_OUTSIDE_SECTOR_280 : 461|1@0+ (1,0) [0|1] "" ADAS
 SG_ DET_HVC_FLAG_280 : 447|1@0+ (1,0) [0|1] "" ADAS
 SG_ DET_CONFD_AZIMUTH_280 : 457|2@0+ (1,0) [0|3] "" ADAS
 SG_ DET_CONFD_ELEVATION_280 : 459|2@0+ (1,0) [0|3] "" ADAS
 SG_ DET_MH_SCAN_INDEX_4LSB_277_280 : 483|4@0+ (1,0) [0|15] "" ADAS
 SG_ DET_MH_CYCLE_COUNTER_277_280 : 495|8@0+ (1,0) [0|255] "" ADAS
 SG_ DET_MH_CRC16_277_280 : 503|16@0+ (1,0) [0|65535] "" ADAS

BO_ 1222 RDR_DETECTION_281_284: 64 RDR08
 SG_ DET_RANGE_281 : 7|15@0+ (0.015625,0) [0|500] "m" ADAS
 SG_ DET_RANGE_ERR_281 : 8|7@0+ (0.0075,0) [0|0.9525] "m" ADAS
 SG_ DET_RANGE_VELOCITY_281 : 17|15@0+ (0.0078125,-128) [-128|127.9921875] "m/s" ADAS
 SG_ DET_RANGE_VELOCITY_ERR_281 : 34|8@0+ (0.003,0) [0|0.765] "m/s" ADAS
 SG_ DET_AZIMUTH_281 : 60|13@0+ (0.0004,-1.5708) [-1.5708|1.5708] "rad" ADAS
 SG_ DET_AZIMUTH_ERR_281 : 78|7@0+ (0.00087267,0) [0|0.11082909] "rad" ADAS
 SG_ DET_ELEVATION_281 : 42|8@0+ (0.00275,-0.34925) [-0.34925|0.34925] "rad" ADAS
 SG_ DET_ELEVATION_ERR_281 : 50|6@0+ (0.00174533,0) [0|0.10995579] "rad" ADAS
 SG_ DET_RCS_281 : 119|8@0+ (0.5,-64) [-64|63.5] "dBsm" ADAS
 SG_ DET_VALID_FLAG_281 : 80|1@0+ (1,0) [0|1] "" ADAS
 SG_ DET_BI_STATIC_FLAG_281 : 487|1@0+ (1,0) [0|1] "" ADAS
 SG_ DET_SUPER_RES_TARGET_281 : 79|1@0+ (1,0) [0|1] "" ADAS
 SG_ DET_SNR_281 : 111|8@0+ (0.35156,0) [0|89.6478] "dB" ADAS
 SG_ DET_POINT_TARGET_PROB_281 : 86|4@0+ (6.67,0) [0|100] "%" ADAS
 SG_ DET_EXISTENCE_PROB_281 : 95|6@0+ (1.588,0) [0|100] "%" ADAS
 SG_ DET_OUTSIDE_SECTOR_281 : 103|1@0+ (1,0) [0|1] "" ADAS
 SG_ DET_HVC_FLAG_281 : 87|1@0+ (1,0) [0|1] "" ADAS
 SG_ DET_CONFD_AZIMUTH_281 : 89|2@0+ (1,0) [0|3] "" ADAS
 SG_ DET_CONFD_ELEVATION_281 : 82|2@0+ (1,0) [0|3] "" ADAS
 SG_ DET_RANGE_282 : 127|15@0+ (0.015625,0) [0|500] "m" ADAS
 SG_ DET_RANGE_ERR_282 : 128|7@0+ (0.0075,0) [0|0.9525] "m" ADAS
 SG_ DET_RANGE_VELOCITY_282 : 137|15@0+ (0.0078125,-128) [-128|127.9921875] "m/s" ADAS
 SG_ DET_RANGE_VELOCITY_ERR_282 : 154|8@0+ (0.003,0) [0|0.765] "m/s" ADAS
 SG_ DET_AZIMUTH_282 : 180|13@0+ (0.0004,-1.5708) [-1.5708|1.5708] "rad" ADAS
 SG_ DET_AZIMUTH_ERR_282 : 198|7@0+ (0.00087267,0) [0|0.11082909] "rad" ADAS
 SG_ DET_ELEVATION_282 : 162|8@0+ (0.00275,-0.34925) [-0.34925|0.34925] "rad" ADAS
 SG_ DET_ELEVATION_ERR_282 : 170|6@0+ (0.00174533,0) [0|0.10995579] "rad" ADAS
 SG_ DET_RCS_282 : 239|8@0+ (0.5,-64) [-64|63.5] "dBsm" ADAS
 SG_ DET_VALID_FLAG_282 : 220|1@0+ (1,0) [0|1] "" ADAS
 SG_ DET_BI_STATIC_FLAG_282 : 486|1@0+ (1,0) [0|1] "" ADAS
 SG_ DET_SUPER_RES_TARGET_282 : 199|1@0+ (1,0) [0|1] "" ADAS
 SG_ DET_SNR_282 : 231|8@0+ (0.35156,0) [0|89.6478] "dB" ADAS
 SG_ DET_POINT_TARGET_PROB_282 : 215|4@0+ (6.67,0) [0|100] "%" ADAS
 SG_ DET_EXISTENCE_PROB_282 : 211|6@0+ (1.588,0) [0|100] "%" ADAS
 SG_ DET_OUTSIDE_SECTOR_282 : 221|1@0+ (1,0) [0|1] "" ADAS
 SG_ DET_HVC_FLAG_282 : 207|1@0+ (1,0) [0|1] "" ADAS
 SG_ DET_CONFD_AZIMUTH_282 : 217|2@0+ (1,0) [0|3] "" ADAS
 SG_ DET_CONFD_ELEVATION_282 : 219|2@0+ (1,0) [0|3] "" ADAS
 SG_ DET_RANGE_283 : 247|15@0+ (0.015625,0) [0|500] "m" ADAS
 SG_ DET_RANGE_ERR_283 : 248|7@0+ (0.0075,0) [0|0.9525] "m" ADAS
 SG_ DET_RANGE_VELOCITY_283 : 257|15@0+ (0.0078125,-128) [-128|127.9921875] "m/s" ADAS
 SG_ DET_RANGE_VELOCITY_ERR_283 : 274|8@0+ (0.003,0) [0|0.765] "m/s" ADAS
 SG_ DET_AZIMUTH_283 : 300|13@0+ (0.0004,-1.5708) [-1.5708|1.5708] "rad" ADAS
 SG_ DET_AZIMUTH_ERR_283 : 318|7@0+ (0.00087267,0) [0|0.11082909] "rad" ADAS
 SG_ DET_ELEVATION_283 : 282|8@0+ (0.00275,-0.34925) [-0.34925|0.34925] "rad" ADAS
 SG_ DET_ELEVATION_ERR_283 : 290|6@0+ (0.00174533,0) [0|0.10995579] "rad" ADAS
 SG_ DET_RCS_283 : 359|8@0+ (0.5,-64) [-64|63.5] "dBsm" ADAS
 SG_ DET_VALID_FLAG_283 : 340|1@0+ (1,0) [0|1] "" ADAS
 SG_ DET_BI_STATIC_FLAG_283 : 485|1@0+ (1,0) [0|1] "" ADAS
 SG_ DET_SUPER_RES_TARGET_283 : 319|1@0+ (1,0) [0|1] "" ADAS
 SG_ DET_SNR_283 : 351|8@0+ (0.35156,0) [0|89.6478] "dB" ADAS
 SG_ DET_POINT_TARGET_PROB_283 : 335|4@0+ (6.67,0) [0|100] "%" ADAS
 SG_ DET_EXISTENCE_PROB_283 : 331|6@0+ (1.588,0) [0|100] "%" ADAS
 SG_ DET_OUTSIDE_SECTOR_283 : 341|1@0+ (1,0) [0|1] "" ADAS
 SG_ DET_HVC_FLAG_283 : 327|1@0+ (1,0) [0|1] "" ADAS
 SG_ DET_CONFD_AZIMUTH_283 : 337|2@0+ (1,0) [0|3] "" ADAS
 SG_ DET_CONFD_ELEVATION_283 : 339|2@0+ (1,0) [0|3] "" ADAS
 SG_ DET_RANGE_284 : 367|15@0+ (0.015625,0) [0|500] "m" ADAS
 SG_ DET_RANGE_ERR_284 : 368|7@0+ (0.0075,0) [0|0.9525] "m" ADAS
 SG_ DET_RANGE_VELOCITY_284 : 377|15@0+ (0.0078125,-128) [-128|127.9921875] "m/s" ADAS
 SG_ DET_RANGE_VELOCITY_ERR_284 : 394|8@0+ (0.003,0) [0|0.765] "m/s" ADAS
 SG_ DET_AZIMUTH_284 : 420|13@0+ (0.0004,-1.5708) [-1.5708|1.5708] "rad" ADAS
 SG_ DET_AZIMUTH_ERR_284 : 438|7@0+ (0.00087267,0) [0|0.11082909] "rad" ADAS
 SG_ DET_ELEVATION_284 : 402|8@0+ (0.00275,-0.34925) [-0.34925|0.34925] "rad" ADAS
 SG_ DET_ELEVATION_ERR_284 : 410|6@0+ (0.00174533,0) [0|0.10995579] "rad" ADAS
 SG_ DET_RCS_284 : 479|8@0+ (0.5,-64) [-64|63.5] "dBsm" ADAS
 SG_ DET_VALID_FLAG_284 : 460|1@0+ (1,0) [0|1] "" ADAS
 SG_ DET_BI_STATIC_FLAG_284 : 484|1@0+ (1,0) [0|1] "" ADAS
 SG_ DET_SUPER_RES_TARGET_284 : 439|1@0+ (1,0) [0|1] "" ADAS
 SG_ DET_SNR_284 : 471|8@0+ (0.35156,0) [0|89.6478] "dB" ADAS
 SG_ DET_POINT_TARGET_PROB_284 : 455|4@0+ (6.67,0) [0|100] "%" ADAS
 SG_ DET_EXISTENCE_PROB_284 : 451|6@0+ (1.588,0) [0|100] "%" ADAS
 SG_ DET_OUTSIDE_SECTOR_284 : 461|1@0+ (1,0) [0|1] "" ADAS
 SG_ DET_HVC_FLAG_284 : 447|1@0+ (1,0) [0|1] "" ADAS
 SG_ DET_CONFD_AZIMUTH_284 : 457|2@0+ (1,0) [0|3] "" ADAS
 SG_ DET_CONFD_ELEVATION_284 : 459|2@0+ (1,0) [0|3] "" ADAS
 SG_ DET_MH_SCAN_INDEX_4LSB_281_284 : 483|4@0+ (1,0) [0|15] "" ADAS
 SG_ DET_MH_CYCLE_COUNTER_281_284 : 495|8@0+ (1,0) [0|255] "" ADAS
 SG_ DET_MH_CRC16_281_284 : 503|16@0+ (1,0) [0|65535] "" ADAS

BO_ 1223 RDR_DETECTION_285_288: 64 RDR08
 SG_ DET_RANGE_285 : 7|15@0+ (0.015625,0) [0|500] "m" ADAS
 SG_ DET_RANGE_ERR_285 : 8|7@0+ (0.0075,0) [0|0.9525] "m" ADAS
 SG_ DET_RANGE_VELOCITY_285 : 17|15@0+ (0.0078125,-128) [-128|127.9921875] "m/s" ADAS
 SG_ DET_RANGE_VELOCITY_ERR_285 : 34|8@0+ (0.003,0) [0|0.765] "m/s" ADAS
 SG_ DET_AZIMUTH_285 : 60|13@0+ (0.0004,-1.5708) [-1.5708|1.5708] "rad" ADAS
 SG_ DET_AZIMUTH_ERR_285 : 78|7@0+ (0.00087267,0) [0|0.11082909] "rad" ADAS
 SG_ DET_ELEVATION_285 : 42|8@0+ (0.00275,-0.34925) [-0.34925|0.34925] "rad" ADAS
 SG_ DET_ELEVATION_ERR_285 : 50|6@0+ (0.00174533,0) [0|0.10995579] "rad" ADAS
 SG_ DET_RCS_285 : 119|8@0+ (0.5,-64) [-64|63.5] "dBsm" ADAS
 SG_ DET_VALID_FLAG_285 : 80|1@0+ (1,0) [0|1] "" ADAS
 SG_ DET_BI_STATIC_FLAG_285 : 487|1@0+ (1,0) [0|1] "" ADAS
 SG_ DET_SUPER_RES_TARGET_285 : 79|1@0+ (1,0) [0|1] "" ADAS
 SG_ DET_SNR_285 : 111|8@0+ (0.35156,0) [0|89.6478] "dB" ADAS
 SG_ DET_POINT_TARGET_PROB_285 : 86|4@0+ (6.67,0) [0|100] "%" ADAS
 SG_ DET_EXISTENCE_PROB_285 : 95|6@0+ (1.588,0) [0|100] "%" ADAS
 SG_ DET_OUTSIDE_SECTOR_285 : 103|1@0+ (1,0) [0|1] "" ADAS
 SG_ DET_HVC_FLAG_285 : 87|1@0+ (1,0) [0|1] "" ADAS
 SG_ DET_CONFD_AZIMUTH_285 : 89|2@0+ (1,0) [0|3] "" ADAS
 SG_ DET_CONFD_ELEVATION_285 : 82|2@0+ (1,0) [0|3] "" ADAS
 SG_ DET_RANGE_286 : 127|15@0+ (0.015625,0) [0|500] "m" ADAS
 SG_ DET_RANGE_ERR_286 : 128|7@0+ (0.0075,0) [0|0.9525] "m" ADAS
 SG_ DET_RANGE_VELOCITY_286 : 137|15@0+ (0.0078125,-128) [-128|127.9921875] "m/s" ADAS
 SG_ DET_RANGE_VELOCITY_ERR_286 : 154|8@0+ (0.003,0) [0|0.765] "m/s" ADAS
 SG_ DET_AZIMUTH_286 : 180|13@0+ (0.0004,-1.5708) [-1.5708|1.5708] "rad" ADAS
 SG_ DET_AZIMUTH_ERR_286 : 198|7@0+ (0.00087267,0) [0|0.11082909] "rad" ADAS
 SG_ DET_ELEVATION_286 : 162|8@0+ (0.00275,-0.34925) [-0.34925|0.34925] "rad" ADAS
 SG_ DET_ELEVATION_ERR_286 : 170|6@0+ (0.00174533,0) [0|0.10995579] "rad" ADAS
 SG_ DET_RCS_286 : 239|8@0+ (0.5,-64) [-64|63.5] "dBsm" ADAS
 SG_ DET_VALID_FLAG_286 : 220|1@0+ (1,0) [0|1] "" ADAS
 SG_ DET_BI_STATIC_FLAG_286 : 486|1@0+ (1,0) [0|1] "" ADAS
 SG_ DET_SUPER_RES_TARGET_286 : 199|1@0+ (1,0) [0|1] "" ADAS
 SG_ DET_SNR_286 : 231|8@0+ (0.35156,0) [0|89.6478] "dB" ADAS
 SG_ DET_POINT_TARGET_PROB_286 : 215|4@0+ (6.67,0) [0|100] "%" ADAS
 SG_ DET_EXISTENCE_PROB_286 : 211|6@0+ (1.588,0) [0|100] "%" ADAS
 SG_ DET_OUTSIDE_SECTOR_286 : 221|1@0+ (1,0) [0|1] "" ADAS
 SG_ DET_HVC_FLAG_286 : 207|1@0+ (1,0) [0|1] "" ADAS
 SG_ DET_CONFD_AZIMUTH_286 : 217|2@0+ (1,0) [0|3] "" ADAS
 SG_ DET_CONFD_ELEVATION_286 : 219|2@0+ (1,0) [0|3] "" ADAS
 SG_ DET_RANGE_287 : 247|15@0+ (0.015625,0) [0|500] "m" ADAS
 SG_ DET_RANGE_ERR_287 : 248|7@0+ (0.0075,0) [0|0.9525] "m" ADAS
 SG_ DET_RANGE_VELOCITY_287 : 257|15@0+ (0.0078125,-128) [-128|127.9921875] "m/s" ADAS
 SG_ DET_RANGE_VELOCITY_ERR_287 : 274|8@0+ (0.003,0) [0|0.765] "m/s" ADAS
 SG_ DET_AZIMUTH_287 : 300|13@0+ (0.0004,-1.5708) [-1.5708|1.5708] "rad" ADAS
 SG_ DET_AZIMUTH_ERR_287 : 318|7@0+ (0.00087267,0) [0|0.11082909] "rad" ADAS
 SG_ DET_ELEVATION_287 : 282|8@0+ (0.00275,-0.34925) [-0.34925|0.34925] "rad" ADAS
 SG_ DET_ELEVATION_ERR_287 : 290|6@0+ (0.00174533,0) [0|0.10995579] "rad" ADAS
 SG_ DET_RCS_287 : 359|8@0+ (0.5,-64) [-64|63.5] "dBsm" ADAS
 SG_ DET_VALID_FLAG_287 : 340|1@0+ (1,0) [0|1] "" ADAS
 SG_ DET_BI_STATIC_FLAG_287 : 485|1@0+ (1,0) [0|1] "" ADAS
 SG_ DET_SUPER_RES_TARGET_287 : 319|1@0+ (1,0) [0|1] "" ADAS
 SG_ DET_SNR_287 : 351|8@0+ (0.35156,0) [0|89.6478] "dB" ADAS
 SG_ DET_POINT_TARGET_PROB_287 : 335|4@0+ (6.67,0) [0|100] "%" ADAS
 SG_ DET_EXISTENCE_PROB_287 : 331|6@0+ (1.588,0) [0|100] "%" ADAS
 SG_ DET_OUTSIDE_SECTOR_287 : 341|1@0+ (1,0) [0|1] "" ADAS
 SG_ DET_HVC_FLAG_287 : 327|1@0+ (1,0) [0|1] "" ADAS
 SG_ DET_CONFD_AZIMUTH_287 : 337|2@0+ (1,0) [0|3] "" ADAS
 SG_ DET_CONFD_ELEVATION_287 : 339|2@0+ (1,0) [0|3] "" ADAS
 SG_ DET_RANGE_288 : 367|15@0+ (0.015625,0) [0|500] "m" ADAS
 SG_ DET_RANGE_ERR_288 : 368|7@0+ (0.0075,0) [0|0.9525] "m" ADAS
 SG_ DET_RANGE_VELOCITY_288 : 377|15@0+ (0.0078125,-128) [-128|127.9921875] "m/s" ADAS
 SG_ DET_RANGE_VELOCITY_ERR_288 : 394|8@0+ (0.003,0) [0|0.765] "m/s" ADAS
 SG_ DET_AZIMUTH_288 : 420|13@0+ (0.0004,-1.5708) [-1.5708|1.5708] "rad" ADAS
 SG_ DET_AZIMUTH_ERR_288 : 438|7@0+ (0.00087267,0) [0|0.11082909] "rad" ADAS
 SG_ DET_ELEVATION_288 : 402|8@0+ (0.00275,-0.34925) [-0.34925|0.34925] "rad" ADAS
 SG_ DET_ELEVATION_ERR_288 : 410|6@0+ (0.00174533,0) [0|0.10995579] "rad" ADAS
 SG_ DET_RCS_288 : 479|8@0+ (0.5,-64) [-64|63.5] "dBsm" ADAS
 SG_ DET_VALID_FLAG_288 : 460|1@0+ (1,0) [0|1] "" ADAS
 SG_ DET_BI_STATIC_FLAG_288 : 484|1@0+ (1,0) [0|1] "" ADAS
 SG_ DET_SUPER_RES_TARGET_288 : 439|1@0+ (1,0) [0|1] "" ADAS
 SG_ DET_SNR_288 : 471|8@0+ (0.35156,0) [0|89.6478] "dB" ADAS
 SG_ DET_POINT_TARGET_PROB_288 : 455|4@0+ (6.67,0) [0|100] "%" ADAS
 SG_ DET_EXISTENCE_PROB_288 : 451|6@0+ (1.588,0) [0|100] "%" ADAS
 SG_ DET_OUTSIDE_SECTOR_288 : 461|1@0+ (1,0) [0|1] "" ADAS
 SG_ DET_HVC_FLAG_288 : 447|1@0+ (1,0) [0|1] "" ADAS
 SG_ DET_CONFD_AZIMUTH_288 : 457|2@0+ (1,0) [0|3] "" ADAS
 SG_ DET_CONFD_ELEVATION_288 : 459|2@0+ (1,0) [0|3] "" ADAS
 SG_ DET_MH_SCAN_INDEX_4LSB_285_288 : 483|4@0+ (1,0) [0|15] "" ADAS
 SG_ DET_MH_CYCLE_COUNTER_285_288 : 495|8@0+ (1,0) [0|255] "" ADAS
 SG_ DET_MH_CRC16_285_288 : 503|16@0+ (1,0) [0|65535] "" ADAS

BO_ 1224 RDR_DETECTION_289_292: 64 RDR08
 SG_ DET_RANGE_289 : 7|15@0+ (0.015625,0) [0|500] "m" ADAS
 SG_ DET_RANGE_ERR_289 : 8|7@0+ (0.0075,0) [0|0.9525] "m" ADAS
 SG_ DET_RANGE_VELOCITY_289 : 17|15@0+ (0.0078125,-128) [-128|127.9921875] "m/s" ADAS
 SG_ DET_RANGE_VELOCITY_ERR_289 : 34|8@0+ (0.003,0) [0|0.765] "m/s" ADAS
 SG_ DET_AZIMUTH_289 : 60|13@0+ (0.0004,-1.5708) [-1.5708|1.5708] "rad" ADAS
 SG_ DET_AZIMUTH_ERR_289 : 78|7@0+ (0.00087267,0) [0|0.11082909] "rad" ADAS
 SG_ DET_ELEVATION_289 : 42|8@0+ (0.00275,-0.34925) [-0.34925|0.34925] "rad" ADAS
 SG_ DET_ELEVATION_ERR_289 : 50|6@0+ (0.00174533,0) [0|0.10995579] "rad" ADAS
 SG_ DET_RCS_289 : 119|8@0+ (0.5,-64) [-64|63.5] "dBsm" ADAS
 SG_ DET_VALID_FLAG_289 : 80|1@0+ (1,0) [0|1] "" ADAS
 SG_ DET_BI_STATIC_FLAG_289 : 487|1@0+ (1,0) [0|1] "" ADAS
 SG_ DET_SUPER_RES_TARGET_289 : 79|1@0+ (1,0) [0|1] "" ADAS
 SG_ DET_SNR_289 : 111|8@0+ (0.35156,0) [0|89.6478] "dB" ADAS
 SG_ DET_POINT_TARGET_PROB_289 : 86|4@0+ (6.67,0) [0|100] "%" ADAS
 SG_ DET_EXISTENCE_PROB_289 : 95|6@0+ (1.588,0) [0|100] "%" ADAS
 SG_ DET_OUTSIDE_SECTOR_289 : 103|1@0+ (1,0) [0|1] "" ADAS
 SG_ DET_HVC_FLAG_289 : 87|1@0+ (1,0) [0|1] "" ADAS
 SG_ DET_CONFD_AZIMUTH_289 : 89|2@0+ (1,0) [0|3] "" ADAS
 SG_ DET_CONFD_ELEVATION_289 : 82|2@0+ (1,0) [0|3] "" ADAS
 SG_ DET_RANGE_290 : 127|15@0+ (0.015625,0) [0|500] "m" ADAS
 SG_ DET_RANGE_ERR_290 : 128|7@0+ (0.0075,0) [0|0.9525] "m" ADAS
 SG_ DET_RANGE_VELOCITY_290 : 137|15@0+ (0.0078125,-128) [-128|127.9921875] "m/s" ADAS
 SG_ DET_RANGE_VELOCITY_ERR_290 : 154|8@0+ (0.003,0) [0|0.765] "m/s" ADAS
 SG_ DET_AZIMUTH_290 : 180|13@0+ (0.0004,-1.5708) [-1.5708|1.5708] "rad" ADAS
 SG_ DET_AZIMUTH_ERR_290 : 198|7@0+ (0.00087267,0) [0|0.11082909] "rad" ADAS
 SG_ DET_ELEVATION_290 : 162|8@0+ (0.00275,-0.34925) [-0.34925|0.34925] "rad" ADAS
 SG_ DET_ELEVATION_ERR_290 : 170|6@0+ (0.00174533,0) [0|0.10995579] "rad" ADAS
 SG_ DET_RCS_290 : 239|8@0+ (0.5,-64) [-64|63.5] "dBsm" ADAS
 SG_ DET_VALID_FLAG_290 : 220|1@0+ (1,0) [0|1] "" ADAS
 SG_ DET_BI_STATIC_FLAG_290 : 486|1@0+ (1,0) [0|1] "" ADAS
 SG_ DET_SUPER_RES_TARGET_290 : 199|1@0+ (1,0) [0|1] "" ADAS
 SG_ DET_SNR_290 : 231|8@0+ (0.35156,0) [0|89.6478] "dB" ADAS
 SG_ DET_POINT_TARGET_PROB_290 : 215|4@0+ (6.67,0) [0|100] "%" ADAS
 SG_ DET_EXISTENCE_PROB_290 : 211|6@0+ (1.588,0) [0|100] "%" ADAS
 SG_ DET_OUTSIDE_SECTOR_290 : 221|1@0+ (1,0) [0|1] "" ADAS
 SG_ DET_HVC_FLAG_290 : 207|1@0+ (1,0) [0|1] "" ADAS
 SG_ DET_CONFD_AZIMUTH_290 : 217|2@0+ (1,0) [0|3] "" ADAS
 SG_ DET_CONFD_ELEVATION_290 : 219|2@0+ (1,0) [0|3] "" ADAS
 SG_ DET_RANGE_291 : 247|15@0+ (0.015625,0) [0|500] "m" ADAS
 SG_ DET_RANGE_ERR_291 : 248|7@0+ (0.0075,0) [0|0.9525] "m" ADAS
 SG_ DET_RANGE_VELOCITY_291 : 257|15@0+ (0.0078125,-128) [-128|127.9921875] "m/s" ADAS
 SG_ DET_RANGE_VELOCITY_ERR_291 : 274|8@0+ (0.003,0) [0|0.765] "m/s" ADAS
 SG_ DET_AZIMUTH_291 : 300|13@0+ (0.0004,-1.5708) [-1.5708|1.5708] "rad" ADAS
 SG_ DET_AZIMUTH_ERR_291 : 318|7@0+ (0.00087267,0) [0|0.11082909] "rad" ADAS
 SG_ DET_ELEVATION_291 : 282|8@0+ (0.00275,-0.34925) [-0.34925|0.34925] "rad" ADAS
 SG_ DET_ELEVATION_ERR_291 : 290|6@0+ (0.00174533,0) [0|0.10995579] "rad" ADAS
 SG_ DET_RCS_291 : 359|8@0+ (0.5,-64) [-64|63.5] "dBsm" ADAS
 SG_ DET_VALID_FLAG_291 : 340|1@0+ (1,0) [0|1] "" ADAS
 SG_ DET_BI_STATIC_FLAG_291 : 485|1@0+ (1,0) [0|1] "" ADAS
 SG_ DET_SUPER_RES_TARGET_291 : 319|1@0+ (1,0) [0|1] "" ADAS
 SG_ DET_SNR_291 : 351|8@0+ (0.35156,0) [0|89.6478] "dB" ADAS
 SG_ DET_POINT_TARGET_PROB_291 : 335|4@0+ (6.67,0) [0|100] "%" ADAS
 SG_ DET_EXISTENCE_PROB_291 : 331|6@0+ (1.588,0) [0|100] "%" ADAS
 SG_ DET_OUTSIDE_SECTOR_291 : 341|1@0+ (1,0) [0|1] "" ADAS
 SG_ DET_HVC_FLAG_291 : 327|1@0+ (1,0) [0|1] "" ADAS
 SG_ DET_CONFD_AZIMUTH_291 : 337|2@0+ (1,0) [0|3] "" ADAS
 SG_ DET_CONFD_ELEVATION_291 : 339|2@0+ (1,0) [0|3] "" ADAS
 SG_ DET_RANGE_292 : 367|15@0+ (0.015625,0) [0|500] "m" ADAS
 SG_ DET_RANGE_ERR_292 : 368|7@0+ (0.0075,0) [0|0.9525] "m" ADAS
 SG_ DET_RANGE_VELOCITY_292 : 377|15@0+ (0.0078125,-128) [-128|127.9921875] "m/s" ADAS
 SG_ DET_RANGE_VELOCITY_ERR_292 : 394|8@0+ (0.003,0) [0|0.765] "m/s" ADAS
 SG_ DET_AZIMUTH_292 : 420|13@0+ (0.0004,-1.5708) [-1.5708|1.5708] "rad" ADAS
 SG_ DET_AZIMUTH_ERR_292 : 438|7@0+ (0.00087267,0) [0|0.11082909] "rad" ADAS
 SG_ DET_ELEVATION_292 : 402|8@0+ (0.00275,-0.34925) [-0.34925|0.34925] "rad" ADAS
 SG_ DET_ELEVATION_ERR_292 : 410|6@0+ (0.00174533,0) [0|0.10995579] "rad" ADAS
 SG_ DET_RCS_292 : 479|8@0+ (0.5,-64) [-64|63.5] "dBsm" ADAS
 SG_ DET_VALID_FLAG_292 : 460|1@0+ (1,0) [0|1] "" ADAS
 SG_ DET_BI_STATIC_FLAG_292 : 484|1@0+ (1,0) [0|1] "" ADAS
 SG_ DET_SUPER_RES_TARGET_292 : 439|1@0+ (1,0) [0|1] "" ADAS
 SG_ DET_SNR_292 : 471|8@0+ (0.35156,0) [0|89.6478] "dB" ADAS
 SG_ DET_POINT_TARGET_PROB_292 : 455|4@0+ (6.67,0) [0|100] "%" ADAS
 SG_ DET_EXISTENCE_PROB_292 : 451|6@0+ (1.588,0) [0|100] "%" ADAS
 SG_ DET_OUTSIDE_SECTOR_292 : 461|1@0+ (1,0) [0|1] "" ADAS
 SG_ DET_HVC_FLAG_292 : 447|1@0+ (1,0) [0|1] "" ADAS
 SG_ DET_CONFD_AZIMUTH_292 : 457|2@0+ (1,0) [0|3] "" ADAS
 SG_ DET_CONFD_ELEVATION_292 : 459|2@0+ (1,0) [0|3] "" ADAS
 SG_ DET_MH_SCAN_INDEX_4LSB_289_292 : 483|4@0+ (1,0) [0|15] "" ADAS
 SG_ DET_MH_CYCLE_COUNTER_289_292 : 495|8@0+ (1,0) [0|255] "" ADAS
 SG_ DET_MH_CRC16_289_292 : 503|16@0+ (1,0) [0|65535] "" ADAS

BO_ 1225 RDR_DETECTION_293_296: 64 RDR08
 SG_ DET_RANGE_293 : 7|15@0+ (0.015625,0) [0|500] "m" ADAS
 SG_ DET_RANGE_ERR_293 : 8|7@0+ (0.0075,0) [0|0.9525] "m" ADAS
 SG_ DET_RANGE_VELOCITY_293 : 17|15@0+ (0.0078125,-128) [-128|127.9921875] "m/s" ADAS
 SG_ DET_RANGE_VELOCITY_ERR_293 : 34|8@0+ (0.003,0) [0|0.765] "m/s" ADAS
 SG_ DET_AZIMUTH_293 : 60|13@0+ (0.0004,-1.5708) [-1.5708|1.5708] "rad" ADAS
 SG_ DET_AZIMUTH_ERR_293 : 78|7@0+ (0.00087267,0) [0|0.11082909] "rad" ADAS
 SG_ DET_ELEVATION_293 : 42|8@0+ (0.00275,-0.34925) [-0.34925|0.34925] "rad" ADAS
 SG_ DET_ELEVATION_ERR_293 : 50|6@0+ (0.00174533,0) [0|0.10995579] "rad" ADAS
 SG_ DET_RCS_293 : 119|8@0+ (0.5,-64) [-64|63.5] "dBsm" ADAS
 SG_ DET_VALID_FLAG_293 : 80|1@0+ (1,0) [0|1] "" ADAS
 SG_ DET_BI_STATIC_FLAG_293 : 487|1@0+ (1,0) [0|1] "" ADAS
 SG_ DET_SUPER_RES_TARGET_293 : 79|1@0+ (1,0) [0|1] "" ADAS
 SG_ DET_SNR_293 : 111|8@0+ (0.35156,0) [0|89.6478] "dB" ADAS
 SG_ DET_POINT_TARGET_PROB_293 : 86|4@0+ (6.67,0) [0|100] "%" ADAS
 SG_ DET_EXISTENCE_PROB_293 : 95|6@0+ (1.588,0) [0|100] "%" ADAS
 SG_ DET_OUTSIDE_SECTOR_293 : 103|1@0+ (1,0) [0|1] "" ADAS
 SG_ DET_HVC_FLAG_293 : 87|1@0+ (1,0) [0|1] "" ADAS
 SG_ DET_CONFD_AZIMUTH_293 : 89|2@0+ (1,0) [0|3] "" ADAS
 SG_ DET_CONFD_ELEVATION_293 : 82|2@0+ (1,0) [0|3] "" ADAS
 SG_ DET_RANGE_294 : 127|15@0+ (0.015625,0) [0|500] "m" ADAS
 SG_ DET_RANGE_ERR_294 : 128|7@0+ (0.0075,0) [0|0.9525] "m" ADAS
 SG_ DET_RANGE_VELOCITY_294 : 137|15@0+ (0.0078125,-128) [-128|127.9921875] "m/s" ADAS
 SG_ DET_RANGE_VELOCITY_ERR_294 : 154|8@0+ (0.003,0) [0|0.765] "m/s" ADAS
 SG_ DET_AZIMUTH_294 : 180|13@0+ (0.0004,-1.5708) [-1.5708|1.5708] "rad" ADAS
 SG_ DET_AZIMUTH_ERR_294 : 198|7@0+ (0.00087267,0) [0|0.11082909] "rad" ADAS
 SG_ DET_ELEVATION_294 : 162|8@0+ (0.00275,-0.34925) [-0.34925|0.34925] "rad" ADAS
 SG_ DET_ELEVATION_ERR_294 : 170|6@0+ (0.00174533,0) [0|0.10995579] "rad" ADAS
 SG_ DET_RCS_294 : 239|8@0+ (0.5,-64) [-64|63.5] "dBsm" ADAS
 SG_ DET_VALID_FLAG_294 : 220|1@0+ (1,0) [0|1] "" ADAS
 SG_ DET_BI_STATIC_FLAG_294 : 486|1@0+ (1,0) [0|1] "" ADAS
 SG_ DET_SUPER_RES_TARGET_294 : 199|1@0+ (1,0) [0|1] "" ADAS
 SG_ DET_SNR_294 : 231|8@0+ (0.35156,0) [0|89.6478] "dB" ADAS
 SG_ DET_POINT_TARGET_PROB_294 : 215|4@0+ (6.67,0) [0|100] "%" ADAS
 SG_ DET_EXISTENCE_PROB_294 : 211|6@0+ (1.588,0) [0|100] "%" ADAS
 SG_ DET_OUTSIDE_SECTOR_294 : 221|1@0+ (1,0) [0|1] "" ADAS
 SG_ DET_HVC_FLAG_294 : 207|1@0+ (1,0) [0|1] "" ADAS
 SG_ DET_CONFD_AZIMUTH_294 : 217|2@0+ (1,0) [0|3] "" ADAS
 SG_ DET_CONFD_ELEVATION_294 : 219|2@0+ (1,0) [0|3] "" ADAS
 SG_ DET_RANGE_295 : 247|15@0+ (0.015625,0) [0|500] "m" ADAS
 SG_ DET_RANGE_ERR_295 : 248|7@0+ (0.0075,0) [0|0.9525] "m" ADAS
 SG_ DET_RANGE_VELOCITY_295 : 257|15@0+ (0.0078125,-128) [-128|127.9921875] "m/s" ADAS
 SG_ DET_RANGE_VELOCITY_ERR_295 : 274|8@0+ (0.003,0) [0|0.765] "m/s" ADAS
 SG_ DET_AZIMUTH_295 : 300|13@0+ (0.0004,-1.5708) [-1.5708|1.5708] "rad" ADAS
 SG_ DET_AZIMUTH_ERR_295 : 318|7@0+ (0.00087267,0) [0|0.11082909] "rad" ADAS
 SG_ DET_ELEVATION_295 : 282|8@0+ (0.00275,-0.34925) [-0.34925|0.34925] "rad" ADAS
 SG_ DET_ELEVATION_ERR_295 : 290|6@0+ (0.00174533,0) [0|0.10995579] "rad" ADAS
 SG_ DET_RCS_295 : 359|8@0+ (0.5,-64) [-64|63.5] "dBsm" ADAS
 SG_ DET_VALID_FLAG_295 : 340|1@0+ (1,0) [0|1] "" ADAS
 SG_ DET_BI_STATIC_FLAG_295 : 485|1@0+ (1,0) [0|1] "" ADAS
 SG_ DET_SUPER_RES_TARGET_295 : 319|1@0+ (1,0) [0|1] "" ADAS
 SG_ DET_SNR_295 : 351|8@0+ (0.35156,0) [0|89.6478] "dB" ADAS
 SG_ DET_POINT_TARGET_PROB_295 : 335|4@0+ (6.67,0) [0|100] "%" ADAS
 SG_ DET_EXISTENCE_PROB_295 : 331|6@0+ (1.588,0) [0|100] "%" ADAS
 SG_ DET_OUTSIDE_SECTOR_295 : 341|1@0+ (1,0) [0|1] "" ADAS
 SG_ DET_HVC_FLAG_295 : 327|1@0+ (1,0) [0|1] "" ADAS
 SG_ DET_CONFD_AZIMUTH_295 : 337|2@0+ (1,0) [0|3] "" ADAS
 SG_ DET_CONFD_ELEVATION_295 : 339|2@0+ (1,0) [0|3] "" ADAS
 SG_ DET_RANGE_296 : 367|15@0+ (0.015625,0) [0|500] "m" ADAS
 SG_ DET_RANGE_ERR_296 : 368|7@0+ (0.0075,0) [0|0.9525] "m" ADAS
 SG_ DET_RANGE_VELOCITY_296 : 377|15@0+ (0.0078125,-128) [-128|127.9921875] "m/s" ADAS
 SG_ DET_RANGE_VELOCITY_ERR_296 : 394|8@0+ (0.003,0) [0|0.765] "m/s" ADAS
 SG_ DET_AZIMUTH_296 : 420|13@0+ (0.0004,-1.5708) [-1.5708|1.5708] "rad" ADAS
 SG_ DET_AZIMUTH_ERR_296 : 438|7@0+ (0.00087267,0) [0|0.11082909] "rad" ADAS
 SG_ DET_ELEVATION_296 : 402|8@0+ (0.00275,-0.34925) [-0.34925|0.34925] "rad" ADAS
 SG_ DET_ELEVATION_ERR_296 : 410|6@0+ (0.00174533,0) [0|0.10995579] "rad" ADAS
 SG_ DET_RCS_296 : 479|8@0+ (0.5,-64) [-64|63.5] "dBsm" ADAS
 SG_ DET_VALID_FLAG_296 : 460|1@0+ (1,0) [0|1] "" ADAS
 SG_ DET_BI_STATIC_FLAG_296 : 484|1@0+ (1,0) [0|1] "" ADAS
 SG_ DET_SUPER_RES_TARGET_296 : 439|1@0+ (1,0) [0|1] "" ADAS
 SG_ DET_SNR_296 : 471|8@0+ (0.35156,0) [0|89.6478] "dB" ADAS
 SG_ DET_POINT_TARGET_PROB_296 : 455|4@0+ (6.67,0) [0|100] "%" ADAS
 SG_ DET_EXISTENCE_PROB_296 : 451|6@0+ (1.588,0) [0|100] "%" ADAS
 SG_ DET_OUTSIDE_SECTOR_296 : 461|1@0+ (1,0) [0|1] "" ADAS
 SG_ DET_HVC_FLAG_296 : 447|1@0+ (1,0) [0|1] "" ADAS
 SG_ DET_CONFD_AZIMUTH_296 : 457|2@0+ (1,0) [0|3] "" ADAS
 SG_ DET_CONFD_ELEVATION_296 : 459|2@0+ (1,0) [0|3] "" ADAS
 SG_ DET_MH_SCAN_INDEX_4LSB_293_296 : 483|4@0+ (1,0) [0|15] "" ADAS
 SG_ DET_MH_CYCLE_COUNTER_293_296 : 495|8@0+ (1,0) [0|255] "" ADAS
 SG_ DET_MH_CRC16_293_296 : 503|16@0+ (1,0) [0|65535] "" ADAS

BO_ 1226 RDR_DETECTION_297_300: 64 RDR08
 SG_ DET_RANGE_297 : 7|15@0+ (0.015625,0) [0|500] "m" ADAS
 SG_ DET_RANGE_ERR_297 : 8|7@0+ (0.0075,0) [0|0.9525] "m" ADAS
 SG_ DET_RANGE_VELOCITY_297 : 17|15@0+ (0.0078125,-128) [-128|127.9921875] "m/s" ADAS
 SG_ DET_RANGE_VELOCITY_ERR_297 : 34|8@0+ (0.003,0) [0|0.765] "m/s" ADAS
 SG_ DET_AZIMUTH_297 : 60|13@0+ (0.0004,-1.5708) [-1.5708|1.5708] "rad" ADAS
 SG_ DET_AZIMUTH_ERR_297 : 78|7@0+ (0.00087267,0) [0|0.11082909] "rad" ADAS
 SG_ DET_ELEVATION_297 : 42|8@0+ (0.00275,-0.34925) [-0.34925|0.34925] "rad" ADAS
 SG_ DET_ELEVATION_ERR_297 : 50|6@0+ (0.00174533,0) [0|0.10995579] "rad" ADAS
 SG_ DET_RCS_297 : 119|8@0+ (0.5,-64) [-64|63.5] "dBsm" ADAS
 SG_ DET_VALID_FLAG_297 : 80|1@0+ (1,0) [0|1] "" ADAS
 SG_ DET_BI_STATIC_FLAG_297 : 487|1@0+ (1,0) [0|1] "" ADAS
 SG_ DET_SUPER_RES_TARGET_297 : 79|1@0+ (1,0) [0|1] "" ADAS
 SG_ DET_SNR_297 : 111|8@0+ (0.35156,0) [0|89.6478] "dB" ADAS
 SG_ DET_POINT_TARGET_PROB_297 : 86|4@0+ (6.67,0) [0|100] "%" ADAS
 SG_ DET_EXISTENCE_PROB_297 : 95|6@0+ (1.588,0) [0|100] "%" ADAS
 SG_ DET_OUTSIDE_SECTOR_297 : 103|1@0+ (1,0) [0|1] "" ADAS
 SG_ DET_HVC_FLAG_297 : 87|1@0+ (1,0) [0|1] "" ADAS
 SG_ DET_CONFD_AZIMUTH_297 : 89|2@0+ (1,0) [0|3] "" ADAS
 SG_ DET_CONFD_ELEVATION_297 : 82|2@0+ (1,0) [0|3] "" ADAS
 SG_ DET_RANGE_298 : 127|15@0+ (0.015625,0) [0|500] "m" ADAS
 SG_ DET_RANGE_ERR_298 : 128|7@0+ (0.0075,0) [0|0.9525] "m" ADAS
 SG_ DET_RANGE_VELOCITY_298 : 137|15@0+ (0.0078125,-128) [-128|127.9921875] "m/s" ADAS
 SG_ DET_RANGE_VELOCITY_ERR_298 : 154|8@0+ (0.003,0) [0|0.765] "m/s" ADAS
 SG_ DET_AZIMUTH_298 : 180|13@0+ (0.0004,-1.5708) [-1.5708|1.5708] "rad" ADAS
 SG_ DET_AZIMUTH_ERR_298 : 198|7@0+ (0.00087267,0) [0|0.11082909] "rad" ADAS
 SG_ DET_ELEVATION_298 : 162|8@0+ (0.00275,-0.34925) [-0.34925|0.34925] "rad" ADAS
 SG_ DET_ELEVATION_ERR_298 : 170|6@0+ (0.00174533,0) [0|0.10995579] "rad" ADAS
 SG_ DET_RCS_298 : 239|8@0+ (0.5,-64) [-64|63.5] "dBsm" ADAS
 SG_ DET_VALID_FLAG_298 : 220|1@0+ (1,0) [0|1] "" ADAS
 SG_ DET_BI_STATIC_FLAG_298 : 486|1@0+ (1,0) [0|1] "" ADAS
 SG_ DET_SUPER_RES_TARGET_298 : 199|1@0+ (1,0) [0|1] "" ADAS
 SG_ DET_SNR_298 : 231|8@0+ (0.35156,0) [0|89.6478] "dB" ADAS
 SG_ DET_POINT_TARGET_PROB_298 : 215|4@0+ (6.67,0) [0|100] "%" ADAS
 SG_ DET_EXISTENCE_PROB_298 : 211|6@0+ (1.588,0) [0|100] "%" ADAS
 SG_ DET_OUTSIDE_SECTOR_298 : 221|1@0+ (1,0) [0|1] "" ADAS
 SG_ DET_HVC_FLAG_298 : 207|1@0+ (1,0) [0|1] "" ADAS
 SG_ DET_CONFD_AZIMUTH_298 : 217|2@0+ (1,0) [0|3] "" ADAS
 SG_ DET_CONFD_ELEVATION_298 : 219|2@0+ (1,0) [0|3] "" ADAS
 SG_ DET_RANGE_299 : 247|15@0+ (0.015625,0) [0|500] "m" ADAS
 SG_ DET_RANGE_ERR_299 : 248|7@0+ (0.0075,0) [0|0.9525] "m" ADAS
 SG_ DET_RANGE_VELOCITY_299 : 257|15@0+ (0.0078125,-128) [-128|127.9921875] "m/s" ADAS
 SG_ DET_RANGE_VELOCITY_ERR_299 : 274|8@0+ (0.003,0) [0|0.765] "m/s" ADAS
 SG_ DET_AZIMUTH_299 : 300|13@0+ (0.0004,-1.5708) [-1.5708|1.5708] "rad" ADAS
 SG_ DET_AZIMUTH_ERR_299 : 318|7@0+ (0.00087267,0) [0|0.11082909] "rad" ADAS
 SG_ DET_ELEVATION_299 : 282|8@0+ (0.00275,-0.34925) [-0.34925|0.34925] "rad" ADAS
 SG_ DET_ELEVATION_ERR_299 : 290|6@0+ (0.00174533,0) [0|0.10995579] "rad" ADAS
 SG_ DET_RCS_299 : 359|8@0+ (0.5,-64) [-64|63.5] "dBsm" ADAS
 SG_ DET_VALID_FLAG_299 : 340|1@0+ (1,0) [0|1] "" ADAS
 SG_ DET_BI_STATIC_FLAG_299 : 485|1@0+ (1,0) [0|1] "" ADAS
 SG_ DET_SUPER_RES_TARGET_299 : 319|1@0+ (1,0) [0|1] "" ADAS
 SG_ DET_SNR_299 : 351|8@0+ (0.35156,0) [0|89.6478] "dB" ADAS
 SG_ DET_POINT_TARGET_PROB_299 : 335|4@0+ (6.67,0) [0|100] "%" ADAS
 SG_ DET_EXISTENCE_PROB_299 : 331|6@0+ (1.588,0) [0|100] "%" ADAS
 SG_ DET_OUTSIDE_SECTOR_299 : 341|1@0+ (1,0) [0|1] "" ADAS
 SG_ DET_HVC_FLAG_299 : 327|1@0+ (1,0) [0|1] "" ADAS
 SG_ DET_CONFD_AZIMUTH_299 : 337|2@0+ (1,0) [0|3] "" ADAS
 SG_ DET_CONFD_ELEVATION_299 : 339|2@0+ (1,0) [0|3] "" ADAS
 SG_ DET_RANGE_300 : 367|15@0+ (0.015625,0) [0|500] "m" ADAS
 SG_ DET_RANGE_ERR_300 : 368|7@0+ (0.0075,0) [0|0.9525] "m" ADAS
 SG_ DET_RANGE_VELOCITY_300 : 377|15@0+ (0.0078125,-128) [-128|127.9921875] "m/s" ADAS
 SG_ DET_RANGE_VELOCITY_ERR_300 : 394|8@0+ (0.003,0) [0|0.765] "m/s" ADAS
 SG_ DET_AZIMUTH_300 : 420|13@0+ (0.0004,-1.5708) [-1.5708|1.5708] "rad" ADAS
 SG_ DET_AZIMUTH_ERR_300 : 438|7@0+ (0.00087267,0) [0|0.11082909] "rad" ADAS
 SG_ DET_ELEVATION_300 : 402|8@0+ (0.00275,-0.34925) [-0.34925|0.34925] "rad" ADAS
 SG_ DET_ELEVATION_ERR_300 : 410|6@0+ (0.00174533,0) [0|0.10995579] "rad" ADAS
 SG_ DET_RCS_300 : 479|8@0+ (0.5,-64) [-64|63.5] "dBsm" ADAS
 SG_ DET_VALID_FLAG_300 : 460|1@0+ (1,0) [0|1] "" ADAS
 SG_ DET_BI_STATIC_FLAG_300 : 484|1@0+ (1,0) [0|1] "" ADAS
 SG_ DET_SUPER_RES_TARGET_300 : 439|1@0+ (1,0) [0|1] "" ADAS
 SG_ DET_SNR_300 : 471|8@0+ (0.35156,0) [0|89.6478] "dB" ADAS
 SG_ DET_POINT_TARGET_PROB_300 : 455|4@0+ (6.67,0) [0|100] "%" ADAS
 SG_ DET_EXISTENCE_PROB_300 : 451|6@0+ (1.588,0) [0|100] "%" ADAS
 SG_ DET_OUTSIDE_SECTOR_300 : 461|1@0+ (1,0) [0|1] "" ADAS
 SG_ DET_HVC_FLAG_300 : 447|1@0+ (1,0) [0|1] "" ADAS
 SG_ DET_CONFD_AZIMUTH_300 : 457|2@0+ (1,0) [0|3] "" ADAS
 SG_ DET_CONFD_ELEVATION_300 : 459|2@0+ (1,0) [0|3] "" ADAS
 SG_ DET_MH_SCAN_INDEX_4LSB_297_300 : 483|4@0+ (1,0) [0|15] "" ADAS
 SG_ DET_MH_CYCLE_COUNTER_297_300 : 495|8@0+ (1,0) [0|255] "" ADAS
 SG_ DET_MH_CRC16_297_300 : 503|16@0+ (1,0) [0|65535] "" ADAS

BO_ 1227 RDR_DETECTION_301_304: 64 RDR08
 SG_ DET_RANGE_301 : 7|15@0+ (0.015625,0) [0|500] "m" ADAS
 SG_ DET_RANGE_ERR_301 : 8|7@0+ (0.0075,0) [0|0.9525] "m" ADAS
 SG_ DET_RANGE_VELOCITY_301 : 17|15@0+ (0.0078125,-128) [-128|127.9921875] "m/s" ADAS
 SG_ DET_RANGE_VELOCITY_ERR_301 : 34|8@0+ (0.003,0) [0|0.765] "m/s" ADAS
 SG_ DET_AZIMUTH_301 : 60|13@0+ (0.0004,-1.5708) [-1.5708|1.5708] "rad" ADAS
 SG_ DET_AZIMUTH_ERR_301 : 78|7@0+ (0.00087267,0) [0|0.11082909] "rad" ADAS
 SG_ DET_ELEVATION_301 : 42|8@0+ (0.00275,-0.34925) [-0.34925|0.34925] "rad" ADAS
 SG_ DET_ELEVATION_ERR_301 : 50|6@0+ (0.00174533,0) [0|0.10995579] "rad" ADAS
 SG_ DET_RCS_301 : 119|8@0+ (0.5,-64) [-64|63.5] "dBsm" ADAS
 SG_ DET_VALID_FLAG_301 : 80|1@0+ (1,0) [0|1] "" ADAS
 SG_ DET_BI_STATIC_FLAG_301 : 487|1@0+ (1,0) [0|1] "" ADAS
 SG_ DET_SUPER_RES_TARGET_301 : 79|1@0+ (1,0) [0|1] "" ADAS
 SG_ DET_SNR_301 : 111|8@0+ (0.35156,0) [0|89.6478] "dB" ADAS
 SG_ DET_POINT_TARGET_PROB_301 : 86|4@0+ (6.67,0) [0|100] "%" ADAS
 SG_ DET_EXISTENCE_PROB_301 : 95|6@0+ (1.588,0) [0|100] "%" ADAS
 SG_ DET_OUTSIDE_SECTOR_301 : 103|1@0+ (1,0) [0|1] "" ADAS
 SG_ DET_HVC_FLAG_301 : 87|1@0+ (1,0) [0|1] "" ADAS
 SG_ DET_CONFD_AZIMUTH_301 : 89|2@0+ (1,0) [0|3] "" ADAS
 SG_ DET_CONFD_ELEVATION_301 : 82|2@0+ (1,0) [0|3] "" ADAS
 SG_ DET_RANGE_302 : 127|15@0+ (0.015625,0) [0|500] "m" ADAS
 SG_ DET_RANGE_ERR_302 : 128|7@0+ (0.0075,0) [0|0.9525] "m" ADAS
 SG_ DET_RANGE_VELOCITY_302 : 137|15@0+ (0.0078125,-128) [-128|127.9921875] "m/s" ADAS
 SG_ DET_RANGE_VELOCITY_ERR_302 : 154|8@0+ (0.003,0) [0|0.765] "m/s" ADAS
 SG_ DET_AZIMUTH_302 : 180|13@0+ (0.0004,-1.5708) [-1.5708|1.5708] "rad" ADAS
 SG_ DET_AZIMUTH_ERR_302 : 198|7@0+ (0.00087267,0) [0|0.11082909] "rad" ADAS
 SG_ DET_ELEVATION_302 : 162|8@0+ (0.00275,-0.34925) [-0.34925|0.34925] "rad" ADAS
 SG_ DET_ELEVATION_ERR_302 : 170|6@0+ (0.00174533,0) [0|0.10995579] "rad" ADAS
 SG_ DET_RCS_302 : 239|8@0+ (0.5,-64) [-64|63.5] "dBsm" ADAS
 SG_ DET_VALID_FLAG_302 : 220|1@0+ (1,0) [0|1] "" ADAS
 SG_ DET_BI_STATIC_FLAG_302 : 486|1@0+ (1,0) [0|1] "" ADAS
 SG_ DET_SUPER_RES_TARGET_302 : 199|1@0+ (1,0) [0|1] "" ADAS
 SG_ DET_SNR_302 : 231|8@0+ (0.35156,0) [0|89.6478] "dB" ADAS
 SG_ DET_POINT_TARGET_PROB_302 : 215|4@0+ (6.67,0) [0|100] "%" ADAS
 SG_ DET_EXISTENCE_PROB_302 : 211|6@0+ (1.588,0) [0|100] "%" ADAS
 SG_ DET_OUTSIDE_SECTOR_302 : 221|1@0+ (1,0) [0|1] "" ADAS
 SG_ DET_HVC_FLAG_302 : 207|1@0+ (1,0) [0|1] "" ADAS
 SG_ DET_CONFD_AZIMUTH_302 : 217|2@0+ (1,0) [0|3] "" ADAS
 SG_ DET_CONFD_ELEVATION_302 : 219|2@0+ (1,0) [0|3] "" ADAS
 SG_ DET_RANGE_303 : 247|15@0+ (0.015625,0) [0|500] "m" ADAS
 SG_ DET_RANGE_ERR_303 : 248|7@0+ (0.0075,0) [0|0.9525] "m" ADAS
 SG_ DET_RANGE_VELOCITY_303 : 257|15@0+ (0.0078125,-128) [-128|127.9921875] "m/s" ADAS
 SG_ DET_RANGE_VELOCITY_ERR_303 : 274|8@0+ (0.003,0) [0|0.765] "m/s" ADAS
 SG_ DET_AZIMUTH_303 : 300|13@0+ (0.0004,-1.5708) [-1.5708|1.5708] "rad" ADAS
 SG_ DET_AZIMUTH_ERR_303 : 318|7@0+ (0.00087267,0) [0|0.11082909] "rad" ADAS
 SG_ DET_ELEVATION_303 : 282|8@0+ (0.00275,-0.34925) [-0.34925|0.34925] "rad" ADAS
 SG_ DET_ELEVATION_ERR_303 : 290|6@0+ (0.00174533,0) [0|0.10995579] "rad" ADAS
 SG_ DET_RCS_303 : 359|8@0+ (0.5,-64) [-64|63.5] "dBsm" ADAS
 SG_ DET_VALID_FLAG_303 : 340|1@0+ (1,0) [0|1] "" ADAS
 SG_ DET_BI_STATIC_FLAG_303 : 485|1@0+ (1,0) [0|1] "" ADAS
 SG_ DET_SUPER_RES_TARGET_303 : 319|1@0+ (1,0) [0|1] "" ADAS
 SG_ DET_SNR_303 : 351|8@0+ (0.35156,0) [0|89.6478] "dB" ADAS
 SG_ DET_POINT_TARGET_PROB_303 : 335|4@0+ (6.67,0) [0|100] "%" ADAS
 SG_ DET_EXISTENCE_PROB_303 : 331|6@0+ (1.588,0) [0|100] "%" ADAS
 SG_ DET_OUTSIDE_SECTOR_303 : 341|1@0+ (1,0) [0|1] "" ADAS
 SG_ DET_HVC_FLAG_303 : 327|1@0+ (1,0) [0|1] "" ADAS
 SG_ DET_CONFD_AZIMUTH_303 : 337|2@0+ (1,0) [0|3] "" ADAS
 SG_ DET_CONFD_ELEVATION_303 : 339|2@0+ (1,0) [0|3] "" ADAS
 SG_ DET_RANGE_304 : 367|15@0+ (0.015625,0) [0|500] "m" ADAS
 SG_ DET_RANGE_ERR_304 : 368|7@0+ (0.0075,0) [0|0.9525] "m" ADAS
 SG_ DET_RANGE_VELOCITY_304 : 377|15@0+ (0.0078125,-128) [-128|127.9921875] "m/s" ADAS
 SG_ DET_RANGE_VELOCITY_ERR_304 : 394|8@0+ (0.003,0) [0|0.765] "m/s" ADAS
 SG_ DET_AZIMUTH_304 : 420|13@0+ (0.0004,-1.5708) [-1.5708|1.5708] "rad" ADAS
 SG_ DET_AZIMUTH_ERR_304 : 438|7@0+ (0.00087267,0) [0|0.11082909] "rad" ADAS
 SG_ DET_ELEVATION_304 : 402|8@0+ (0.00275,-0.34925) [-0.34925|0.34925] "rad" ADAS
 SG_ DET_ELEVATION_ERR_304 : 410|6@0+ (0.00174533,0) [0|0.10995579] "rad" ADAS
 SG_ DET_RCS_304 : 479|8@0+ (0.5,-64) [-64|63.5] "dBsm" ADAS
 SG_ DET_VALID_FLAG_304 : 460|1@0+ (1,0) [0|1] "" ADAS
 SG_ DET_BI_STATIC_FLAG_304 : 484|1@0+ (1,0) [0|1] "" ADAS
 SG_ DET_SUPER_RES_TARGET_304 : 439|1@0+ (1,0) [0|1] "" ADAS
 SG_ DET_SNR_304 : 471|8@0+ (0.35156,0) [0|89.6478] "dB" ADAS
 SG_ DET_POINT_TARGET_PROB_304 : 455|4@0+ (6.67,0) [0|100] "%" ADAS
 SG_ DET_EXISTENCE_PROB_304 : 451|6@0+ (1.588,0) [0|100] "%" ADAS
 SG_ DET_OUTSIDE_SECTOR_304 : 461|1@0+ (1,0) [0|1] "" ADAS
 SG_ DET_HVC_FLAG_304 : 447|1@0+ (1,0) [0|1] "" ADAS
 SG_ DET_CONFD_AZIMUTH_304 : 457|2@0+ (1,0) [0|3] "" ADAS
 SG_ DET_CONFD_ELEVATION_304 : 459|2@0+ (1,0) [0|3] "" ADAS
 SG_ DET_MH_SCAN_INDEX_4LSB_301_304 : 483|4@0+ (1,0) [0|15] "" ADAS
 SG_ DET_MH_CYCLE_COUNTER_301_304 : 495|8@0+ (1,0) [0|255] "" ADAS
 SG_ DET_MH_CRC16_301_304 : 503|16@0+ (1,0) [0|65535] "" ADAS

BO_ 1228 RDR_DETECTION_305_308: 64 RDR08
 SG_ DET_RANGE_305 : 7|15@0+ (0.015625,0) [0|500] "m" ADAS
 SG_ DET_RANGE_ERR_305 : 8|7@0+ (0.0075,0) [0|0.9525] "m" ADAS
 SG_ DET_RANGE_VELOCITY_305 : 17|15@0+ (0.0078125,-128) [-128|127.9921875] "m/s" ADAS
 SG_ DET_RANGE_VELOCITY_ERR_305 : 34|8@0+ (0.003,0) [0|0.765] "m/s" ADAS
 SG_ DET_AZIMUTH_305 : 60|13@0+ (0.0004,-1.5708) [-1.5708|1.5708] "rad" ADAS
 SG_ DET_AZIMUTH_ERR_305 : 78|7@0+ (0.00087267,0) [0|0.11082909] "rad" ADAS
 SG_ DET_ELEVATION_305 : 42|8@0+ (0.00275,-0.34925) [-0.34925|0.34925] "rad" ADAS
 SG_ DET_ELEVATION_ERR_305 : 50|6@0+ (0.00174533,0) [0|0.10995579] "rad" ADAS
 SG_ DET_RCS_305 : 119|8@0+ (0.5,-64) [-64|63.5] "dBsm" ADAS
 SG_ DET_VALID_FLAG_305 : 80|1@0+ (1,0) [0|1] "" ADAS
 SG_ DET_BI_STATIC_FLAG_305 : 487|1@0+ (1,0) [0|1] "" ADAS
 SG_ DET_SUPER_RES_TARGET_305 : 79|1@0+ (1,0) [0|1] "" ADAS
 SG_ DET_SNR_305 : 111|8@0+ (0.35156,0) [0|89.6478] "dB" ADAS
 SG_ DET_POINT_TARGET_PROB_305 : 86|4@0+ (6.67,0) [0|100] "%" ADAS
 SG_ DET_EXISTENCE_PROB_305 : 95|6@0+ (1.588,0) [0|100] "%" ADAS
 SG_ DET_OUTSIDE_SECTOR_305 : 103|1@0+ (1,0) [0|1] "" ADAS
 SG_ DET_HVC_FLAG_305 : 87|1@0+ (1,0) [0|1] "" ADAS
 SG_ DET_CONFD_AZIMUTH_305 : 89|2@0+ (1,0) [0|3] "" ADAS
 SG_ DET_CONFD_ELEVATION_305 : 82|2@0+ (1,0) [0|3] "" ADAS
 SG_ DET_RANGE_306 : 127|15@0+ (0.015625,0) [0|500] "m" ADAS
 SG_ DET_RANGE_ERR_306 : 128|7@0+ (0.0075,0) [0|0.9525] "m" ADAS
 SG_ DET_RANGE_VELOCITY_306 : 137|15@0+ (0.0078125,-128) [-128|127.9921875] "m/s" ADAS
 SG_ DET_RANGE_VELOCITY_ERR_306 : 154|8@0+ (0.003,0) [0|0.765] "m/s" ADAS
 SG_ DET_AZIMUTH_306 : 180|13@0+ (0.0004,-1.5708) [-1.5708|1.5708] "rad" ADAS
 SG_ DET_AZIMUTH_ERR_306 : 198|7@0+ (0.00087267,0) [0|0.11082909] "rad" ADAS
 SG_ DET_ELEVATION_306 : 162|8@0+ (0.00275,-0.34925) [-0.34925|0.34925] "rad" ADAS
 SG_ DET_ELEVATION_ERR_306 : 170|6@0+ (0.00174533,0) [0|0.10995579] "rad" ADAS
 SG_ DET_RCS_306 : 239|8@0+ (0.5,-64) [-64|63.5] "dBsm" ADAS
 SG_ DET_VALID_FLAG_306 : 220|1@0+ (1,0) [0|1] "" ADAS
 SG_ DET_BI_STATIC_FLAG_306 : 486|1@0+ (1,0) [0|1] "" ADAS
 SG_ DET_SUPER_RES_TARGET_306 : 199|1@0+ (1,0) [0|1] "" ADAS
 SG_ DET_SNR_306 : 231|8@0+ (0.35156,0) [0|89.6478] "dB" ADAS
 SG_ DET_POINT_TARGET_PROB_306 : 215|4@0+ (6.67,0) [0|100] "%" ADAS
 SG_ DET_EXISTENCE_PROB_306 : 211|6@0+ (1.588,0) [0|100] "%" ADAS
 SG_ DET_OUTSIDE_SECTOR_306 : 221|1@0+ (1,0) [0|1] "" ADAS
 SG_ DET_HVC_FLAG_306 : 207|1@0+ (1,0) [0|1] "" ADAS
 SG_ DET_CONFD_AZIMUTH_306 : 217|2@0+ (1,0) [0|3] "" ADAS
 SG_ DET_CONFD_ELEVATION_306 : 219|2@0+ (1,0) [0|3] "" ADAS
 SG_ DET_RANGE_307 : 247|15@0+ (0.015625,0) [0|500] "m" ADAS
 SG_ DET_RANGE_ERR_307 : 248|7@0+ (0.0075,0) [0|0.9525] "m" ADAS
 SG_ DET_RANGE_VELOCITY_307 : 257|15@0+ (0.0078125,-128) [-128|127.9921875] "m/s" ADAS
 SG_ DET_RANGE_VELOCITY_ERR_307 : 274|8@0+ (0.003,0) [0|0.765] "m/s" ADAS
 SG_ DET_AZIMUTH_307 : 300|13@0+ (0.0004,-1.5708) [-1.5708|1.5708] "rad" ADAS
 SG_ DET_AZIMUTH_ERR_307 : 318|7@0+ (0.00087267,0) [0|0.11082909] "rad" ADAS
 SG_ DET_ELEVATION_307 : 282|8@0+ (0.00275,-0.34925) [-0.34925|0.34925] "rad" ADAS
 SG_ DET_ELEVATION_ERR_307 : 290|6@0+ (0.00174533,0) [0|0.10995579] "rad" ADAS
 SG_ DET_RCS_307 : 359|8@0+ (0.5,-64) [-64|63.5] "dBsm" ADAS
 SG_ DET_VALID_FLAG_307 : 340|1@0+ (1,0) [0|1] "" ADAS
 SG_ DET_BI_STATIC_FLAG_307 : 485|1@0+ (1,0) [0|1] "" ADAS
 SG_ DET_SUPER_RES_TARGET_307 : 319|1@0+ (1,0) [0|1] "" ADAS
 SG_ DET_SNR_307 : 351|8@0+ (0.35156,0) [0|89.6478] "dB" ADAS
 SG_ DET_POINT_TARGET_PROB_307 : 335|4@0+ (6.67,0) [0|100] "%" ADAS
 SG_ DET_EXISTENCE_PROB_307 : 331|6@0+ (1.588,0) [0|100] "%" ADAS
 SG_ DET_OUTSIDE_SECTOR_307 : 341|1@0+ (1,0) [0|1] "" ADAS
 SG_ DET_HVC_FLAG_307 : 327|1@0+ (1,0) [0|1] "" ADAS
 SG_ DET_CONFD_AZIMUTH_307 : 337|2@0+ (1,0) [0|3] "" ADAS
 SG_ DET_CONFD_ELEVATION_307 : 339|2@0+ (1,0) [0|3] "" ADAS
 SG_ DET_RANGE_308 : 367|15@0+ (0.015625,0) [0|500] "m" ADAS
 SG_ DET_RANGE_ERR_308 : 368|7@0+ (0.0075,0) [0|0.9525] "m" ADAS
 SG_ DET_RANGE_VELOCITY_308 : 377|15@0+ (0.0078125,-128) [-128|127.9921875] "m/s" ADAS
 SG_ DET_RANGE_VELOCITY_ERR_308 : 394|8@0+ (0.003,0) [0|0.765] "m/s" ADAS
 SG_ DET_AZIMUTH_308 : 420|13@0+ (0.0004,-1.5708) [-1.5708|1.5708] "rad" ADAS
 SG_ DET_AZIMUTH_ERR_308 : 438|7@0+ (0.00087267,0) [0|0.11082909] "rad" ADAS
 SG_ DET_ELEVATION_308 : 402|8@0+ (0.00275,-0.34925) [-0.34925|0.34925] "rad" ADAS
 SG_ DET_ELEVATION_ERR_308 : 410|6@0+ (0.00174533,0) [0|0.10995579] "rad" ADAS
 SG_ DET_RCS_308 : 479|8@0+ (0.5,-64) [-64|63.5] "dBsm" ADAS
 SG_ DET_VALID_FLAG_308 : 460|1@0+ (1,0) [0|1] "" ADAS
 SG_ DET_BI_STATIC_FLAG_308 : 484|1@0+ (1,0) [0|1] "" ADAS
 SG_ DET_SUPER_RES_TARGET_308 : 439|1@0+ (1,0) [0|1] "" ADAS
 SG_ DET_SNR_308 : 471|8@0+ (0.35156,0) [0|89.6478] "dB" ADAS
 SG_ DET_POINT_TARGET_PROB_308 : 455|4@0+ (6.67,0) [0|100] "%" ADAS
 SG_ DET_EXISTENCE_PROB_308 : 451|6@0+ (1.588,0) [0|100] "%" ADAS
 SG_ DET_OUTSIDE_SECTOR_308 : 461|1@0+ (1,0) [0|1] "" ADAS
 SG_ DET_HVC_FLAG_308 : 447|1@0+ (1,0) [0|1] "" ADAS
 SG_ DET_CONFD_AZIMUTH_308 : 457|2@0+ (1,0) [0|3] "" ADAS
 SG_ DET_CONFD_ELEVATION_308 : 459|2@0+ (1,0) [0|3] "" ADAS
 SG_ DET_MH_SCAN_INDEX_4LSB_305_308 : 483|4@0+ (1,0) [0|15] "" ADAS
 SG_ DET_MH_CYCLE_COUNTER_305_308 : 495|8@0+ (1,0) [0|255] "" ADAS
 SG_ DET_MH_CRC16_305_308 : 503|16@0+ (1,0) [0|65535] "" ADAS

BO_ 1229 RDR_DETECTION_309_312: 64 RDR08
 SG_ DET_RANGE_309 : 7|15@0+ (0.015625,0) [0|500] "m" ADAS
 SG_ DET_RANGE_ERR_309 : 8|7@0+ (0.0075,0) [0|0.9525] "m" ADAS
 SG_ DET_RANGE_VELOCITY_309 : 17|15@0+ (0.0078125,-128) [-128|127.9921875] "m/s" ADAS
 SG_ DET_RANGE_VELOCITY_ERR_309 : 34|8@0+ (0.003,0) [0|0.765] "m/s" ADAS
 SG_ DET_AZIMUTH_309 : 60|13@0+ (0.0004,-1.5708) [-1.5708|1.5708] "rad" ADAS
 SG_ DET_AZIMUTH_ERR_309 : 78|7@0+ (0.00087267,0) [0|0.11082909] "rad" ADAS
 SG_ DET_ELEVATION_309 : 42|8@0+ (0.00275,-0.34925) [-0.34925|0.34925] "rad" ADAS
 SG_ DET_ELEVATION_ERR_309 : 50|6@0+ (0.00174533,0) [0|0.10995579] "rad" ADAS
 SG_ DET_RCS_309 : 119|8@0+ (0.5,-64) [-64|63.5] "dBsm" ADAS
 SG_ DET_VALID_FLAG_309 : 80|1@0+ (1,0) [0|1] "" ADAS
 SG_ DET_BI_STATIC_FLAG_309 : 487|1@0+ (1,0) [0|1] "" ADAS
 SG_ DET_SUPER_RES_TARGET_309 : 79|1@0+ (1,0) [0|1] "" ADAS
 SG_ DET_SNR_309 : 111|8@0+ (0.35156,0) [0|89.6478] "dB" ADAS
 SG_ DET_POINT_TARGET_PROB_309 : 86|4@0+ (6.67,0) [0|100] "%" ADAS
 SG_ DET_EXISTENCE_PROB_309 : 95|6@0+ (1.588,0) [0|100] "%" ADAS
 SG_ DET_OUTSIDE_SECTOR_309 : 103|1@0+ (1,0) [0|1] "" ADAS
 SG_ DET_HVC_FLAG_309 : 87|1@0+ (1,0) [0|1] "" ADAS
 SG_ DET_CONFD_AZIMUTH_309 : 89|2@0+ (1,0) [0|3] "" ADAS
 SG_ DET_CONFD_ELEVATION_309 : 82|2@0+ (1,0) [0|3] "" ADAS
 SG_ DET_RANGE_310 : 127|15@0+ (0.015625,0) [0|500] "m" ADAS
 SG_ DET_RANGE_ERR_310 : 128|7@0+ (0.0075,0) [0|0.9525] "m" ADAS
 SG_ DET_RANGE_VELOCITY_310 : 137|15@0+ (0.0078125,-128) [-128|127.9921875] "m/s" ADAS
 SG_ DET_RANGE_VELOCITY_ERR_310 : 154|8@0+ (0.003,0) [0|0.765] "m/s" ADAS
 SG_ DET_AZIMUTH_310 : 180|13@0+ (0.0004,-1.5708) [-1.5708|1.5708] "rad" ADAS
 SG_ DET_AZIMUTH_ERR_310 : 198|7@0+ (0.00087267,0) [0|0.11082909] "rad" ADAS
 SG_ DET_ELEVATION_310 : 162|8@0+ (0.00275,-0.34925) [-0.34925|0.34925] "rad" ADAS
 SG_ DET_ELEVATION_ERR_310 : 170|6@0+ (0.00174533,0) [0|0.10995579] "rad" ADAS
 SG_ DET_RCS_310 : 239|8@0+ (0.5,-64) [-64|63.5] "dBsm" ADAS
 SG_ DET_VALID_FLAG_310 : 220|1@0+ (1,0) [0|1] "" ADAS
 SG_ DET_BI_STATIC_FLAG_310 : 486|1@0+ (1,0) [0|1] "" ADAS
 SG_ DET_SUPER_RES_TARGET_310 : 199|1@0+ (1,0) [0|1] "" ADAS
 SG_ DET_SNR_310 : 231|8@0+ (0.35156,0) [0|89.6478] "dB" ADAS
 SG_ DET_POINT_TARGET_PROB_310 : 215|4@0+ (6.67,0) [0|100] "%" ADAS
 SG_ DET_EXISTENCE_PROB_310 : 211|6@0+ (1.588,0) [0|100] "%" ADAS
 SG_ DET_OUTSIDE_SECTOR_310 : 221|1@0+ (1,0) [0|1] "" ADAS
 SG_ DET_HVC_FLAG_310 : 207|1@0+ (1,0) [0|1] "" ADAS
 SG_ DET_CONFD_AZIMUTH_310 : 217|2@0+ (1,0) [0|3] "" ADAS
 SG_ DET_CONFD_ELEVATION_310 : 219|2@0+ (1,0) [0|3] "" ADAS
 SG_ DET_RANGE_311 : 247|15@0+ (0.015625,0) [0|500] "m" ADAS
 SG_ DET_RANGE_ERR_311 : 248|7@0+ (0.0075,0) [0|0.9525] "m" ADAS
 SG_ DET_RANGE_VELOCITY_311 : 257|15@0+ (0.0078125,-128) [-128|127.9921875] "m/s" ADAS
 SG_ DET_RANGE_VELOCITY_ERR_311 : 274|8@0+ (0.003,0) [0|0.765] "m/s" ADAS
 SG_ DET_AZIMUTH_311 : 300|13@0+ (0.0004,-1.5708) [-1.5708|1.5708] "rad" ADAS
 SG_ DET_AZIMUTH_ERR_311 : 318|7@0+ (0.00087267,0) [0|0.11082909] "rad" ADAS
 SG_ DET_ELEVATION_311 : 282|8@0+ (0.00275,-0.34925) [-0.34925|0.34925] "rad" ADAS
 SG_ DET_ELEVATION_ERR_311 : 290|6@0+ (0.00174533,0) [0|0.10995579] "rad" ADAS
 SG_ DET_RCS_311 : 359|8@0+ (0.5,-64) [-64|63.5] "dBsm" ADAS
 SG_ DET_VALID_FLAG_311 : 340|1@0+ (1,0) [0|1] "" ADAS
 SG_ DET_BI_STATIC_FLAG_311 : 485|1@0+ (1,0) [0|1] "" ADAS
 SG_ DET_SUPER_RES_TARGET_311 : 319|1@0+ (1,0) [0|1] "" ADAS
 SG_ DET_SNR_311 : 351|8@0+ (0.35156,0) [0|89.6478] "dB" ADAS
 SG_ DET_POINT_TARGET_PROB_311 : 335|4@0+ (6.67,0) [0|100] "%" ADAS
 SG_ DET_EXISTENCE_PROB_311 : 331|6@0+ (1.588,0) [0|100] "%" ADAS
 SG_ DET_OUTSIDE_SECTOR_311 : 341|1@0+ (1,0) [0|1] "" ADAS
 SG_ DET_HVC_FLAG_311 : 327|1@0+ (1,0) [0|1] "" ADAS
 SG_ DET_CONFD_AZIMUTH_311 : 337|2@0+ (1,0) [0|3] "" ADAS
 SG_ DET_CONFD_ELEVATION_311 : 339|2@0+ (1,0) [0|3] "" ADAS
 SG_ DET_RANGE_312 : 367|15@0+ (0.015625,0) [0|500] "m" ADAS
 SG_ DET_RANGE_ERR_312 : 368|7@0+ (0.0075,0) [0|0.9525] "m" ADAS
 SG_ DET_RANGE_VELOCITY_312 : 377|15@0+ (0.0078125,-128) [-128|127.9921875] "m/s" ADAS
 SG_ DET_RANGE_VELOCITY_ERR_312 : 394|8@0+ (0.003,0) [0|0.765] "m/s" ADAS
 SG_ DET_AZIMUTH_312 : 420|13@0+ (0.0004,-1.5708) [-1.5708|1.5708] "rad" ADAS
 SG_ DET_AZIMUTH_ERR_312 : 438|7@0+ (0.00087267,0) [0|0.11082909] "rad" ADAS
 SG_ DET_ELEVATION_312 : 402|8@0+ (0.00275,-0.34925) [-0.34925|0.34925] "rad" ADAS
 SG_ DET_ELEVATION_ERR_312 : 410|6@0+ (0.00174533,0) [0|0.10995579] "rad" ADAS
 SG_ DET_RCS_312 : 479|8@0+ (0.5,-64) [-64|63.5] "dBsm" ADAS
 SG_ DET_VALID_FLAG_312 : 460|1@0+ (1,0) [0|1] "" ADAS
 SG_ DET_BI_STATIC_FLAG_312 : 484|1@0+ (1,0) [0|1] "" ADAS
 SG_ DET_SUPER_RES_TARGET_312 : 439|1@0+ (1,0) [0|1] "" ADAS
 SG_ DET_SNR_312 : 471|8@0+ (0.35156,0) [0|89.6478] "dB" ADAS
 SG_ DET_POINT_TARGET_PROB_312 : 455|4@0+ (6.67,0) [0|100] "%" ADAS
 SG_ DET_EXISTENCE_PROB_312 : 451|6@0+ (1.588,0) [0|100] "%" ADAS
 SG_ DET_OUTSIDE_SECTOR_312 : 461|1@0+ (1,0) [0|1] "" ADAS
 SG_ DET_HVC_FLAG_312 : 447|1@0+ (1,0) [0|1] "" ADAS
 SG_ DET_CONFD_AZIMUTH_312 : 457|2@0+ (1,0) [0|3] "" ADAS
 SG_ DET_CONFD_ELEVATION_312 : 459|2@0+ (1,0) [0|3] "" ADAS
 SG_ DET_MH_SCAN_INDEX_4LSB_309_312 : 483|4@0+ (1,0) [0|15] "" ADAS
 SG_ DET_MH_CYCLE_COUNTER_309_312 : 495|8@0+ (1,0) [0|255] "" ADAS
 SG_ DET_MH_CRC16_309_312 : 503|16@0+ (1,0) [0|65535] "" ADAS

BO_ 1230 RDR_DETECTION_313_316: 64 RDR08
 SG_ DET_RANGE_313 : 7|15@0+ (0.015625,0) [0|500] "m" ADAS
 SG_ DET_RANGE_ERR_313 : 8|7@0+ (0.0075,0) [0|0.9525] "m" ADAS
 SG_ DET_RANGE_VELOCITY_313 : 17|15@0+ (0.0078125,-128) [-128|127.9921875] "m/s" ADAS
 SG_ DET_RANGE_VELOCITY_ERR_313 : 34|8@0+ (0.003,0) [0|0.765] "m/s" ADAS
 SG_ DET_AZIMUTH_313 : 60|13@0+ (0.0004,-1.5708) [-1.5708|1.5708] "rad" ADAS
 SG_ DET_AZIMUTH_ERR_313 : 78|7@0+ (0.00087267,0) [0|0.11082909] "rad" ADAS
 SG_ DET_ELEVATION_313 : 42|8@0+ (0.00275,-0.34925) [-0.34925|0.34925] "rad" ADAS
 SG_ DET_ELEVATION_ERR_313 : 50|6@0+ (0.00174533,0) [0|0.10995579] "rad" ADAS
 SG_ DET_RCS_313 : 119|8@0+ (0.5,-64) [-64|63.5] "dBsm" ADAS
 SG_ DET_VALID_FLAG_313 : 80|1@0+ (1,0) [0|1] "" ADAS
 SG_ DET_BI_STATIC_FLAG_313 : 487|1@0+ (1,0) [0|1] "" ADAS
 SG_ DET_SUPER_RES_TARGET_313 : 79|1@0+ (1,0) [0|1] "" ADAS
 SG_ DET_SNR_313 : 111|8@0+ (0.35156,0) [0|89.6478] "dB" ADAS
 SG_ DET_POINT_TARGET_PROB_313 : 86|4@0+ (6.67,0) [0|100] "%" ADAS
 SG_ DET_EXISTENCE_PROB_313 : 95|6@0+ (1.588,0) [0|100] "%" ADAS
 SG_ DET_OUTSIDE_SECTOR_313 : 103|1@0+ (1,0) [0|1] "" ADAS
 SG_ DET_HVC_FLAG_313 : 87|1@0+ (1,0) [0|1] "" ADAS
 SG_ DET_CONFD_AZIMUTH_313 : 89|2@0+ (1,0) [0|3] "" ADAS
 SG_ DET_CONFD_ELEVATION_313 : 82|2@0+ (1,0) [0|3] "" ADAS
 SG_ DET_RANGE_314 : 127|15@0+ (0.015625,0) [0|500] "m" ADAS
 SG_ DET_RANGE_ERR_314 : 128|7@0+ (0.0075,0) [0|0.9525] "m" ADAS
 SG_ DET_RANGE_VELOCITY_314 : 137|15@0+ (0.0078125,-128) [-128|127.9921875] "m/s" ADAS
 SG_ DET_RANGE_VELOCITY_ERR_314 : 154|8@0+ (0.003,0) [0|0.765] "m/s" ADAS
 SG_ DET_AZIMUTH_314 : 180|13@0+ (0.0004,-1.5708) [-1.5708|1.5708] "rad" ADAS
 SG_ DET_AZIMUTH_ERR_314 : 198|7@0+ (0.00087267,0) [0|0.11082909] "rad" ADAS
 SG_ DET_ELEVATION_314 : 162|8@0+ (0.00275,-0.34925) [-0.34925|0.34925] "rad" ADAS
 SG_ DET_ELEVATION_ERR_314 : 170|6@0+ (0.00174533,0) [0|0.10995579] "rad" ADAS
 SG_ DET_RCS_314 : 239|8@0+ (0.5,-64) [-64|63.5] "dBsm" ADAS
 SG_ DET_VALID_FLAG_314 : 220|1@0+ (1,0) [0|1] "" ADAS
 SG_ DET_BI_STATIC_FLAG_314 : 486|1@0+ (1,0) [0|1] "" ADAS
 SG_ DET_SUPER_RES_TARGET_314 : 199|1@0+ (1,0) [0|1] "" ADAS
 SG_ DET_SNR_314 : 231|8@0+ (0.35156,0) [0|89.6478] "dB" ADAS
 SG_ DET_POINT_TARGET_PROB_314 : 215|4@0+ (6.67,0) [0|100] "%" ADAS
 SG_ DET_EXISTENCE_PROB_314 : 211|6@0+ (1.588,0) [0|100] "%" ADAS
 SG_ DET_OUTSIDE_SECTOR_314 : 221|1@0+ (1,0) [0|1] "" ADAS
 SG_ DET_HVC_FLAG_314 : 207|1@0+ (1,0) [0|1] "" ADAS
 SG_ DET_CONFD_AZIMUTH_314 : 217|2@0+ (1,0) [0|3] "" ADAS
 SG_ DET_CONFD_ELEVATION_314 : 219|2@0+ (1,0) [0|3] "" ADAS
 SG_ DET_RANGE_315 : 247|15@0+ (0.015625,0) [0|500] "m" ADAS
 SG_ DET_RANGE_ERR_315 : 248|7@0+ (0.0075,0) [0|0.9525] "m" ADAS
 SG_ DET_RANGE_VELOCITY_315 : 257|15@0+ (0.0078125,-128) [-128|127.9921875] "m/s" ADAS
 SG_ DET_RANGE_VELOCITY_ERR_315 : 274|8@0+ (0.003,0) [0|0.765] "m/s" ADAS
 SG_ DET_AZIMUTH_315 : 300|13@0+ (0.0004,-1.5708) [-1.5708|1.5708] "rad" ADAS
 SG_ DET_AZIMUTH_ERR_315 : 318|7@0+ (0.00087267,0) [0|0.11082909] "rad" ADAS
 SG_ DET_ELEVATION_315 : 282|8@0+ (0.00275,-0.34925) [-0.34925|0.34925] "rad" ADAS
 SG_ DET_ELEVATION_ERR_315 : 290|6@0+ (0.00174533,0) [0|0.10995579] "rad" ADAS
 SG_ DET_RCS_315 : 359|8@0+ (0.5,-64) [-64|63.5] "dBsm" ADAS
 SG_ DET_VALID_FLAG_315 : 340|1@0+ (1,0) [0|1] "" ADAS
 SG_ DET_BI_STATIC_FLAG_315 : 485|1@0+ (1,0) [0|1] "" ADAS
 SG_ DET_SUPER_RES_TARGET_315 : 319|1@0+ (1,0) [0|1] "" ADAS
 SG_ DET_SNR_315 : 351|8@0+ (0.35156,0) [0|89.6478] "dB" ADAS
 SG_ DET_POINT_TARGET_PROB_315 : 335|4@0+ (6.67,0) [0|100] "%" ADAS
 SG_ DET_EXISTENCE_PROB_315 : 331|6@0+ (1.588,0) [0|100] "%" ADAS
 SG_ DET_OUTSIDE_SECTOR_315 : 341|1@0+ (1,0) [0|1] "" ADAS
 SG_ DET_HVC_FLAG_315 : 327|1@0+ (1,0) [0|1] "" ADAS
 SG_ DET_CONFD_AZIMUTH_315 : 337|2@0+ (1,0) [0|3] "" ADAS
 SG_ DET_CONFD_ELEVATION_315 : 339|2@0+ (1,0) [0|3] "" ADAS
 SG_ DET_RANGE_316 : 367|15@0+ (0.015625,0) [0|500] "m" ADAS
 SG_ DET_RANGE_ERR_316 : 368|7@0+ (0.0075,0) [0|0.9525] "m" ADAS
 SG_ DET_RANGE_VELOCITY_316 : 377|15@0+ (0.0078125,-128) [-128|127.9921875] "m/s" ADAS
 SG_ DET_RANGE_VELOCITY_ERR_316 : 394|8@0+ (0.003,0) [0|0.765] "m/s" ADAS
 SG_ DET_AZIMUTH_316 : 420|13@0+ (0.0004,-1.5708) [-1.5708|1.5708] "rad" ADAS
 SG_ DET_AZIMUTH_ERR_316 : 438|7@0+ (0.00087267,0) [0|0.11082909] "rad" ADAS
 SG_ DET_ELEVATION_316 : 402|8@0+ (0.00275,-0.34925) [-0.34925|0.34925] "rad" ADAS
 SG_ DET_ELEVATION_ERR_316 : 410|6@0+ (0.00174533,0) [0|0.10995579] "rad" ADAS
 SG_ DET_RCS_316 : 479|8@0+ (0.5,-64) [-64|63.5] "dBsm" ADAS
 SG_ DET_VALID_FLAG_316 : 460|1@0+ (1,0) [0|1] "" ADAS
 SG_ DET_BI_STATIC_FLAG_316 : 484|1@0+ (1,0) [0|1] "" ADAS
 SG_ DET_SUPER_RES_TARGET_316 : 439|1@0+ (1,0) [0|1] "" ADAS
 SG_ DET_SNR_316 : 471|8@0+ (0.35156,0) [0|89.6478] "dB" ADAS
 SG_ DET_POINT_TARGET_PROB_316 : 455|4@0+ (6.67,0) [0|100] "%" ADAS
 SG_ DET_EXISTENCE_PROB_316 : 451|6@0+ (1.588,0) [0|100] "%" ADAS
 SG_ DET_OUTSIDE_SECTOR_316 : 461|1@0+ (1,0) [0|1] "" ADAS
 SG_ DET_HVC_FLAG_316 : 447|1@0+ (1,0) [0|1] "" ADAS
 SG_ DET_CONFD_AZIMUTH_316 : 457|2@0+ (1,0) [0|3] "" ADAS
 SG_ DET_CONFD_ELEVATION_316 : 459|2@0+ (1,0) [0|3] "" ADAS
 SG_ DET_MH_SCAN_INDEX_4LSB_313_316 : 483|4@0+ (1,0) [0|15] "" ADAS
 SG_ DET_MH_CYCLE_COUNTER_313_316 : 495|8@0+ (1,0) [0|255] "" ADAS
 SG_ DET_MH_CRC16_313_316 : 503|16@0+ (1,0) [0|65535] "" ADAS

BO_ 1231 RDR_DETECTION_317_320: 64 RDR08
 SG_ DET_RANGE_317 : 7|15@0+ (0.015625,0) [0|500] "m" ADAS
 SG_ DET_RANGE_ERR_317 : 8|7@0+ (0.0075,0) [0|0.9525] "m" ADAS
 SG_ DET_RANGE_VELOCITY_317 : 17|15@0+ (0.0078125,-128) [-128|127.9921875] "m/s" ADAS
 SG_ DET_RANGE_VELOCITY_ERR_317 : 34|8@0+ (0.003,0) [0|0.765] "m/s" ADAS
 SG_ DET_AZIMUTH_317 : 60|13@0+ (0.0004,-1.5708) [-1.5708|1.5708] "rad" ADAS
 SG_ DET_AZIMUTH_ERR_317 : 78|7@0+ (0.00087267,0) [0|0.11082909] "rad" ADAS
 SG_ DET_ELEVATION_317 : 42|8@0+ (0.00275,-0.34925) [-0.34925|0.34925] "rad" ADAS
 SG_ DET_ELEVATION_ERR_317 : 50|6@0+ (0.00174533,0) [0|0.10995579] "rad" ADAS
 SG_ DET_RCS_317 : 119|8@0+ (0.5,-64) [-64|63.5] "dBsm" ADAS
 SG_ DET_VALID_FLAG_317 : 80|1@0+ (1,0) [0|1] "" ADAS
 SG_ DET_BI_STATIC_FLAG_317 : 487|1@0+ (1,0) [0|1] "" ADAS
 SG_ DET_SUPER_RES_TARGET_317 : 79|1@0+ (1,0) [0|1] "" ADAS
 SG_ DET_SNR_317 : 111|8@0+ (0.35156,0) [0|89.6478] "dB" ADAS
 SG_ DET_POINT_TARGET_PROB_317 : 86|4@0+ (6.67,0) [0|100] "%" ADAS
 SG_ DET_EXISTENCE_PROB_317 : 95|6@0+ (1.588,0) [0|100] "%" ADAS
 SG_ DET_OUTSIDE_SECTOR_317 : 103|1@0+ (1,0) [0|1] "" ADAS
 SG_ DET_HVC_FLAG_317 : 87|1@0+ (1,0) [0|1] "" ADAS
 SG_ DET_CONFD_AZIMUTH_317 : 89|2@0+ (1,0) [0|3] "" ADAS
 SG_ DET_CONFD_ELEVATION_317 : 82|2@0+ (1,0) [0|3] "" ADAS
 SG_ DET_RANGE_318 : 127|15@0+ (0.015625,0) [0|500] "m" ADAS
 SG_ DET_RANGE_ERR_318 : 128|7@0+ (0.0075,0) [0|0.9525] "m" ADAS
 SG_ DET_RANGE_VELOCITY_318 : 137|15@0+ (0.0078125,-128) [-128|127.9921875] "m/s" ADAS
 SG_ DET_RANGE_VELOCITY_ERR_318 : 154|8@0+ (0.003,0) [0|0.765] "m/s" ADAS
 SG_ DET_AZIMUTH_318 : 180|13@0+ (0.0004,-1.5708) [-1.5708|1.5708] "rad" ADAS
 SG_ DET_AZIMUTH_ERR_318 : 198|7@0+ (0.00087267,0) [0|0.11082909] "rad" ADAS
 SG_ DET_ELEVATION_318 : 162|8@0+ (0.00275,-0.34925) [-0.34925|0.34925] "rad" ADAS
 SG_ DET_ELEVATION_ERR_318 : 170|6@0+ (0.00174533,0) [0|0.10995579] "rad" ADAS
 SG_ DET_RCS_318 : 239|8@0+ (0.5,-64) [-64|63.5] "dBsm" ADAS
 SG_ DET_VALID_FLAG_318 : 220|1@0+ (1,0) [0|1] "" ADAS
 SG_ DET_BI_STATIC_FLAG_318 : 486|1@0+ (1,0) [0|1] "" ADAS
 SG_ DET_SUPER_RES_TARGET_318 : 199|1@0+ (1,0) [0|1] "" ADAS
 SG_ DET_SNR_318 : 231|8@0+ (0.35156,0) [0|89.6478] "dB" ADAS
 SG_ DET_POINT_TARGET_PROB_318 : 215|4@0+ (6.67,0) [0|100] "%" ADAS
 SG_ DET_EXISTENCE_PROB_318 : 211|6@0+ (1.588,0) [0|100] "%" ADAS
 SG_ DET_OUTSIDE_SECTOR_318 : 221|1@0+ (1,0) [0|1] "" ADAS
 SG_ DET_HVC_FLAG_318 : 207|1@0+ (1,0) [0|1] "" ADAS
 SG_ DET_CONFD_AZIMUTH_318 : 217|2@0+ (1,0) [0|3] "" ADAS
 SG_ DET_CONFD_ELEVATION_318 : 219|2@0+ (1,0) [0|3] "" ADAS
 SG_ DET_RANGE_319 : 247|15@0+ (0.015625,0) [0|500] "m" ADAS
 SG_ DET_RANGE_ERR_319 : 248|7@0+ (0.0075,0) [0|0.9525] "m" ADAS
 SG_ DET_RANGE_VELOCITY_319 : 257|15@0+ (0.0078125,-128) [-128|127.9921875] "m/s" ADAS
 SG_ DET_RANGE_VELOCITY_ERR_319 : 274|8@0+ (0.003,0) [0|0.765] "m/s" ADAS
 SG_ DET_AZIMUTH_319 : 300|13@0+ (0.0004,-1.5708) [-1.5708|1.5708] "rad" ADAS
 SG_ DET_AZIMUTH_ERR_319 : 318|7@0+ (0.00087267,0) [0|0.11082909] "rad" ADAS
 SG_ DET_ELEVATION_319 : 282|8@0+ (0.00275,-0.34925) [-0.34925|0.34925] "rad" ADAS
 SG_ DET_ELEVATION_ERR_319 : 290|6@0+ (0.00174533,0) [0|0.10995579] "rad" ADAS
 SG_ DET_RCS_319 : 359|8@0+ (0.5,-64) [-64|63.5] "dBsm" ADAS
 SG_ DET_VALID_FLAG_319 : 340|1@0+ (1,0) [0|1] "" ADAS
 SG_ DET_BI_STATIC_FLAG_319 : 485|1@0+ (1,0) [0|1] "" ADAS
 SG_ DET_SUPER_RES_TARGET_319 : 319|1@0+ (1,0) [0|1] "" ADAS
 SG_ DET_SNR_319 : 351|8@0+ (0.35156,0) [0|89.6478] "dB" ADAS
 SG_ DET_POINT_TARGET_PROB_319 : 335|4@0+ (6.67,0) [0|100] "%" ADAS
 SG_ DET_EXISTENCE_PROB_319 : 331|6@0+ (1.588,0) [0|100] "%" ADAS
 SG_ DET_OUTSIDE_SECTOR_319 : 341|1@0+ (1,0) [0|1] "" ADAS
 SG_ DET_HVC_FLAG_319 : 327|1@0+ (1,0) [0|1] "" ADAS
 SG_ DET_CONFD_AZIMUTH_319 : 337|2@0+ (1,0) [0|3] "" ADAS
 SG_ DET_CONFD_ELEVATION_319 : 339|2@0+ (1,0) [0|3] "" ADAS
 SG_ DET_RANGE_320 : 367|15@0+ (0.015625,0) [0|500] "m" ADAS
 SG_ DET_RANGE_ERR_320 : 368|7@0+ (0.0075,0) [0|0.9525] "m" ADAS
 SG_ DET_RANGE_VELOCITY_320 : 377|15@0+ (0.0078125,-128) [-128|127.9921875] "m/s" ADAS
 SG_ DET_RANGE_VELOCITY_ERR_320 : 394|8@0+ (0.003,0) [0|0.765] "m/s" ADAS
 SG_ DET_AZIMUTH_320 : 420|13@0+ (0.0004,-1.5708) [-1.5708|1.5708] "rad" ADAS
 SG_ DET_AZIMUTH_ERR_320 : 438|7@0+ (0.00087267,0) [0|0.11082909] "rad" ADAS
 SG_ DET_ELEVATION_320 : 402|8@0+ (0.00275,-0.34925) [-0.34925|0.34925] "rad" ADAS
 SG_ DET_ELEVATION_ERR_320 : 410|6@0+ (0.00174533,0) [0|0.10995579] "rad" ADAS
 SG_ DET_RCS_320 : 479|8@0+ (0.5,-64) [-64|63.5] "dBsm" ADAS
 SG_ DET_VALID_FLAG_320 : 460|1@0+ (1,0) [0|1] "" ADAS
 SG_ DET_BI_STATIC_FLAG_320 : 484|1@0+ (1,0) [0|1] "" ADAS
 SG_ DET_SUPER_RES_TARGET_320 : 439|1@0+ (1,0) [0|1] "" ADAS
 SG_ DET_SNR_320 : 471|8@0+ (0.35156,0) [0|89.6478] "dB" ADAS
 SG_ DET_POINT_TARGET_PROB_320 : 455|4@0+ (6.67,0) [0|100] "%" ADAS
 SG_ DET_EXISTENCE_PROB_320 : 451|6@0+ (1.588,0) [0|100] "%" ADAS
 SG_ DET_OUTSIDE_SECTOR_320 : 461|1@0+ (1,0) [0|1] "" ADAS
 SG_ DET_HVC_FLAG_320 : 447|1@0+ (1,0) [0|1] "" ADAS
 SG_ DET_CONFD_AZIMUTH_320 : 457|2@0+ (1,0) [0|3] "" ADAS
 SG_ DET_CONFD_ELEVATION_320 : 459|2@0+ (1,0) [0|3] "" ADAS
 SG_ DET_MH_SCAN_INDEX_4LSB_317_320 : 483|4@0+ (1,0) [0|15] "" ADAS
 SG_ DET_MH_CYCLE_COUNTER_317_320 : 495|8@0+ (1,0) [0|255] "" ADAS
 SG_ DET_MH_CRC16_317_320 : 503|16@0+ (1,0) [0|65535] "" ADAS

BO_ 1232 RDR_DETECTION_321_324: 64 RDR08
 SG_ DET_RANGE_321 : 7|15@0+ (0.015625,0) [0|500] "m" ADAS
 SG_ DET_RANGE_ERR_321 : 8|7@0+ (0.0075,0) [0|0.9525] "m" ADAS
 SG_ DET_RANGE_VELOCITY_321 : 17|15@0+ (0.0078125,-128) [-128|127.9921875] "m/s" ADAS
 SG_ DET_RANGE_VELOCITY_ERR_321 : 34|8@0+ (0.003,0) [0|0.765] "m/s" ADAS
 SG_ DET_AZIMUTH_321 : 60|13@0+ (0.0004,-1.5708) [-1.5708|1.5708] "rad" ADAS
 SG_ DET_AZIMUTH_ERR_321 : 78|7@0+ (0.00087267,0) [0|0.11082909] "rad" ADAS
 SG_ DET_ELEVATION_321 : 42|8@0+ (0.00275,-0.34925) [-0.34925|0.34925] "rad" ADAS
 SG_ DET_ELEVATION_ERR_321 : 50|6@0+ (0.00174533,0) [0|0.10995579] "rad" ADAS
 SG_ DET_RCS_321 : 119|8@0+ (0.5,-64) [-64|63.5] "dBsm" ADAS
 SG_ DET_VALID_FLAG_321 : 80|1@0+ (1,0) [0|1] "" ADAS
 SG_ DET_BI_STATIC_FLAG_321 : 487|1@0+ (1,0) [0|1] "" ADAS
 SG_ DET_SUPER_RES_TARGET_321 : 79|1@0+ (1,0) [0|1] "" ADAS
 SG_ DET_SNR_321 : 111|8@0+ (0.35156,0) [0|89.6478] "dB" ADAS
 SG_ DET_POINT_TARGET_PROB_321 : 86|4@0+ (6.67,0) [0|100] "%" ADAS
 SG_ DET_EXISTENCE_PROB_321 : 95|6@0+ (1.588,0) [0|100] "%" ADAS
 SG_ DET_OUTSIDE_SECTOR_321 : 103|1@0+ (1,0) [0|1] "" ADAS
 SG_ DET_HVC_FLAG_321 : 87|1@0+ (1,0) [0|1] "" ADAS
 SG_ DET_CONFD_AZIMUTH_321 : 89|2@0+ (1,0) [0|3] "" ADAS
 SG_ DET_CONFD_ELEVATION_321 : 82|2@0+ (1,0) [0|3] "" ADAS
 SG_ DET_RANGE_322 : 127|15@0+ (0.015625,0) [0|500] "m" ADAS
 SG_ DET_RANGE_ERR_322 : 128|7@0+ (0.0075,0) [0|0.9525] "m" ADAS
 SG_ DET_RANGE_VELOCITY_322 : 137|15@0+ (0.0078125,-128) [-128|127.9921875] "m/s" ADAS
 SG_ DET_RANGE_VELOCITY_ERR_322 : 154|8@0+ (0.003,0) [0|0.765] "m/s" ADAS
 SG_ DET_AZIMUTH_322 : 180|13@0+ (0.0004,-1.5708) [-1.5708|1.5708] "rad" ADAS
 SG_ DET_AZIMUTH_ERR_322 : 198|7@0+ (0.00087267,0) [0|0.11082909] "rad" ADAS
 SG_ DET_ELEVATION_322 : 162|8@0+ (0.00275,-0.34925) [-0.34925|0.34925] "rad" ADAS
 SG_ DET_ELEVATION_ERR_322 : 170|6@0+ (0.00174533,0) [0|0.10995579] "rad" ADAS
 SG_ DET_RCS_322 : 239|8@0+ (0.5,-64) [-64|63.5] "dBsm" ADAS
 SG_ DET_VALID_FLAG_322 : 220|1@0+ (1,0) [0|1] "" ADAS
 SG_ DET_BI_STATIC_FLAG_322 : 486|1@0+ (1,0) [0|1] "" ADAS
 SG_ DET_SUPER_RES_TARGET_322 : 199|1@0+ (1,0) [0|1] "" ADAS
 SG_ DET_SNR_322 : 231|8@0+ (0.35156,0) [0|89.6478] "dB" ADAS
 SG_ DET_POINT_TARGET_PROB_322 : 215|4@0+ (6.67,0) [0|100] "%" ADAS
 SG_ DET_EXISTENCE_PROB_322 : 211|6@0+ (1.588,0) [0|100] "%" ADAS
 SG_ DET_OUTSIDE_SECTOR_322 : 221|1@0+ (1,0) [0|1] "" ADAS
 SG_ DET_HVC_FLAG_322 : 207|1@0+ (1,0) [0|1] "" ADAS
 SG_ DET_CONFD_AZIMUTH_322 : 217|2@0+ (1,0) [0|3] "" ADAS
 SG_ DET_CONFD_ELEVATION_322 : 219|2@0+ (1,0) [0|3] "" ADAS
 SG_ DET_RANGE_323 : 247|15@0+ (0.015625,0) [0|500] "m" ADAS
 SG_ DET_RANGE_ERR_323 : 248|7@0+ (0.0075,0) [0|0.9525] "m" ADAS
 SG_ DET_RANGE_VELOCITY_323 : 257|15@0+ (0.0078125,-128) [-128|127.9921875] "m/s" ADAS
 SG_ DET_RANGE_VELOCITY_ERR_323 : 274|8@0+ (0.003,0) [0|0.765] "m/s" ADAS
 SG_ DET_AZIMUTH_323 : 300|13@0+ (0.0004,-1.5708) [-1.5708|1.5708] "rad" ADAS
 SG_ DET_AZIMUTH_ERR_323 : 318|7@0+ (0.00087267,0) [0|0.11082909] "rad" ADAS
 SG_ DET_ELEVATION_323 : 282|8@0+ (0.00275,-0.34925) [-0.34925|0.34925] "rad" ADAS
 SG_ DET_ELEVATION_ERR_323 : 290|6@0+ (0.00174533,0) [0|0.10995579] "rad" ADAS
 SG_ DET_RCS_323 : 359|8@0+ (0.5,-64) [-64|63.5] "dBsm" ADAS
 SG_ DET_VALID_FLAG_323 : 340|1@0+ (1,0) [0|1] "" ADAS
 SG_ DET_BI_STATIC_FLAG_323 : 485|1@0+ (1,0) [0|1] "" ADAS
 SG_ DET_SUPER_RES_TARGET_323 : 319|1@0+ (1,0) [0|1] "" ADAS
 SG_ DET_SNR_323 : 351|8@0+ (0.35156,0) [0|89.6478] "dB" ADAS
 SG_ DET_POINT_TARGET_PROB_323 : 335|4@0+ (6.67,0) [0|100] "%" ADAS
 SG_ DET_EXISTENCE_PROB_323 : 331|6@0+ (1.588,0) [0|100] "%" ADAS
 SG_ DET_OUTSIDE_SECTOR_323 : 341|1@0+ (1,0) [0|1] "" ADAS
 SG_ DET_HVC_FLAG_323 : 327|1@0+ (1,0) [0|1] "" ADAS
 SG_ DET_CONFD_AZIMUTH_323 : 337|2@0+ (1,0) [0|3] "" ADAS
 SG_ DET_CONFD_ELEVATION_323 : 339|2@0+ (1,0) [0|3] "" ADAS
 SG_ DET_RANGE_324 : 367|15@0+ (0.015625,0) [0|500] "m" ADAS
 SG_ DET_RANGE_ERR_324 : 368|7@0+ (0.0075,0) [0|0.9525] "m" ADAS
 SG_ DET_RANGE_VELOCITY_324 : 377|15@0+ (0.0078125,-128) [-128|127.9921875] "m/s" ADAS
 SG_ DET_RANGE_VELOCITY_ERR_324 : 394|8@0+ (0.003,0) [0|0.765] "m/s" ADAS
 SG_ DET_AZIMUTH_324 : 420|13@0+ (0.0004,-1.5708) [-1.5708|1.5708] "rad" ADAS
 SG_ DET_AZIMUTH_ERR_324 : 438|7@0+ (0.00087267,0) [0|0.11082909] "rad" ADAS
 SG_ DET_ELEVATION_324 : 402|8@0+ (0.00275,-0.34925) [-0.34925|0.34925] "rad" ADAS
 SG_ DET_ELEVATION_ERR_324 : 410|6@0+ (0.00174533,0) [0|0.10995579] "rad" ADAS
 SG_ DET_RCS_324 : 479|8@0+ (0.5,-64) [-64|63.5] "dBsm" ADAS
 SG_ DET_VALID_FLAG_324 : 460|1@0+ (1,0) [0|1] "" ADAS
 SG_ DET_BI_STATIC_FLAG_324 : 484|1@0+ (1,0) [0|1] "" ADAS
 SG_ DET_SUPER_RES_TARGET_324 : 439|1@0+ (1,0) [0|1] "" ADAS
 SG_ DET_SNR_324 : 471|8@0+ (0.35156,0) [0|89.6478] "dB" ADAS
 SG_ DET_POINT_TARGET_PROB_324 : 455|4@0+ (6.67,0) [0|100] "%" ADAS
 SG_ DET_EXISTENCE_PROB_324 : 451|6@0+ (1.588,0) [0|100] "%" ADAS
 SG_ DET_OUTSIDE_SECTOR_324 : 461|1@0+ (1,0) [0|1] "" ADAS
 SG_ DET_HVC_FLAG_324 : 447|1@0+ (1,0) [0|1] "" ADAS
 SG_ DET_CONFD_AZIMUTH_324 : 457|2@0+ (1,0) [0|3] "" ADAS
 SG_ DET_CONFD_ELEVATION_324 : 459|2@0+ (1,0) [0|3] "" ADAS
 SG_ DET_MH_SCAN_INDEX_4LSB_321_324 : 483|4@0+ (1,0) [0|15] "" ADAS
 SG_ DET_MH_CYCLE_COUNTER_321_324 : 495|8@0+ (1,0) [0|255] "" ADAS
 SG_ DET_MH_CRC16_321_324 : 503|16@0+ (1,0) [0|65535] "" ADAS

BO_ 1233 RDR_DETECTION_325_328: 64 RDR08
 SG_ DET_RANGE_325 : 7|15@0+ (0.015625,0) [0|500] "m" ADAS
 SG_ DET_RANGE_ERR_325 : 8|7@0+ (0.0075,0) [0|0.9525] "m" ADAS
 SG_ DET_RANGE_VELOCITY_325 : 17|15@0+ (0.0078125,-128) [-128|127.9921875] "m/s" ADAS
 SG_ DET_RANGE_VELOCITY_ERR_325 : 34|8@0+ (0.003,0) [0|0.765] "m/s" ADAS
 SG_ DET_AZIMUTH_325 : 60|13@0+ (0.0004,-1.5708) [-1.5708|1.5708] "rad" ADAS
 SG_ DET_AZIMUTH_ERR_325 : 78|7@0+ (0.00087267,0) [0|0.11082909] "rad" ADAS
 SG_ DET_ELEVATION_325 : 42|8@0+ (0.00275,-0.34925) [-0.34925|0.34925] "rad" ADAS
 SG_ DET_ELEVATION_ERR_325 : 50|6@0+ (0.00174533,0) [0|0.10995579] "rad" ADAS
 SG_ DET_RCS_325 : 119|8@0+ (0.5,-64) [-64|63.5] "dBsm" ADAS
 SG_ DET_VALID_FLAG_325 : 80|1@0+ (1,0) [0|1] "" ADAS
 SG_ DET_BI_STATIC_FLAG_325 : 487|1@0+ (1,0) [0|1] "" ADAS
 SG_ DET_SUPER_RES_TARGET_325 : 79|1@0+ (1,0) [0|1] "" ADAS
 SG_ DET_SNR_325 : 111|8@0+ (0.35156,0) [0|89.6478] "dB" ADAS
 SG_ DET_POINT_TARGET_PROB_325 : 86|4@0+ (6.67,0) [0|100] "%" ADAS
 SG_ DET_EXISTENCE_PROB_325 : 95|6@0+ (1.588,0) [0|100] "%" ADAS
 SG_ DET_OUTSIDE_SECTOR_325 : 103|1@0+ (1,0) [0|1] "" ADAS
 SG_ DET_HVC_FLAG_325 : 87|1@0+ (1,0) [0|1] "" ADAS
 SG_ DET_CONFD_AZIMUTH_325 : 89|2@0+ (1,0) [0|3] "" ADAS
 SG_ DET_CONFD_ELEVATION_325 : 82|2@0+ (1,0) [0|3] "" ADAS
 SG_ DET_RANGE_326 : 127|15@0+ (0.015625,0) [0|500] "m" ADAS
 SG_ DET_RANGE_ERR_326 : 128|7@0+ (0.0075,0) [0|0.9525] "m" ADAS
 SG_ DET_RANGE_VELOCITY_326 : 137|15@0+ (0.0078125,-128) [-128|127.9921875] "m/s" ADAS
 SG_ DET_RANGE_VELOCITY_ERR_326 : 154|8@0+ (0.003,0) [0|0.765] "m/s" ADAS
 SG_ DET_AZIMUTH_326 : 180|13@0+ (0.0004,-1.5708) [-1.5708|1.5708] "rad" ADAS
 SG_ DET_AZIMUTH_ERR_326 : 198|7@0+ (0.00087267,0) [0|0.11082909] "rad" ADAS
 SG_ DET_ELEVATION_326 : 162|8@0+ (0.00275,-0.34925) [-0.34925|0.34925] "rad" ADAS
 SG_ DET_ELEVATION_ERR_326 : 170|6@0+ (0.00174533,0) [0|0.10995579] "rad" ADAS
 SG_ DET_RCS_326 : 239|8@0+ (0.5,-64) [-64|63.5] "dBsm" ADAS
 SG_ DET_VALID_FLAG_326 : 220|1@0+ (1,0) [0|1] "" ADAS
 SG_ DET_BI_STATIC_FLAG_326 : 486|1@0+ (1,0) [0|1] "" ADAS
 SG_ DET_SUPER_RES_TARGET_326 : 199|1@0+ (1,0) [0|1] "" ADAS
 SG_ DET_SNR_326 : 231|8@0+ (0.35156,0) [0|89.6478] "dB" ADAS
 SG_ DET_POINT_TARGET_PROB_326 : 215|4@0+ (6.67,0) [0|100] "%" ADAS
 SG_ DET_EXISTENCE_PROB_326 : 211|6@0+ (1.588,0) [0|100] "%" ADAS
 SG_ DET_OUTSIDE_SECTOR_326 : 221|1@0+ (1,0) [0|1] "" ADAS
 SG_ DET_HVC_FLAG_326 : 207|1@0+ (1,0) [0|1] "" ADAS
 SG_ DET_CONFD_AZIMUTH_326 : 217|2@0+ (1,0) [0|3] "" ADAS
 SG_ DET_CONFD_ELEVATION_326 : 219|2@0+ (1,0) [0|3] "" ADAS
 SG_ DET_RANGE_327 : 247|15@0+ (0.015625,0) [0|500] "m" ADAS
 SG_ DET_RANGE_ERR_327 : 248|7@0+ (0.0075,0) [0|0.9525] "m" ADAS
 SG_ DET_RANGE_VELOCITY_327 : 257|15@0+ (0.0078125,-128) [-128|127.9921875] "m/s" ADAS
 SG_ DET_RANGE_VELOCITY_ERR_327 : 274|8@0+ (0.003,0) [0|0.765] "m/s" ADAS
 SG_ DET_AZIMUTH_327 : 300|13@0+ (0.0004,-1.5708) [-1.5708|1.5708] "rad" ADAS
 SG_ DET_AZIMUTH_ERR_327 : 318|7@0+ (0.00087267,0) [0|0.11082909] "rad" ADAS
 SG_ DET_ELEVATION_327 : 282|8@0+ (0.00275,-0.34925) [-0.34925|0.34925] "rad" ADAS
 SG_ DET_ELEVATION_ERR_327 : 290|6@0+ (0.00174533,0) [0|0.10995579] "rad" ADAS
 SG_ DET_RCS_327 : 359|8@0+ (0.5,-64) [-64|63.5] "dBsm" ADAS
 SG_ DET_VALID_FLAG_327 : 340|1@0+ (1,0) [0|1] "" ADAS
 SG_ DET_BI_STATIC_FLAG_327 : 485|1@0+ (1,0) [0|1] "" ADAS
 SG_ DET_SUPER_RES_TARGET_327 : 319|1@0+ (1,0) [0|1] "" ADAS
 SG_ DET_SNR_327 : 351|8@0+ (0.35156,0) [0|89.6478] "dB" ADAS
 SG_ DET_POINT_TARGET_PROB_327 : 335|4@0+ (6.67,0) [0|100] "%" ADAS
 SG_ DET_EXISTENCE_PROB_327 : 331|6@0+ (1.588,0) [0|100] "%" ADAS
 SG_ DET_OUTSIDE_SECTOR_327 : 341|1@0+ (1,0) [0|1] "" ADAS
 SG_ DET_HVC_FLAG_327 : 327|1@0+ (1,0) [0|1] "" ADAS
 SG_ DET_CONFD_AZIMUTH_327 : 337|2@0+ (1,0) [0|3] "" ADAS
 SG_ DET_CONFD_ELEVATION_327 : 339|2@0+ (1,0) [0|3] "" ADAS
 SG_ DET_RANGE_328 : 367|15@0+ (0.015625,0) [0|500] "m" ADAS
 SG_ DET_RANGE_ERR_328 : 368|7@0+ (0.0075,0) [0|0.9525] "m" ADAS
 SG_ DET_RANGE_VELOCITY_328 : 377|15@0+ (0.0078125,-128) [-128|127.9921875] "m/s" ADAS
 SG_ DET_RANGE_VELOCITY_ERR_328 : 394|8@0+ (0.003,0) [0|0.765] "m/s" ADAS
 SG_ DET_AZIMUTH_328 : 420|13@0+ (0.0004,-1.5708) [-1.5708|1.5708] "rad" ADAS
 SG_ DET_AZIMUTH_ERR_328 : 438|7@0+ (0.00087267,0) [0|0.11082909] "rad" ADAS
 SG_ DET_ELEVATION_328 : 402|8@0+ (0.00275,-0.34925) [-0.34925|0.34925] "rad" ADAS
 SG_ DET_ELEVATION_ERR_328 : 410|6@0+ (0.00174533,0) [0|0.10995579] "rad" ADAS
 SG_ DET_RCS_328 : 479|8@0+ (0.5,-64) [-64|63.5] "dBsm" ADAS
 SG_ DET_VALID_FLAG_328 : 460|1@0+ (1,0) [0|1] "" ADAS
 SG_ DET_BI_STATIC_FLAG_328 : 484|1@0+ (1,0) [0|1] "" ADAS
 SG_ DET_SUPER_RES_TARGET_328 : 439|1@0+ (1,0) [0|1] "" ADAS
 SG_ DET_SNR_328 : 471|8@0+ (0.35156,0) [0|89.6478] "dB" ADAS
 SG_ DET_POINT_TARGET_PROB_328 : 455|4@0+ (6.67,0) [0|100] "%" ADAS
 SG_ DET_EXISTENCE_PROB_328 : 451|6@0+ (1.588,0) [0|100] "%" ADAS
 SG_ DET_OUTSIDE_SECTOR_328 : 461|1@0+ (1,0) [0|1] "" ADAS
 SG_ DET_HVC_FLAG_328 : 447|1@0+ (1,0) [0|1] "" ADAS
 SG_ DET_CONFD_AZIMUTH_328 : 457|2@0+ (1,0) [0|3] "" ADAS
 SG_ DET_CONFD_ELEVATION_328 : 459|2@0+ (1,0) [0|3] "" ADAS
 SG_ DET_MH_SCAN_INDEX_4LSB_325_328 : 483|4@0+ (1,0) [0|15] "" ADAS
 SG_ DET_MH_CYCLE_COUNTER_325_328 : 495|8@0+ (1,0) [0|255] "" ADAS
 SG_ DET_MH_CRC16_325_328 : 503|16@0+ (1,0) [0|65535] "" ADAS

CM_ SG_ 1216 DET_RANGE_257 " measured position  of the detection";
CM_ SG_ 1216 DET_RANGE_ERR_257 "RMSE or standard deviation of the measured angle  of the detection";
CM_ SG_ 1216 DET_RANGE_VELOCITY_257 "Radial velocity of the detection positive in direction to the sensor";
CM_ SG_ 1216 DET_RANGE_VELOCITY_ERR_257 "RMSE or standard deviation of the measure radial velocity of the detection";
CM_ SG_ 1216 DET_AZIMUTH_257 "Measured angle  of the detection";
CM_ SG_ 1216 DET_AZIMUTH_ERR_257 "RMSE or standard deviation of the measured angle  of the detection";
CM_ SG_ 1216 DET_ELEVATION_257 "measured elevation of the detection";
CM_ SG_ 1216 DET_ELEVATION_ERR_257 "RMSE or standard deviation of the measured elevation  of the detection";
CM_ SG_ 1216 DET_RCS_257 "Radar Cross Section or Amplitude, is a measure of how detectable an object is by radar. A larger RCS indicates that an object is more easily detected.";
CM_ SG_ 1216 DET_VALID_FLAG_257 "is set if the measured detection is valid";
CM_ SG_ 1216 DET_BI_STATIC_FLAG_257 "1 if detection is bi-static 0 otherwise";
CM_ SG_ 1216 DET_SUPER_RES_TARGET_257 "flasg is set if the detection is super resolution target";
CM_ SG_ 1216 DET_SNR_257 "The signal to noise ratio (SNR) of the radar detection";
CM_ SG_ 1216 DET_POINT_TARGET_PROB_257 "Describes the possibility if more than one real-world object has led to this detection. 0[%] := 100[%] Multi target probability";
CM_ SG_ 1216 DET_EXISTENCE_PROB_257 "Existence probability of the detection not based on history. Value does  not depend on any past experience with similar detections.
\note Use as confidence measure where a low value means less confidence
and a high value indicates strong confidence.";
CM_ SG_ 1216 DET_OUTSIDE_SECTOR_257 "Flag to indicate detections outside the sector, set if the wrong sector calibration matrix was used";
CM_ SG_ 1216 DET_HVC_FLAG_257 "Core2 Vehicle clutter flag";
CM_ SG_ 1216 DET_CONFD_AZIMUTH_257 "Define the Confidence of Azimuth for Detection ";
CM_ SG_ 1216 DET_CONFD_ELEVATION_257 "Define the Confidence of Elevation for the Detection ";
CM_ SG_ 1216 DET_BI_STATIC_FLAG_258 "1 if detection is bi-static 0 otherwise";
CM_ SG_ 1216 DET_BI_STATIC_FLAG_259 "1 if detection is bi-static 0 otherwise";
CM_ SG_ 1216 DET_BI_STATIC_FLAG_260 "1 if detection is bi-static 0 otherwise";
CM_ SG_ 1216 DET_MH_SCAN_INDEX_4LSB_257_260 "Scan index of the measured detection";
CM_ SG_ 1216 DET_MH_CYCLE_COUNTER_257_260 "Detection Alive Counter";
CM_ SG_ 1217 DET_RANGE_261 " measured position  of the detection";
CM_ SG_ 1217 DET_RANGE_ERR_261 "RMSE or standard deviation of the measured angle  of the detection";
CM_ SG_ 1217 DET_RANGE_VELOCITY_261 "Radial velocity of the detection positive in direction to the sensor";
CM_ SG_ 1217 DET_RANGE_VELOCITY_ERR_261 "RMSE or standard deviation of the measure radial velocity of the detection";
CM_ SG_ 1217 DET_AZIMUTH_261 "Measured angle  of the detection";
CM_ SG_ 1217 DET_AZIMUTH_ERR_261 "RMSE or standard deviation of the measured angle  of the detection";
CM_ SG_ 1217 DET_ELEVATION_261 "measured elevation of the detection";
CM_ SG_ 1217 DET_ELEVATION_ERR_261 "RMSE or standard deviation of the measured elevation  of the detection";
CM_ SG_ 1217 DET_RCS_261 "Radar Cross Section or Amplitude, is a measure of how detectable an object is by radar. A larger RCS indicates that an object is more easily detected.";
CM_ SG_ 1217 DET_VALID_FLAG_261 "is set if the measured detection is valid";
CM_ SG_ 1217 DET_BI_STATIC_FLAG_261 "1 if detection is bi-static 0 otherwise";
CM_ SG_ 1217 DET_SUPER_RES_TARGET_261 "flasg is set if the detection is super resolution target";
CM_ SG_ 1217 DET_SNR_261 "The signal to noise ratio (SNR) of the radar detection";
CM_ SG_ 1217 DET_POINT_TARGET_PROB_261 "Describes the possibility if more than one real-world object has led to this detection. 0[%] := 100[%] Multi target probability";
CM_ SG_ 1217 DET_EXISTENCE_PROB_261 "Existence probability of the detection not based on history. Value does  not depend on any past experience with similar detections.
\note Use as confidence measure where a low value means less confidence
and a high value indicates strong confidence.";
CM_ SG_ 1217 DET_OUTSIDE_SECTOR_261 "Flag to indicate detections outside the sector, set if the wrong sector calibration matrix was used";
CM_ SG_ 1217 DET_HVC_FLAG_261 "Core2 Vehicle clutter flag";
CM_ SG_ 1217 DET_CONFD_AZIMUTH_261 "Define the Confidence of Azimuth for Detection ";
CM_ SG_ 1217 DET_CONFD_ELEVATION_261 "Define the Confidence of Elevation for the Detection ";
CM_ SG_ 1217 DET_BI_STATIC_FLAG_262 "1 if detection is bi-static 0 otherwise";
CM_ SG_ 1217 DET_BI_STATIC_FLAG_263 "1 if detection is bi-static 0 otherwise";
CM_ SG_ 1217 DET_BI_STATIC_FLAG_264 "1 if detection is bi-static 0 otherwise";
CM_ SG_ 1217 DET_MH_SCAN_INDEX_4LSB_261_264 "Scan index of the measured detection";
CM_ SG_ 1217 DET_MH_CYCLE_COUNTER_261_264 "Detection Alive Counter";
CM_ SG_ 1218 DET_RANGE_265 " measured position  of the detection";
CM_ SG_ 1218 DET_RANGE_ERR_265 "RMSE or standard deviation of the measured angle  of the detection";
CM_ SG_ 1218 DET_RANGE_VELOCITY_265 "Radial velocity of the detection positive in direction to the sensor";
CM_ SG_ 1218 DET_RANGE_VELOCITY_ERR_265 "RMSE or standard deviation of the measure radial velocity of the detection";
CM_ SG_ 1218 DET_AZIMUTH_265 "Measured angle  of the detection";
CM_ SG_ 1218 DET_AZIMUTH_ERR_265 "RMSE or standard deviation of the measured angle  of the detection";
CM_ SG_ 1218 DET_ELEVATION_265 "measured elevation of the detection";
CM_ SG_ 1218 DET_ELEVATION_ERR_265 "RMSE or standard deviation of the measured elevation  of the detection";
CM_ SG_ 1218 DET_RCS_265 "Radar Cross Section or Amplitude, is a measure of how detectable an object is by radar. A larger RCS indicates that an object is more easily detected.";
CM_ SG_ 1218 DET_VALID_FLAG_265 "is set if the measured detection is valid";
CM_ SG_ 1218 DET_BI_STATIC_FLAG_265 "1 if detection is bi-static 0 otherwise";
CM_ SG_ 1218 DET_SUPER_RES_TARGET_265 "flasg is set if the detection is super resolution target";
CM_ SG_ 1218 DET_SNR_265 "The signal to noise ratio (SNR) of the radar detection";
CM_ SG_ 1218 DET_POINT_TARGET_PROB_265 "Describes the possibility if more than one real-world object has led to this detection. 0[%] := 100[%] Multi target probability";
CM_ SG_ 1218 DET_EXISTENCE_PROB_265 "Existence probability of the detection not based on history. Value does  not depend on any past experience with similar detections.
\note Use as confidence measure where a low value means less confidence
and a high value indicates strong confidence.";
CM_ SG_ 1218 DET_OUTSIDE_SECTOR_265 "Flag to indicate detections outside the sector, set if the wrong sector calibration matrix was used";
CM_ SG_ 1218 DET_HVC_FLAG_265 "Core2 Vehicle clutter flag";
CM_ SG_ 1218 DET_CONFD_AZIMUTH_265 "Define the Confidence of Azimuth for Detection ";
CM_ SG_ 1218 DET_CONFD_ELEVATION_265 "Define the Confidence of Elevation for the Detection ";
CM_ SG_ 1218 DET_BI_STATIC_FLAG_266 "1 if detection is bi-static 0 otherwise";
CM_ SG_ 1218 DET_BI_STATIC_FLAG_267 "1 if detection is bi-static 0 otherwise";
CM_ SG_ 1218 DET_BI_STATIC_FLAG_268 "1 if detection is bi-static 0 otherwise";
CM_ SG_ 1218 DET_MH_SCAN_INDEX_4LSB_265_268 "Scan index of the measured detection";
CM_ SG_ 1218 DET_MH_CYCLE_COUNTER_265_268 "Detection Alive Counter";
CM_ SG_ 1219 DET_RANGE_269 " measured position  of the detection";
CM_ SG_ 1219 DET_RANGE_ERR_269 "RMSE or standard deviation of the measured angle  of the detection";
CM_ SG_ 1219 DET_RANGE_VELOCITY_269 "Radial velocity of the detection positive in direction to the sensor";
CM_ SG_ 1219 DET_RANGE_VELOCITY_ERR_269 "RMSE or standard deviation of the measure radial velocity of the detection";
CM_ SG_ 1219 DET_AZIMUTH_269 "Measured angle  of the detection";
CM_ SG_ 1219 DET_AZIMUTH_ERR_269 "RMSE or standard deviation of the measured angle  of the detection";
CM_ SG_ 1219 DET_ELEVATION_269 "measured elevation of the detection";
CM_ SG_ 1219 DET_ELEVATION_ERR_269 "RMSE or standard deviation of the measured elevation  of the detection";
CM_ SG_ 1219 DET_RCS_269 "Radar Cross Section or Amplitude, is a measure of how detectable an object is by radar. A larger RCS indicates that an object is more easily detected.";
CM_ SG_ 1219 DET_VALID_FLAG_269 "is set if the measured detection is valid";
CM_ SG_ 1219 DET_BI_STATIC_FLAG_269 "1 if detection is bi-static 0 otherwise";
CM_ SG_ 1219 DET_SUPER_RES_TARGET_269 "flasg is set if the detection is super resolution target";
CM_ SG_ 1219 DET_SNR_269 "The signal to noise ratio (SNR) of the radar detection";
CM_ SG_ 1219 DET_POINT_TARGET_PROB_269 "Describes the possibility if more than one real-world object has led to this detection. 0[%] := 100[%] Multi target probability";
CM_ SG_ 1219 DET_EXISTENCE_PROB_269 "Existence probability of the detection not based on history. Value does  not depend on any past experience with similar detections.
\note Use as confidence measure where a low value means less confidence
and a high value indicates strong confidence.";
CM_ SG_ 1219 DET_OUTSIDE_SECTOR_269 "Flag to indicate detections outside the sector, set if the wrong sector calibration matrix was used";
CM_ SG_ 1219 DET_HVC_FLAG_269 "Core2 Vehicle clutter flag";
CM_ SG_ 1219 DET_CONFD_AZIMUTH_269 "Define the Confidence of Azimuth for Detection ";
CM_ SG_ 1219 DET_CONFD_ELEVATION_269 "Define the Confidence of Elevation for the Detection ";
CM_ SG_ 1219 DET_BI_STATIC_FLAG_270 "1 if detection is bi-static 0 otherwise";
CM_ SG_ 1219 DET_BI_STATIC_FLAG_271 "1 if detection is bi-static 0 otherwise";
CM_ SG_ 1219 DET_BI_STATIC_FLAG_272 "1 if detection is bi-static 0 otherwise";
CM_ SG_ 1219 DET_MH_SCAN_INDEX_4LSB_269_272 "Scan index of the measured detection";
CM_ SG_ 1219 DET_MH_CYCLE_COUNTER_269_272 "Detection Alive Counter";
CM_ SG_ 1220 DET_RANGE_273 " measured position  of the detection";
CM_ SG_ 1220 DET_RANGE_ERR_273 "RMSE or standard deviation of the measured angle  of the detection";
CM_ SG_ 1220 DET_RANGE_VELOCITY_273 "Radial velocity of the detection positive in direction to the sensor";
CM_ SG_ 1220 DET_RANGE_VELOCITY_ERR_273 "RMSE or standard deviation of the measure radial velocity of the detection";
CM_ SG_ 1220 DET_AZIMUTH_273 "Measured angle  of the detection";
CM_ SG_ 1220 DET_AZIMUTH_ERR_273 "RMSE or standard deviation of the measured angle  of the detection";
CM_ SG_ 1220 DET_ELEVATION_273 "measured elevation of the detection";
CM_ SG_ 1220 DET_ELEVATION_ERR_273 "RMSE or standard deviation of the measured elevation  of the detection";
CM_ SG_ 1220 DET_RCS_273 "Radar Cross Section or Amplitude, is a measure of how detectable an object is by radar. A larger RCS indicates that an object is more easily detected.";
CM_ SG_ 1220 DET_VALID_FLAG_273 "is set if the measured detection is valid";
CM_ SG_ 1220 DET_BI_STATIC_FLAG_273 "1 if detection is bi-static 0 otherwise";
CM_ SG_ 1220 DET_SUPER_RES_TARGET_273 "flasg is set if the detection is super resolution target";
CM_ SG_ 1220 DET_SNR_273 "The signal to noise ratio (SNR) of the radar detection";
CM_ SG_ 1220 DET_POINT_TARGET_PROB_273 "Describes the possibility if more than one real-world object has led to this detection. 0[%] := 100[%] Multi target probability";
CM_ SG_ 1220 DET_EXISTENCE_PROB_273 "Existence probability of the detection not based on history. Value does  not depend on any past experience with similar detections.
\note Use as confidence measure where a low value means less confidence
and a high value indicates strong confidence.";
CM_ SG_ 1220 DET_OUTSIDE_SECTOR_273 "Flag to indicate detections outside the sector, set if the wrong sector calibration matrix was used";
CM_ SG_ 1220 DET_HVC_FLAG_273 "Core2 Vehicle clutter flag";
CM_ SG_ 1220 DET_CONFD_AZIMUTH_273 "Define the Confidence of Azimuth for Detection ";
CM_ SG_ 1220 DET_CONFD_ELEVATION_273 "Define the Confidence of Elevation for the Detection ";
CM_ SG_ 1220 DET_BI_STATIC_FLAG_274 "1 if detection is bi-static 0 otherwise";
CM_ SG_ 1220 DET_BI_STATIC_FLAG_275 "1 if detection is bi-static 0 otherwise";
CM_ SG_ 1220 DET_BI_STATIC_FLAG_276 "1 if detection is bi-static 0 otherwise";
CM_ SG_ 1220 DET_MH_SCAN_INDEX_4LSB_273_276 "Scan index of the measured detection";
CM_ SG_ 1220 DET_MH_CYCLE_COUNTER_273_276 "Detection Alive Counter";
CM_ SG_ 1221 DET_RANGE_277 " measured position  of the detection";
CM_ SG_ 1221 DET_RANGE_ERR_277 "RMSE or standard deviation of the measured angle  of the detection";
CM_ SG_ 1221 DET_RANGE_VELOCITY_277 "Radial velocity of the detection positive in direction to the sensor";
CM_ SG_ 1221 DET_RANGE_VELOCITY_ERR_277 "RMSE or standard deviation of the measure radial velocity of the detection";
CM_ SG_ 1221 DET_AZIMUTH_277 "Measured angle  of the detection";
CM_ SG_ 1221 DET_AZIMUTH_ERR_277 "RMSE or standard deviation of the measured angle  of the detection";
CM_ SG_ 1221 DET_ELEVATION_277 "measured elevation of the detection";
CM_ SG_ 1221 DET_ELEVATION_ERR_277 "RMSE or standard deviation of the measured elevation  of the detection";
CM_ SG_ 1221 DET_RCS_277 "Radar Cross Section or Amplitude, is a measure of how detectable an object is by radar. A larger RCS indicates that an object is more easily detected.";
CM_ SG_ 1221 DET_VALID_FLAG_277 "is set if the measured detection is valid";
CM_ SG_ 1221 DET_BI_STATIC_FLAG_277 "1 if detection is bi-static 0 otherwise";
CM_ SG_ 1221 DET_SUPER_RES_TARGET_277 "flasg is set if the detection is super resolution target";
CM_ SG_ 1221 DET_SNR_277 "The signal to noise ratio (SNR) of the radar detection";
CM_ SG_ 1221 DET_POINT_TARGET_PROB_277 "Describes the possibility if more than one real-world object has led to this detection. 0[%] := 100[%] Multi target probability";
CM_ SG_ 1221 DET_EXISTENCE_PROB_277 "Existence probability of the detection not based on history. Value does  not depend on any past experience with similar detections.
\note Use as confidence measure where a low value means less confidence
and a high value indicates strong confidence.";
CM_ SG_ 1221 DET_OUTSIDE_SECTOR_277 "Flag to indicate detections outside the sector, set if the wrong sector calibration matrix was used";
CM_ SG_ 1221 DET_HVC_FLAG_277 "Core2 Vehicle clutter flag";
CM_ SG_ 1221 DET_CONFD_AZIMUTH_277 "Define the Confidence of Azimuth for Detection ";
CM_ SG_ 1221 DET_CONFD_ELEVATION_277 "Define the Confidence of Elevation for the Detection ";
CM_ SG_ 1221 DET_BI_STATIC_FLAG_278 "1 if detection is bi-static 0 otherwise";
CM_ SG_ 1221 DET_BI_STATIC_FLAG_279 "1 if detection is bi-static 0 otherwise";
CM_ SG_ 1221 DET_BI_STATIC_FLAG_280 "1 if detection is bi-static 0 otherwise";
CM_ SG_ 1221 DET_MH_SCAN_INDEX_4LSB_277_280 "Scan index of the measured detection";
CM_ SG_ 1221 DET_MH_CYCLE_COUNTER_277_280 "Detection Alive Counter";
CM_ SG_ 1222 DET_RANGE_281 " measured position  of the detection";
CM_ SG_ 1222 DET_RANGE_ERR_281 "RMSE or standard deviation of the measured angle  of the detection";
CM_ SG_ 1222 DET_RANGE_VELOCITY_281 "Radial velocity of the detection positive in direction to the sensor";
CM_ SG_ 1222 DET_RANGE_VELOCITY_ERR_281 "RMSE or standard deviation of the measure radial velocity of the detection";
CM_ SG_ 1222 DET_AZIMUTH_281 "Measured angle  of the detection";
CM_ SG_ 1222 DET_AZIMUTH_ERR_281 "RMSE or standard deviation of the measured angle  of the detection";
CM_ SG_ 1222 DET_ELEVATION_281 "measured elevation of the detection";
CM_ SG_ 1222 DET_ELEVATION_ERR_281 "RMSE or standard deviation of the measured elevation  of the detection";
CM_ SG_ 1222 DET_RCS_281 "Radar Cross Section or Amplitude, is a measure of how detectable an object is by radar. A larger RCS indicates that an object is more easily detected.";
CM_ SG_ 1222 DET_VALID_FLAG_281 "is set if the measured detection is valid";
CM_ SG_ 1222 DET_BI_STATIC_FLAG_281 "1 if detection is bi-static 0 otherwise";
CM_ SG_ 1222 DET_SUPER_RES_TARGET_281 "flasg is set if the detection is super resolution target";
CM_ SG_ 1222 DET_SNR_281 "The signal to noise ratio (SNR) of the radar detection";
CM_ SG_ 1222 DET_POINT_TARGET_PROB_281 "Describes the possibility if more than one real-world object has led to this detection. 0[%] := 100[%] Multi target probability";
CM_ SG_ 1222 DET_EXISTENCE_PROB_281 "Existence probability of the detection not based on history. Value does  not depend on any past experience with similar detections.
\note Use as confidence measure where a low value means less confidence
and a high value indicates strong confidence.";
CM_ SG_ 1222 DET_OUTSIDE_SECTOR_281 "Flag to indicate detections outside the sector, set if the wrong sector calibration matrix was used";
CM_ SG_ 1222 DET_HVC_FLAG_281 "Core2 Vehicle clutter flag";
CM_ SG_ 1222 DET_CONFD_AZIMUTH_281 "Define the Confidence of Azimuth for Detection ";
CM_ SG_ 1222 DET_CONFD_ELEVATION_281 "Define the Confidence of Elevation for the Detection ";
CM_ SG_ 1222 DET_BI_STATIC_FLAG_282 "1 if detection is bi-static 0 otherwise";
CM_ SG_ 1222 DET_BI_STATIC_FLAG_283 "1 if detection is bi-static 0 otherwise";
CM_ SG_ 1222 DET_BI_STATIC_FLAG_284 "1 if detection is bi-static 0 otherwise";
CM_ SG_ 1222 DET_MH_SCAN_INDEX_4LSB_281_284 "Scan index of the measured detection";
CM_ SG_ 1222 DET_MH_CYCLE_COUNTER_281_284 "Detection Alive Counter";
CM_ SG_ 1223 DET_RANGE_285 " measured position  of the detection";
CM_ SG_ 1223 DET_RANGE_ERR_285 "RMSE or standard deviation of the measured angle  of the detection";
CM_ SG_ 1223 DET_RANGE_VELOCITY_285 "Radial velocity of the detection positive in direction to the sensor";
CM_ SG_ 1223 DET_RANGE_VELOCITY_ERR_285 "RMSE or standard deviation of the measure radial velocity of the detection";
CM_ SG_ 1223 DET_AZIMUTH_285 "Measured angle  of the detection";
CM_ SG_ 1223 DET_AZIMUTH_ERR_285 "RMSE or standard deviation of the measured angle  of the detection";
CM_ SG_ 1223 DET_ELEVATION_285 "measured elevation of the detection";
CM_ SG_ 1223 DET_ELEVATION_ERR_285 "RMSE or standard deviation of the measured elevation  of the detection";
CM_ SG_ 1223 DET_RCS_285 "Radar Cross Section or Amplitude, is a measure of how detectable an object is by radar. A larger RCS indicates that an object is more easily detected.";
CM_ SG_ 1223 DET_VALID_FLAG_285 "is set if the measured detection is valid";
CM_ SG_ 1223 DET_BI_STATIC_FLAG_285 "1 if detection is bi-static 0 otherwise";
CM_ SG_ 1223 DET_SUPER_RES_TARGET_285 "flasg is set if the detection is super resolution target";
CM_ SG_ 1223 DET_SNR_285 "The signal to noise ratio (SNR) of the radar detection";
CM_ SG_ 1223 DET_POINT_TARGET_PROB_285 "Describes the possibility if more than one real-world object has led to this detection. 0[%] := 100[%] Multi target probability";
CM_ SG_ 1223 DET_EXISTENCE_PROB_285 "Existence probability of the detection not based on history. Value does  not depend on any past experience with similar detections.
\note Use as confidence measure where a low value means less confidence
and a high value indicates strong confidence.";
CM_ SG_ 1223 DET_OUTSIDE_SECTOR_285 "Flag to indicate detections outside the sector, set if the wrong sector calibration matrix was used";
CM_ SG_ 1223 DET_HVC_FLAG_285 "Core2 Vehicle clutter flag";
CM_ SG_ 1223 DET_CONFD_AZIMUTH_285 "Define the Confidence of Azimuth for Detection ";
CM_ SG_ 1223 DET_CONFD_ELEVATION_285 "Define the Confidence of Elevation for the Detection ";
CM_ SG_ 1223 DET_BI_STATIC_FLAG_286 "1 if detection is bi-static 0 otherwise";
CM_ SG_ 1223 DET_BI_STATIC_FLAG_287 "1 if detection is bi-static 0 otherwise";
CM_ SG_ 1223 DET_BI_STATIC_FLAG_288 "1 if detection is bi-static 0 otherwise";
CM_ SG_ 1223 DET_MH_SCAN_INDEX_4LSB_285_288 "Scan index of the measured detection";
CM_ SG_ 1223 DET_MH_CYCLE_COUNTER_285_288 "Detection Alive Counter";
CM_ SG_ 1224 DET_RANGE_289 " measured position  of the detection";
CM_ SG_ 1224 DET_RANGE_ERR_289 "RMSE or standard deviation of the measured angle  of the detection";
CM_ SG_ 1224 DET_RANGE_VELOCITY_289 "Radial velocity of the detection positive in direction to the sensor";
CM_ SG_ 1224 DET_RANGE_VELOCITY_ERR_289 "RMSE or standard deviation of the measure radial velocity of the detection";
CM_ SG_ 1224 DET_AZIMUTH_289 "Measured angle  of the detection";
CM_ SG_ 1224 DET_AZIMUTH_ERR_289 "RMSE or standard deviation of the measured angle  of the detection";
CM_ SG_ 1224 DET_ELEVATION_289 "measured elevation of the detection";
CM_ SG_ 1224 DET_ELEVATION_ERR_289 "RMSE or standard deviation of the measured elevation  of the detection";
CM_ SG_ 1224 DET_RCS_289 "Radar Cross Section or Amplitude, is a measure of how detectable an object is by radar. A larger RCS indicates that an object is more easily detected.";
CM_ SG_ 1224 DET_VALID_FLAG_289 "is set if the measured detection is valid";
CM_ SG_ 1224 DET_BI_STATIC_FLAG_289 "1 if detection is bi-static 0 otherwise";
CM_ SG_ 1224 DET_SUPER_RES_TARGET_289 "flasg is set if the detection is super resolution target";
CM_ SG_ 1224 DET_SNR_289 "The signal to noise ratio (SNR) of the radar detection";
CM_ SG_ 1224 DET_POINT_TARGET_PROB_289 "Describes the possibility if more than one real-world object has led to this detection. 0[%] := 100[%] Multi target probability";
CM_ SG_ 1224 DET_EXISTENCE_PROB_289 "Existence probability of the detection not based on history. Value does  not depend on any past experience with similar detections.
\note Use as confidence measure where a low value means less confidence
and a high value indicates strong confidence.";
CM_ SG_ 1224 DET_OUTSIDE_SECTOR_289 "Flag to indicate detections outside the sector, set if the wrong sector calibration matrix was used";
CM_ SG_ 1224 DET_HVC_FLAG_289 "Core2 Vehicle clutter flag";
CM_ SG_ 1224 DET_CONFD_AZIMUTH_289 "Define the Confidence of Azimuth for Detection ";
CM_ SG_ 1224 DET_CONFD_ELEVATION_289 "Define the Confidence of Elevation for the Detection ";
CM_ SG_ 1224 DET_BI_STATIC_FLAG_290 "1 if detection is bi-static 0 otherwise";
CM_ SG_ 1224 DET_BI_STATIC_FLAG_291 "1 if detection is bi-static 0 otherwise";
CM_ SG_ 1224 DET_BI_STATIC_FLAG_292 "1 if detection is bi-static 0 otherwise";
CM_ SG_ 1224 DET_MH_SCAN_INDEX_4LSB_289_292 "Scan index of the measured detection";
CM_ SG_ 1224 DET_MH_CYCLE_COUNTER_289_292 "Detection Alive Counter";
CM_ SG_ 1225 DET_RANGE_293 " measured position  of the detection";
CM_ SG_ 1225 DET_RANGE_ERR_293 "RMSE or standard deviation of the measured angle  of the detection";
CM_ SG_ 1225 DET_RANGE_VELOCITY_293 "Radial velocity of the detection positive in direction to the sensor";
CM_ SG_ 1225 DET_RANGE_VELOCITY_ERR_293 "RMSE or standard deviation of the measure radial velocity of the detection";
CM_ SG_ 1225 DET_AZIMUTH_293 "Measured angle  of the detection";
CM_ SG_ 1225 DET_AZIMUTH_ERR_293 "RMSE or standard deviation of the measured angle  of the detection";
CM_ SG_ 1225 DET_ELEVATION_293 "measured elevation of the detection";
CM_ SG_ 1225 DET_ELEVATION_ERR_293 "RMSE or standard deviation of the measured elevation  of the detection";
CM_ SG_ 1225 DET_RCS_293 "Radar Cross Section or Amplitude, is a measure of how detectable an object is by radar. A larger RCS indicates that an object is more easily detected.";
CM_ SG_ 1225 DET_VALID_FLAG_293 "is set if the measured detection is valid";
CM_ SG_ 1225 DET_BI_STATIC_FLAG_293 "1 if detection is bi-static 0 otherwise";
CM_ SG_ 1225 DET_SUPER_RES_TARGET_293 "flasg is set if the detection is super resolution target";
CM_ SG_ 1225 DET_SNR_293 "The signal to noise ratio (SNR) of the radar detection";
CM_ SG_ 1225 DET_POINT_TARGET_PROB_293 "Describes the possibility if more than one real-world object has led to this detection. 0[%] := 100[%] Multi target probability";
CM_ SG_ 1225 DET_EXISTENCE_PROB_293 "Existence probability of the detection not based on history. Value does  not depend on any past experience with similar detections.
\note Use as confidence measure where a low value means less confidence
and a high value indicates strong confidence.";
CM_ SG_ 1225 DET_OUTSIDE_SECTOR_293 "Flag to indicate detections outside the sector, set if the wrong sector calibration matrix was used";
CM_ SG_ 1225 DET_HVC_FLAG_293 "Core2 Vehicle clutter flag";
CM_ SG_ 1225 DET_CONFD_AZIMUTH_293 "Define the Confidence of Azimuth for Detection ";
CM_ SG_ 1225 DET_CONFD_ELEVATION_293 "Define the Confidence of Elevation for the Detection ";
CM_ SG_ 1225 DET_BI_STATIC_FLAG_294 "1 if detection is bi-static 0 otherwise";
CM_ SG_ 1225 DET_BI_STATIC_FLAG_295 "1 if detection is bi-static 0 otherwise";
CM_ SG_ 1225 DET_BI_STATIC_FLAG_296 "1 if detection is bi-static 0 otherwise";
CM_ SG_ 1225 DET_MH_SCAN_INDEX_4LSB_293_296 "Scan index of the measured detection";
CM_ SG_ 1225 DET_MH_CYCLE_COUNTER_293_296 "Detection Alive Counter";
CM_ SG_ 1226 DET_RANGE_297 " measured position  of the detection";
CM_ SG_ 1226 DET_RANGE_ERR_297 "RMSE or standard deviation of the measured angle  of the detection";
CM_ SG_ 1226 DET_RANGE_VELOCITY_297 "Radial velocity of the detection positive in direction to the sensor";
CM_ SG_ 1226 DET_RANGE_VELOCITY_ERR_297 "RMSE or standard deviation of the measure radial velocity of the detection";
CM_ SG_ 1226 DET_AZIMUTH_297 "Measured angle  of the detection";
CM_ SG_ 1226 DET_AZIMUTH_ERR_297 "RMSE or standard deviation of the measured angle  of the detection";
CM_ SG_ 1226 DET_ELEVATION_297 "measured elevation of the detection";
CM_ SG_ 1226 DET_ELEVATION_ERR_297 "RMSE or standard deviation of the measured elevation  of the detection";
CM_ SG_ 1226 DET_RCS_297 "Radar Cross Section or Amplitude, is a measure of how detectable an object is by radar. A larger RCS indicates that an object is more easily detected.";
CM_ SG_ 1226 DET_VALID_FLAG_297 "is set if the measured detection is valid";
CM_ SG_ 1226 DET_BI_STATIC_FLAG_297 "1 if detection is bi-static 0 otherwise";
CM_ SG_ 1226 DET_SUPER_RES_TARGET_297 "flasg is set if the detection is super resolution target";
CM_ SG_ 1226 DET_SNR_297 "The signal to noise ratio (SNR) of the radar detection";
CM_ SG_ 1226 DET_POINT_TARGET_PROB_297 "Describes the possibility if more than one real-world object has led to this detection. 0[%] := 100[%] Multi target probability";
CM_ SG_ 1226 DET_EXISTENCE_PROB_297 "Existence probability of the detection not based on history. Value does  not depend on any past experience with similar detections.
\note Use as confidence measure where a low value means less confidence
and a high value indicates strong confidence.";
CM_ SG_ 1226 DET_OUTSIDE_SECTOR_297 "Flag to indicate detections outside the sector, set if the wrong sector calibration matrix was used";
CM_ SG_ 1226 DET_HVC_FLAG_297 "Core2 Vehicle clutter flag";
CM_ SG_ 1226 DET_CONFD_AZIMUTH_297 "Define the Confidence of Azimuth for Detection ";
CM_ SG_ 1226 DET_CONFD_ELEVATION_297 "Define the Confidence of Elevation for the Detection ";
CM_ SG_ 1226 DET_BI_STATIC_FLAG_298 "1 if detection is bi-static 0 otherwise";
CM_ SG_ 1226 DET_BI_STATIC_FLAG_299 "1 if detection is bi-static 0 otherwise";
CM_ SG_ 1226 DET_BI_STATIC_FLAG_300 "1 if detection is bi-static 0 otherwise";
CM_ SG_ 1226 DET_MH_SCAN_INDEX_4LSB_297_300 "Scan index of the measured detection";
CM_ SG_ 1226 DET_MH_CYCLE_COUNTER_297_300 "Detection Alive Counter";
CM_ SG_ 1227 DET_RANGE_301 " measured position  of the detection";
CM_ SG_ 1227 DET_RANGE_ERR_301 "RMSE or standard deviation of the measured angle  of the detection";
CM_ SG_ 1227 DET_RANGE_VELOCITY_301 "Radial velocity of the detection positive in direction to the sensor";
CM_ SG_ 1227 DET_RANGE_VELOCITY_ERR_301 "RMSE or standard deviation of the measure radial velocity of the detection";
CM_ SG_ 1227 DET_AZIMUTH_301 "Measured angle  of the detection";
CM_ SG_ 1227 DET_AZIMUTH_ERR_301 "RMSE or standard deviation of the measured angle  of the detection";
CM_ SG_ 1227 DET_ELEVATION_301 "measured elevation of the detection";
CM_ SG_ 1227 DET_ELEVATION_ERR_301 "RMSE or standard deviation of the measured elevation  of the detection";
CM_ SG_ 1227 DET_RCS_301 "Radar Cross Section or Amplitude, is a measure of how detectable an object is by radar. A larger RCS indicates that an object is more easily detected.";
CM_ SG_ 1227 DET_VALID_FLAG_301 "is set if the measured detection is valid";
CM_ SG_ 1227 DET_BI_STATIC_FLAG_301 "1 if detection is bi-static 0 otherwise";
CM_ SG_ 1227 DET_SUPER_RES_TARGET_301 "flasg is set if the detection is super resolution target";
CM_ SG_ 1227 DET_SNR_301 "The signal to noise ratio (SNR) of the radar detection";
CM_ SG_ 1227 DET_POINT_TARGET_PROB_301 "Describes the possibility if more than one real-world object has led to this detection. 0[%] := 100[%] Multi target probability";
CM_ SG_ 1227 DET_EXISTENCE_PROB_301 "Existence probability of the detection not based on history. Value does  not depend on any past experience with similar detections.
\note Use as confidence measure where a low value means less confidence
and a high value indicates strong confidence.";
CM_ SG_ 1227 DET_OUTSIDE_SECTOR_301 "Flag to indicate detections outside the sector, set if the wrong sector calibration matrix was used";
CM_ SG_ 1227 DET_HVC_FLAG_301 "Core2 Vehicle clutter flag";
CM_ SG_ 1227 DET_CONFD_AZIMUTH_301 "Define the Confidence of Azimuth for Detection ";
CM_ SG_ 1227 DET_CONFD_ELEVATION_301 "Define the Confidence of Elevation for the Detection ";
CM_ SG_ 1227 DET_BI_STATIC_FLAG_302 "1 if detection is bi-static 0 otherwise";
CM_ SG_ 1227 DET_BI_STATIC_FLAG_303 "1 if detection is bi-static 0 otherwise";
CM_ SG_ 1227 DET_BI_STATIC_FLAG_304 "1 if detection is bi-static 0 otherwise";
CM_ SG_ 1227 DET_MH_SCAN_INDEX_4LSB_301_304 "Scan index of the measured detection";
CM_ SG_ 1227 DET_MH_CYCLE_COUNTER_301_304 "Detection Alive Counter";
CM_ SG_ 1228 DET_RANGE_305 " measured position  of the detection";
CM_ SG_ 1228 DET_RANGE_ERR_305 "RMSE or standard deviation of the measured angle  of the detection";
CM_ SG_ 1228 DET_RANGE_VELOCITY_305 "Radial velocity of the detection positive in direction to the sensor";
CM_ SG_ 1228 DET_RANGE_VELOCITY_ERR_305 "RMSE or standard deviation of the measure radial velocity of the detection";
CM_ SG_ 1228 DET_AZIMUTH_305 "Measured angle  of the detection";
CM_ SG_ 1228 DET_AZIMUTH_ERR_305 "RMSE or standard deviation of the measured angle  of the detection";
CM_ SG_ 1228 DET_ELEVATION_305 "measured elevation of the detection";
CM_ SG_ 1228 DET_ELEVATION_ERR_305 "RMSE or standard deviation of the measured elevation  of the detection";
CM_ SG_ 1228 DET_RCS_305 "Radar Cross Section or Amplitude, is a measure of how detectable an object is by radar. A larger RCS indicates that an object is more easily detected.";
CM_ SG_ 1228 DET_VALID_FLAG_305 "is set if the measured detection is valid";
CM_ SG_ 1228 DET_BI_STATIC_FLAG_305 "1 if detection is bi-static 0 otherwise";
CM_ SG_ 1228 DET_SUPER_RES_TARGET_305 "flasg is set if the detection is super resolution target";
CM_ SG_ 1228 DET_SNR_305 "The signal to noise ratio (SNR) of the radar detection";
CM_ SG_ 1228 DET_POINT_TARGET_PROB_305 "Describes the possibility if more than one real-world object has led to this detection. 0[%] := 100[%] Multi target probability";
CM_ SG_ 1228 DET_EXISTENCE_PROB_305 "Existence probability of the detection not based on history. Value does  not depend on any past experience with similar detections.
\note Use as confidence measure where a low value means less confidence
and a high value indicates strong confidence.";
CM_ SG_ 1228 DET_OUTSIDE_SECTOR_305 "Flag to indicate detections outside the sector, set if the wrong sector calibration matrix was used";
CM_ SG_ 1228 DET_HVC_FLAG_305 "Core2 Vehicle clutter flag";
CM_ SG_ 1228 DET_CONFD_AZIMUTH_305 "Define the Confidence of Azimuth for Detection ";
CM_ SG_ 1228 DET_CONFD_ELEVATION_305 "Define the Confidence of Elevation for the Detection ";
CM_ SG_ 1228 DET_BI_STATIC_FLAG_306 "1 if detection is bi-static 0 otherwise";
CM_ SG_ 1228 DET_BI_STATIC_FLAG_307 "1 if detection is bi-static 0 otherwise";
CM_ SG_ 1228 DET_BI_STATIC_FLAG_308 "1 if detection is bi-static 0 otherwise";
CM_ SG_ 1228 DET_MH_SCAN_INDEX_4LSB_305_308 "Scan index of the measured detection";
CM_ SG_ 1228 DET_MH_CYCLE_COUNTER_305_308 "Detection Alive Counter";
CM_ SG_ 1229 DET_RANGE_309 " measured position  of the detection";
CM_ SG_ 1229 DET_RANGE_ERR_309 "RMSE or standard deviation of the measured angle  of the detection";
CM_ SG_ 1229 DET_RANGE_VELOCITY_309 "Radial velocity of the detection positive in direction to the sensor";
CM_ SG_ 1229 DET_RANGE_VELOCITY_ERR_309 "RMSE or standard deviation of the measure radial velocity of the detection";
CM_ SG_ 1229 DET_AZIMUTH_309 "Measured angle  of the detection";
CM_ SG_ 1229 DET_AZIMUTH_ERR_309 "RMSE or standard deviation of the measured angle  of the detection";
CM_ SG_ 1229 DET_ELEVATION_309 "measured elevation of the detection";
CM_ SG_ 1229 DET_ELEVATION_ERR_309 "RMSE or standard deviation of the measured elevation  of the detection";
CM_ SG_ 1229 DET_RCS_309 "Radar Cross Section or Amplitude, is a measure of how detectable an object is by radar. A larger RCS indicates that an object is more easily detected.";
CM_ SG_ 1229 DET_VALID_FLAG_309 "is set if the measured detection is valid";
CM_ SG_ 1229 DET_BI_STATIC_FLAG_309 "1 if detection is bi-static 0 otherwise";
CM_ SG_ 1229 DET_SUPER_RES_TARGET_309 "flasg is set if the detection is super resolution target";
CM_ SG_ 1229 DET_SNR_309 "The signal to noise ratio (SNR) of the radar detection";
CM_ SG_ 1229 DET_POINT_TARGET_PROB_309 "Describes the possibility if more than one real-world object has led to this detection. 0[%] := 100[%] Multi target probability";
CM_ SG_ 1229 DET_EXISTENCE_PROB_309 "Existence probability of the detection not based on history. Value does  not depend on any past experience with similar detections.
\note Use as confidence measure where a low value means less confidence
and a high value indicates strong confidence.";
CM_ SG_ 1229 DET_OUTSIDE_SECTOR_309 "Flag to indicate detections outside the sector, set if the wrong sector calibration matrix was used";
CM_ SG_ 1229 DET_HVC_FLAG_309 "Core2 Vehicle clutter flag";
CM_ SG_ 1229 DET_CONFD_AZIMUTH_309 "Define the Confidence of Azimuth for Detection ";
CM_ SG_ 1229 DET_CONFD_ELEVATION_309 "Define the Confidence of Elevation for the Detection ";
CM_ SG_ 1229 DET_BI_STATIC_FLAG_310 "1 if detection is bi-static 0 otherwise";
CM_ SG_ 1229 DET_BI_STATIC_FLAG_311 "1 if detection is bi-static 0 otherwise";
CM_ SG_ 1229 DET_BI_STATIC_FLAG_312 "1 if detection is bi-static 0 otherwise";
CM_ SG_ 1229 DET_MH_SCAN_INDEX_4LSB_309_312 "Scan index of the measured detection";
CM_ SG_ 1229 DET_MH_CYCLE_COUNTER_309_312 "Detection Alive Counter";
CM_ SG_ 1230 DET_RANGE_313 " measured position  of the detection";
CM_ SG_ 1230 DET_RANGE_ERR_313 "RMSE or standard deviation of the measured angle  of the detection";
CM_ SG_ 1230 DET_RANGE_VELOCITY_313 "Radial velocity of the detection positive in direction to the sensor";
CM_ SG_ 1230 DET_RANGE_VELOCITY_ERR_313 "RMSE or standard deviation of the measure radial velocity of the detection";
CM_ SG_ 1230 DET_AZIMUTH_313 "Measured angle  of the detection";
CM_ SG_ 1230 DET_AZIMUTH_ERR_313 "RMSE or standard deviation of the measured angle  of the detection";
CM_ SG_ 1230 DET_ELEVATION_313 "measured elevation of the detection";
CM_ SG_ 1230 DET_ELEVATION_ERR_313 "RMSE or standard deviation of the measured elevation  of the detection";
CM_ SG_ 1230 DET_RCS_313 "Radar Cross Section or Amplitude, is a measure of how detectable an object is by radar. A larger RCS indicates that an object is more easily detected.";
CM_ SG_ 1230 DET_VALID_FLAG_313 "is set if the measured detection is valid";
CM_ SG_ 1230 DET_BI_STATIC_FLAG_313 "1 if detection is bi-static 0 otherwise";
CM_ SG_ 1230 DET_SUPER_RES_TARGET_313 "flasg is set if the detection is super resolution target";
CM_ SG_ 1230 DET_SNR_313 "The signal to noise ratio (SNR) of the radar detection";
CM_ SG_ 1230 DET_POINT_TARGET_PROB_313 "Describes the possibility if more than one real-world object has led to this detection. 0[%] := 100[%] Multi target probability";
CM_ SG_ 1230 DET_EXISTENCE_PROB_313 "Existence probability of the detection not based on history. Value does  not depend on any past experience with similar detections.
\note Use as confidence measure where a low value means less confidence
and a high value indicates strong confidence.";
CM_ SG_ 1230 DET_OUTSIDE_SECTOR_313 "Flag to indicate detections outside the sector, set if the wrong sector calibration matrix was used";
CM_ SG_ 1230 DET_HVC_FLAG_313 "Core2 Vehicle clutter flag";
CM_ SG_ 1230 DET_CONFD_AZIMUTH_313 "Define the Confidence of Azimuth for Detection ";
CM_ SG_ 1230 DET_CONFD_ELEVATION_313 "Define the Confidence of Elevation for the Detection ";
CM_ SG_ 1230 DET_BI_STATIC_FLAG_314 "1 if detection is bi-static 0 otherwise";
CM_ SG_ 1230 DET_BI_STATIC_FLAG_315 "1 if detection is bi-static 0 otherwise";
CM_ SG_ 1230 DET_BI_STATIC_FLAG_316 "1 if detection is bi-static 0 otherwise";
CM_ SG_ 1230 DET_MH_SCAN_INDEX_4LSB_313_316 "Scan index of the measured detection";
CM_ SG_ 1230 DET_MH_CYCLE_COUNTER_313_316 "Detection Alive Counter";
CM_ SG_ 1231 DET_RANGE_317 " measured position  of the detection";
CM_ SG_ 1231 DET_RANGE_ERR_317 "RMSE or standard deviation of the measured angle  of the detection";
CM_ SG_ 1231 DET_RANGE_VELOCITY_317 "Radial velocity of the detection positive in direction to the sensor";
CM_ SG_ 1231 DET_RANGE_VELOCITY_ERR_317 "RMSE or standard deviation of the measure radial velocity of the detection";
CM_ SG_ 1231 DET_AZIMUTH_317 "Measured angle  of the detection";
CM_ SG_ 1231 DET_AZIMUTH_ERR_317 "RMSE or standard deviation of the measured angle  of the detection";
CM_ SG_ 1231 DET_ELEVATION_317 "measured elevation of the detection";
CM_ SG_ 1231 DET_ELEVATION_ERR_317 "RMSE or standard deviation of the measured elevation  of the detection";
CM_ SG_ 1231 DET_RCS_317 "Radar Cross Section or Amplitude, is a measure of how detectable an object is by radar. A larger RCS indicates that an object is more easily detected.";
CM_ SG_ 1231 DET_VALID_FLAG_317 "is set if the measured detection is valid";
CM_ SG_ 1231 DET_BI_STATIC_FLAG_317 "1 if detection is bi-static 0 otherwise";
CM_ SG_ 1231 DET_SUPER_RES_TARGET_317 "flasg is set if the detection is super resolution target";
CM_ SG_ 1231 DET_SNR_317 "The signal to noise ratio (SNR) of the radar detection";
CM_ SG_ 1231 DET_POINT_TARGET_PROB_317 "Describes the possibility if more than one real-world object has led to this detection. 0[%] := 100[%] Multi target probability";
CM_ SG_ 1231 DET_EXISTENCE_PROB_317 "Existence probability of the detection not based on history. Value does  not depend on any past experience with similar detections.
\note Use as confidence measure where a low value means less confidence
and a high value indicates strong confidence.";
CM_ SG_ 1231 DET_OUTSIDE_SECTOR_317 "Flag to indicate detections outside the sector, set if the wrong sector calibration matrix was used";
CM_ SG_ 1231 DET_HVC_FLAG_317 "Core2 Vehicle clutter flag";
CM_ SG_ 1231 DET_CONFD_AZIMUTH_317 "Define the Confidence of Azimuth for Detection ";
CM_ SG_ 1231 DET_CONFD_ELEVATION_317 "Define the Confidence of Elevation for the Detection ";
CM_ SG_ 1231 DET_BI_STATIC_FLAG_318 "1 if detection is bi-static 0 otherwise";
CM_ SG_ 1231 DET_BI_STATIC_FLAG_319 "1 if detection is bi-static 0 otherwise";
CM_ SG_ 1231 DET_BI_STATIC_FLAG_320 "1 if detection is bi-static 0 otherwise";
CM_ SG_ 1231 DET_MH_SCAN_INDEX_4LSB_317_320 "Scan index of the measured detection";
CM_ SG_ 1231 DET_MH_CYCLE_COUNTER_317_320 "Detection Alive Counter";
CM_ SG_ 1232 DET_RANGE_321 " measured position  of the detection";
CM_ SG_ 1232 DET_RANGE_ERR_321 "RMSE or standard deviation of the measured angle  of the detection";
CM_ SG_ 1232 DET_RANGE_VELOCITY_321 "Radial velocity of the detection positive in direction to the sensor";
CM_ SG_ 1232 DET_RANGE_VELOCITY_ERR_321 "RMSE or standard deviation of the measure radial velocity of the detection";
CM_ SG_ 1232 DET_AZIMUTH_321 "Measured angle  of the detection";
CM_ SG_ 1232 DET_AZIMUTH_ERR_321 "RMSE or standard deviation of the measured angle  of the detection";
CM_ SG_ 1232 DET_ELEVATION_321 "measured elevation of the detection";
CM_ SG_ 1232 DET_ELEVATION_ERR_321 "RMSE or standard deviation of the measured elevation  of the detection";
CM_ SG_ 1232 DET_RCS_321 "Radar Cross Section or Amplitude, is a measure of how detectable an object is by radar. A larger RCS indicates that an object is more easily detected.";
CM_ SG_ 1232 DET_VALID_FLAG_321 "is set if the measured detection is valid";
CM_ SG_ 1232 DET_BI_STATIC_FLAG_321 "1 if detection is bi-static 0 otherwise";
CM_ SG_ 1232 DET_SUPER_RES_TARGET_321 "flasg is set if the detection is super resolution target";
CM_ SG_ 1232 DET_SNR_321 "The signal to noise ratio (SNR) of the radar detection";
CM_ SG_ 1232 DET_POINT_TARGET_PROB_321 "Describes the possibility if more than one real-world object has led to this detection. 0[%] := 100[%] Multi target probability";
CM_ SG_ 1232 DET_EXISTENCE_PROB_321 "Existence probability of the detection not based on history. Value does  not depend on any past experience with similar detections.
\note Use as confidence measure where a low value means less confidence
and a high value indicates strong confidence.";
CM_ SG_ 1232 DET_OUTSIDE_SECTOR_321 "Flag to indicate detections outside the sector, set if the wrong sector calibration matrix was used";
CM_ SG_ 1232 DET_HVC_FLAG_321 "Core2 Vehicle clutter flag";
CM_ SG_ 1232 DET_CONFD_AZIMUTH_321 "Define the Confidence of Azimuth for Detection ";
CM_ SG_ 1232 DET_CONFD_ELEVATION_321 "Define the Confidence of Elevation for the Detection ";
CM_ SG_ 1232 DET_BI_STATIC_FLAG_322 "1 if detection is bi-static 0 otherwise";
CM_ SG_ 1232 DET_BI_STATIC_FLAG_323 "1 if detection is bi-static 0 otherwise";
CM_ SG_ 1232 DET_BI_STATIC_FLAG_324 "1 if detection is bi-static 0 otherwise";
CM_ SG_ 1232 DET_MH_SCAN_INDEX_4LSB_321_324 "Scan index of the measured detection";
CM_ SG_ 1232 DET_MH_CYCLE_COUNTER_321_324 "Detection Alive Counter";
CM_ SG_ 1233 DET_RANGE_325 " measured position  of the detection";
CM_ SG_ 1233 DET_RANGE_ERR_325 "RMSE or standard deviation of the measured angle  of the detection";
CM_ SG_ 1233 DET_RANGE_VELOCITY_325 "Radial velocity of the detection positive in direction to the sensor";
CM_ SG_ 1233 DET_RANGE_VELOCITY_ERR_325 "RMSE or standard deviation of the measure radial velocity of the detection";
CM_ SG_ 1233 DET_AZIMUTH_325 "Measured angle  of the detection";
CM_ SG_ 1233 DET_AZIMUTH_ERR_325 "RMSE or standard deviation of the measured angle  of the detection";
CM_ SG_ 1233 DET_ELEVATION_325 "measured elevation of the detection";
CM_ SG_ 1233 DET_ELEVATION_ERR_325 "RMSE or standard deviation of the measured elevation  of the detection";
CM_ SG_ 1233 DET_RCS_325 "Radar Cross Section or Amplitude, is a measure of how detectable an object is by radar. A larger RCS indicates that an object is more easily detected.";
CM_ SG_ 1233 DET_VALID_FLAG_325 "is set if the measured detection is valid";
CM_ SG_ 1233 DET_BI_STATIC_FLAG_325 "1 if detection is bi-static 0 otherwise";
CM_ SG_ 1233 DET_SUPER_RES_TARGET_325 "flasg is set if the detection is super resolution target";
CM_ SG_ 1233 DET_SNR_325 "The signal to noise ratio (SNR) of the radar detection";
CM_ SG_ 1233 DET_POINT_TARGET_PROB_325 "Describes the possibility if more than one real-world object has led to this detection. 0[%] := 100[%] Multi target probability";
CM_ SG_ 1233 DET_EXISTENCE_PROB_325 "Existence probability of the detection not based on history. Value does  not depend on any past experience with similar detections.
\note Use as confidence measure where a low value means less confidence
and a high value indicates strong confidence.";
CM_ SG_ 1233 DET_OUTSIDE_SECTOR_325 "Flag to indicate detections outside the sector, set if the wrong sector calibration matrix was used";
CM_ SG_ 1233 DET_HVC_FLAG_325 "Core2 Vehicle clutter flag";
CM_ SG_ 1233 DET_CONFD_AZIMUTH_325 "Define the Confidence of Azimuth for Detection ";
CM_ SG_ 1233 DET_CONFD_ELEVATION_325 "Define the Confidence of Elevation for the Detection ";
CM_ SG_ 1233 DET_BI_STATIC_FLAG_326 "1 if detection is bi-static 0 otherwise";
CM_ SG_ 1233 DET_BI_STATIC_FLAG_327 "1 if detection is bi-static 0 otherwise";
CM_ SG_ 1233 DET_BI_STATIC_FLAG_328 "1 if detection is bi-static 0 otherwise";
CM_ SG_ 1233 DET_MH_SCAN_INDEX_4LSB_325_328 "Scan index of the measured detection";
CM_ SG_ 1233 DET_MH_CYCLE_COUNTER_325_328 "Detection Alive Counter";

BA_DEF_ BO_ "CanTpBs" INT 0 255;
BA_DEF_ BO_ "DiagRequest" ENUM  "No","Yes";
BA_DEF_ BO_ "DiagResponse" ENUM  "No","Yes";
BA_DEF_ BO_ "EventRateOfChange" INT 10 10000;
BA_DEF_ BO_ "GenMsgCycleTime" INT 0 100000;
BA_DEF_ BO_ "GenMsgILSupport" ENUM  "No","Yes";
BA_DEF_ BO_ "GenMsgNrOfRepetition" INT 0 100;
BA_DEF_ BO_ "GenMsgSendType" ENUM  "FixedPeriodic","Event","EnabledPeriodic","NotUsed","NotUsed","EventPeriodic","NotUsed","NotUsed","NoMsgSendType";
BA_DEF_ BO_ "NetworkInitialization" ENUM  "No","Yes";
BA_DEF_ BO_ "NmAsrMessage" ENUM  "No","Yes";
BA_DEF_ BO_ "NmMessage" ENUM  "No","Yes";
BA_DEF_ BO_ "VFrameFormat" ENUM  "StandardCAN","ExtendedCAN","reserved","reserved","reserved","reserved","reserved","reserved","reserved","reserved","reserved","reserved","reserved","reserved","StandardCAN_FD","ExtendedCAN_FD";
BA_DEF_ SG_ "GenSigCmt" STRING;
BA_DEF_ SG_ "GenSigCycleTime" INT 0 0;
BA_DEF_ SG_ "GenSigSendType" ENUM  "Cyclic","OnWrite","vector_leerstring","OnChange","vector_leerstring","IfActive","vector_leerstring","NoSigSendType";
BA_DEF_ SG_ "GenSigStartValue" INT 0 1000000000;
BA_DEF_ SG_ "GenSigTimeoutTime" INT 0 0;
BA_DEF_ SG_ "GenSigVtEn" STRING;
BA_DEF_ SG_ "GenSigVtName" STRING;
BA_DEF_ SG_ "InvalidValue" STRING;
BA_DEF_DEF_ "CanTpBs" 255;
BA_DEF_DEF_ "DiagRequest" "No";
BA_DEF_DEF_ "DiagResponse" "No";
BA_DEF_DEF_ "EventRateOfChange" 10000;
BA_DEF_DEF_ "GenMsgCycleTime" 0;
BA_DEF_DEF_ "GenMsgILSupport" "Yes";
BA_DEF_DEF_ "GenMsgNrOfRepetition" 0;
BA_DEF_DEF_ "GenMsgSendType" "NoMsgSendType";
BA_DEF_DEF_ "GenSigCmt" "";
BA_DEF_DEF_ "GenSigCycleTime" 0;
BA_DEF_DEF_ "GenSigSendType" "NoSigSendType";
BA_DEF_DEF_ "GenSigStartValue" 0;
BA_DEF_DEF_ "GenSigTimeoutTime" 0;
BA_DEF_DEF_ "GenSigVtEn" "";
BA_DEF_DEF_ "GenSigVtName" "";
BA_DEF_DEF_ "InvalidValue" "";
BA_DEF_DEF_ "NetworkInitialization" "Yes";
BA_DEF_DEF_ "NmAsrMessage" "No";
BA_DEF_DEF_ "NmMessage" "No";
BA_DEF_DEF_ "VFrameFormat" "StandardCAN_FD";
BA_ "GenMsgSendType" BO_ 1216 1;
BA_ "GenMsgSendType" BO_ 1217 1;
BA_ "GenMsgSendType" BO_ 1218 1;
BA_ "GenMsgSendType" BO_ 1219 1;
BA_ "GenMsgSendType" BO_ 1220 1;
BA_ "GenMsgSendType" BO_ 1221 1;
BA_ "GenMsgSendType" BO_ 1222 1;
BA_ "GenMsgSendType" BO_ 1223 1;
BA_ "GenMsgSendType" BO_ 1224 1;
BA_ "GenMsgSendType" BO_ 1225 1;
BA_ "GenMsgSendType" BO_ 1226 1;
BA_ "GenMsgSendType" BO_ 1227 1;
BA_ "GenMsgSendType" BO_ 1228 1;
BA_ "GenMsgSendType" BO_ 1229 1;
BA_ "GenMsgSendType" BO_ 1230 1;
BA_ "GenMsgSendType" BO_ 1231 1;
BA_ "GenMsgSendType" BO_ 1232 1;
BA_ "GenMsgSendType" BO_ 1233 1;
BA_ "GenSigStartValue" SG_ 1216 DET_RANGE_VELOCITY_257 16384;
BA_ "GenSigStartValue" SG_ 1216 DET_RCS_257 128;
BA_ "GenSigStartValue" SG_ 1216 DET_RANGE_VELOCITY_258 16384;
BA_ "GenSigStartValue" SG_ 1216 DET_RCS_258 128;
BA_ "GenSigStartValue" SG_ 1216 DET_RANGE_VELOCITY_259 16384;
BA_ "GenSigStartValue" SG_ 1216 DET_RCS_259 128;
BA_ "GenSigStartValue" SG_ 1216 DET_RANGE_VELOCITY_260 16384;
BA_ "GenSigStartValue" SG_ 1216 DET_RCS_260 128;
BA_ "GenSigStartValue" SG_ 1217 DET_RANGE_VELOCITY_261 16384;
BA_ "GenSigStartValue" SG_ 1217 DET_RCS_261 128;
BA_ "GenSigStartValue" SG_ 1217 DET_RANGE_VELOCITY_262 16384;
BA_ "GenSigStartValue" SG_ 1217 DET_RCS_262 128;
BA_ "GenSigStartValue" SG_ 1217 DET_RANGE_VELOCITY_263 16384;
BA_ "GenSigStartValue" SG_ 1217 DET_RCS_263 128;
BA_ "GenSigStartValue" SG_ 1217 DET_RANGE_VELOCITY_264 16384;
BA_ "GenSigStartValue" SG_ 1217 DET_RCS_264 128;
BA_ "GenSigStartValue" SG_ 1218 DET_RANGE_VELOCITY_265 16384;
BA_ "GenSigStartValue" SG_ 1218 DET_RCS_265 128;
BA_ "GenSigStartValue" SG_ 1218 DET_RANGE_VELOCITY_266 16384;
BA_ "GenSigStartValue" SG_ 1218 DET_RCS_266 128;
BA_ "GenSigStartValue" SG_ 1218 DET_RANGE_VELOCITY_267 16384;
BA_ "GenSigStartValue" SG_ 1218 DET_RCS_267 128;
BA_ "GenSigStartValue" SG_ 1218 DET_RANGE_VELOCITY_268 16384;
BA_ "GenSigStartValue" SG_ 1218 DET_RCS_268 128;
BA_ "GenSigStartValue" SG_ 1219 DET_RANGE_VELOCITY_269 16384;
BA_ "GenSigStartValue" SG_ 1219 DET_RCS_269 128;
BA_ "GenSigStartValue" SG_ 1219 DET_RANGE_VELOCITY_270 16384;
BA_ "GenSigStartValue" SG_ 1219 DET_RCS_270 128;
BA_ "GenSigStartValue" SG_ 1219 DET_RANGE_VELOCITY_271 16384;
BA_ "GenSigStartValue" SG_ 1219 DET_RCS_271 128;
BA_ "GenSigStartValue" SG_ 1219 DET_RANGE_VELOCITY_272 16384;
BA_ "GenSigStartValue" SG_ 1219 DET_RCS_272 128;
BA_ "GenSigStartValue" SG_ 1220 DET_RANGE_VELOCITY_273 16384;
BA_ "GenSigStartValue" SG_ 1220 DET_RCS_273 128;
BA_ "GenSigStartValue" SG_ 1220 DET_RANGE_VELOCITY_274 16384;
BA_ "GenSigStartValue" SG_ 1220 DET_RCS_274 128;
BA_ "GenSigStartValue" SG_ 1220 DET_RANGE_VELOCITY_275 16384;
BA_ "GenSigStartValue" SG_ 1220 DET_RCS_275 128;
BA_ "GenSigStartValue" SG_ 1220 DET_RANGE_VELOCITY_276 16384;
BA_ "GenSigStartValue" SG_ 1220 DET_RCS_276 128;
BA_ "GenSigStartValue" SG_ 1221 DET_RANGE_VELOCITY_277 16384;
BA_ "GenSigStartValue" SG_ 1221 DET_RCS_277 128;
BA_ "GenSigStartValue" SG_ 1221 DET_RANGE_VELOCITY_278 16384;
BA_ "GenSigStartValue" SG_ 1221 DET_RCS_278 128;
BA_ "GenSigStartValue" SG_ 1221 DET_RANGE_VELOCITY_279 16384;
BA_ "GenSigStartValue" SG_ 1221 DET_RCS_279 128;
BA_ "GenSigStartValue" SG_ 1221 DET_RANGE_VELOCITY_280 16384;
BA_ "GenSigStartValue" SG_ 1221 DET_RCS_280 128;
BA_ "GenSigStartValue" SG_ 1222 DET_RANGE_VELOCITY_281 16384;
BA_ "GenSigStartValue" SG_ 1222 DET_RCS_281 128;
BA_ "GenSigStartValue" SG_ 1222 DET_RANGE_VELOCITY_282 16384;
BA_ "GenSigStartValue" SG_ 1222 DET_RCS_282 128;
BA_ "GenSigStartValue" SG_ 1222 DET_RANGE_VELOCITY_283 16384;
BA_ "GenSigStartValue" SG_ 1222 DET_RCS_283 128;
BA_ "GenSigStartValue" SG_ 1222 DET_RANGE_VELOCITY_284 16384;
BA_ "GenSigStartValue" SG_ 1222 DET_RCS_284 128;
BA_ "GenSigStartValue" SG_ 1223 DET_RANGE_VELOCITY_285 16384;
BA_ "GenSigStartValue" SG_ 1223 DET_RCS_285 128;
BA_ "GenSigStartValue" SG_ 1223 DET_RANGE_VELOCITY_286 16384;
BA_ "GenSigStartValue" SG_ 1223 DET_RCS_286 128;
BA_ "GenSigStartValue" SG_ 1223 DET_RANGE_VELOCITY_287 16384;
BA_ "GenSigStartValue" SG_ 1223 DET_RCS_287 128;
BA_ "GenSigStartValue" SG_ 1223 DET_RANGE_VELOCITY_288 16384;
BA_ "GenSigStartValue" SG_ 1223 DET_RCS_288 128;
BA_ "GenSigStartValue" SG_ 1224 DET_RANGE_VELOCITY_289 16384;
BA_ "GenSigStartValue" SG_ 1224 DET_RCS_289 128;
BA_ "GenSigStartValue" SG_ 1224 DET_RANGE_VELOCITY_290 16384;
BA_ "GenSigStartValue" SG_ 1224 DET_RCS_290 128;
BA_ "GenSigStartValue" SG_ 1224 DET_RANGE_VELOCITY_291 16384;
BA_ "GenSigStartValue" SG_ 1224 DET_RCS_291 128;
BA_ "GenSigStartValue" SG_ 1224 DET_RANGE_VELOCITY_292 16384;
BA_ "GenSigStartValue" SG_ 1224 DET_RCS_292 128;
BA_ "GenSigStartValue" SG_ 1225 DET_RANGE_VELOCITY_293 16384;
BA_ "GenSigStartValue" SG_ 1225 DET_RCS_293 128;
BA_ "GenSigStartValue" SG_ 1225 DET_RANGE_VELOCITY_294 16384;
BA_ "GenSigStartValue" SG_ 1225 DET_RCS_294 128;
BA_ "GenSigStartValue" SG_ 1225 DET_RANGE_VELOCITY_295 16384;
BA_ "GenSigStartValue" SG_ 1225 DET_RCS_295 128;
BA_ "GenSigStartValue" SG_ 1225 DET_RANGE_VELOCITY_296 16384;
BA_ "GenSigStartValue" SG_ 1225 DET_RCS_296 128;
BA_ "GenSigStartValue" SG_ 1226 DET_RANGE_VELOCITY_297 16384;
BA_ "GenSigStartValue" SG_ 1226 DET_RCS_297 128;
BA_ "GenSigStartValue" SG_ 1226 DET_RANGE_VELOCITY_298 16384;
BA_ "GenSigStartValue" SG_ 1226 DET_RCS_298 128;
BA_ "GenSigStartValue" SG_ 1226 DET_RANGE_VELOCITY_299 16384;
BA_ "GenSigStartValue" SG_ 1226 DET_RCS_299 128;
BA_ "GenSigStartValue" SG_ 1226 DET_RANGE_VELOCITY_300 16384;
BA_ "GenSigStartValue" SG_ 1226 DET_RCS_300 128;
BA_ "GenSigStartValue" SG_ 1227 DET_RANGE_VELOCITY_301 16384;
BA_ "GenSigStartValue" SG_ 1227 DET_RCS_301 128;
BA_ "GenSigStartValue" SG_ 1227 DET_RANGE_VELOCITY_302 16384;
BA_ "GenSigStartValue" SG_ 1227 DET_RCS_302 128;
BA_ "GenSigStartValue" SG_ 1227 DET_RANGE_VELOCITY_303 16384;
BA_ "GenSigStartValue" SG_ 1227 DET_RCS_303 128;
BA_ "GenSigStartValue" SG_ 1227 DET_RANGE_VELOCITY_304 16384;
BA_ "GenSigStartValue" SG_ 1227 DET_RCS_304 128;
BA_ "GenSigStartValue" SG_ 1228 DET_RANGE_VELOCITY_305 16384;
BA_ "GenSigStartValue" SG_ 1228 DET_RCS_305 128;
BA_ "GenSigStartValue" SG_ 1228 DET_RANGE_VELOCITY_306 16384;
BA_ "GenSigStartValue" SG_ 1228 DET_RCS_306 128;
BA_ "GenSigStartValue" SG_ 1228 DET_RANGE_VELOCITY_307 16384;
BA_ "GenSigStartValue" SG_ 1228 DET_RCS_307 128;
BA_ "GenSigStartValue" SG_ 1228 DET_RANGE_VELOCITY_308 16384;
BA_ "GenSigStartValue" SG_ 1228 DET_RCS_308 128;
BA_ "GenSigStartValue" SG_ 1229 DET_RANGE_VELOCITY_309 16384;
BA_ "GenSigStartValue" SG_ 1229 DET_RCS_309 128;
BA_ "GenSigStartValue" SG_ 1229 DET_RANGE_VELOCITY_310 16384;
BA_ "GenSigStartValue" SG_ 1229 DET_RCS_310 128;
BA_ "GenSigStartValue" SG_ 1229 DET_RANGE_VELOCITY_311 16384;
BA_ "GenSigStartValue" SG_ 1229 DET_RCS_311 128;
BA_ "GenSigStartValue" SG_ 1229 DET_RANGE_VELOCITY_312 16384;
BA_ "GenSigStartValue" SG_ 1229 DET_RCS_312 128;
BA_ "GenSigStartValue" SG_ 1230 DET_RANGE_VELOCITY_313 16384;
BA_ "GenSigStartValue" SG_ 1230 DET_RCS_313 128;
BA_ "GenSigStartValue" SG_ 1230 DET_RANGE_VELOCITY_314 16384;
BA_ "GenSigStartValue" SG_ 1230 DET_RCS_314 128;
BA_ "GenSigStartValue" SG_ 1230 DET_RANGE_VELOCITY_315 16384;
BA_ "GenSigStartValue" SG_ 1230 DET_RCS_315 128;
BA_ "GenSigStartValue" SG_ 1230 DET_RANGE_VELOCITY_316 16384;
BA_ "GenSigStartValue" SG_ 1230 DET_RCS_316 128;
BA_ "GenSigStartValue" SG_ 1231 DET_RANGE_VELOCITY_317 16384;
BA_ "GenSigStartValue" SG_ 1231 DET_RCS_317 128;
BA_ "GenSigStartValue" SG_ 1231 DET_RANGE_VELOCITY_318 16384;
BA_ "GenSigStartValue" SG_ 1231 DET_RCS_318 128;
BA_ "GenSigStartValue" SG_ 1231 DET_RANGE_VELOCITY_319 16384;
BA_ "GenSigStartValue" SG_ 1231 DET_RCS_319 128;
BA_ "GenSigStartValue" SG_ 1231 DET_RANGE_VELOCITY_320 16384;
BA_ "GenSigStartValue" SG_ 1231 DET_RCS_320 128;
BA_ "GenSigStartValue" SG_ 1232 DET_RANGE_VELOCITY_321 16384;
BA_ "GenSigStartValue" SG_ 1232 DET_RCS_321 128;
BA_ "GenSigStartValue" SG_ 1232 DET_RANGE_VELOCITY_322 16384;
BA_ "GenSigStartValue" SG_ 1232 DET_RCS_322 128;
BA_ "GenSigStartValue" SG_ 1232 DET_RANGE_VELOCITY_323 16384;
BA_ "GenSigStartValue" SG_ 1232 DET_RCS_323 128;
BA_ "GenSigStartValue" SG_ 1232 DET_RANGE_VELOCITY_324 16384;
BA_ "GenSigStartValue" SG_ 1232 DET_RCS_324 128;
BA_ "GenSigStartValue" SG_ 1233 DET_RANGE_VELOCITY_325 16384;
BA_ "GenSigStartValue" SG_ 1233 DET_RCS_325 128;
BA_ "GenSigStartValue" SG_ 1233 DET_RANGE_VELOCITY_326 16384;
BA_ "GenSigStartValue" SG_ 1233 DET_RCS_326 128;
BA_ "GenSigStartValue" SG_ 1233 DET_RANGE_VELOCITY_327 16384;
BA_ "GenSigStartValue" SG_ 1233 DET_RCS_327 128;
BA_ "GenSigStartValue" SG_ 1233 DET_RANGE_VELOCITY_328 16384;
BA_ "GenSigStartValue" SG_ 1233 DET_RCS_328 128;
VAL_ 1216 DET_CONFD_AZIMUTH_257 0 "High" 1 "MidHigh" 2 "MidLow" 3 "Low";
VAL_ 1216 DET_CONFD_ELEVATION_257 0 "High" 1 "MidHigh" 2 "MidLow" 3 "Low";
VAL_ 1216 DET_CONFD_AZIMUTH_258 0 "High" 1 "MidHigh" 2 "MidLow" 3 "Low";
VAL_ 1216 DET_CONFD_ELEVATION_258 0 "High" 1 "MidHigh" 2 "MidLow" 3 "Low";
VAL_ 1216 DET_CONFD_AZIMUTH_259 0 "High" 1 "MidHigh" 2 "MidLow" 3 "Low";
VAL_ 1216 DET_CONFD_ELEVATION_259 0 "High" 1 "MidHigh" 2 "MidLow" 3 "Low";
VAL_ 1217 DET_CONFD_AZIMUTH_261 0 "High" 1 "MidHigh" 2 "MidLow" 3 "Low";
VAL_ 1217 DET_CONFD_ELEVATION_261 0 "High" 1 "MidHigh" 2 "MidLow" 3 "Low";
VAL_ 1217 DET_CONFD_AZIMUTH_262 0 "High" 1 "MidHigh" 2 "MidLow" 3 "Low";
VAL_ 1217 DET_CONFD_ELEVATION_262 0 "High" 1 "MidHigh" 2 "MidLow" 3 "Low";
VAL_ 1217 DET_CONFD_AZIMUTH_263 0 "High" 1 "MidHigh" 2 "MidLow" 3 "Low";
VAL_ 1217 DET_CONFD_ELEVATION_263 0 "High" 1 "MidHigh" 2 "MidLow" 3 "Low";
VAL_ 1218 DET_CONFD_AZIMUTH_265 0 "High" 1 "MidHigh" 2 "MidLow" 3 "Low";
VAL_ 1218 DET_CONFD_ELEVATION_265 0 "High" 1 "MidHigh" 2 "MidLow" 3 "Low";
VAL_ 1218 DET_CONFD_AZIMUTH_266 0 "High" 1 "MidHigh" 2 "MidLow" 3 "Low";
VAL_ 1218 DET_CONFD_ELEVATION_266 0 "High" 1 "MidHigh" 2 "MidLow" 3 "Low";
VAL_ 1218 DET_CONFD_AZIMUTH_267 0 "High" 1 "MidHigh" 2 "MidLow" 3 "Low";
VAL_ 1218 DET_CONFD_ELEVATION_267 0 "High" 1 "MidHigh" 2 "MidLow" 3 "Low";
VAL_ 1219 DET_CONFD_AZIMUTH_269 0 "High" 1 "MidHigh" 2 "MidLow" 3 "Low";
VAL_ 1219 DET_CONFD_ELEVATION_269 0 "High" 1 "MidHigh" 2 "MidLow" 3 "Low";
VAL_ 1219 DET_CONFD_AZIMUTH_270 0 "High" 1 "MidHigh" 2 "MidLow" 3 "Low";
VAL_ 1219 DET_CONFD_ELEVATION_270 0 "High" 1 "MidHigh" 2 "MidLow" 3 "Low";
VAL_ 1219 DET_CONFD_AZIMUTH_271 0 "High" 1 "MidHigh" 2 "MidLow" 3 "Low";
VAL_ 1219 DET_CONFD_ELEVATION_271 0 "High" 1 "MidHigh" 2 "MidLow" 3 "Low";
VAL_ 1220 DET_CONFD_AZIMUTH_273 0 "High" 1 "MidHigh" 2 "MidLow" 3 "Low";
VAL_ 1220 DET_CONFD_ELEVATION_273 0 "High" 1 "MidHigh" 2 "MidLow" 3 "Low";
VAL_ 1220 DET_CONFD_AZIMUTH_274 0 "High" 1 "MidHigh" 2 "MidLow" 3 "Low";
VAL_ 1220 DET_CONFD_ELEVATION_274 0 "High" 1 "MidHigh" 2 "MidLow" 3 "Low";
VAL_ 1220 DET_CONFD_AZIMUTH_275 0 "High" 1 "MidHigh" 2 "MidLow" 3 "Low";
VAL_ 1220 DET_CONFD_ELEVATION_275 0 "High" 1 "MidHigh" 2 "MidLow" 3 "Low";
VAL_ 1221 DET_CONFD_AZIMUTH_277 0 "High" 1 "MidHigh" 2 "MidLow" 3 "Low";
VAL_ 1221 DET_CONFD_ELEVATION_277 0 "High" 1 "MidHigh" 2 "MidLow" 3 "Low";
VAL_ 1221 DET_CONFD_AZIMUTH_278 0 "High" 1 "MidHigh" 2 "MidLow" 3 "Low";
VAL_ 1221 DET_CONFD_ELEVATION_278 0 "High" 1 "MidHigh" 2 "MidLow" 3 "Low";
VAL_ 1221 DET_CONFD_AZIMUTH_279 0 "High" 1 "MidHigh" 2 "MidLow" 3 "Low";
VAL_ 1221 DET_CONFD_ELEVATION_279 0 "High" 1 "MidHigh" 2 "MidLow" 3 "Low";
VAL_ 1222 DET_CONFD_AZIMUTH_281 0 "High" 1 "MidHigh" 2 "MidLow" 3 "Low";
VAL_ 1222 DET_CONFD_ELEVATION_281 0 "High" 1 "MidHigh" 2 "MidLow" 3 "Low";
VAL_ 1222 DET_CONFD_AZIMUTH_282 0 "High" 1 "MidHigh" 2 "MidLow" 3 "Low";
VAL_ 1222 DET_CONFD_ELEVATION_282 0 "High" 1 "MidHigh" 2 "MidLow" 3 "Low";
VAL_ 1222 DET_CONFD_AZIMUTH_283 0 "High" 1 "MidHigh" 2 "MidLow" 3 "Low";
VAL_ 1222 DET_CONFD_ELEVATION_283 0 "High" 1 "MidHigh" 2 "MidLow" 3 "Low";
VAL_ 1223 DET_CONFD_AZIMUTH_285 0 "High" 1 "MidHigh" 2 "MidLow" 3 "Low";
VAL_ 1223 DET_CONFD_ELEVATION_285 0 "High" 1 "MidHigh" 2 "MidLow" 3 "Low";
VAL_ 1223 DET_CONFD_AZIMUTH_286 0 "High" 1 "MidHigh" 2 "MidLow" 3 "Low";
VAL_ 1223 DET_CONFD_ELEVATION_286 0 "High" 1 "MidHigh" 2 "MidLow" 3 "Low";
VAL_ 1223 DET_CONFD_AZIMUTH_287 0 "High" 1 "MidHigh" 2 "MidLow" 3 "Low";
VAL_ 1223 DET_CONFD_ELEVATION_287 0 "High" 1 "MidHigh" 2 "MidLow" 3 "Low";
VAL_ 1224 DET_CONFD_AZIMUTH_289 0 "High" 1 "MidHigh" 2 "MidLow" 3 "Low";
VAL_ 1224 DET_CONFD_ELEVATION_289 0 "High" 1 "MidHigh" 2 "MidLow" 3 "Low";
VAL_ 1224 DET_CONFD_AZIMUTH_290 0 "High" 1 "MidHigh" 2 "MidLow" 3 "Low";
VAL_ 1224 DET_CONFD_ELEVATION_290 0 "High" 1 "MidHigh" 2 "MidLow" 3 "Low";
VAL_ 1224 DET_CONFD_AZIMUTH_291 0 "High" 1 "MidHigh" 2 "MidLow" 3 "Low";
VAL_ 1224 DET_CONFD_ELEVATION_291 0 "High" 1 "MidHigh" 2 "MidLow" 3 "Low";
VAL_ 1225 DET_CONFD_AZIMUTH_293 0 "High" 1 "MidHigh" 2 "MidLow" 3 "Low";
VAL_ 1225 DET_CONFD_ELEVATION_293 0 "High" 1 "MidHigh" 2 "MidLow" 3 "Low";
VAL_ 1225 DET_CONFD_AZIMUTH_294 0 "High" 1 "MidHigh" 2 "MidLow" 3 "Low";
VAL_ 1225 DET_CONFD_ELEVATION_294 0 "High" 1 "MidHigh" 2 "MidLow" 3 "Low";
VAL_ 1225 DET_CONFD_AZIMUTH_295 0 "High" 1 "MidHigh" 2 "MidLow" 3 "Low";
VAL_ 1225 DET_CONFD_ELEVATION_295 0 "High" 1 "MidHigh" 2 "MidLow" 3 "Low";
VAL_ 1226 DET_CONFD_AZIMUTH_297 0 "High" 1 "MidHigh" 2 "MidLow" 3 "Low";
VAL_ 1226 DET_CONFD_ELEVATION_297 0 "High" 1 "MidHigh" 2 "MidLow" 3 "Low";
VAL_ 1226 DET_CONFD_AZIMUTH_298 0 "High" 1 "MidHigh" 2 "MidLow" 3 "Low";
VAL_ 1226 DET_CONFD_ELEVATION_298 0 "High" 1 "MidHigh" 2 "MidLow" 3 "Low";
VAL_ 1226 DET_CONFD_AZIMUTH_299 0 "High" 1 "MidHigh" 2 "MidLow" 3 "Low";
VAL_ 1226 DET_CONFD_ELEVATION_299 0 "High" 1 "MidHigh" 2 "MidLow" 3 "Low";
VAL_ 1227 DET_CONFD_AZIMUTH_301 0 "High" 1 "MidHigh" 2 "MidLow" 3 "Low";
VAL_ 1227 DET_CONFD_ELEVATION_301 0 "High" 1 "MidHigh" 2 "MidLow" 3 "Low";
VAL_ 1227 DET_CONFD_AZIMUTH_302 0 "High" 1 "MidHigh" 2 "MidLow" 3 "Low";
VAL_ 1227 DET_CONFD_ELEVATION_302 0 "High" 1 "MidHigh" 2 "MidLow" 3 "Low";
VAL_ 1227 DET_CONFD_AZIMUTH_303 0 "High" 1 "MidHigh" 2 "MidLow" 3 "Low";
VAL_ 1227 DET_CONFD_ELEVATION_303 0 "High" 1 "MidHigh" 2 "MidLow" 3 "Low";
VAL_ 1228 DET_CONFD_AZIMUTH_305 0 "High" 1 "MidHigh" 2 "MidLow" 3 "Low";
VAL_ 1228 DET_CONFD_ELEVATION_305 0 "High" 1 "MidHigh" 2 "MidLow" 3 "Low";
VAL_ 1228 DET_CONFD_AZIMUTH_306 0 "High" 1 "MidHigh" 2 "MidLow" 3 "Low";
VAL_ 1228 DET_CONFD_ELEVATION_306 0 "High" 1 "MidHigh" 2 "MidLow" 3 "Low";
VAL_ 1228 DET_CONFD_AZIMUTH_307 0 "High" 1 "MidHigh" 2 "MidLow" 3 "Low";
VAL_ 1228 DET_CONFD_ELEVATION_307 0 "High" 1 "MidHigh" 2 "MidLow" 3 "Low";
VAL_ 1229 DET_CONFD_AZIMUTH_309 0 "High" 1 "MidHigh" 2 "MidLow" 3 "Low";
VAL_ 1229 DET_CONFD_ELEVATION_309 0 "High" 1 "MidHigh" 2 "MidLow" 3 "Low";
VAL_ 1229 DET_CONFD_AZIMUTH_310 0 "High" 1 "MidHigh" 2 "MidLow" 3 "Low";
VAL_ 1229 DET_CONFD_ELEVATION_310 0 "High" 1 "MidHigh" 2 "MidLow" 3 "Low";
VAL_ 1229 DET_CONFD_AZIMUTH_311 0 "High" 1 "MidHigh" 2 "MidLow" 3 "Low";
VAL_ 1229 DET_CONFD_ELEVATION_311 0 "High" 1 "MidHigh" 2 "MidLow" 3 "Low";
VAL_ 1230 DET_CONFD_AZIMUTH_313 0 "High" 1 "MidHigh" 2 "MidLow" 3 "Low";
VAL_ 1230 DET_CONFD_ELEVATION_313 0 "High" 1 "MidHigh" 2 "MidLow" 3 "Low";
VAL_ 1230 DET_CONFD_AZIMUTH_314 0 "High" 1 "MidHigh" 2 "MidLow" 3 "Low";
VAL_ 1230 DET_CONFD_ELEVATION_314 0 "High" 1 "MidHigh" 2 "MidLow" 3 "Low";
VAL_ 1230 DET_CONFD_AZIMUTH_315 0 "High" 1 "MidHigh" 2 "MidLow" 3 "Low";
VAL_ 1230 DET_CONFD_ELEVATION_315 0 "High" 1 "MidHigh" 2 "MidLow" 3 "Low";
VAL_ 1231 DET_CONFD_AZIMUTH_317 0 "High" 1 "MidHigh" 2 "MidLow" 3 "Low";
VAL_ 1231 DET_CONFD_ELEVATION_317 0 "High" 1 "MidHigh" 2 "MidLow" 3 "Low";
VAL_ 1231 DET_CONFD_AZIMUTH_318 0 "High" 1 "MidHigh" 2 "MidLow" 3 "Low";
VAL_ 1231 DET_CONFD_ELEVATION_318 0 "High" 1 "MidHigh" 2 "MidLow" 3 "Low";
VAL_ 1231 DET_CONFD_AZIMUTH_319 0 "High" 1 "MidHigh" 2 "MidLow" 3 "Low";
VAL_ 1231 DET_CONFD_ELEVATION_319 0 "High" 1 "MidHigh" 2 "MidLow" 3 "Low";
VAL_ 1232 DET_CONFD_AZIMUTH_321 0 "High" 1 "MidHigh" 2 "MidLow" 3 "Low";
VAL_ 1232 DET_CONFD_ELEVATION_321 0 "High" 1 "MidHigh" 2 "MidLow" 3 "Low";
VAL_ 1232 DET_CONFD_AZIMUTH_322 0 "High" 1 "MidHigh" 2 "MidLow" 3 "Low";
VAL_ 1232 DET_CONFD_ELEVATION_322 0 "High" 1 "MidHigh" 2 "MidLow" 3 "Low";
VAL_ 1232 DET_CONFD_AZIMUTH_323 0 "High" 1 "MidHigh" 2 "MidLow" 3 "Low";
VAL_ 1232 DET_CONFD_ELEVATION_323 0 "High" 1 "MidHigh" 2 "MidLow" 3 "Low";
VAL_ 1233 DET_CONFD_AZIMUTH_325 0 "High" 1 "MidHigh" 2 "MidLow" 3 "Low";
VAL_ 1233 DET_CONFD_ELEVATION_325 0 "High" 1 "MidHigh" 2 "MidLow" 3 "Low";
VAL_ 1233 DET_CONFD_AZIMUTH_326 0 "High" 1 "MidHigh" 2 "MidLow" 3 "Low";
VAL_ 1233 DET_CONFD_ELEVATION_326 0 "High" 1 "MidHigh" 2 "MidLow" 3 "Low";
VAL_ 1233 DET_CONFD_AZIMUTH_327 0 "High" 1 "MidHigh" 2 "MidLow" 3 "Low";
VAL_ 1233 DET_CONFD_ELEVATION_327 0 "High" 1 "MidHigh" 2 "MidLow" 3 "Low";
SIG_GROUP_ 1216 Detections_257_260 1 : DET_MH_CRC16_257_260 DET_MH_CYCLE_COUNTER_257_260 DET_MH_SCAN_INDEX_4LSB_257_260 DET_CONFD_ELEVATION_257 DET_CONFD_AZIMUTH_257 DET_HVC_FLAG_257 DET_OUTSIDE_SECTOR_257 DET_EXISTENCE_PROB_257 DET_POINT_TARGET_PROB_257 DET_SNR_257 DET_SUPER_RES_TARGET_257 DET_BI_STATIC_FLAG_257 DET_VALID_FLAG_257 DET_RCS_257 DET_ELEVATION_ERR_257 DET_ELEVATION_257 DET_AZIMUTH_ERR_257 DET_AZIMUTH_257 DET_RANGE_VELOCITY_ERR_257 DET_RANGE_VELOCITY_257 DET_RANGE_ERR_257 DET_RANGE_257 DET_CONFD_ELEVATION_258 DET_CONFD_AZIMUTH_258 DET_HVC_FLAG_258 DET_OUTSIDE_SECTOR_258 DET_EXISTENCE_PROB_258 DET_POINT_TARGET_PROB_258 DET_SNR_258 DET_SUPER_RES_TARGET_258 DET_BI_STATIC_FLAG_258 DET_VALID_FLAG_258 DET_RCS_258 DET_ELEVATION_258 DET_ELEVATION_ERR_258 DET_AZIMUTH_ERR_258 DET_AZIMUTH_258 DET_RANGE_VELOCITY_ERR_258 DET_RANGE_VELOCITY_258 DET_RANGE_ERR_258 DET_RANGE_258 DET_CONFD_ELEVATION_259 DET_CONFD_AZIMUTH_259 DET_HVC_FLAG_259 DET_OUTSIDE_SECTOR_259 DET_EXISTENCE_PROB_259 DET_POINT_TARGET_PROB_259 DET_SUPER_RES_TARGET_259 DET_BI_STATIC_FLAG_259 DET_VALID_FLAG_259 DET_RCS_259 DET_ELEVATION_259 DET_SNR_259 DET_ELEVATION_ERR_259 DET_AZIMUTH_ERR_259 DET_RANGE_VELOCITY_ERR_259 DET_AZIMUTH_259 DET_RANGE_VELOCITY_259 DET_RANGE_ERR_259 DET_RANGE_259 DET_BI_STATIC_FLAG_260 DET_CONFD_ELEVATION_260 DET_CONFD_AZIMUTH_260 DET_HVC_FLAG_260 DET_OUTSIDE_SECTOR_260 DET_EXISTENCE_PROB_260 DET_POINT_TARGET_PROB_260 DET_SNR_260 DET_SUPER_RES_TARGET_260 DET_VALID_FLAG_260 DET_RCS_260 DET_ELEVATION_ERR_260 DET_ELEVATION_260 DET_AZIMUTH_ERR_260 DET_AZIMUTH_260 DET_RANGE_VELOCITY_ERR_260 DET_RANGE_VELOCITY_260 DET_RANGE_ERR_260 DET_RANGE_260;
SIG_GROUP_ 1217 Detections_261_264 1 : DET_MH_CRC16_261_264 DET_MH_CYCLE_COUNTER_261_264 DET_MH_SCAN_INDEX_4LSB_261_264 DET_CONFD_ELEVATION_261 DET_CONFD_AZIMUTH_261 DET_HVC_FLAG_261 DET_OUTSIDE_SECTOR_261 DET_EXISTENCE_PROB_261 DET_POINT_TARGET_PROB_261 DET_SNR_261 DET_SUPER_RES_TARGET_261 DET_BI_STATIC_FLAG_261 DET_VALID_FLAG_261 DET_RCS_261 DET_ELEVATION_ERR_261 DET_ELEVATION_261 DET_AZIMUTH_ERR_261 DET_AZIMUTH_261 DET_RANGE_VELOCITY_ERR_261 DET_RANGE_VELOCITY_261 DET_RANGE_ERR_261 DET_RANGE_261 DET_CONFD_ELEVATION_262 DET_CONFD_AZIMUTH_262 DET_HVC_FLAG_262 DET_OUTSIDE_SECTOR_262 DET_EXISTENCE_PROB_262 DET_POINT_TARGET_PROB_262 DET_SNR_262 DET_SUPER_RES_TARGET_262 DET_BI_STATIC_FLAG_262 DET_VALID_FLAG_262 DET_RCS_262 DET_ELEVATION_262 DET_ELEVATION_ERR_262 DET_AZIMUTH_ERR_262 DET_AZIMUTH_262 DET_RANGE_VELOCITY_ERR_262 DET_RANGE_VELOCITY_262 DET_RANGE_ERR_262 DET_RANGE_262 DET_CONFD_ELEVATION_263 DET_CONFD_AZIMUTH_263 DET_HVC_FLAG_263 DET_OUTSIDE_SECTOR_263 DET_EXISTENCE_PROB_263 DET_POINT_TARGET_PROB_263 DET_SUPER_RES_TARGET_263 DET_BI_STATIC_FLAG_263 DET_VALID_FLAG_263 DET_RCS_263 DET_ELEVATION_263 DET_SNR_263 DET_ELEVATION_ERR_263 DET_AZIMUTH_ERR_263 DET_RANGE_VELOCITY_ERR_263 DET_AZIMUTH_263 DET_RANGE_VELOCITY_263 DET_RANGE_ERR_263 DET_RANGE_263 DET_BI_STATIC_FLAG_264 DET_CONFD_ELEVATION_264 DET_CONFD_AZIMUTH_264 DET_HVC_FLAG_264 DET_OUTSIDE_SECTOR_264 DET_EXISTENCE_PROB_264 DET_POINT_TARGET_PROB_264 DET_SNR_264 DET_SUPER_RES_TARGET_264 DET_VALID_FLAG_264 DET_RCS_264 DET_ELEVATION_ERR_264 DET_ELEVATION_264 DET_AZIMUTH_ERR_264 DET_AZIMUTH_264 DET_RANGE_VELOCITY_ERR_264 DET_RANGE_VELOCITY_264 DET_RANGE_ERR_264 DET_RANGE_264;
SIG_GROUP_ 1218 Detections_265_268 1 : DET_MH_CRC16_265_268 DET_MH_CYCLE_COUNTER_265_268 DET_MH_SCAN_INDEX_4LSB_265_268 DET_CONFD_ELEVATION_265 DET_CONFD_AZIMUTH_265 DET_HVC_FLAG_265 DET_OUTSIDE_SECTOR_265 DET_EXISTENCE_PROB_265 DET_POINT_TARGET_PROB_265 DET_SNR_265 DET_SUPER_RES_TARGET_265 DET_BI_STATIC_FLAG_265 DET_VALID_FLAG_265 DET_RCS_265 DET_ELEVATION_ERR_265 DET_ELEVATION_265 DET_AZIMUTH_ERR_265 DET_AZIMUTH_265 DET_RANGE_VELOCITY_ERR_265 DET_RANGE_VELOCITY_265 DET_RANGE_ERR_265 DET_RANGE_265 DET_CONFD_ELEVATION_266 DET_CONFD_AZIMUTH_266 DET_HVC_FLAG_266 DET_OUTSIDE_SECTOR_266 DET_EXISTENCE_PROB_266 DET_POINT_TARGET_PROB_266 DET_SNR_266 DET_SUPER_RES_TARGET_266 DET_BI_STATIC_FLAG_266 DET_VALID_FLAG_266 DET_RCS_266 DET_ELEVATION_266 DET_ELEVATION_ERR_266 DET_AZIMUTH_ERR_266 DET_AZIMUTH_266 DET_RANGE_VELOCITY_ERR_266 DET_RANGE_VELOCITY_266 DET_RANGE_ERR_266 DET_RANGE_266 DET_CONFD_ELEVATION_267 DET_CONFD_AZIMUTH_267 DET_HVC_FLAG_267 DET_OUTSIDE_SECTOR_267 DET_EXISTENCE_PROB_267 DET_POINT_TARGET_PROB_267 DET_SUPER_RES_TARGET_267 DET_BI_STATIC_FLAG_267 DET_VALID_FLAG_267 DET_RCS_267 DET_ELEVATION_267 DET_SNR_267 DET_ELEVATION_ERR_267 DET_AZIMUTH_ERR_267 DET_RANGE_VELOCITY_ERR_267 DET_AZIMUTH_267 DET_RANGE_VELOCITY_267 DET_RANGE_ERR_267 DET_RANGE_267 DET_BI_STATIC_FLAG_268 DET_CONFD_ELEVATION_268 DET_CONFD_AZIMUTH_268 DET_HVC_FLAG_268 DET_OUTSIDE_SECTOR_268 DET_EXISTENCE_PROB_268 DET_POINT_TARGET_PROB_268 DET_SNR_268 DET_SUPER_RES_TARGET_268 DET_VALID_FLAG_268 DET_RCS_268 DET_ELEVATION_ERR_268 DET_ELEVATION_268 DET_AZIMUTH_ERR_268 DET_AZIMUTH_268 DET_RANGE_VELOCITY_ERR_268 DET_RANGE_VELOCITY_268 DET_RANGE_ERR_268 DET_RANGE_268;
SIG_GROUP_ 1219 Detections_269_272 1 : DET_MH_CRC16_269_272 DET_MH_CYCLE_COUNTER_269_272 DET_MH_SCAN_INDEX_4LSB_269_272 DET_CONFD_ELEVATION_269 DET_CONFD_AZIMUTH_269 DET_HVC_FLAG_269 DET_OUTSIDE_SECTOR_269 DET_EXISTENCE_PROB_269 DET_POINT_TARGET_PROB_269 DET_SNR_269 DET_SUPER_RES_TARGET_269 DET_BI_STATIC_FLAG_269 DET_VALID_FLAG_269 DET_RCS_269 DET_ELEVATION_ERR_269 DET_ELEVATION_269 DET_AZIMUTH_ERR_269 DET_AZIMUTH_269 DET_RANGE_VELOCITY_ERR_269 DET_RANGE_VELOCITY_269 DET_RANGE_ERR_269 DET_RANGE_269 DET_CONFD_ELEVATION_270 DET_CONFD_AZIMUTH_270 DET_HVC_FLAG_270 DET_OUTSIDE_SECTOR_270 DET_EXISTENCE_PROB_270 DET_POINT_TARGET_PROB_270 DET_SNR_270 DET_SUPER_RES_TARGET_270 DET_BI_STATIC_FLAG_270 DET_VALID_FLAG_270 DET_RCS_270 DET_ELEVATION_270 DET_ELEVATION_ERR_270 DET_AZIMUTH_ERR_270 DET_AZIMUTH_270 DET_RANGE_VELOCITY_ERR_270 DET_RANGE_VELOCITY_270 DET_RANGE_ERR_270 DET_RANGE_270 DET_CONFD_ELEVATION_271 DET_CONFD_AZIMUTH_271 DET_HVC_FLAG_271 DET_OUTSIDE_SECTOR_271 DET_EXISTENCE_PROB_271 DET_POINT_TARGET_PROB_271 DET_SUPER_RES_TARGET_271 DET_BI_STATIC_FLAG_271 DET_VALID_FLAG_271 DET_RCS_271 DET_ELEVATION_271 DET_SNR_271 DET_ELEVATION_ERR_271 DET_AZIMUTH_ERR_271 DET_RANGE_VELOCITY_ERR_271 DET_AZIMUTH_271 DET_RANGE_VELOCITY_271 DET_RANGE_ERR_271 DET_RANGE_271 DET_BI_STATIC_FLAG_272 DET_CONFD_ELEVATION_272 DET_CONFD_AZIMUTH_272 DET_HVC_FLAG_272 DET_OUTSIDE_SECTOR_272 DET_EXISTENCE_PROB_272 DET_POINT_TARGET_PROB_272 DET_SNR_272 DET_SUPER_RES_TARGET_272 DET_VALID_FLAG_272 DET_RCS_272 DET_ELEVATION_ERR_272 DET_ELEVATION_272 DET_AZIMUTH_ERR_272 DET_AZIMUTH_272 DET_RANGE_VELOCITY_ERR_272 DET_RANGE_VELOCITY_272 DET_RANGE_ERR_272 DET_RANGE_272;
SIG_GROUP_ 1220 Detections_273_276 1 : DET_MH_CRC16_273_276 DET_MH_CYCLE_COUNTER_273_276 DET_MH_SCAN_INDEX_4LSB_273_276 DET_CONFD_ELEVATION_273 DET_CONFD_AZIMUTH_273 DET_HVC_FLAG_273 DET_OUTSIDE_SECTOR_273 DET_EXISTENCE_PROB_273 DET_POINT_TARGET_PROB_273 DET_SNR_273 DET_SUPER_RES_TARGET_273 DET_BI_STATIC_FLAG_273 DET_VALID_FLAG_273 DET_RCS_273 DET_ELEVATION_ERR_273 DET_ELEVATION_273 DET_AZIMUTH_ERR_273 DET_AZIMUTH_273 DET_RANGE_VELOCITY_ERR_273 DET_RANGE_VELOCITY_273 DET_RANGE_ERR_273 DET_RANGE_273 DET_CONFD_ELEVATION_274 DET_CONFD_AZIMUTH_274 DET_HVC_FLAG_274 DET_OUTSIDE_SECTOR_274 DET_EXISTENCE_PROB_274 DET_POINT_TARGET_PROB_274 DET_SNR_274 DET_SUPER_RES_TARGET_274 DET_BI_STATIC_FLAG_274 DET_VALID_FLAG_274 DET_RCS_274 DET_ELEVATION_274 DET_ELEVATION_ERR_274 DET_AZIMUTH_ERR_274 DET_AZIMUTH_274 DET_RANGE_VELOCITY_ERR_274 DET_RANGE_VELOCITY_274 DET_RANGE_ERR_274 DET_RANGE_274 DET_CONFD_ELEVATION_275 DET_CONFD_AZIMUTH_275 DET_HVC_FLAG_275 DET_OUTSIDE_SECTOR_275 DET_EXISTENCE_PROB_275 DET_POINT_TARGET_PROB_275 DET_SUPER_RES_TARGET_275 DET_BI_STATIC_FLAG_275 DET_VALID_FLAG_275 DET_RCS_275 DET_ELEVATION_275 DET_SNR_275 DET_ELEVATION_ERR_275 DET_AZIMUTH_ERR_275 DET_RANGE_VELOCITY_ERR_275 DET_AZIMUTH_275 DET_RANGE_VELOCITY_275 DET_RANGE_ERR_275 DET_RANGE_275 DET_BI_STATIC_FLAG_276 DET_CONFD_ELEVATION_276 DET_CONFD_AZIMUTH_276 DET_HVC_FLAG_276 DET_OUTSIDE_SECTOR_276 DET_EXISTENCE_PROB_276 DET_POINT_TARGET_PROB_276 DET_SNR_276 DET_SUPER_RES_TARGET_276 DET_VALID_FLAG_276 DET_RCS_276 DET_ELEVATION_ERR_276 DET_ELEVATION_276 DET_AZIMUTH_ERR_276 DET_AZIMUTH_276 DET_RANGE_VELOCITY_ERR_276 DET_RANGE_VELOCITY_276 DET_RANGE_ERR_276 DET_RANGE_276;
SIG_GROUP_ 1221 Detections_277_280 1 : DET_MH_CRC16_277_280 DET_MH_CYCLE_COUNTER_277_280 DET_MH_SCAN_INDEX_4LSB_277_280 DET_CONFD_ELEVATION_277 DET_CONFD_AZIMUTH_277 DET_HVC_FLAG_277 DET_OUTSIDE_SECTOR_277 DET_EXISTENCE_PROB_277 DET_POINT_TARGET_PROB_277 DET_SNR_277 DET_SUPER_RES_TARGET_277 DET_BI_STATIC_FLAG_277 DET_VALID_FLAG_277 DET_RCS_277 DET_ELEVATION_ERR_277 DET_ELEVATION_277 DET_AZIMUTH_ERR_277 DET_AZIMUTH_277 DET_RANGE_VELOCITY_ERR_277 DET_RANGE_VELOCITY_277 DET_RANGE_ERR_277 DET_RANGE_277 DET_CONFD_ELEVATION_278 DET_CONFD_AZIMUTH_278 DET_HVC_FLAG_278 DET_OUTSIDE_SECTOR_278 DET_EXISTENCE_PROB_278 DET_POINT_TARGET_PROB_278 DET_SNR_278 DET_SUPER_RES_TARGET_278 DET_BI_STATIC_FLAG_278 DET_VALID_FLAG_278 DET_RCS_278 DET_ELEVATION_278 DET_ELEVATION_ERR_278 DET_AZIMUTH_ERR_278 DET_AZIMUTH_278 DET_RANGE_VELOCITY_ERR_278 DET_RANGE_VELOCITY_278 DET_RANGE_ERR_278 DET_RANGE_278 DET_CONFD_ELEVATION_279 DET_CONFD_AZIMUTH_279 DET_HVC_FLAG_279 DET_OUTSIDE_SECTOR_279 DET_EXISTENCE_PROB_279 DET_POINT_TARGET_PROB_279 DET_SUPER_RES_TARGET_279 DET_BI_STATIC_FLAG_279 DET_VALID_FLAG_279 DET_RCS_279 DET_ELEVATION_279 DET_SNR_279 DET_ELEVATION_ERR_279 DET_AZIMUTH_ERR_279 DET_RANGE_VELOCITY_ERR_279 DET_AZIMUTH_279 DET_RANGE_VELOCITY_279 DET_RANGE_ERR_279 DET_RANGE_279 DET_BI_STATIC_FLAG_280 DET_CONFD_ELEVATION_280 DET_CONFD_AZIMUTH_280 DET_HVC_FLAG_280 DET_OUTSIDE_SECTOR_280 DET_EXISTENCE_PROB_280 DET_POINT_TARGET_PROB_280 DET_SNR_280 DET_SUPER_RES_TARGET_280 DET_VALID_FLAG_280 DET_RCS_280 DET_ELEVATION_ERR_280 DET_ELEVATION_280 DET_AZIMUTH_ERR_280 DET_AZIMUTH_280 DET_RANGE_VELOCITY_ERR_280 DET_RANGE_VELOCITY_280 DET_RANGE_ERR_280 DET_RANGE_280;
SIG_GROUP_ 1222 Detections_281_284 1 : DET_MH_CRC16_281_284 DET_MH_CYCLE_COUNTER_281_284 DET_MH_SCAN_INDEX_4LSB_281_284 DET_CONFD_ELEVATION_281 DET_CONFD_AZIMUTH_281 DET_HVC_FLAG_281 DET_OUTSIDE_SECTOR_281 DET_EXISTENCE_PROB_281 DET_POINT_TARGET_PROB_281 DET_SNR_281 DET_SUPER_RES_TARGET_281 DET_BI_STATIC_FLAG_281 DET_VALID_FLAG_281 DET_RCS_281 DET_ELEVATION_ERR_281 DET_ELEVATION_281 DET_AZIMUTH_ERR_281 DET_AZIMUTH_281 DET_RANGE_VELOCITY_ERR_281 DET_RANGE_VELOCITY_281 DET_RANGE_ERR_281 DET_RANGE_281 DET_CONFD_ELEVATION_282 DET_CONFD_AZIMUTH_282 DET_HVC_FLAG_282 DET_OUTSIDE_SECTOR_282 DET_EXISTENCE_PROB_282 DET_POINT_TARGET_PROB_282 DET_SNR_282 DET_SUPER_RES_TARGET_282 DET_BI_STATIC_FLAG_282 DET_VALID_FLAG_282 DET_RCS_282 DET_ELEVATION_282 DET_ELEVATION_ERR_282 DET_AZIMUTH_ERR_282 DET_AZIMUTH_282 DET_RANGE_VELOCITY_ERR_282 DET_RANGE_VELOCITY_282 DET_RANGE_ERR_282 DET_RANGE_282 DET_CONFD_ELEVATION_283 DET_CONFD_AZIMUTH_283 DET_HVC_FLAG_283 DET_OUTSIDE_SECTOR_283 DET_EXISTENCE_PROB_283 DET_POINT_TARGET_PROB_283 DET_SUPER_RES_TARGET_283 DET_BI_STATIC_FLAG_283 DET_VALID_FLAG_283 DET_RCS_283 DET_ELEVATION_283 DET_SNR_283 DET_ELEVATION_ERR_283 DET_AZIMUTH_ERR_283 DET_RANGE_VELOCITY_ERR_283 DET_AZIMUTH_283 DET_RANGE_VELOCITY_283 DET_RANGE_ERR_283 DET_RANGE_283 DET_BI_STATIC_FLAG_284 DET_CONFD_ELEVATION_284 DET_CONFD_AZIMUTH_284 DET_HVC_FLAG_284 DET_OUTSIDE_SECTOR_284 DET_EXISTENCE_PROB_284 DET_POINT_TARGET_PROB_284 DET_SNR_284 DET_SUPER_RES_TARGET_284 DET_VALID_FLAG_284 DET_RCS_284 DET_ELEVATION_ERR_284 DET_ELEVATION_284 DET_AZIMUTH_ERR_284 DET_AZIMUTH_284 DET_RANGE_VELOCITY_ERR_284 DET_RANGE_VELOCITY_284 DET_RANGE_ERR_284 DET_RANGE_284;
SIG_GROUP_ 1223 Detections_285_288 1 : DET_MH_CRC16_285_288 DET_MH_CYCLE_COUNTER_285_288 DET_MH_SCAN_INDEX_4LSB_285_288 DET_CONFD_ELEVATION_285 DET_CONFD_AZIMUTH_285 DET_HVC_FLAG_285 DET_OUTSIDE_SECTOR_285 DET_EXISTENCE_PROB_285 DET_POINT_TARGET_PROB_285 DET_SNR_285 DET_SUPER_RES_TARGET_285 DET_BI_STATIC_FLAG_285 DET_VALID_FLAG_285 DET_RCS_285 DET_ELEVATION_ERR_285 DET_ELEVATION_285 DET_AZIMUTH_ERR_285 DET_AZIMUTH_285 DET_RANGE_VELOCITY_ERR_285 DET_RANGE_VELOCITY_285 DET_RANGE_ERR_285 DET_RANGE_285 DET_CONFD_ELEVATION_286 DET_CONFD_AZIMUTH_286 DET_HVC_FLAG_286 DET_OUTSIDE_SECTOR_286 DET_EXISTENCE_PROB_286 DET_POINT_TARGET_PROB_286 DET_SNR_286 DET_SUPER_RES_TARGET_286 DET_BI_STATIC_FLAG_286 DET_VALID_FLAG_286 DET_RCS_286 DET_ELEVATION_286 DET_ELEVATION_ERR_286 DET_AZIMUTH_ERR_286 DET_AZIMUTH_286 DET_RANGE_VELOCITY_ERR_286 DET_RANGE_VELOCITY_286 DET_RANGE_ERR_286 DET_RANGE_286 DET_CONFD_ELEVATION_287 DET_CONFD_AZIMUTH_287 DET_HVC_FLAG_287 DET_OUTSIDE_SECTOR_287 DET_EXISTENCE_PROB_287 DET_POINT_TARGET_PROB_287 DET_SUPER_RES_TARGET_287 DET_BI_STATIC_FLAG_287 DET_VALID_FLAG_287 DET_RCS_287 DET_ELEVATION_287 DET_SNR_287 DET_ELEVATION_ERR_287 DET_AZIMUTH_ERR_287 DET_RANGE_VELOCITY_ERR_287 DET_AZIMUTH_287 DET_RANGE_VELOCITY_287 DET_RANGE_ERR_287 DET_RANGE_287 DET_BI_STATIC_FLAG_288 DET_CONFD_ELEVATION_288 DET_CONFD_AZIMUTH_288 DET_HVC_FLAG_288 DET_OUTSIDE_SECTOR_288 DET_EXISTENCE_PROB_288 DET_POINT_TARGET_PROB_288 DET_SNR_288 DET_SUPER_RES_TARGET_288 DET_VALID_FLAG_288 DET_RCS_288 DET_ELEVATION_ERR_288 DET_ELEVATION_288 DET_AZIMUTH_ERR_288 DET_AZIMUTH_288 DET_RANGE_VELOCITY_ERR_288 DET_RANGE_VELOCITY_288 DET_RANGE_ERR_288 DET_RANGE_288;
SIG_GROUP_ 1224 Detections_289_292 1 : DET_MH_CRC16_289_292 DET_MH_CYCLE_COUNTER_289_292 DET_MH_SCAN_INDEX_4LSB_289_292 DET_CONFD_ELEVATION_289 DET_CONFD_AZIMUTH_289 DET_HVC_FLAG_289 DET_OUTSIDE_SECTOR_289 DET_EXISTENCE_PROB_289 DET_POINT_TARGET_PROB_289 DET_SNR_289 DET_SUPER_RES_TARGET_289 DET_BI_STATIC_FLAG_289 DET_VALID_FLAG_289 DET_RCS_289 DET_ELEVATION_ERR_289 DET_ELEVATION_289 DET_AZIMUTH_ERR_289 DET_AZIMUTH_289 DET_RANGE_VELOCITY_ERR_289 DET_RANGE_VELOCITY_289 DET_RANGE_ERR_289 DET_RANGE_289 DET_CONFD_ELEVATION_290 DET_CONFD_AZIMUTH_290 DET_HVC_FLAG_290 DET_OUTSIDE_SECTOR_290 DET_EXISTENCE_PROB_290 DET_POINT_TARGET_PROB_290 DET_SNR_290 DET_SUPER_RES_TARGET_290 DET_BI_STATIC_FLAG_290 DET_VALID_FLAG_290 DET_RCS_290 DET_ELEVATION_290 DET_ELEVATION_ERR_290 DET_AZIMUTH_ERR_290 DET_AZIMUTH_290 DET_RANGE_VELOCITY_ERR_290 DET_RANGE_VELOCITY_290 DET_RANGE_ERR_290 DET_RANGE_290 DET_CONFD_ELEVATION_291 DET_CONFD_AZIMUTH_291 DET_HVC_FLAG_291 DET_OUTSIDE_SECTOR_291 DET_EXISTENCE_PROB_291 DET_POINT_TARGET_PROB_291 DET_SUPER_RES_TARGET_291 DET_BI_STATIC_FLAG_291 DET_VALID_FLAG_291 DET_RCS_291 DET_ELEVATION_291 DET_SNR_291 DET_ELEVATION_ERR_291 DET_AZIMUTH_ERR_291 DET_RANGE_VELOCITY_ERR_291 DET_AZIMUTH_291 DET_RANGE_VELOCITY_291 DET_RANGE_ERR_291 DET_RANGE_291 DET_BI_STATIC_FLAG_292 DET_CONFD_ELEVATION_292 DET_CONFD_AZIMUTH_292 DET_HVC_FLAG_292 DET_OUTSIDE_SECTOR_292 DET_EXISTENCE_PROB_292 DET_POINT_TARGET_PROB_292 DET_SNR_292 DET_SUPER_RES_TARGET_292 DET_VALID_FLAG_292 DET_RCS_292 DET_ELEVATION_ERR_292 DET_ELEVATION_292 DET_AZIMUTH_ERR_292 DET_AZIMUTH_292 DET_RANGE_VELOCITY_ERR_292 DET_RANGE_VELOCITY_292 DET_RANGE_ERR_292 DET_RANGE_292;
SIG_GROUP_ 1225 Detections_293_296 1 : DET_MH_CRC16_293_296 DET_MH_CYCLE_COUNTER_293_296 DET_MH_SCAN_INDEX_4LSB_293_296 DET_CONFD_ELEVATION_293 DET_CONFD_AZIMUTH_293 DET_HVC_FLAG_293 DET_OUTSIDE_SECTOR_293 DET_EXISTENCE_PROB_293 DET_POINT_TARGET_PROB_293 DET_SNR_293 DET_SUPER_RES_TARGET_293 DET_BI_STATIC_FLAG_293 DET_VALID_FLAG_293 DET_RCS_293 DET_ELEVATION_ERR_293 DET_ELEVATION_293 DET_AZIMUTH_ERR_293 DET_AZIMUTH_293 DET_RANGE_VELOCITY_ERR_293 DET_RANGE_VELOCITY_293 DET_RANGE_ERR_293 DET_RANGE_293 DET_CONFD_ELEVATION_294 DET_CONFD_AZIMUTH_294 DET_HVC_FLAG_294 DET_OUTSIDE_SECTOR_294 DET_EXISTENCE_PROB_294 DET_POINT_TARGET_PROB_294 DET_SNR_294 DET_SUPER_RES_TARGET_294 DET_BI_STATIC_FLAG_294 DET_VALID_FLAG_294 DET_RCS_294 DET_ELEVATION_294 DET_ELEVATION_ERR_294 DET_AZIMUTH_ERR_294 DET_AZIMUTH_294 DET_RANGE_VELOCITY_ERR_294 DET_RANGE_VELOCITY_294 DET_RANGE_ERR_294 DET_RANGE_294 DET_CONFD_ELEVATION_295 DET_CONFD_AZIMUTH_295 DET_HVC_FLAG_295 DET_OUTSIDE_SECTOR_295 DET_EXISTENCE_PROB_295 DET_POINT_TARGET_PROB_295 DET_SUPER_RES_TARGET_295 DET_BI_STATIC_FLAG_295 DET_VALID_FLAG_295 DET_RCS_295 DET_ELEVATION_295 DET_SNR_295 DET_ELEVATION_ERR_295 DET_AZIMUTH_ERR_295 DET_RANGE_VELOCITY_ERR_295 DET_AZIMUTH_295 DET_RANGE_VELOCITY_295 DET_RANGE_ERR_295 DET_RANGE_295 DET_BI_STATIC_FLAG_296 DET_CONFD_ELEVATION_296 DET_CONFD_AZIMUTH_296 DET_HVC_FLAG_296 DET_OUTSIDE_SECTOR_296 DET_EXISTENCE_PROB_296 DET_POINT_TARGET_PROB_296 DET_SNR_296 DET_SUPER_RES_TARGET_296 DET_VALID_FLAG_296 DET_RCS_296 DET_ELEVATION_ERR_296 DET_ELEVATION_296 DET_AZIMUTH_ERR_296 DET_AZIMUTH_296 DET_RANGE_VELOCITY_ERR_296 DET_RANGE_VELOCITY_296 DET_RANGE_ERR_296 DET_RANGE_296;
SIG_GROUP_ 1226 Detections_297_300 1 : DET_MH_CRC16_297_300 DET_MH_CYCLE_COUNTER_297_300 DET_MH_SCAN_INDEX_4LSB_297_300 DET_CONFD_ELEVATION_297 DET_CONFD_AZIMUTH_297 DET_HVC_FLAG_297 DET_OUTSIDE_SECTOR_297 DET_EXISTENCE_PROB_297 DET_POINT_TARGET_PROB_297 DET_SNR_297 DET_SUPER_RES_TARGET_297 DET_BI_STATIC_FLAG_297 DET_VALID_FLAG_297 DET_RCS_297 DET_ELEVATION_ERR_297 DET_ELEVATION_297 DET_AZIMUTH_ERR_297 DET_AZIMUTH_297 DET_RANGE_VELOCITY_ERR_297 DET_RANGE_VELOCITY_297 DET_RANGE_ERR_297 DET_RANGE_297 DET_CONFD_ELEVATION_298 DET_CONFD_AZIMUTH_298 DET_HVC_FLAG_298 DET_OUTSIDE_SECTOR_298 DET_EXISTENCE_PROB_298 DET_POINT_TARGET_PROB_298 DET_SNR_298 DET_SUPER_RES_TARGET_298 DET_BI_STATIC_FLAG_298 DET_VALID_FLAG_298 DET_RCS_298 DET_ELEVATION_298 DET_ELEVATION_ERR_298 DET_AZIMUTH_ERR_298 DET_AZIMUTH_298 DET_RANGE_VELOCITY_ERR_298 DET_RANGE_VELOCITY_298 DET_RANGE_ERR_298 DET_RANGE_298 DET_CONFD_ELEVATION_299 DET_CONFD_AZIMUTH_299 DET_HVC_FLAG_299 DET_OUTSIDE_SECTOR_299 DET_EXISTENCE_PROB_299 DET_POINT_TARGET_PROB_299 DET_SUPER_RES_TARGET_299 DET_BI_STATIC_FLAG_299 DET_VALID_FLAG_299 DET_RCS_299 DET_ELEVATION_299 DET_SNR_299 DET_ELEVATION_ERR_299 DET_AZIMUTH_ERR_299 DET_RANGE_VELOCITY_ERR_299 DET_AZIMUTH_299 DET_RANGE_VELOCITY_299 DET_RANGE_ERR_299 DET_RANGE_299 DET_BI_STATIC_FLAG_300 DET_CONFD_ELEVATION_300 DET_CONFD_AZIMUTH_300 DET_HVC_FLAG_300 DET_OUTSIDE_SECTOR_300 DET_EXISTENCE_PROB_300 DET_POINT_TARGET_PROB_300 DET_SNR_300 DET_SUPER_RES_TARGET_300 DET_VALID_FLAG_300 DET_RCS_300 DET_ELEVATION_ERR_300 DET_ELEVATION_300 DET_AZIMUTH_ERR_300 DET_AZIMUTH_300 DET_RANGE_VELOCITY_ERR_300 DET_RANGE_VELOCITY_300 DET_RANGE_ERR_300 DET_RANGE_300;
SIG_GROUP_ 1227 Detections_301_304 1 : DET_MH_CRC16_301_304 DET_MH_CYCLE_COUNTER_301_304 DET_MH_SCAN_INDEX_4LSB_301_304 DET_CONFD_ELEVATION_301 DET_CONFD_AZIMUTH_301 DET_HVC_FLAG_301 DET_OUTSIDE_SECTOR_301 DET_EXISTENCE_PROB_301 DET_POINT_TARGET_PROB_301 DET_SNR_301 DET_SUPER_RES_TARGET_301 DET_BI_STATIC_FLAG_301 DET_VALID_FLAG_301 DET_RCS_301 DET_ELEVATION_ERR_301 DET_ELEVATION_301 DET_AZIMUTH_ERR_301 DET_AZIMUTH_301 DET_RANGE_VELOCITY_ERR_301 DET_RANGE_VELOCITY_301 DET_RANGE_ERR_301 DET_RANGE_301 DET_CONFD_ELEVATION_302 DET_CONFD_AZIMUTH_302 DET_HVC_FLAG_302 DET_OUTSIDE_SECTOR_302 DET_EXISTENCE_PROB_302 DET_POINT_TARGET_PROB_302 DET_SNR_302 DET_SUPER_RES_TARGET_302 DET_BI_STATIC_FLAG_302 DET_VALID_FLAG_302 DET_RCS_302 DET_ELEVATION_302 DET_ELEVATION_ERR_302 DET_AZIMUTH_ERR_302 DET_AZIMUTH_302 DET_RANGE_VELOCITY_ERR_302 DET_RANGE_VELOCITY_302 DET_RANGE_ERR_302 DET_RANGE_302 DET_CONFD_ELEVATION_303 DET_CONFD_AZIMUTH_303 DET_HVC_FLAG_303 DET_OUTSIDE_SECTOR_303 DET_EXISTENCE_PROB_303 DET_POINT_TARGET_PROB_303 DET_SUPER_RES_TARGET_303 DET_BI_STATIC_FLAG_303 DET_VALID_FLAG_303 DET_RCS_303 DET_ELEVATION_303 DET_SNR_303 DET_ELEVATION_ERR_303 DET_AZIMUTH_ERR_303 DET_RANGE_VELOCITY_ERR_303 DET_AZIMUTH_303 DET_RANGE_VELOCITY_303 DET_RANGE_ERR_303 DET_RANGE_303 DET_BI_STATIC_FLAG_304 DET_CONFD_ELEVATION_304 DET_CONFD_AZIMUTH_304 DET_HVC_FLAG_304 DET_OUTSIDE_SECTOR_304 DET_EXISTENCE_PROB_304 DET_POINT_TARGET_PROB_304 DET_SNR_304 DET_SUPER_RES_TARGET_304 DET_VALID_FLAG_304 DET_RCS_304 DET_ELEVATION_ERR_304 DET_ELEVATION_304 DET_AZIMUTH_ERR_304 DET_AZIMUTH_304 DET_RANGE_VELOCITY_ERR_304 DET_RANGE_VELOCITY_304 DET_RANGE_ERR_304 DET_RANGE_304;
SIG_GROUP_ 1228 Detections_305_308 1 : DET_MH_CRC16_305_308 DET_MH_CYCLE_COUNTER_305_308 DET_MH_SCAN_INDEX_4LSB_305_308 DET_CONFD_ELEVATION_305 DET_CONFD_AZIMUTH_305 DET_HVC_FLAG_305 DET_OUTSIDE_SECTOR_305 DET_EXISTENCE_PROB_305 DET_POINT_TARGET_PROB_305 DET_SNR_305 DET_SUPER_RES_TARGET_305 DET_BI_STATIC_FLAG_305 DET_VALID_FLAG_305 DET_RCS_305 DET_ELEVATION_ERR_305 DET_ELEVATION_305 DET_AZIMUTH_ERR_305 DET_AZIMUTH_305 DET_RANGE_VELOCITY_ERR_305 DET_RANGE_VELOCITY_305 DET_RANGE_ERR_305 DET_RANGE_305 DET_CONFD_ELEVATION_306 DET_CONFD_AZIMUTH_306 DET_HVC_FLAG_306 DET_OUTSIDE_SECTOR_306 DET_EXISTENCE_PROB_306 DET_POINT_TARGET_PROB_306 DET_SNR_306 DET_SUPER_RES_TARGET_306 DET_BI_STATIC_FLAG_306 DET_VALID_FLAG_306 DET_RCS_306 DET_ELEVATION_306 DET_ELEVATION_ERR_306 DET_AZIMUTH_ERR_306 DET_AZIMUTH_306 DET_RANGE_VELOCITY_ERR_306 DET_RANGE_VELOCITY_306 DET_RANGE_ERR_306 DET_RANGE_306 DET_CONFD_ELEVATION_307 DET_CONFD_AZIMUTH_307 DET_HVC_FLAG_307 DET_OUTSIDE_SECTOR_307 DET_EXISTENCE_PROB_307 DET_POINT_TARGET_PROB_307 DET_SUPER_RES_TARGET_307 DET_BI_STATIC_FLAG_307 DET_VALID_FLAG_307 DET_RCS_307 DET_ELEVATION_307 DET_SNR_307 DET_ELEVATION_ERR_307 DET_AZIMUTH_ERR_307 DET_RANGE_VELOCITY_ERR_307 DET_AZIMUTH_307 DET_RANGE_VELOCITY_307 DET_RANGE_ERR_307 DET_RANGE_307 DET_BI_STATIC_FLAG_308 DET_CONFD_ELEVATION_308 DET_CONFD_AZIMUTH_308 DET_HVC_FLAG_308 DET_OUTSIDE_SECTOR_308 DET_EXISTENCE_PROB_308 DET_POINT_TARGET_PROB_308 DET_SNR_308 DET_SUPER_RES_TARGET_308 DET_VALID_FLAG_308 DET_RCS_308 DET_ELEVATION_ERR_308 DET_ELEVATION_308 DET_AZIMUTH_ERR_308 DET_AZIMUTH_308 DET_RANGE_VELOCITY_ERR_308 DET_RANGE_VELOCITY_308 DET_RANGE_ERR_308 DET_RANGE_308;
SIG_GROUP_ 1229 Detections_309_312 1 : DET_MH_CRC16_309_312 DET_MH_CYCLE_COUNTER_309_312 DET_MH_SCAN_INDEX_4LSB_309_312 DET_CONFD_ELEVATION_309 DET_CONFD_AZIMUTH_309 DET_HVC_FLAG_309 DET_OUTSIDE_SECTOR_309 DET_EXISTENCE_PROB_309 DET_POINT_TARGET_PROB_309 DET_SNR_309 DET_SUPER_RES_TARGET_309 DET_BI_STATIC_FLAG_309 DET_VALID_FLAG_309 DET_RCS_309 DET_ELEVATION_ERR_309 DET_ELEVATION_309 DET_AZIMUTH_ERR_309 DET_AZIMUTH_309 DET_RANGE_VELOCITY_ERR_309 DET_RANGE_VELOCITY_309 DET_RANGE_ERR_309 DET_RANGE_309 DET_CONFD_ELEVATION_310 DET_CONFD_AZIMUTH_310 DET_HVC_FLAG_310 DET_OUTSIDE_SECTOR_310 DET_EXISTENCE_PROB_310 DET_POINT_TARGET_PROB_310 DET_SNR_310 DET_SUPER_RES_TARGET_310 DET_BI_STATIC_FLAG_310 DET_VALID_FLAG_310 DET_RCS_310 DET_ELEVATION_310 DET_ELEVATION_ERR_310 DET_AZIMUTH_ERR_310 DET_AZIMUTH_310 DET_RANGE_VELOCITY_ERR_310 DET_RANGE_VELOCITY_310 DET_RANGE_ERR_310 DET_RANGE_310 DET_CONFD_ELEVATION_311 DET_CONFD_AZIMUTH_311 DET_HVC_FLAG_311 DET_OUTSIDE_SECTOR_311 DET_EXISTENCE_PROB_311 DET_POINT_TARGET_PROB_311 DET_SUPER_RES_TARGET_311 DET_BI_STATIC_FLAG_311 DET_VALID_FLAG_311 DET_RCS_311 DET_ELEVATION_311 DET_SNR_311 DET_ELEVATION_ERR_311 DET_AZIMUTH_ERR_311 DET_RANGE_VELOCITY_ERR_311 DET_AZIMUTH_311 DET_RANGE_VELOCITY_311 DET_RANGE_ERR_311 DET_RANGE_311 DET_BI_STATIC_FLAG_312 DET_CONFD_ELEVATION_312 DET_CONFD_AZIMUTH_312 DET_HVC_FLAG_312 DET_OUTSIDE_SECTOR_312 DET_EXISTENCE_PROB_312 DET_POINT_TARGET_PROB_312 DET_SNR_312 DET_SUPER_RES_TARGET_312 DET_VALID_FLAG_312 DET_RCS_312 DET_ELEVATION_ERR_312 DET_ELEVATION_312 DET_AZIMUTH_ERR_312 DET_AZIMUTH_312 DET_RANGE_VELOCITY_ERR_312 DET_RANGE_VELOCITY_312 DET_RANGE_ERR_312 DET_RANGE_312;
SIG_GROUP_ 1230 Detections_313_316 1 : DET_MH_CRC16_313_316 DET_MH_CYCLE_COUNTER_313_316 DET_MH_SCAN_INDEX_4LSB_313_316 DET_CONFD_ELEVATION_313 DET_CONFD_AZIMUTH_313 DET_HVC_FLAG_313 DET_OUTSIDE_SECTOR_313 DET_EXISTENCE_PROB_313 DET_POINT_TARGET_PROB_313 DET_SNR_313 DET_SUPER_RES_TARGET_313 DET_BI_STATIC_FLAG_313 DET_VALID_FLAG_313 DET_RCS_313 DET_ELEVATION_ERR_313 DET_ELEVATION_313 DET_AZIMUTH_ERR_313 DET_AZIMUTH_313 DET_RANGE_VELOCITY_ERR_313 DET_RANGE_VELOCITY_313 DET_RANGE_ERR_313 DET_RANGE_313 DET_CONFD_ELEVATION_314 DET_CONFD_AZIMUTH_314 DET_HVC_FLAG_314 DET_OUTSIDE_SECTOR_314 DET_EXISTENCE_PROB_314 DET_POINT_TARGET_PROB_314 DET_SNR_314 DET_SUPER_RES_TARGET_314 DET_BI_STATIC_FLAG_314 DET_VALID_FLAG_314 DET_RCS_314 DET_ELEVATION_314 DET_ELEVATION_ERR_314 DET_AZIMUTH_ERR_314 DET_AZIMUTH_314 DET_RANGE_VELOCITY_ERR_314 DET_RANGE_VELOCITY_314 DET_RANGE_ERR_314 DET_RANGE_314 DET_CONFD_ELEVATION_315 DET_CONFD_AZIMUTH_315 DET_HVC_FLAG_315 DET_OUTSIDE_SECTOR_315 DET_EXISTENCE_PROB_315 DET_POINT_TARGET_PROB_315 DET_SUPER_RES_TARGET_315 DET_BI_STATIC_FLAG_315 DET_VALID_FLAG_315 DET_RCS_315 DET_ELEVATION_315 DET_SNR_315 DET_ELEVATION_ERR_315 DET_AZIMUTH_ERR_315 DET_RANGE_VELOCITY_ERR_315 DET_AZIMUTH_315 DET_RANGE_VELOCITY_315 DET_RANGE_ERR_315 DET_RANGE_315 DET_BI_STATIC_FLAG_316 DET_CONFD_ELEVATION_316 DET_CONFD_AZIMUTH_316 DET_HVC_FLAG_316 DET_OUTSIDE_SECTOR_316 DET_EXISTENCE_PROB_316 DET_POINT_TARGET_PROB_316 DET_SNR_316 DET_SUPER_RES_TARGET_316 DET_VALID_FLAG_316 DET_RCS_316 DET_ELEVATION_ERR_316 DET_ELEVATION_316 DET_AZIMUTH_ERR_316 DET_AZIMUTH_316 DET_RANGE_VELOCITY_ERR_316 DET_RANGE_VELOCITY_316 DET_RANGE_ERR_316 DET_RANGE_316;
SIG_GROUP_ 1231 Detections_317_320 1 : DET_MH_CRC16_317_320 DET_MH_CYCLE_COUNTER_317_320 DET_MH_SCAN_INDEX_4LSB_317_320 DET_CONFD_ELEVATION_317 DET_CONFD_AZIMUTH_317 DET_HVC_FLAG_317 DET_OUTSIDE_SECTOR_317 DET_EXISTENCE_PROB_317 DET_POINT_TARGET_PROB_317 DET_SNR_317 DET_SUPER_RES_TARGET_317 DET_BI_STATIC_FLAG_317 DET_VALID_FLAG_317 DET_RCS_317 DET_ELEVATION_ERR_317 DET_ELEVATION_317 DET_AZIMUTH_ERR_317 DET_AZIMUTH_317 DET_RANGE_VELOCITY_ERR_317 DET_RANGE_VELOCITY_317 DET_RANGE_ERR_317 DET_RANGE_317 DET_CONFD_ELEVATION_318 DET_CONFD_AZIMUTH_318 DET_HVC_FLAG_318 DET_OUTSIDE_SECTOR_318 DET_EXISTENCE_PROB_318 DET_POINT_TARGET_PROB_318 DET_SNR_318 DET_SUPER_RES_TARGET_318 DET_BI_STATIC_FLAG_318 DET_VALID_FLAG_318 DET_RCS_318 DET_ELEVATION_318 DET_ELEVATION_ERR_318 DET_AZIMUTH_ERR_318 DET_AZIMUTH_318 DET_RANGE_VELOCITY_ERR_318 DET_RANGE_VELOCITY_318 DET_RANGE_ERR_318 DET_RANGE_318 DET_CONFD_ELEVATION_319 DET_CONFD_AZIMUTH_319 DET_HVC_FLAG_319 DET_OUTSIDE_SECTOR_319 DET_EXISTENCE_PROB_319 DET_POINT_TARGET_PROB_319 DET_SUPER_RES_TARGET_319 DET_BI_STATIC_FLAG_319 DET_VALID_FLAG_319 DET_RCS_319 DET_ELEVATION_319 DET_SNR_319 DET_ELEVATION_ERR_319 DET_AZIMUTH_ERR_319 DET_RANGE_VELOCITY_ERR_319 DET_AZIMUTH_319 DET_RANGE_VELOCITY_319 DET_RANGE_ERR_319 DET_RANGE_319 DET_BI_STATIC_FLAG_320 DET_CONFD_ELEVATION_320 DET_CONFD_AZIMUTH_320 DET_HVC_FLAG_320 DET_OUTSIDE_SECTOR_320 DET_EXISTENCE_PROB_320 DET_POINT_TARGET_PROB_320 DET_SNR_320 DET_SUPER_RES_TARGET_320 DET_VALID_FLAG_320 DET_RCS_320 DET_ELEVATION_ERR_320 DET_ELEVATION_320 DET_AZIMUTH_ERR_320 DET_AZIMUTH_320 DET_RANGE_VELOCITY_ERR_320 DET_RANGE_VELOCITY_320 DET_RANGE_ERR_320 DET_RANGE_320;
SIG_GROUP_ 1232 Detections_321_324 1 : DET_MH_CRC16_321_324 DET_MH_CYCLE_COUNTER_321_324 DET_MH_SCAN_INDEX_4LSB_321_324 DET_CONFD_ELEVATION_321 DET_CONFD_AZIMUTH_321 DET_HVC_FLAG_321 DET_OUTSIDE_SECTOR_321 DET_EXISTENCE_PROB_321 DET_POINT_TARGET_PROB_321 DET_SNR_321 DET_SUPER_RES_TARGET_321 DET_BI_STATIC_FLAG_321 DET_VALID_FLAG_321 DET_RCS_321 DET_ELEVATION_ERR_321 DET_ELEVATION_321 DET_AZIMUTH_ERR_321 DET_AZIMUTH_321 DET_RANGE_VELOCITY_ERR_321 DET_RANGE_VELOCITY_321 DET_RANGE_ERR_321 DET_RANGE_321 DET_CONFD_ELEVATION_322 DET_CONFD_AZIMUTH_322 DET_HVC_FLAG_322 DET_OUTSIDE_SECTOR_322 DET_EXISTENCE_PROB_322 DET_POINT_TARGET_PROB_322 DET_SNR_322 DET_SUPER_RES_TARGET_322 DET_BI_STATIC_FLAG_322 DET_VALID_FLAG_322 DET_RCS_322 DET_ELEVATION_322 DET_ELEVATION_ERR_322 DET_AZIMUTH_ERR_322 DET_AZIMUTH_322 DET_RANGE_VELOCITY_ERR_322 DET_RANGE_VELOCITY_322 DET_RANGE_ERR_322 DET_RANGE_322 DET_CONFD_ELEVATION_323 DET_CONFD_AZIMUTH_323 DET_HVC_FLAG_323 DET_OUTSIDE_SECTOR_323 DET_EXISTENCE_PROB_323 DET_POINT_TARGET_PROB_323 DET_SUPER_RES_TARGET_323 DET_BI_STATIC_FLAG_323 DET_VALID_FLAG_323 DET_RCS_323 DET_ELEVATION_323 DET_SNR_323 DET_ELEVATION_ERR_323 DET_AZIMUTH_ERR_323 DET_RANGE_VELOCITY_ERR_323 DET_AZIMUTH_323 DET_RANGE_VELOCITY_323 DET_RANGE_ERR_323 DET_RANGE_323 DET_BI_STATIC_FLAG_324 DET_CONFD_ELEVATION_324 DET_CONFD_AZIMUTH_324 DET_HVC_FLAG_324 DET_OUTSIDE_SECTOR_324 DET_EXISTENCE_PROB_324 DET_POINT_TARGET_PROB_324 DET_SNR_324 DET_SUPER_RES_TARGET_324 DET_VALID_FLAG_324 DET_RCS_324 DET_ELEVATION_ERR_324 DET_ELEVATION_324 DET_AZIMUTH_ERR_324 DET_AZIMUTH_324 DET_RANGE_VELOCITY_ERR_324 DET_RANGE_VELOCITY_324 DET_RANGE_ERR_324 DET_RANGE_324;
SIG_GROUP_ 1233 Detections_325_328 1 : DET_MH_CRC16_325_328 DET_MH_CYCLE_COUNTER_325_328 DET_MH_SCAN_INDEX_4LSB_325_328 DET_CONFD_ELEVATION_325 DET_CONFD_AZIMUTH_325 DET_HVC_FLAG_325 DET_OUTSIDE_SECTOR_325 DET_EXISTENCE_PROB_325 DET_POINT_TARGET_PROB_325 DET_SNR_325 DET_SUPER_RES_TARGET_325 DET_BI_STATIC_FLAG_325 DET_VALID_FLAG_325 DET_RCS_325 DET_ELEVATION_ERR_325 DET_ELEVATION_325 DET_AZIMUTH_ERR_325 DET_AZIMUTH_325 DET_RANGE_VELOCITY_ERR_325 DET_RANGE_VELOCITY_325 DET_RANGE_ERR_325 DET_RANGE_325 DET_CONFD_ELEVATION_326 DET_CONFD_AZIMUTH_326 DET_HVC_FLAG_326 DET_OUTSIDE_SECTOR_326 DET_EXISTENCE_PROB_326 DET_POINT_TARGET_PROB_326 DET_SNR_326 DET_SUPER_RES_TARGET_326 DET_BI_STATIC_FLAG_326 DET_VALID_FLAG_326 DET_RCS_326 DET_ELEVATION_326 DET_ELEVATION_ERR_326 DET_AZIMUTH_ERR_326 DET_AZIMUTH_326 DET_RANGE_VELOCITY_ERR_326 DET_RANGE_VELOCITY_326 DET_RANGE_ERR_326 DET_RANGE_326 DET_CONFD_ELEVATION_327 DET_CONFD_AZIMUTH_327 DET_HVC_FLAG_327 DET_OUTSIDE_SECTOR_327 DET_EXISTENCE_PROB_327 DET_POINT_TARGET_PROB_327 DET_SUPER_RES_TARGET_327 DET_BI_STATIC_FLAG_327 DET_VALID_FLAG_327 DET_RCS_327 DET_ELEVATION_327 DET_SNR_327 DET_ELEVATION_ERR_327 DET_AZIMUTH_ERR_327 DET_RANGE_VELOCITY_ERR_327 DET_AZIMUTH_327 DET_RANGE_VELOCITY_327 DET_RANGE_ERR_327 DET_RANGE_327 DET_BI_STATIC_FLAG_328 DET_CONFD_ELEVATION_328 DET_CONFD_AZIMUTH_328 DET_HVC_FLAG_328 DET_OUTSIDE_SECTOR_328 DET_EXISTENCE_PROB_328 DET_POINT_TARGET_PROB_328 DET_SNR_328 DET_SUPER_RES_TARGET_328 DET_VALID_FLAG_328 DET_RCS_328 DET_ELEVATION_ERR_328 DET_ELEVATION_328 DET_AZIMUTH_ERR_328 DET_AZIMUTH_328 DET_RANGE_VELOCITY_ERR_328 DET_RANGE_VELOCITY_328 DET_RANGE_ERR_328 DET_RANGE_328;

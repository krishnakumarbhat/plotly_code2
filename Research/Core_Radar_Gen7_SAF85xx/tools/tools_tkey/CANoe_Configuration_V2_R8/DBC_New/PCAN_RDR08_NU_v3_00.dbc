VERSION "created by canmatrix"

NS_ :

BS_:

BU_: External_Tool ADAS RDR08

BO_ 1163 RDR_DETECTION_045_048: 64 RDR08
 SG_ DET_RANGE_045 : 24|15@1+ (0.015625,0) [0|500] "m"  ADAS
 SG_ DET_RANGE_ERR_045 : 40|7@1+ (0.0075,0) [0|0.9525] "m"  ADAS
 SG_ DET_RANGE_VELOCITY_045 : 48|15@1+ (0.0078125,-128) [-128|127.9921875] "m/s"  ADAS
 SG_ DET_RANGE_VELOCITY_ERR_045 : 64|8@1+ (0.003,0) [0|0.765] "m/s"  ADAS
 SG_ DET_AZIMUTH_045 : 88|13@1+ (0.0004,-1.5708) [-1.5708|1.5708] "rad"  ADAS
 SG_ DET_AZIMUTH_ERR_045 : 105|7@1+ (0.00087267,0) [0|0.11082909] "rad"  ADAS
 SG_ DET_ELEVATION_045 : 72|8@1+ (0.00275,-0.34925) [-0.34925|0.34925] "rad"  ADAS
 SG_ DET_ELEVATION_ERR_045 : 80|6@1+ (0.00174533,0) [0|0.10995579] "rad"  ADAS
 SG_ DET_RCS_045 : 136|8@1+ (0.5,-64) [-64|63.5] "dBsm"  ADAS
 SG_ DET_VALID_FLAG_045 : 119|1@1+ (1,0) [0|1] ""  ADAS
 SG_ DET_BI_STATIC_FLAG_045 : 504|1@1+ (1,0) [0|1] ""  ADAS
 SG_ DET_SUPER_RES_TARGET_045 : 104|1@1+ (1,0) [0|1] ""  ADAS
 SG_ DET_SNR_045 : 128|8@1+ (0.35156,0) [0|89.6478] "dB"  ADAS
 SG_ DET_POINT_TARGET_PROB_045 : 114|4@1+ (6.67,0) [0|100] "%"  ADAS
 SG_ DET_EXISTENCE_PROB_045 : 120|6@1+ (1.588,0) [0|100] "%"  ADAS
 SG_ DET_OUTSIDE_SECTOR_045 : 159|1@1+ (1,0) [0|1] ""  ADAS
 SG_ DET_HVC_FLAG_045 : 118|1@1+ (1,0) [0|1] ""  ADAS
 SG_ DET_CONFD_AZIMUTH_045 : 126|2@1+ (1,0) [0|3] ""  ADAS
 SG_ DET_CONFD_ELEVATION_045 : 112|2@1+ (1,0) [0|3] ""  ADAS
 SG_ DET_RANGE_046 : 144|15@1+ (0.015625,0) [0|500] "m"  ADAS
 SG_ DET_RANGE_ERR_046 : 160|7@1+ (0.0075,0) [0|0.9525] "m"  ADAS
 SG_ DET_RANGE_VELOCITY_046 : 168|15@1+ (0.0078125,-128) [-128|127.9921875] "m/s"  ADAS
 SG_ DET_RANGE_VELOCITY_ERR_046 : 184|8@1+ (0.003,0) [0|0.765] "m/s"  ADAS
 SG_ DET_AZIMUTH_046 : 208|13@1+ (0.0004,-1.5708) [-1.5708|1.5708] "rad"  ADAS
 SG_ DET_AZIMUTH_ERR_046 : 224|7@1+ (0.00087267,0) [0|0.11082909] "rad"  ADAS
 SG_ DET_ELEVATION_046 : 192|8@1+ (0.00275,-0.34925) [-0.34925|0.34925] "rad"  ADAS
 SG_ DET_ELEVATION_ERR_046 : 200|6@1+ (0.00174533,0) [0|0.10995579] "rad"  ADAS
 SG_ DET_RCS_046 : 256|8@1+ (0.5,-64) [-64|63.5] "dBsm"  ADAS
 SG_ DET_VALID_FLAG_046 : 167|1@1+ (1,0) [0|1] ""  ADAS
 SG_ DET_BI_STATIC_FLAG_046 : 505|1@1+ (1,0) [0|1] ""  ADAS
 SG_ DET_SUPER_RES_TARGET_046 : 247|1@1+ (1,0) [0|1] ""  ADAS
 SG_ DET_SNR_046 : 248|8@1+ (0.35156,0) [0|89.6478] "dB"  ADAS
 SG_ DET_POINT_TARGET_PROB_046 : 240|4@1+ (6.67,0) [0|100] "%"  ADAS
 SG_ DET_EXISTENCE_PROB_046 : 232|6@1+ (1.588,0) [0|100] "%"  ADAS
 SG_ DET_OUTSIDE_SECTOR_046 : 183|1@1+ (1,0) [0|1] ""  ADAS
 SG_ DET_HVC_FLAG_046 : 246|1@1+ (1,0) [0|1] ""  ADAS
 SG_ DET_CONFD_AZIMUTH_046 : 206|2@1+ (1,0) [0|3] ""  ADAS
 SG_ DET_CONFD_ELEVATION_046 : 244|2@1+ (1,0) [0|3] ""  ADAS
 SG_ DET_RANGE_047 : 264|15@1+ (0.015625,0) [0|500] "m"  ADAS
 SG_ DET_RANGE_ERR_047 : 280|7@1+ (0.0075,0) [0|0.9525] "m"  ADAS
 SG_ DET_RANGE_VELOCITY_047 : 288|15@1+ (0.0078125,-128) [-128|127.9921875] "m/s"  ADAS
 SG_ DET_RANGE_VELOCITY_ERR_047 : 304|8@1+ (0.003,0) [0|0.765] "m/s"  ADAS
 SG_ DET_AZIMUTH_047 : 328|13@1+ (0.0004,-1.5708) [-1.5708|1.5708] "rad"  ADAS
 SG_ DET_AZIMUTH_ERR_047 : 345|7@1+ (0.00087267,0) [0|0.11082909] "rad"  ADAS
 SG_ DET_ELEVATION_047 : 312|8@1+ (0.00275,-0.34925) [-0.34925|0.34925] "rad"  ADAS
 SG_ DET_ELEVATION_ERR_047 : 320|6@1+ (0.00174533,0) [0|0.10995579] "rad"  ADAS
 SG_ DET_RCS_047 : 376|8@1+ (0.5,-64) [-64|63.5] "dBsm"  ADAS
 SG_ DET_VALID_FLAG_047 : 399|1@1+ (1,0) [0|1] ""  ADAS
 SG_ DET_BI_STATIC_FLAG_047 : 482|1@1+ (1,0) [0|1] ""  ADAS
 SG_ DET_SUPER_RES_TARGET_047 : 344|1@1+ (1,0) [0|1] ""  ADAS
 SG_ DET_SNR_047 : 368|8@1+ (0.35156,0) [0|89.6478] "dB"  ADAS
 SG_ DET_POINT_TARGET_PROB_047 : 360|4@1+ (6.67,0) [0|100] "%"  ADAS
 SG_ DET_EXISTENCE_PROB_047 : 352|6@1+ (1.588,0) [0|100] "%"  ADAS
 SG_ DET_OUTSIDE_SECTOR_047 : 407|1@1+ (1,0) [0|1] ""  ADAS
 SG_ DET_HVC_FLAG_047 : 364|1@1+ (1,0) [0|1] ""  ADAS
 SG_ DET_CONFD_AZIMUTH_047 : 365|2@1+ (1,0) [0|3] ""  ADAS
 SG_ DET_CONFD_ELEVATION_047 : 358|2@1+ (1,0) [0|3] ""  ADAS
 SG_ DET_RANGE_048 : 384|15@1+ (0.015625,0) [0|500] "m"  ADAS
 SG_ DET_RANGE_ERR_048 : 400|7@1+ (0.0075,0) [0|0.9525] "m"  ADAS
 SG_ DET_RANGE_VELOCITY_048 : 408|15@1+ (0.0078125,-128) [-128|127.9921875] "m/s"  ADAS
 SG_ DET_RANGE_VELOCITY_ERR_048 : 424|8@1+ (0.003,0) [0|0.765] "m/s"  ADAS
 SG_ DET_AZIMUTH_048 : 448|13@1+ (0.0004,-1.5708) [-1.5708|1.5708] "rad"  ADAS
 SG_ DET_AZIMUTH_ERR_048 : 465|7@1+ (0.00087267,0) [0|0.11082909] "rad"  ADAS
 SG_ DET_ELEVATION_048 : 432|8@1+ (0.00275,-0.34925) [-0.34925|0.34925] "rad"  ADAS
 SG_ DET_ELEVATION_ERR_048 : 440|6@1+ (0.00174533,0) [0|0.10995579] "rad"  ADAS
 SG_ DET_RCS_048 : 496|8@1+ (0.5,-64) [-64|63.5] "dBsm"  ADAS
 SG_ DET_VALID_FLAG_048 : 485|1@1+ (1,0) [0|1] ""  ADAS
 SG_ DET_BI_STATIC_FLAG_048 : 483|1@1+ (1,0) [0|1] ""  ADAS
 SG_ DET_SUPER_RES_TARGET_048 : 446|1@1+ (1,0) [0|1] ""  ADAS
 SG_ DET_SNR_048 : 488|8@1+ (0.35156,0) [0|89.6478] "dB"  ADAS
 SG_ DET_POINT_TARGET_PROB_048 : 472|4@1+ (6.67,0) [0|100] "%"  ADAS
 SG_ DET_EXISTENCE_PROB_048 : 506|6@1+ (1.588,0) [0|100] "%"  ADAS
 SG_ DET_OUTSIDE_SECTOR_048 : 481|1@1+ (1,0) [0|1] ""  ADAS
 SG_ DET_HVC_FLAG_048 : 464|1@1+ (1,0) [0|1] ""  ADAS
 SG_ DET_CONFD_AZIMUTH_048 : 486|2@1+ (1,0) [0|3] ""  ADAS
 SG_ DET_CONFD_ELEVATION_048 : 461|2@1+ (1,0) [0|3] ""  ADAS
 SG_ DET_MH_SCAN_INDEX_4LSB_045_048 : 476|4@1+ (1,0) [0|15] ""  ADAS
 SG_ DET_MH_CYCLE_COUNTER_045_048 : 16|8@1+ (1,0) [0|255] ""  ADAS
 SG_ DET_MH_CRC16_045_048 : 0|16@1+ (1,0) [0|65535] ""  ADAS

BO_ 1164 RDR_DETECTION_049_052: 64 RDR08
 SG_ DET_RANGE_049 : 24|15@1+ (0.015625,0) [0|500] "m"  ADAS
 SG_ DET_RANGE_ERR_049 : 40|7@1+ (0.0075,0) [0|0.9525] "m"  ADAS
 SG_ DET_RANGE_VELOCITY_049 : 48|15@1+ (0.0078125,-128) [-128|127.9921875] "m/s"  ADAS
 SG_ DET_RANGE_VELOCITY_ERR_049 : 64|8@1+ (0.003,0) [0|0.765] "m/s"  ADAS
 SG_ DET_AZIMUTH_049 : 88|13@1+ (0.0004,-1.5708) [-1.5708|1.5708] "rad"  ADAS
 SG_ DET_AZIMUTH_ERR_049 : 105|7@1+ (0.00087267,0) [0|0.11082909] "rad"  ADAS
 SG_ DET_ELEVATION_049 : 72|8@1+ (0.00275,-0.34925) [-0.34925|0.34925] "rad"  ADAS
 SG_ DET_ELEVATION_ERR_049 : 80|6@1+ (0.00174533,0) [0|0.10995579] "rad"  ADAS
 SG_ DET_RCS_049 : 136|8@1+ (0.5,-64) [-64|63.5] "dBsm"  ADAS
 SG_ DET_VALID_FLAG_049 : 119|1@1+ (1,0) [0|1] ""  ADAS
 SG_ DET_BI_STATIC_FLAG_049 : 504|1@1+ (1,0) [0|1] ""  ADAS
 SG_ DET_SUPER_RES_TARGET_049 : 104|1@1+ (1,0) [0|1] ""  ADAS
 SG_ DET_SNR_049 : 128|8@1+ (0.35156,0) [0|89.6478] "dB"  ADAS
 SG_ DET_POINT_TARGET_PROB_049 : 114|4@1+ (6.67,0) [0|100] "%"  ADAS
 SG_ DET_EXISTENCE_PROB_049 : 120|6@1+ (1.588,0) [0|100] "%"  ADAS
 SG_ DET_OUTSIDE_SECTOR_049 : 159|1@1+ (1,0) [0|1] ""  ADAS
 SG_ DET_HVC_FLAG_049 : 118|1@1+ (1,0) [0|1] ""  ADAS
 SG_ DET_CONFD_AZIMUTH_049 : 126|2@1+ (1,0) [0|3] ""  ADAS
 SG_ DET_CONFD_ELEVATION_049 : 112|2@1+ (1,0) [0|3] ""  ADAS
 SG_ DET_RANGE_050 : 144|15@1+ (0.015625,0) [0|500] "m"  ADAS
 SG_ DET_RANGE_ERR_050 : 160|7@1+ (0.0075,0) [0|0.9525] "m"  ADAS
 SG_ DET_RANGE_VELOCITY_050 : 168|15@1+ (0.0078125,-128) [-128|127.9921875] "m/s"  ADAS
 SG_ DET_RANGE_VELOCITY_ERR_050 : 184|8@1+ (0.003,0) [0|0.765] "m/s"  ADAS
 SG_ DET_AZIMUTH_050 : 208|13@1+ (0.0004,-1.5708) [-1.5708|1.5708] "rad"  ADAS
 SG_ DET_AZIMUTH_ERR_050 : 224|7@1+ (0.00087267,0) [0|0.11082909] "rad"  ADAS
 SG_ DET_ELEVATION_050 : 192|8@1+ (0.00275,-0.34925) [-0.34925|0.34925] "rad"  ADAS
 SG_ DET_ELEVATION_ERR_050 : 200|6@1+ (0.00174533,0) [0|0.10995579] "rad"  ADAS
 SG_ DET_RCS_050 : 256|8@1+ (0.5,-64) [-64|63.5] "dBsm"  ADAS
 SG_ DET_VALID_FLAG_050 : 167|1@1+ (1,0) [0|1] ""  ADAS
 SG_ DET_BI_STATIC_FLAG_050 : 505|1@1+ (1,0) [0|1] ""  ADAS
 SG_ DET_SUPER_RES_TARGET_050 : 247|1@1+ (1,0) [0|1] ""  ADAS
 SG_ DET_SNR_050 : 248|8@1+ (0.35156,0) [0|89.6478] "dB"  ADAS
 SG_ DET_POINT_TARGET_PROB_050 : 240|4@1+ (6.67,0) [0|100] "%"  ADAS
 SG_ DET_EXISTENCE_PROB_050 : 232|6@1+ (1.588,0) [0|100] "%"  ADAS
 SG_ DET_OUTSIDE_SECTOR_050 : 183|1@1+ (1,0) [0|1] ""  ADAS
 SG_ DET_HVC_FLAG_050 : 246|1@1+ (1,0) [0|1] ""  ADAS
 SG_ DET_CONFD_AZIMUTH_050 : 206|2@1+ (1,0) [0|3] ""  ADAS
 SG_ DET_CONFD_ELEVATION_050 : 244|2@1+ (1,0) [0|3] ""  ADAS
 SG_ DET_RANGE_051 : 264|15@1+ (0.015625,0) [0|500] "m"  ADAS
 SG_ DET_RANGE_ERR_051 : 280|7@1+ (0.0075,0) [0|0.9525] "m"  ADAS
 SG_ DET_RANGE_VELOCITY_051 : 288|15@1+ (0.0078125,-128) [-128|127.9921875] "m/s"  ADAS
 SG_ DET_RANGE_VELOCITY_ERR_051 : 304|8@1+ (0.003,0) [0|0.765] "m/s"  ADAS
 SG_ DET_AZIMUTH_051 : 328|13@1+ (0.0004,-1.5708) [-1.5708|1.5708] "rad"  ADAS
 SG_ DET_AZIMUTH_ERR_051 : 345|7@1+ (0.00087267,0) [0|0.11082909] "rad"  ADAS
 SG_ DET_ELEVATION_051 : 312|8@1+ (0.00275,-0.34925) [-0.34925|0.34925] "rad"  ADAS
 SG_ DET_ELEVATION_ERR_051 : 320|6@1+ (0.00174533,0) [0|0.10995579] "rad"  ADAS
 SG_ DET_RCS_051 : 376|8@1+ (0.5,-64) [-64|63.5] "dBsm"  ADAS
 SG_ DET_VALID_FLAG_051 : 399|1@1+ (1,0) [0|1] ""  ADAS
 SG_ DET_BI_STATIC_FLAG_051 : 482|1@1+ (1,0) [0|1] ""  ADAS
 SG_ DET_SUPER_RES_TARGET_051 : 344|1@1+ (1,0) [0|1] ""  ADAS
 SG_ DET_SNR_051 : 368|8@1+ (0.35156,0) [0|89.6478] "dB"  ADAS
 SG_ DET_POINT_TARGET_PROB_051 : 360|4@1+ (6.67,0) [0|100] "%"  ADAS
 SG_ DET_EXISTENCE_PROB_051 : 352|6@1+ (1.588,0) [0|100] "%"  ADAS
 SG_ DET_OUTSIDE_SECTOR_051 : 407|1@1+ (1,0) [0|1] ""  ADAS
 SG_ DET_HVC_FLAG_051 : 364|1@1+ (1,0) [0|1] ""  ADAS
 SG_ DET_CONFD_AZIMUTH_051 : 365|2@1+ (1,0) [0|3] ""  ADAS
 SG_ DET_CONFD_ELEVATION_051 : 358|2@1+ (1,0) [0|3] ""  ADAS
 SG_ DET_RANGE_052 : 384|15@1+ (0.015625,0) [0|500] "m"  ADAS
 SG_ DET_RANGE_ERR_052 : 400|7@1+ (0.0075,0) [0|0.9525] "m"  ADAS
 SG_ DET_RANGE_VELOCITY_052 : 408|15@1+ (0.0078125,-128) [-128|127.9921875] "m/s"  ADAS
 SG_ DET_RANGE_VELOCITY_ERR_052 : 424|8@1+ (0.003,0) [0|0.765] "m/s"  ADAS
 SG_ DET_AZIMUTH_052 : 448|13@1+ (0.0004,-1.5708) [-1.5708|1.5708] "rad"  ADAS
 SG_ DET_AZIMUTH_ERR_052 : 465|7@1+ (0.00087267,0) [0|0.11082909] "rad"  ADAS
 SG_ DET_ELEVATION_052 : 432|8@1+ (0.00275,-0.34925) [-0.34925|0.34925] "rad"  ADAS
 SG_ DET_ELEVATION_ERR_052 : 440|6@1+ (0.00174533,0) [0|0.10995579] "rad"  ADAS
 SG_ DET_RCS_052 : 496|8@1+ (0.5,-64) [-64|63.5] "dBsm"  ADAS
 SG_ DET_VALID_FLAG_052 : 485|1@1+ (1,0) [0|1] ""  ADAS
 SG_ DET_BI_STATIC_FLAG_052 : 483|1@1+ (1,0) [0|1] ""  ADAS
 SG_ DET_SUPER_RES_TARGET_052 : 446|1@1+ (1,0) [0|1] ""  ADAS
 SG_ DET_SNR_052 : 488|8@1+ (0.35156,0) [0|89.6478] "dB"  ADAS
 SG_ DET_POINT_TARGET_PROB_052 : 472|4@1+ (6.67,0) [0|100] "%"  ADAS
 SG_ DET_EXISTENCE_PROB_052 : 506|6@1+ (1.588,0) [0|100] "%"  ADAS
 SG_ DET_OUTSIDE_SECTOR_052 : 481|1@1+ (1,0) [0|1] ""  ADAS
 SG_ DET_HVC_FLAG_052 : 464|1@1+ (1,0) [0|1] ""  ADAS
 SG_ DET_CONFD_AZIMUTH_052 : 486|2@1+ (1,0) [0|3] ""  ADAS
 SG_ DET_CONFD_ELEVATION_052 : 461|2@1+ (1,0) [0|3] ""  ADAS
 SG_ DET_MH_SCAN_INDEX_4LSB_049_052 : 476|4@1+ (1,0) [0|15] ""  ADAS
 SG_ DET_MH_CYCLE_COUNTER_049_052 : 16|8@1+ (1,0) [0|255] ""  ADAS
 SG_ DET_MH_CRC16_049_052 : 0|16@1+ (1,0) [0|65535] ""  ADAS

BO_ 1165 RDR_DETECTION_053_056: 64 RDR08
 SG_ DET_RANGE_053 : 24|15@1+ (0.015625,0) [0|500] "m"  ADAS
 SG_ DET_RANGE_ERR_053 : 40|7@1+ (0.0075,0) [0|0.9525] "m"  ADAS
 SG_ DET_RANGE_VELOCITY_053 : 48|15@1+ (0.0078125,-128) [-128|127.9921875] "m/s"  ADAS
 SG_ DET_RANGE_VELOCITY_ERR_053 : 64|8@1+ (0.003,0) [0|0.765] "m/s"  ADAS
 SG_ DET_AZIMUTH_053 : 88|13@1+ (0.0004,-1.5708) [-1.5708|1.5708] "rad"  ADAS
 SG_ DET_AZIMUTH_ERR_053 : 105|7@1+ (0.00087267,0) [0|0.11082909] "rad"  ADAS
 SG_ DET_ELEVATION_053 : 72|8@1+ (0.00275,-0.34925) [-0.34925|0.34925] "rad"  ADAS
 SG_ DET_ELEVATION_ERR_053 : 80|6@1+ (0.00174533,0) [0|0.10995579] "rad"  ADAS
 SG_ DET_RCS_053 : 136|8@1+ (0.5,-64) [-64|63.5] "dBsm"  ADAS
 SG_ DET_VALID_FLAG_053 : 119|1@1+ (1,0) [0|1] ""  ADAS
 SG_ DET_BI_STATIC_FLAG_053 : 504|1@1+ (1,0) [0|1] ""  ADAS
 SG_ DET_SUPER_RES_TARGET_053 : 104|1@1+ (1,0) [0|1] ""  ADAS
 SG_ DET_SNR_053 : 128|8@1+ (0.35156,0) [0|89.6478] "dB"  ADAS
 SG_ DET_POINT_TARGET_PROB_053 : 114|4@1+ (6.67,0) [0|100] "%"  ADAS
 SG_ DET_EXISTENCE_PROB_053 : 120|6@1+ (1.588,0) [0|100] "%"  ADAS
 SG_ DET_OUTSIDE_SECTOR_053 : 159|1@1+ (1,0) [0|1] ""  ADAS
 SG_ DET_HVC_FLAG_053 : 118|1@1+ (1,0) [0|1] ""  ADAS
 SG_ DET_CONFD_AZIMUTH_053 : 126|2@1+ (1,0) [0|3] ""  ADAS
 SG_ DET_CONFD_ELEVATION_053 : 112|2@1+ (1,0) [0|3] ""  ADAS
 SG_ DET_RANGE_054 : 144|15@1+ (0.015625,0) [0|500] "m"  ADAS
 SG_ DET_RANGE_ERR_054 : 160|7@1+ (0.0075,0) [0|0.9525] "m"  ADAS
 SG_ DET_RANGE_VELOCITY_054 : 168|15@1+ (0.0078125,-128) [-128|127.9921875] "m/s"  ADAS
 SG_ DET_RANGE_VELOCITY_ERR_054 : 184|8@1+ (0.003,0) [0|0.765] "m/s"  ADAS
 SG_ DET_AZIMUTH_054 : 208|13@1+ (0.0004,-1.5708) [-1.5708|1.5708] "rad"  ADAS
 SG_ DET_AZIMUTH_ERR_054 : 224|7@1+ (0.00087267,0) [0|0.11082909] "rad"  ADAS
 SG_ DET_ELEVATION_054 : 192|8@1+ (0.00275,-0.34925) [-0.34925|0.34925] "rad"  ADAS
 SG_ DET_ELEVATION_ERR_054 : 200|6@1+ (0.00174533,0) [0|0.10995579] "rad"  ADAS
 SG_ DET_RCS_054 : 256|8@1+ (0.5,-64) [-64|63.5] "dBsm"  ADAS
 SG_ DET_VALID_FLAG_054 : 167|1@1+ (1,0) [0|1] ""  ADAS
 SG_ DET_BI_STATIC_FLAG_054 : 505|1@1+ (1,0) [0|1] ""  ADAS
 SG_ DET_SUPER_RES_TARGET_054 : 247|1@1+ (1,0) [0|1] ""  ADAS
 SG_ DET_SNR_054 : 248|8@1+ (0.35156,0) [0|89.6478] "dB"  ADAS
 SG_ DET_POINT_TARGET_PROB_054 : 240|4@1+ (6.67,0) [0|100] "%"  ADAS
 SG_ DET_EXISTENCE_PROB_054 : 232|6@1+ (1.588,0) [0|100] "%"  ADAS
 SG_ DET_OUTSIDE_SECTOR_054 : 183|1@1+ (1,0) [0|1] ""  ADAS
 SG_ DET_HVC_FLAG_054 : 246|1@1+ (1,0) [0|1] ""  ADAS
 SG_ DET_CONFD_AZIMUTH_054 : 206|2@1+ (1,0) [0|3] ""  ADAS
 SG_ DET_CONFD_ELEVATION_054 : 244|2@1+ (1,0) [0|3] ""  ADAS
 SG_ DET_RANGE_055 : 264|15@1+ (0.015625,0) [0|500] "m"  ADAS
 SG_ DET_RANGE_ERR_055 : 280|7@1+ (0.0075,0) [0|0.9525] "m"  ADAS
 SG_ DET_RANGE_VELOCITY_055 : 288|15@1+ (0.0078125,-128) [-128|127.9921875] "m/s"  ADAS
 SG_ DET_RANGE_VELOCITY_ERR_055 : 304|8@1+ (0.003,0) [0|0.765] "m/s"  ADAS
 SG_ DET_AZIMUTH_055 : 328|13@1+ (0.0004,-1.5708) [-1.5708|1.5708] "rad"  ADAS
 SG_ DET_AZIMUTH_ERR_055 : 345|7@1+ (0.00087267,0) [0|0.11082909] "rad"  ADAS
 SG_ DET_ELEVATION_055 : 312|8@1+ (0.00275,-0.34925) [-0.34925|0.34925] "rad"  ADAS
 SG_ DET_ELEVATION_ERR_055 : 320|6@1+ (0.00174533,0) [0|0.10995579] "rad"  ADAS
 SG_ DET_RCS_055 : 376|8@1+ (0.5,-64) [-64|63.5] "dBsm"  ADAS
 SG_ DET_VALID_FLAG_055 : 399|1@1+ (1,0) [0|1] ""  ADAS
 SG_ DET_BI_STATIC_FLAG_055 : 482|1@1+ (1,0) [0|1] ""  ADAS
 SG_ DET_SUPER_RES_TARGET_055 : 344|1@1+ (1,0) [0|1] ""  ADAS
 SG_ DET_SNR_055 : 368|8@1+ (0.35156,0) [0|89.6478] "dB"  ADAS
 SG_ DET_POINT_TARGET_PROB_055 : 360|4@1+ (6.67,0) [0|100] "%"  ADAS
 SG_ DET_EXISTENCE_PROB_055 : 352|6@1+ (1.588,0) [0|100] "%"  ADAS
 SG_ DET_OUTSIDE_SECTOR_055 : 407|1@1+ (1,0) [0|1] ""  ADAS
 SG_ DET_HVC_FLAG_055 : 364|1@1+ (1,0) [0|1] ""  ADAS
 SG_ DET_CONFD_AZIMUTH_055 : 365|2@1+ (1,0) [0|3] ""  ADAS
 SG_ DET_CONFD_ELEVATION_055 : 358|2@1+ (1,0) [0|3] ""  ADAS
 SG_ DET_RANGE_056 : 384|15@1+ (0.015625,0) [0|500] "m"  ADAS
 SG_ DET_RANGE_ERR_056 : 400|7@1+ (0.0075,0) [0|0.9525] "m"  ADAS
 SG_ DET_RANGE_VELOCITY_056 : 408|15@1+ (0.0078125,-128) [-128|127.9921875] "m/s"  ADAS
 SG_ DET_RANGE_VELOCITY_ERR_056 : 424|8@1+ (0.003,0) [0|0.765] "m/s"  ADAS
 SG_ DET_AZIMUTH_056 : 448|13@1+ (0.0004,-1.5708) [-1.5708|1.5708] "rad"  ADAS
 SG_ DET_AZIMUTH_ERR_056 : 465|7@1+ (0.00087267,0) [0|0.11082909] "rad"  ADAS
 SG_ DET_ELEVATION_056 : 432|8@1+ (0.00275,-0.34925) [-0.34925|0.34925] "rad"  ADAS
 SG_ DET_ELEVATION_ERR_056 : 440|6@1+ (0.00174533,0) [0|0.10995579] "rad"  ADAS
 SG_ DET_RCS_056 : 496|8@1+ (0.5,-64) [-64|63.5] "dBsm"  ADAS
 SG_ DET_VALID_FLAG_056 : 485|1@1+ (1,0) [0|1] ""  ADAS
 SG_ DET_BI_STATIC_FLAG_056 : 483|1@1+ (1,0) [0|1] ""  ADAS
 SG_ DET_SUPER_RES_TARGET_056 : 446|1@1+ (1,0) [0|1] ""  ADAS
 SG_ DET_SNR_056 : 488|8@1+ (0.35156,0) [0|89.6478] "dB"  ADAS
 SG_ DET_POINT_TARGET_PROB_056 : 472|4@1+ (6.67,0) [0|100] "%"  ADAS
 SG_ DET_EXISTENCE_PROB_056 : 506|6@1+ (1.588,0) [0|100] "%"  ADAS
 SG_ DET_OUTSIDE_SECTOR_056 : 481|1@1+ (1,0) [0|1] ""  ADAS
 SG_ DET_HVC_FLAG_056 : 464|1@1+ (1,0) [0|1] ""  ADAS
 SG_ DET_CONFD_AZIMUTH_056 : 486|2@1+ (1,0) [0|3] ""  ADAS
 SG_ DET_CONFD_ELEVATION_056 : 461|2@1+ (1,0) [0|3] ""  ADAS
 SG_ DET_MH_SCAN_INDEX_4LSB_053_056 : 476|4@1+ (1,0) [0|15] ""  ADAS
 SG_ DET_MH_CYCLE_COUNTER_053_056 : 16|8@1+ (1,0) [0|255] ""  ADAS
 SG_ DET_MH_CRC16_053_056 : 0|16@1+ (1,0) [0|65535] ""  ADAS

BO_ 1166 RDR_DETECTION_057_060: 64 RDR08
 SG_ DET_RANGE_057 : 24|15@1+ (0.015625,0) [0|500] "m"  ADAS
 SG_ DET_RANGE_ERR_057 : 40|7@1+ (0.0075,0) [0|0.9525] "m"  ADAS
 SG_ DET_RANGE_VELOCITY_057 : 48|15@1+ (0.0078125,-128) [-128|127.9921875] "m/s"  ADAS
 SG_ DET_RANGE_VELOCITY_ERR_057 : 64|8@1+ (0.003,0) [0|0.765] "m/s"  ADAS
 SG_ DET_AZIMUTH_057 : 88|13@1+ (0.0004,-1.5708) [-1.5708|1.5708] "rad"  ADAS
 SG_ DET_AZIMUTH_ERR_057 : 105|7@1+ (0.00087267,0) [0|0.11082909] "rad"  ADAS
 SG_ DET_ELEVATION_057 : 72|8@1+ (0.00275,-0.34925) [-0.34925|0.34925] "rad"  ADAS
 SG_ DET_ELEVATION_ERR_057 : 80|6@1+ (0.00174533,0) [0|0.10995579] "rad"  ADAS
 SG_ DET_RCS_057 : 136|8@1+ (0.5,-64) [-64|63.5] "dBsm"  ADAS
 SG_ DET_VALID_FLAG_057 : 119|1@1+ (1,0) [0|1] ""  ADAS
 SG_ DET_BI_STATIC_FLAG_057 : 504|1@1+ (1,0) [0|1] ""  ADAS
 SG_ DET_SUPER_RES_TARGET_057 : 104|1@1+ (1,0) [0|1] ""  ADAS
 SG_ DET_SNR_057 : 128|8@1+ (0.35156,0) [0|89.6478] "dB"  ADAS
 SG_ DET_POINT_TARGET_PROB_057 : 114|4@1+ (6.67,0) [0|100] "%"  ADAS
 SG_ DET_EXISTENCE_PROB_057 : 120|6@1+ (1.588,0) [0|100] "%"  ADAS
 SG_ DET_OUTSIDE_SECTOR_057 : 159|1@1+ (1,0) [0|1] ""  ADAS
 SG_ DET_HVC_FLAG_057 : 118|1@1+ (1,0) [0|1] ""  ADAS
 SG_ DET_CONFD_AZIMUTH_057 : 126|2@1+ (1,0) [0|3] ""  ADAS
 SG_ DET_CONFD_ELEVATION_057 : 112|2@1+ (1,0) [0|3] ""  ADAS
 SG_ DET_RANGE_058 : 144|15@1+ (0.015625,0) [0|500] "m"  ADAS
 SG_ DET_RANGE_ERR_058 : 160|7@1+ (0.0075,0) [0|0.9525] "m"  ADAS
 SG_ DET_RANGE_VELOCITY_058 : 168|15@1+ (0.0078125,-128) [-128|127.9921875] "m/s"  ADAS
 SG_ DET_RANGE_VELOCITY_ERR_058 : 184|8@1+ (0.003,0) [0|0.765] "m/s"  ADAS
 SG_ DET_AZIMUTH_058 : 208|13@1+ (0.0004,-1.5708) [-1.5708|1.5708] "rad"  ADAS
 SG_ DET_AZIMUTH_ERR_058 : 224|7@1+ (0.00087267,0) [0|0.11082909] "rad"  ADAS
 SG_ DET_ELEVATION_058 : 192|8@1+ (0.00275,-0.34925) [-0.34925|0.34925] "rad"  ADAS
 SG_ DET_ELEVATION_ERR_058 : 200|6@1+ (0.00174533,0) [0|0.10995579] "rad"  ADAS
 SG_ DET_RCS_058 : 256|8@1+ (0.5,-64) [-64|63.5] "dBsm"  ADAS
 SG_ DET_VALID_FLAG_058 : 167|1@1+ (1,0) [0|1] ""  ADAS
 SG_ DET_BI_STATIC_FLAG_058 : 505|1@1+ (1,0) [0|1] ""  ADAS
 SG_ DET_SUPER_RES_TARGET_058 : 247|1@1+ (1,0) [0|1] ""  ADAS
 SG_ DET_SNR_058 : 248|8@1+ (0.35156,0) [0|89.6478] "dB"  ADAS
 SG_ DET_POINT_TARGET_PROB_058 : 240|4@1+ (6.67,0) [0|100] "%"  ADAS
 SG_ DET_EXISTENCE_PROB_058 : 232|6@1+ (1.588,0) [0|100] "%"  ADAS
 SG_ DET_OUTSIDE_SECTOR_058 : 183|1@1+ (1,0) [0|1] ""  ADAS
 SG_ DET_HVC_FLAG_058 : 246|1@1+ (1,0) [0|1] ""  ADAS
 SG_ DET_CONFD_AZIMUTH_058 : 206|2@1+ (1,0) [0|3] ""  ADAS
 SG_ DET_CONFD_ELEVATION_058 : 244|2@1+ (1,0) [0|3] ""  ADAS
 SG_ DET_RANGE_059 : 264|15@1+ (0.015625,0) [0|500] "m"  ADAS
 SG_ DET_RANGE_ERR_059 : 280|7@1+ (0.0075,0) [0|0.9525] "m"  ADAS
 SG_ DET_RANGE_VELOCITY_059 : 288|15@1+ (0.0078125,-128) [-128|127.9921875] "m/s"  ADAS
 SG_ DET_RANGE_VELOCITY_ERR_059 : 304|8@1+ (0.003,0) [0|0.765] "m/s"  ADAS
 SG_ DET_AZIMUTH_059 : 328|13@1+ (0.0004,-1.5708) [-1.5708|1.5708] "rad"  ADAS
 SG_ DET_AZIMUTH_ERR_059 : 345|7@1+ (0.00087267,0) [0|0.11082909] "rad"  ADAS
 SG_ DET_ELEVATION_059 : 312|8@1+ (0.00275,-0.34925) [-0.34925|0.34925] "rad"  ADAS
 SG_ DET_ELEVATION_ERR_059 : 320|6@1+ (0.00174533,0) [0|0.10995579] "rad"  ADAS
 SG_ DET_RCS_059 : 376|8@1+ (0.5,-64) [-64|63.5] "dBsm"  ADAS
 SG_ DET_VALID_FLAG_059 : 399|1@1+ (1,0) [0|1] ""  ADAS
 SG_ DET_BI_STATIC_FLAG_059 : 482|1@1+ (1,0) [0|1] ""  ADAS
 SG_ DET_SUPER_RES_TARGET_059 : 344|1@1+ (1,0) [0|1] ""  ADAS
 SG_ DET_SNR_059 : 368|8@1+ (0.35156,0) [0|89.6478] "dB"  ADAS
 SG_ DET_POINT_TARGET_PROB_059 : 360|4@1+ (6.67,0) [0|100] "%"  ADAS
 SG_ DET_EXISTENCE_PROB_059 : 352|6@1+ (1.588,0) [0|100] "%"  ADAS
 SG_ DET_OUTSIDE_SECTOR_059 : 407|1@1+ (1,0) [0|1] ""  ADAS
 SG_ DET_HVC_FLAG_059 : 364|1@1+ (1,0) [0|1] ""  ADAS
 SG_ DET_CONFD_AZIMUTH_059 : 365|2@1+ (1,0) [0|3] ""  ADAS
 SG_ DET_CONFD_ELEVATION_059 : 358|2@1+ (1,0) [0|3] ""  ADAS
 SG_ DET_RANGE_060 : 384|15@1+ (0.015625,0) [0|500] "m"  ADAS
 SG_ DET_RANGE_ERR_060 : 400|7@1+ (0.0075,0) [0|0.9525] "m"  ADAS
 SG_ DET_RANGE_VELOCITY_060 : 408|15@1+ (0.0078125,-128) [-128|127.9921875] "m/s"  ADAS
 SG_ DET_RANGE_VELOCITY_ERR_060 : 424|8@1+ (0.003,0) [0|0.765] "m/s"  ADAS
 SG_ DET_AZIMUTH_060 : 448|13@1+ (0.0004,-1.5708) [-1.5708|1.5708] "rad"  ADAS
 SG_ DET_AZIMUTH_ERR_060 : 465|7@1+ (0.00087267,0) [0|0.11082909] "rad"  ADAS
 SG_ DET_ELEVATION_060 : 432|8@1+ (0.00275,-0.34925) [-0.34925|0.34925] "rad"  ADAS
 SG_ DET_ELEVATION_ERR_060 : 440|6@1+ (0.00174533,0) [0|0.10995579] "rad"  ADAS
 SG_ DET_RCS_060 : 496|8@1+ (0.5,-64) [-64|63.5] "dBsm"  ADAS
 SG_ DET_VALID_FLAG_060 : 485|1@1+ (1,0) [0|1] ""  ADAS
 SG_ DET_BI_STATIC_FLAG_060 : 483|1@1+ (1,0) [0|1] ""  ADAS
 SG_ DET_SUPER_RES_TARGET_060 : 446|1@1+ (1,0) [0|1] ""  ADAS
 SG_ DET_SNR_060 : 488|8@1+ (0.35156,0) [0|89.6478] "dB"  ADAS
 SG_ DET_POINT_TARGET_PROB_060 : 472|4@1+ (6.67,0) [0|100] "%"  ADAS
 SG_ DET_EXISTENCE_PROB_060 : 506|6@1+ (1.588,0) [0|100] "%"  ADAS
 SG_ DET_OUTSIDE_SECTOR_060 : 481|1@1+ (1,0) [0|1] ""  ADAS
 SG_ DET_HVC_FLAG_060 : 464|1@1+ (1,0) [0|1] ""  ADAS
 SG_ DET_CONFD_AZIMUTH_060 : 486|2@1+ (1,0) [0|3] ""  ADAS
 SG_ DET_CONFD_ELEVATION_060 : 461|2@1+ (1,0) [0|3] ""  ADAS
 SG_ DET_MH_SCAN_INDEX_4LSB_057_060 : 476|4@1+ (1,0) [0|15] ""  ADAS
 SG_ DET_MH_CYCLE_COUNTER_057_060 : 16|8@1+ (1,0) [0|255] ""  ADAS
 SG_ DET_MH_CRC16_057_060 : 0|16@1+ (1,0) [0|65535] ""  ADAS

BO_ 1167 RDR_DETECTION_061_064: 64 RDR08
 SG_ DET_RANGE_061 : 24|15@1+ (0.015625,0) [0|500] "m"  ADAS
 SG_ DET_RANGE_ERR_061 : 40|7@1+ (0.0075,0) [0|0.9525] "m"  ADAS
 SG_ DET_RANGE_VELOCITY_061 : 48|15@1+ (0.0078125,-128) [-128|127.9921875] "m/s"  ADAS
 SG_ DET_RANGE_VELOCITY_ERR_061 : 64|8@1+ (0.003,0) [0|0.765] "m/s"  ADAS
 SG_ DET_AZIMUTH_061 : 88|13@1+ (0.0004,-1.5708) [-1.5708|1.5708] "rad"  ADAS
 SG_ DET_AZIMUTH_ERR_061 : 105|7@1+ (0.00087267,0) [0|0.11082909] "rad"  ADAS
 SG_ DET_ELEVATION_061 : 72|8@1+ (0.00275,-0.34925) [-0.34925|0.34925] "rad"  ADAS
 SG_ DET_ELEVATION_ERR_061 : 80|6@1+ (0.00174533,0) [0|0.10995579] "rad"  ADAS
 SG_ DET_RCS_061 : 136|8@1+ (0.5,-64) [-64|63.5] "dBsm"  ADAS
 SG_ DET_VALID_FLAG_061 : 119|1@1+ (1,0) [0|1] ""  ADAS
 SG_ DET_BI_STATIC_FLAG_061 : 504|1@1+ (1,0) [0|1] ""  ADAS
 SG_ DET_SUPER_RES_TARGET_061 : 104|1@1+ (1,0) [0|1] ""  ADAS
 SG_ DET_SNR_061 : 128|8@1+ (0.35156,0) [0|89.6478] "dB"  ADAS
 SG_ DET_POINT_TARGET_PROB_061 : 114|4@1+ (6.67,0) [0|100] "%"  ADAS
 SG_ DET_EXISTENCE_PROB_061 : 120|6@1+ (1.588,0) [0|100] "%"  ADAS
 SG_ DET_OUTSIDE_SECTOR_061 : 159|1@1+ (1,0) [0|1] ""  ADAS
 SG_ DET_HVC_FLAG_061 : 118|1@1+ (1,0) [0|1] ""  ADAS
 SG_ DET_CONFD_AZIMUTH_061 : 126|2@1+ (1,0) [0|3] ""  ADAS
 SG_ DET_CONFD_ELEVATION_061 : 112|2@1+ (1,0) [0|3] ""  ADAS
 SG_ DET_RANGE_062 : 144|15@1+ (0.015625,0) [0|500] "m"  ADAS
 SG_ DET_RANGE_ERR_062 : 160|7@1+ (0.0075,0) [0|0.9525] "m"  ADAS
 SG_ DET_RANGE_VELOCITY_062 : 168|15@1+ (0.0078125,-128) [-128|127.9921875] "m/s"  ADAS
 SG_ DET_RANGE_VELOCITY_ERR_062 : 184|8@1+ (0.003,0) [0|0.765] "m/s"  ADAS
 SG_ DET_AZIMUTH_062 : 208|13@1+ (0.0004,-1.5708) [-1.5708|1.5708] "rad"  ADAS
 SG_ DET_AZIMUTH_ERR_062 : 224|7@1+ (0.00087267,0) [0|0.11082909] "rad"  ADAS
 SG_ DET_ELEVATION_062 : 192|8@1+ (0.00275,-0.34925) [-0.34925|0.34925] "rad"  ADAS
 SG_ DET_ELEVATION_ERR_062 : 200|6@1+ (0.00174533,0) [0|0.10995579] "rad"  ADAS
 SG_ DET_RCS_062 : 256|8@1+ (0.5,-64) [-64|63.5] "dBsm"  ADAS
 SG_ DET_VALID_FLAG_062 : 167|1@1+ (1,0) [0|1] ""  ADAS
 SG_ DET_BI_STATIC_FLAG_062 : 505|1@1+ (1,0) [0|1] ""  ADAS
 SG_ DET_SUPER_RES_TARGET_062 : 247|1@1+ (1,0) [0|1] ""  ADAS
 SG_ DET_SNR_062 : 248|8@1+ (0.35156,0) [0|89.6478] "dB"  ADAS
 SG_ DET_POINT_TARGET_PROB_062 : 240|4@1+ (6.67,0) [0|100] "%"  ADAS
 SG_ DET_EXISTENCE_PROB_062 : 232|6@1+ (1.588,0) [0|100] "%"  ADAS
 SG_ DET_OUTSIDE_SECTOR_062 : 183|1@1+ (1,0) [0|1] ""  ADAS
 SG_ DET_HVC_FLAG_062 : 246|1@1+ (1,0) [0|1] ""  ADAS
 SG_ DET_CONFD_AZIMUTH_062 : 206|2@1+ (1,0) [0|3] ""  ADAS
 SG_ DET_CONFD_ELEVATION_062 : 244|2@1+ (1,0) [0|3] ""  ADAS
 SG_ DET_RANGE_063 : 264|15@1+ (0.015625,0) [0|500] "m"  ADAS
 SG_ DET_RANGE_ERR_063 : 280|7@1+ (0.0075,0) [0|0.9525] "m"  ADAS
 SG_ DET_RANGE_VELOCITY_063 : 288|15@1+ (0.0078125,-128) [-128|127.9921875] "m/s"  ADAS
 SG_ DET_RANGE_VELOCITY_ERR_063 : 304|8@1+ (0.003,0) [0|0.765] "m/s"  ADAS
 SG_ DET_AZIMUTH_063 : 328|13@1+ (0.0004,-1.5708) [-1.5708|1.5708] "rad"  ADAS
 SG_ DET_AZIMUTH_ERR_063 : 345|7@1+ (0.00087267,0) [0|0.11082909] "rad"  ADAS
 SG_ DET_ELEVATION_063 : 312|8@1+ (0.00275,-0.34925) [-0.34925|0.34925] "rad"  ADAS
 SG_ DET_ELEVATION_ERR_063 : 320|6@1+ (0.00174533,0) [0|0.10995579] "rad"  ADAS
 SG_ DET_RCS_063 : 376|8@1+ (0.5,-64) [-64|63.5] "dBsm"  ADAS
 SG_ DET_VALID_FLAG_063 : 399|1@1+ (1,0) [0|1] ""  ADAS
 SG_ DET_BI_STATIC_FLAG_063 : 482|1@1+ (1,0) [0|1] ""  ADAS
 SG_ DET_SUPER_RES_TARGET_063 : 344|1@1+ (1,0) [0|1] ""  ADAS
 SG_ DET_SNR_063 : 368|8@1+ (0.35156,0) [0|89.6478] "dB"  ADAS
 SG_ DET_POINT_TARGET_PROB_063 : 360|4@1+ (6.67,0) [0|100] "%"  ADAS
 SG_ DET_EXISTENCE_PROB_063 : 352|6@1+ (1.588,0) [0|100] "%"  ADAS
 SG_ DET_OUTSIDE_SECTOR_063 : 407|1@1+ (1,0) [0|1] ""  ADAS
 SG_ DET_HVC_FLAG_063 : 364|1@1+ (1,0) [0|1] ""  ADAS
 SG_ DET_CONFD_AZIMUTH_063 : 365|2@1+ (1,0) [0|3] ""  ADAS
 SG_ DET_CONFD_ELEVATION_063 : 358|2@1+ (1,0) [0|3] ""  ADAS
 SG_ DET_RANGE_064 : 384|15@1+ (0.015625,0) [0|500] "m"  ADAS
 SG_ DET_RANGE_ERR_064 : 400|7@1+ (0.0075,0) [0|0.9525] "m"  ADAS
 SG_ DET_RANGE_VELOCITY_064 : 408|15@1+ (0.0078125,-128) [-128|127.9921875] "m/s"  ADAS
 SG_ DET_RANGE_VELOCITY_ERR_064 : 424|8@1+ (0.003,0) [0|0.765] "m/s"  ADAS
 SG_ DET_AZIMUTH_064 : 448|13@1+ (0.0004,-1.5708) [-1.5708|1.5708] "rad"  ADAS
 SG_ DET_AZIMUTH_ERR_064 : 465|7@1+ (0.00087267,0) [0|0.11082909] "rad"  ADAS
 SG_ DET_ELEVATION_064 : 432|8@1+ (0.00275,-0.34925) [-0.34925|0.34925] "rad"  ADAS
 SG_ DET_ELEVATION_ERR_064 : 440|6@1+ (0.00174533,0) [0|0.10995579] "rad"  ADAS
 SG_ DET_RCS_064 : 496|8@1+ (0.5,-64) [-64|63.5] "dBsm"  ADAS
 SG_ DET_VALID_FLAG_064 : 485|1@1+ (1,0) [0|1] ""  ADAS
 SG_ DET_BI_STATIC_FLAG_064 : 483|1@1+ (1,0) [0|1] ""  ADAS
 SG_ DET_SUPER_RES_TARGET_064 : 446|1@1+ (1,0) [0|1] ""  ADAS
 SG_ DET_SNR_064 : 488|8@1+ (0.35156,0) [0|89.6478] "dB"  ADAS
 SG_ DET_POINT_TARGET_PROB_064 : 472|4@1+ (6.67,0) [0|100] "%"  ADAS
 SG_ DET_EXISTENCE_PROB_064 : 506|6@1+ (1.588,0) [0|100] "%"  ADAS
 SG_ DET_OUTSIDE_SECTOR_064 : 481|1@1+ (1,0) [0|1] ""  ADAS
 SG_ DET_HVC_FLAG_064 : 464|1@1+ (1,0) [0|1] ""  ADAS
 SG_ DET_CONFD_AZIMUTH_064 : 486|2@1+ (1,0) [0|3] ""  ADAS
 SG_ DET_CONFD_ELEVATION_064 : 461|2@1+ (1,0) [0|3] ""  ADAS
 SG_ DET_MH_SCAN_INDEX_4LSB_061_064 : 476|4@1+ (1,0) [0|15] ""  ADAS
 SG_ DET_MH_CYCLE_COUNTER_061_064 : 16|8@1+ (1,0) [0|255] ""  ADAS
 SG_ DET_MH_CRC16_061_064 : 0|16@1+ (1,0) [0|65535] ""  ADAS

BO_ 1168 RDR_DETECTION_065_068: 64 RDR08
 SG_ DET_RANGE_065 : 24|15@1+ (0.015625,0) [0|500] "m"  ADAS
 SG_ DET_RANGE_ERR_065 : 40|7@1+ (0.0075,0) [0|0.9525] "m"  ADAS
 SG_ DET_RANGE_VELOCITY_065 : 48|15@1+ (0.0078125,-128) [-128|127.9921875] "m/s"  ADAS
 SG_ DET_RANGE_VELOCITY_ERR_065 : 64|8@1+ (0.003,0) [0|0.765] "m/s"  ADAS
 SG_ DET_AZIMUTH_065 : 88|13@1+ (0.0004,-1.5708) [-1.5708|1.5708] "rad"  ADAS
 SG_ DET_AZIMUTH_ERR_065 : 105|7@1+ (0.00087267,0) [0|0.11082909] "rad"  ADAS
 SG_ DET_ELEVATION_065 : 72|8@1+ (0.00275,-0.34925) [-0.34925|0.34925] "rad"  ADAS
 SG_ DET_ELEVATION_ERR_065 : 80|6@1+ (0.00174533,0) [0|0.10995579] "rad"  ADAS
 SG_ DET_RCS_065 : 136|8@1+ (0.5,-64) [-64|63.5] "dBsm"  ADAS
 SG_ DET_VALID_FLAG_065 : 119|1@1+ (1,0) [0|1] ""  ADAS
 SG_ DET_BI_STATIC_FLAG_065 : 504|1@1+ (1,0) [0|1] ""  ADAS
 SG_ DET_SUPER_RES_TARGET_065 : 104|1@1+ (1,0) [0|1] ""  ADAS
 SG_ DET_SNR_065 : 128|8@1+ (0.35156,0) [0|89.6478] "dB"  ADAS
 SG_ DET_POINT_TARGET_PROB_065 : 114|4@1+ (6.67,0) [0|100] "%"  ADAS
 SG_ DET_EXISTENCE_PROB_065 : 120|6@1+ (1.588,0) [0|100] "%"  ADAS
 SG_ DET_OUTSIDE_SECTOR_065 : 159|1@1+ (1,0) [0|1] ""  ADAS
 SG_ DET_HVC_FLAG_065 : 118|1@1+ (1,0) [0|1] ""  ADAS
 SG_ DET_CONFD_AZIMUTH_065 : 126|2@1+ (1,0) [0|3] ""  ADAS
 SG_ DET_CONFD_ELEVATION_065 : 112|2@1+ (1,0) [0|3] ""  ADAS
 SG_ DET_RANGE_066 : 144|15@1+ (0.015625,0) [0|500] "m"  ADAS
 SG_ DET_RANGE_ERR_066 : 160|7@1+ (0.0075,0) [0|0.9525] "m"  ADAS
 SG_ DET_RANGE_VELOCITY_066 : 168|15@1+ (0.0078125,-128) [-128|127.9921875] "m/s"  ADAS
 SG_ DET_RANGE_VELOCITY_ERR_066 : 184|8@1+ (0.003,0) [0|0.765] "m/s"  ADAS
 SG_ DET_AZIMUTH_066 : 208|13@1+ (0.0004,-1.5708) [-1.5708|1.5708] "rad"  ADAS
 SG_ DET_AZIMUTH_ERR_066 : 224|7@1+ (0.00087267,0) [0|0.11082909] "rad"  ADAS
 SG_ DET_ELEVATION_066 : 192|8@1+ (0.00275,-0.34925) [-0.34925|0.34925] "rad"  ADAS
 SG_ DET_ELEVATION_ERR_066 : 200|6@1+ (0.00174533,0) [0|0.10995579] "rad"  ADAS
 SG_ DET_RCS_066 : 256|8@1+ (0.5,-64) [-64|63.5] "dBsm"  ADAS
 SG_ DET_VALID_FLAG_066 : 167|1@1+ (1,0) [0|1] ""  ADAS
 SG_ DET_BI_STATIC_FLAG_066 : 505|1@1+ (1,0) [0|1] ""  ADAS
 SG_ DET_SUPER_RES_TARGET_066 : 247|1@1+ (1,0) [0|1] ""  ADAS
 SG_ DET_SNR_066 : 248|8@1+ (0.35156,0) [0|89.6478] "dB"  ADAS
 SG_ DET_POINT_TARGET_PROB_066 : 240|4@1+ (6.67,0) [0|100] "%"  ADAS
 SG_ DET_EXISTENCE_PROB_066 : 232|6@1+ (1.588,0) [0|100] "%"  ADAS
 SG_ DET_OUTSIDE_SECTOR_066 : 183|1@1+ (1,0) [0|1] ""  ADAS
 SG_ DET_HVC_FLAG_066 : 246|1@1+ (1,0) [0|1] ""  ADAS
 SG_ DET_CONFD_AZIMUTH_066 : 206|2@1+ (1,0) [0|3] ""  ADAS
 SG_ DET_CONFD_ELEVATION_066 : 244|2@1+ (1,0) [0|3] ""  ADAS
 SG_ DET_RANGE_067 : 264|15@1+ (0.015625,0) [0|500] "m"  ADAS
 SG_ DET_RANGE_ERR_067 : 280|7@1+ (0.0075,0) [0|0.9525] "m"  ADAS
 SG_ DET_RANGE_VELOCITY_067 : 288|15@1+ (0.0078125,-128) [-128|127.9921875] "m/s"  ADAS
 SG_ DET_RANGE_VELOCITY_ERR_067 : 304|8@1+ (0.003,0) [0|0.765] "m/s"  ADAS
 SG_ DET_AZIMUTH_067 : 328|13@1+ (0.0004,-1.5708) [-1.5708|1.5708] "rad"  ADAS
 SG_ DET_AZIMUTH_ERR_067 : 345|7@1+ (0.00087267,0) [0|0.11082909] "rad"  ADAS
 SG_ DET_ELEVATION_067 : 312|8@1+ (0.00275,-0.34925) [-0.34925|0.34925] "rad"  ADAS
 SG_ DET_ELEVATION_ERR_067 : 320|6@1+ (0.00174533,0) [0|0.10995579] "rad"  ADAS
 SG_ DET_RCS_067 : 376|8@1+ (0.5,-64) [-64|63.5] "dBsm"  ADAS
 SG_ DET_VALID_FLAG_067 : 399|1@1+ (1,0) [0|1] ""  ADAS
 SG_ DET_BI_STATIC_FLAG_067 : 482|1@1+ (1,0) [0|1] ""  ADAS
 SG_ DET_SUPER_RES_TARGET_067 : 344|1@1+ (1,0) [0|1] ""  ADAS
 SG_ DET_SNR_067 : 368|8@1+ (0.35156,0) [0|89.6478] "dB"  ADAS
 SG_ DET_POINT_TARGET_PROB_067 : 360|4@1+ (6.67,0) [0|100] "%"  ADAS
 SG_ DET_EXISTENCE_PROB_067 : 352|6@1+ (1.588,0) [0|100] "%"  ADAS
 SG_ DET_OUTSIDE_SECTOR_067 : 407|1@1+ (1,0) [0|1] ""  ADAS
 SG_ DET_HVC_FLAG_067 : 364|1@1+ (1,0) [0|1] ""  ADAS
 SG_ DET_CONFD_AZIMUTH_067 : 365|2@1+ (1,0) [0|3] ""  ADAS
 SG_ DET_CONFD_ELEVATION_067 : 358|2@1+ (1,0) [0|3] ""  ADAS
 SG_ DET_RANGE_068 : 384|15@1+ (0.015625,0) [0|500] "m"  ADAS
 SG_ DET_RANGE_ERR_068 : 400|7@1+ (0.0075,0) [0|0.9525] "m"  ADAS
 SG_ DET_RANGE_VELOCITY_068 : 408|15@1+ (0.0078125,-128) [-128|127.9921875] "m/s"  ADAS
 SG_ DET_RANGE_VELOCITY_ERR_068 : 424|8@1+ (0.003,0) [0|0.765] "m/s"  ADAS
 SG_ DET_AZIMUTH_068 : 448|13@1+ (0.0004,-1.5708) [-1.5708|1.5708] "rad"  ADAS
 SG_ DET_AZIMUTH_ERR_068 : 465|7@1+ (0.00087267,0) [0|0.11082909] "rad"  ADAS
 SG_ DET_ELEVATION_068 : 432|8@1+ (0.00275,-0.34925) [-0.34925|0.34925] "rad"  ADAS
 SG_ DET_ELEVATION_ERR_068 : 440|6@1+ (0.00174533,0) [0|0.10995579] "rad"  ADAS
 SG_ DET_RCS_068 : 496|8@1+ (0.5,-64) [-64|63.5] "dBsm"  ADAS
 SG_ DET_VALID_FLAG_068 : 485|1@1+ (1,0) [0|1] ""  ADAS
 SG_ DET_BI_STATIC_FLAG_068 : 483|1@1+ (1,0) [0|1] ""  ADAS
 SG_ DET_SUPER_RES_TARGET_068 : 446|1@1+ (1,0) [0|1] ""  ADAS
 SG_ DET_SNR_068 : 488|8@1+ (0.35156,0) [0|89.6478] "dB"  ADAS
 SG_ DET_POINT_TARGET_PROB_068 : 472|4@1+ (6.67,0) [0|100] "%"  ADAS
 SG_ DET_EXISTENCE_PROB_068 : 506|6@1+ (1.588,0) [0|100] "%"  ADAS
 SG_ DET_OUTSIDE_SECTOR_068 : 481|1@1+ (1,0) [0|1] ""  ADAS
 SG_ DET_HVC_FLAG_068 : 464|1@1+ (1,0) [0|1] ""  ADAS
 SG_ DET_CONFD_AZIMUTH_068 : 486|2@1+ (1,0) [0|3] ""  ADAS
 SG_ DET_CONFD_ELEVATION_068 : 461|2@1+ (1,0) [0|3] ""  ADAS
 SG_ DET_MH_SCAN_INDEX_4LSB_065_068 : 476|4@1+ (1,0) [0|15] ""  ADAS
 SG_ DET_MH_CYCLE_COUNTER_065_068 : 16|8@1+ (1,0) [0|255] ""  ADAS
 SG_ DET_MH_CRC16_065_068 : 0|16@1+ (1,0) [0|65535] ""  ADAS

BO_ 1169 RDR_DETECTION_069_072: 64 RDR08
 SG_ DET_RANGE_069 : 24|15@1+ (0.015625,0) [0|500] "m"  ADAS
 SG_ DET_RANGE_ERR_069 : 40|7@1+ (0.0075,0) [0|0.9525] "m"  ADAS
 SG_ DET_RANGE_VELOCITY_069 : 48|15@1+ (0.0078125,-128) [-128|127.9921875] "m/s"  ADAS
 SG_ DET_RANGE_VELOCITY_ERR_069 : 64|8@1+ (0.003,0) [0|0.765] "m/s"  ADAS
 SG_ DET_AZIMUTH_069 : 88|13@1+ (0.0004,-1.5708) [-1.5708|1.5708] "rad"  ADAS
 SG_ DET_AZIMUTH_ERR_069 : 105|7@1+ (0.00087267,0) [0|0.11082909] "rad"  ADAS
 SG_ DET_ELEVATION_069 : 72|8@1+ (0.00275,-0.34925) [-0.34925|0.34925] "rad"  ADAS
 SG_ DET_ELEVATION_ERR_069 : 80|6@1+ (0.00174533,0) [0|0.10995579] "rad"  ADAS
 SG_ DET_RCS_069 : 136|8@1+ (0.5,-64) [-64|63.5] "dBsm"  ADAS
 SG_ DET_VALID_FLAG_069 : 119|1@1+ (1,0) [0|1] ""  ADAS
 SG_ DET_BI_STATIC_FLAG_069 : 504|1@1+ (1,0) [0|1] ""  ADAS
 SG_ DET_SUPER_RES_TARGET_069 : 104|1@1+ (1,0) [0|1] ""  ADAS
 SG_ DET_SNR_069 : 128|8@1+ (0.35156,0) [0|89.6478] "dB"  ADAS
 SG_ DET_POINT_TARGET_PROB_069 : 114|4@1+ (6.67,0) [0|100] "%"  ADAS
 SG_ DET_EXISTENCE_PROB_069 : 120|6@1+ (1.588,0) [0|100] "%"  ADAS
 SG_ DET_OUTSIDE_SECTOR_069 : 159|1@1+ (1,0) [0|1] ""  ADAS
 SG_ DET_HVC_FLAG_069 : 118|1@1+ (1,0) [0|1] ""  ADAS
 SG_ DET_CONFD_AZIMUTH_069 : 126|2@1+ (1,0) [0|3] ""  ADAS
 SG_ DET_CONFD_ELEVATION_069 : 112|2@1+ (1,0) [0|3] ""  ADAS
 SG_ DET_RANGE_070 : 144|15@1+ (0.015625,0) [0|500] "m"  ADAS
 SG_ DET_RANGE_ERR_070 : 160|7@1+ (0.0075,0) [0|0.9525] "m"  ADAS
 SG_ DET_RANGE_VELOCITY_070 : 168|15@1+ (0.0078125,-128) [-128|127.9921875] "m/s"  ADAS
 SG_ DET_RANGE_VELOCITY_ERR_070 : 184|8@1+ (0.003,0) [0|0.765] "m/s"  ADAS
 SG_ DET_AZIMUTH_070 : 208|13@1+ (0.0004,-1.5708) [-1.5708|1.5708] "rad"  ADAS
 SG_ DET_AZIMUTH_ERR_070 : 224|7@1+ (0.00087267,0) [0|0.11082909] "rad"  ADAS
 SG_ DET_ELEVATION_070 : 192|8@1+ (0.00275,-0.34925) [-0.34925|0.34925] "rad"  ADAS
 SG_ DET_ELEVATION_ERR_070 : 200|6@1+ (0.00174533,0) [0|0.10995579] "rad"  ADAS
 SG_ DET_RCS_070 : 256|8@1+ (0.5,-64) [-64|63.5] "dBsm"  ADAS
 SG_ DET_VALID_FLAG_070 : 167|1@1+ (1,0) [0|1] ""  ADAS
 SG_ DET_BI_STATIC_FLAG_070 : 505|1@1+ (1,0) [0|1] ""  ADAS
 SG_ DET_SUPER_RES_TARGET_070 : 247|1@1+ (1,0) [0|1] ""  ADAS
 SG_ DET_SNR_070 : 248|8@1+ (0.35156,0) [0|89.6478] "dB"  ADAS
 SG_ DET_POINT_TARGET_PROB_070 : 240|4@1+ (6.67,0) [0|100] "%"  ADAS
 SG_ DET_EXISTENCE_PROB_070 : 232|6@1+ (1.588,0) [0|100] "%"  ADAS
 SG_ DET_OUTSIDE_SECTOR_070 : 183|1@1+ (1,0) [0|1] ""  ADAS
 SG_ DET_HVC_FLAG_070 : 246|1@1+ (1,0) [0|1] ""  ADAS
 SG_ DET_CONFD_AZIMUTH_070 : 206|2@1+ (1,0) [0|3] ""  ADAS
 SG_ DET_CONFD_ELEVATION_070 : 244|2@1+ (1,0) [0|3] ""  ADAS
 SG_ DET_RANGE_071 : 264|15@1+ (0.015625,0) [0|500] "m"  ADAS
 SG_ DET_RANGE_ERR_071 : 280|7@1+ (0.0075,0) [0|0.9525] "m"  ADAS
 SG_ DET_RANGE_VELOCITY_071 : 288|15@1+ (0.0078125,-128) [-128|127.9921875] "m/s"  ADAS
 SG_ DET_RANGE_VELOCITY_ERR_071 : 304|8@1+ (0.003,0) [0|0.765] "m/s"  ADAS
 SG_ DET_AZIMUTH_071 : 328|13@1+ (0.0004,-1.5708) [-1.5708|1.5708] "rad"  ADAS
 SG_ DET_AZIMUTH_ERR_071 : 345|7@1+ (0.00087267,0) [0|0.11082909] "rad"  ADAS
 SG_ DET_ELEVATION_071 : 312|8@1+ (0.00275,-0.34925) [-0.34925|0.34925] "rad"  ADAS
 SG_ DET_ELEVATION_ERR_071 : 320|6@1+ (0.00174533,0) [0|0.10995579] "rad"  ADAS
 SG_ DET_RCS_071 : 376|8@1+ (0.5,-64) [-64|63.5] "dBsm"  ADAS
 SG_ DET_VALID_FLAG_071 : 399|1@1+ (1,0) [0|1] ""  ADAS
 SG_ DET_BI_STATIC_FLAG_071 : 482|1@1+ (1,0) [0|1] ""  ADAS
 SG_ DET_SUPER_RES_TARGET_071 : 344|1@1+ (1,0) [0|1] ""  ADAS
 SG_ DET_SNR_071 : 368|8@1+ (0.35156,0) [0|89.6478] "dB"  ADAS
 SG_ DET_POINT_TARGET_PROB_071 : 360|4@1+ (6.67,0) [0|100] "%"  ADAS
 SG_ DET_EXISTENCE_PROB_071 : 352|6@1+ (1.588,0) [0|100] "%"  ADAS
 SG_ DET_OUTSIDE_SECTOR_071 : 407|1@1+ (1,0) [0|1] ""  ADAS
 SG_ DET_HVC_FLAG_071 : 364|1@1+ (1,0) [0|1] ""  ADAS
 SG_ DET_CONFD_AZIMUTH_071 : 365|2@1+ (1,0) [0|3] ""  ADAS
 SG_ DET_CONFD_ELEVATION_071 : 358|2@1+ (1,0) [0|3] ""  ADAS
 SG_ DET_RANGE_072 : 384|15@1+ (0.015625,0) [0|500] "m"  ADAS
 SG_ DET_RANGE_ERR_072 : 400|7@1+ (0.0075,0) [0|0.9525] "m"  ADAS
 SG_ DET_RANGE_VELOCITY_072 : 408|15@1+ (0.0078125,-128) [-128|127.9921875] "m/s"  ADAS
 SG_ DET_RANGE_VELOCITY_ERR_072 : 424|8@1+ (0.003,0) [0|0.765] "m/s"  ADAS
 SG_ DET_AZIMUTH_072 : 448|13@1+ (0.0004,-1.5708) [-1.5708|1.5708] "rad"  ADAS
 SG_ DET_AZIMUTH_ERR_072 : 465|7@1+ (0.00087267,0) [0|0.11082909] "rad"  ADAS
 SG_ DET_ELEVATION_072 : 432|8@1+ (0.00275,-0.34925) [-0.34925|0.34925] "rad"  ADAS
 SG_ DET_ELEVATION_ERR_072 : 440|6@1+ (0.00174533,0) [0|0.10995579] "rad"  ADAS
 SG_ DET_RCS_072 : 496|8@1+ (0.5,-64) [-64|63.5] "dBsm"  ADAS
 SG_ DET_VALID_FLAG_072 : 485|1@1+ (1,0) [0|1] ""  ADAS
 SG_ DET_BI_STATIC_FLAG_072 : 483|1@1+ (1,0) [0|1] ""  ADAS
 SG_ DET_SUPER_RES_TARGET_072 : 446|1@1+ (1,0) [0|1] ""  ADAS
 SG_ DET_SNR_072 : 488|8@1+ (0.35156,0) [0|89.6478] "dB"  ADAS
 SG_ DET_POINT_TARGET_PROB_072 : 472|4@1+ (6.67,0) [0|100] "%"  ADAS
 SG_ DET_EXISTENCE_PROB_072 : 506|6@1+ (1.588,0) [0|100] "%"  ADAS
 SG_ DET_OUTSIDE_SECTOR_072 : 481|1@1+ (1,0) [0|1] ""  ADAS
 SG_ DET_HVC_FLAG_072 : 464|1@1+ (1,0) [0|1] ""  ADAS
 SG_ DET_CONFD_AZIMUTH_072 : 486|2@1+ (1,0) [0|3] ""  ADAS
 SG_ DET_CONFD_ELEVATION_072 : 461|2@1+ (1,0) [0|3] ""  ADAS
 SG_ DET_MH_SCAN_INDEX_4LSB_069_072 : 476|4@1+ (1,0) [0|15] ""  ADAS
 SG_ DET_MH_CYCLE_COUNTER_069_072 : 16|8@1+ (1,0) [0|255] ""  ADAS
 SG_ DET_MH_CRC16_069_072 : 0|16@1+ (1,0) [0|65535] ""  ADAS

BO_ 1170 RDR_DETECTION_073_076: 64 RDR08
 SG_ DET_RANGE_073 : 24|15@1+ (0.015625,0) [0|500] "m"  ADAS
 SG_ DET_RANGE_ERR_073 : 40|7@1+ (0.0075,0) [0|0.9525] "m"  ADAS
 SG_ DET_RANGE_VELOCITY_073 : 48|15@1+ (0.0078125,-128) [-128|127.9921875] "m/s"  ADAS
 SG_ DET_RANGE_VELOCITY_ERR_073 : 64|8@1+ (0.003,0) [0|0.765] "m/s"  ADAS
 SG_ DET_AZIMUTH_073 : 88|13@1+ (0.0004,-1.5708) [-1.5708|1.5708] "rad"  ADAS
 SG_ DET_AZIMUTH_ERR_073 : 105|7@1+ (0.00087267,0) [0|0.11082909] "rad"  ADAS
 SG_ DET_ELEVATION_073 : 72|8@1+ (0.00275,-0.34925) [-0.34925|0.34925] "rad"  ADAS
 SG_ DET_ELEVATION_ERR_073 : 80|6@1+ (0.00174533,0) [0|0.10995579] "rad"  ADAS
 SG_ DET_RCS_073 : 136|8@1+ (0.5,-64) [-64|63.5] "dBsm"  ADAS
 SG_ DET_VALID_FLAG_073 : 119|1@1+ (1,0) [0|1] ""  ADAS
 SG_ DET_BI_STATIC_FLAG_073 : 504|1@1+ (1,0) [0|1] ""  ADAS
 SG_ DET_SUPER_RES_TARGET_073 : 104|1@1+ (1,0) [0|1] ""  ADAS
 SG_ DET_SNR_073 : 128|8@1+ (0.35156,0) [0|89.6478] "dB"  ADAS
 SG_ DET_POINT_TARGET_PROB_073 : 114|4@1+ (6.67,0) [0|100] "%"  ADAS
 SG_ DET_EXISTENCE_PROB_073 : 120|6@1+ (1.588,0) [0|100] "%"  ADAS
 SG_ DET_OUTSIDE_SECTOR_073 : 159|1@1+ (1,0) [0|1] ""  ADAS
 SG_ DET_HVC_FLAG_073 : 118|1@1+ (1,0) [0|1] ""  ADAS
 SG_ DET_CONFD_AZIMUTH_073 : 126|2@1+ (1,0) [0|3] ""  ADAS
 SG_ DET_CONFD_ELEVATION_073 : 112|2@1+ (1,0) [0|3] ""  ADAS
 SG_ DET_RANGE_074 : 144|15@1+ (0.015625,0) [0|500] "m"  ADAS
 SG_ DET_RANGE_ERR_074 : 160|7@1+ (0.0075,0) [0|0.9525] "m"  ADAS
 SG_ DET_RANGE_VELOCITY_074 : 168|15@1+ (0.0078125,-128) [-128|127.9921875] "m/s"  ADAS
 SG_ DET_RANGE_VELOCITY_ERR_074 : 184|8@1+ (0.003,0) [0|0.765] "m/s"  ADAS
 SG_ DET_AZIMUTH_074 : 208|13@1+ (0.0004,-1.5708) [-1.5708|1.5708] "rad"  ADAS
 SG_ DET_AZIMUTH_ERR_074 : 224|7@1+ (0.00087267,0) [0|0.11082909] "rad"  ADAS
 SG_ DET_ELEVATION_074 : 192|8@1+ (0.00275,-0.34925) [-0.34925|0.34925] "rad"  ADAS
 SG_ DET_ELEVATION_ERR_074 : 200|6@1+ (0.00174533,0) [0|0.10995579] "rad"  ADAS
 SG_ DET_RCS_074 : 256|8@1+ (0.5,-64) [-64|63.5] "dBsm"  ADAS
 SG_ DET_VALID_FLAG_074 : 167|1@1+ (1,0) [0|1] ""  ADAS
 SG_ DET_BI_STATIC_FLAG_074 : 505|1@1+ (1,0) [0|1] ""  ADAS
 SG_ DET_SUPER_RES_TARGET_074 : 247|1@1+ (1,0) [0|1] ""  ADAS
 SG_ DET_SNR_074 : 248|8@1+ (0.35156,0) [0|89.6478] "dB"  ADAS
 SG_ DET_POINT_TARGET_PROB_074 : 240|4@1+ (6.67,0) [0|100] "%"  ADAS
 SG_ DET_EXISTENCE_PROB_074 : 232|6@1+ (1.588,0) [0|100] "%"  ADAS
 SG_ DET_OUTSIDE_SECTOR_074 : 183|1@1+ (1,0) [0|1] ""  ADAS
 SG_ DET_HVC_FLAG_074 : 246|1@1+ (1,0) [0|1] ""  ADAS
 SG_ DET_CONFD_AZIMUTH_074 : 206|2@1+ (1,0) [0|3] ""  ADAS
 SG_ DET_CONFD_ELEVATION_074 : 244|2@1+ (1,0) [0|3] ""  ADAS
 SG_ DET_RANGE_075 : 264|15@1+ (0.015625,0) [0|500] "m"  ADAS
 SG_ DET_RANGE_ERR_075 : 280|7@1+ (0.0075,0) [0|0.9525] "m"  ADAS
 SG_ DET_RANGE_VELOCITY_075 : 288|15@1+ (0.0078125,-128) [-128|127.9921875] "m/s"  ADAS
 SG_ DET_RANGE_VELOCITY_ERR_075 : 304|8@1+ (0.003,0) [0|0.765] "m/s"  ADAS
 SG_ DET_AZIMUTH_075 : 328|13@1+ (0.0004,-1.5708) [-1.5708|1.5708] "rad"  ADAS
 SG_ DET_AZIMUTH_ERR_075 : 345|7@1+ (0.00087267,0) [0|0.11082909] "rad"  ADAS
 SG_ DET_ELEVATION_075 : 312|8@1+ (0.00275,-0.34925) [-0.34925|0.34925] "rad"  ADAS
 SG_ DET_ELEVATION_ERR_075 : 320|6@1+ (0.00174533,0) [0|0.10995579] "rad"  ADAS
 SG_ DET_RCS_075 : 376|8@1+ (0.5,-64) [-64|63.5] "dBsm"  ADAS
 SG_ DET_VALID_FLAG_075 : 399|1@1+ (1,0) [0|1] ""  ADAS
 SG_ DET_BI_STATIC_FLAG_075 : 482|1@1+ (1,0) [0|1] ""  ADAS
 SG_ DET_SUPER_RES_TARGET_075 : 344|1@1+ (1,0) [0|1] ""  ADAS
 SG_ DET_SNR_075 : 368|8@1+ (0.35156,0) [0|89.6478] "dB"  ADAS
 SG_ DET_POINT_TARGET_PROB_075 : 360|4@1+ (6.67,0) [0|100] "%"  ADAS
 SG_ DET_EXISTENCE_PROB_075 : 352|6@1+ (1.588,0) [0|100] "%"  ADAS
 SG_ DET_OUTSIDE_SECTOR_075 : 407|1@1+ (1,0) [0|1] ""  ADAS
 SG_ DET_HVC_FLAG_075 : 364|1@1+ (1,0) [0|1] ""  ADAS
 SG_ DET_CONFD_AZIMUTH_075 : 365|2@1+ (1,0) [0|3] ""  ADAS
 SG_ DET_CONFD_ELEVATION_075 : 358|2@1+ (1,0) [0|3] ""  ADAS
 SG_ DET_RANGE_076 : 384|15@1+ (0.015625,0) [0|500] "m"  ADAS
 SG_ DET_RANGE_ERR_076 : 400|7@1+ (0.0075,0) [0|0.9525] "m"  ADAS
 SG_ DET_RANGE_VELOCITY_076 : 408|15@1+ (0.0078125,-128) [-128|127.9921875] "m/s"  ADAS
 SG_ DET_RANGE_VELOCITY_ERR_076 : 424|8@1+ (0.003,0) [0|0.765] "m/s"  ADAS
 SG_ DET_AZIMUTH_076 : 448|13@1+ (0.0004,-1.5708) [-1.5708|1.5708] "rad"  ADAS
 SG_ DET_AZIMUTH_ERR_076 : 465|7@1+ (0.00087267,0) [0|0.11082909] "rad"  ADAS
 SG_ DET_ELEVATION_076 : 432|8@1+ (0.00275,-0.34925) [-0.34925|0.34925] "rad"  ADAS
 SG_ DET_ELEVATION_ERR_076 : 440|6@1+ (0.00174533,0) [0|0.10995579] "rad"  ADAS
 SG_ DET_RCS_076 : 496|8@1+ (0.5,-64) [-64|63.5] "dBsm"  ADAS
 SG_ DET_VALID_FLAG_076 : 485|1@1+ (1,0) [0|1] ""  ADAS
 SG_ DET_BI_STATIC_FLAG_076 : 483|1@1+ (1,0) [0|1] ""  ADAS
 SG_ DET_SUPER_RES_TARGET_076 : 446|1@1+ (1,0) [0|1] ""  ADAS
 SG_ DET_SNR_076 : 488|8@1+ (0.35156,0) [0|89.6478] "dB"  ADAS
 SG_ DET_POINT_TARGET_PROB_076 : 472|4@1+ (6.67,0) [0|100] "%"  ADAS
 SG_ DET_EXISTENCE_PROB_076 : 506|6@1+ (1.588,0) [0|100] "%"  ADAS
 SG_ DET_OUTSIDE_SECTOR_076 : 481|1@1+ (1,0) [0|1] ""  ADAS
 SG_ DET_HVC_FLAG_076 : 464|1@1+ (1,0) [0|1] ""  ADAS
 SG_ DET_CONFD_AZIMUTH_076 : 486|2@1+ (1,0) [0|3] ""  ADAS
 SG_ DET_CONFD_ELEVATION_076 : 461|2@1+ (1,0) [0|3] ""  ADAS
 SG_ DET_MH_SCAN_INDEX_4LSB_073_076 : 476|4@1+ (1,0) [0|15] ""  ADAS
 SG_ DET_MH_CYCLE_COUNTER_073_076 : 16|8@1+ (1,0) [0|255] ""  ADAS
 SG_ DET_MH_CRC16_073_076 : 0|16@1+ (1,0) [0|65535] ""  ADAS

BO_ 1171 RDR_DETECTION_077_080: 64 RDR08
 SG_ DET_RANGE_077 : 24|15@1+ (0.015625,0) [0|500] "m"  ADAS
 SG_ DET_RANGE_ERR_077 : 40|7@1+ (0.0075,0) [0|0.9525] "m"  ADAS
 SG_ DET_RANGE_VELOCITY_077 : 48|15@1+ (0.0078125,-128) [-128|127.9921875] "m/s"  ADAS
 SG_ DET_RANGE_VELOCITY_ERR_077 : 64|8@1+ (0.003,0) [0|0.765] "m/s"  ADAS
 SG_ DET_AZIMUTH_077 : 88|13@1+ (0.0004,-1.5708) [-1.5708|1.5708] "rad"  ADAS
 SG_ DET_AZIMUTH_ERR_077 : 105|7@1+ (0.00087267,0) [0|0.11082909] "rad"  ADAS
 SG_ DET_ELEVATION_077 : 72|8@1+ (0.00275,-0.34925) [-0.34925|0.34925] "rad"  ADAS
 SG_ DET_ELEVATION_ERR_077 : 80|6@1+ (0.00174533,0) [0|0.10995579] "rad"  ADAS
 SG_ DET_RCS_077 : 136|8@1+ (0.5,-64) [-64|63.5] "dBsm"  ADAS
 SG_ DET_VALID_FLAG_077 : 119|1@1+ (1,0) [0|1] ""  ADAS
 SG_ DET_BI_STATIC_FLAG_077 : 504|1@1+ (1,0) [0|1] ""  ADAS
 SG_ DET_SUPER_RES_TARGET_077 : 104|1@1+ (1,0) [0|1] ""  ADAS
 SG_ DET_SNR_077 : 128|8@1+ (0.35156,0) [0|89.6478] "dB"  ADAS
 SG_ DET_POINT_TARGET_PROB_077 : 114|4@1+ (6.67,0) [0|100] "%"  ADAS
 SG_ DET_EXISTENCE_PROB_077 : 120|6@1+ (1.588,0) [0|100] "%"  ADAS
 SG_ DET_OUTSIDE_SECTOR_077 : 159|1@1+ (1,0) [0|1] ""  ADAS
 SG_ DET_HVC_FLAG_077 : 118|1@1+ (1,0) [0|1] ""  ADAS
 SG_ DET_CONFD_AZIMUTH_077 : 126|2@1+ (1,0) [0|3] ""  ADAS
 SG_ DET_CONFD_ELEVATION_077 : 112|2@1+ (1,0) [0|3] ""  ADAS
 SG_ DET_RANGE_078 : 144|15@1+ (0.015625,0) [0|500] "m"  ADAS
 SG_ DET_RANGE_ERR_078 : 160|7@1+ (0.0075,0) [0|0.9525] "m"  ADAS
 SG_ DET_RANGE_VELOCITY_078 : 168|15@1+ (0.0078125,-128) [-128|127.9921875] "m/s"  ADAS
 SG_ DET_RANGE_VELOCITY_ERR_078 : 184|8@1+ (0.003,0) [0|0.765] "m/s"  ADAS
 SG_ DET_AZIMUTH_078 : 208|13@1+ (0.0004,-1.5708) [-1.5708|1.5708] "rad"  ADAS
 SG_ DET_AZIMUTH_ERR_078 : 224|7@1+ (0.00087267,0) [0|0.11082909] "rad"  ADAS
 SG_ DET_ELEVATION_078 : 192|8@1+ (0.00275,-0.34925) [-0.34925|0.34925] "rad"  ADAS
 SG_ DET_ELEVATION_ERR_078 : 200|6@1+ (0.00174533,0) [0|0.10995579] "rad"  ADAS
 SG_ DET_RCS_078 : 256|8@1+ (0.5,-64) [-64|63.5] "dBsm"  ADAS
 SG_ DET_VALID_FLAG_078 : 167|1@1+ (1,0) [0|1] ""  ADAS
 SG_ DET_BI_STATIC_FLAG_078 : 505|1@1+ (1,0) [0|1] ""  ADAS
 SG_ DET_SUPER_RES_TARGET_078 : 247|1@1+ (1,0) [0|1] ""  ADAS
 SG_ DET_SNR_078 : 248|8@1+ (0.35156,0) [0|89.6478] "dB"  ADAS
 SG_ DET_POINT_TARGET_PROB_078 : 240|4@1+ (6.67,0) [0|100] "%"  ADAS
 SG_ DET_EXISTENCE_PROB_078 : 232|6@1+ (1.588,0) [0|100] "%"  ADAS
 SG_ DET_OUTSIDE_SECTOR_078 : 183|1@1+ (1,0) [0|1] ""  ADAS
 SG_ DET_HVC_FLAG_078 : 246|1@1+ (1,0) [0|1] ""  ADAS
 SG_ DET_CONFD_AZIMUTH_078 : 206|2@1+ (1,0) [0|3] ""  ADAS
 SG_ DET_CONFD_ELEVATION_078 : 244|2@1+ (1,0) [0|3] ""  ADAS
 SG_ DET_RANGE_079 : 264|15@1+ (0.015625,0) [0|500] "m"  ADAS
 SG_ DET_RANGE_ERR_079 : 280|7@1+ (0.0075,0) [0|0.9525] "m"  ADAS
 SG_ DET_RANGE_VELOCITY_079 : 288|15@1+ (0.0078125,-128) [-128|127.9921875] "m/s"  ADAS
 SG_ DET_RANGE_VELOCITY_ERR_079 : 304|8@1+ (0.003,0) [0|0.765] "m/s"  ADAS
 SG_ DET_AZIMUTH_079 : 328|13@1+ (0.0004,-1.5708) [-1.5708|1.5708] "rad"  ADAS
 SG_ DET_AZIMUTH_ERR_079 : 345|7@1+ (0.00087267,0) [0|0.11082909] "rad"  ADAS
 SG_ DET_ELEVATION_079 : 312|8@1+ (0.00275,-0.34925) [-0.34925|0.34925] "rad"  ADAS
 SG_ DET_ELEVATION_ERR_079 : 320|6@1+ (0.00174533,0) [0|0.10995579] "rad"  ADAS
 SG_ DET_RCS_079 : 376|8@1+ (0.5,-64) [-64|63.5] "dBsm"  ADAS
 SG_ DET_VALID_FLAG_079 : 399|1@1+ (1,0) [0|1] ""  ADAS
 SG_ DET_BI_STATIC_FLAG_079 : 482|1@1+ (1,0) [0|1] ""  ADAS
 SG_ DET_SUPER_RES_TARGET_079 : 344|1@1+ (1,0) [0|1] ""  ADAS
 SG_ DET_SNR_079 : 368|8@1+ (0.35156,0) [0|89.6478] "dB"  ADAS
 SG_ DET_POINT_TARGET_PROB_079 : 360|4@1+ (6.67,0) [0|100] "%"  ADAS
 SG_ DET_EXISTENCE_PROB_079 : 352|6@1+ (1.588,0) [0|100] "%"  ADAS
 SG_ DET_OUTSIDE_SECTOR_079 : 407|1@1+ (1,0) [0|1] ""  ADAS
 SG_ DET_HVC_FLAG_079 : 364|1@1+ (1,0) [0|1] ""  ADAS
 SG_ DET_CONFD_AZIMUTH_079 : 365|2@1+ (1,0) [0|3] ""  ADAS
 SG_ DET_CONFD_ELEVATION_079 : 358|2@1+ (1,0) [0|3] ""  ADAS
 SG_ DET_RANGE_080 : 384|15@1+ (0.015625,0) [0|500] "m"  ADAS
 SG_ DET_RANGE_ERR_080 : 400|7@1+ (0.0075,0) [0|0.9525] "m"  ADAS
 SG_ DET_RANGE_VELOCITY_080 : 408|15@1+ (0.0078125,-128) [-128|127.9921875] "m/s"  ADAS
 SG_ DET_RANGE_VELOCITY_ERR_080 : 424|8@1+ (0.003,0) [0|0.765] "m/s"  ADAS
 SG_ DET_AZIMUTH_080 : 448|13@1+ (0.0004,-1.5708) [-1.5708|1.5708] "rad"  ADAS
 SG_ DET_AZIMUTH_ERR_080 : 465|7@1+ (0.00087267,0) [0|0.11082909] "rad"  ADAS
 SG_ DET_ELEVATION_080 : 432|8@1+ (0.00275,-0.34925) [-0.34925|0.34925] "rad"  ADAS
 SG_ DET_ELEVATION_ERR_080 : 440|6@1+ (0.00174533,0) [0|0.10995579] "rad"  ADAS
 SG_ DET_RCS_080 : 496|8@1+ (0.5,-64) [-64|63.5] "dBsm"  ADAS
 SG_ DET_VALID_FLAG_080 : 485|1@1+ (1,0) [0|1] ""  ADAS
 SG_ DET_BI_STATIC_FLAG_080 : 483|1@1+ (1,0) [0|1] ""  ADAS
 SG_ DET_SUPER_RES_TARGET_080 : 446|1@1+ (1,0) [0|1] ""  ADAS
 SG_ DET_SNR_080 : 488|8@1+ (0.35156,0) [0|89.6478] "dB"  ADAS
 SG_ DET_POINT_TARGET_PROB_080 : 472|4@1+ (6.67,0) [0|100] "%"  ADAS
 SG_ DET_EXISTENCE_PROB_080 : 506|6@1+ (1.588,0) [0|100] "%"  ADAS
 SG_ DET_OUTSIDE_SECTOR_080 : 481|1@1+ (1,0) [0|1] ""  ADAS
 SG_ DET_HVC_FLAG_080 : 464|1@1+ (1,0) [0|1] ""  ADAS
 SG_ DET_CONFD_AZIMUTH_080 : 486|2@1+ (1,0) [0|3] ""  ADAS
 SG_ DET_CONFD_ELEVATION_080 : 461|2@1+ (1,0) [0|3] ""  ADAS
 SG_ DET_MH_SCAN_INDEX_4LSB_077_080 : 476|4@1+ (1,0) [0|15] ""  ADAS
 SG_ DET_MH_CYCLE_COUNTER_077_080 : 16|8@1+ (1,0) [0|255] ""  ADAS
 SG_ DET_MH_CRC16_077_080 : 0|16@1+ (1,0) [0|65535] ""  ADAS

BO_ 1172 RDR_DETECTION_081_084: 64 RDR08
 SG_ DET_RANGE_081 : 24|15@1+ (0.015625,0) [0|500] "m"  ADAS
 SG_ DET_RANGE_ERR_081 : 40|7@1+ (0.0075,0) [0|0.9525] "m"  ADAS
 SG_ DET_RANGE_VELOCITY_081 : 48|15@1+ (0.0078125,-128) [-128|127.9921875] "m/s"  ADAS
 SG_ DET_RANGE_VELOCITY_ERR_081 : 64|8@1+ (0.003,0) [0|0.765] "m/s"  ADAS
 SG_ DET_AZIMUTH_081 : 88|13@1+ (0.0004,-1.5708) [-1.5708|1.5708] "rad"  ADAS
 SG_ DET_AZIMUTH_ERR_081 : 105|7@1+ (0.00087267,0) [0|0.11082909] "rad"  ADAS
 SG_ DET_ELEVATION_081 : 72|8@1+ (0.00275,-0.34925) [-0.34925|0.34925] "rad"  ADAS
 SG_ DET_ELEVATION_ERR_081 : 80|6@1+ (0.00174533,0) [0|0.10995579] "rad"  ADAS
 SG_ DET_RCS_081 : 136|8@1+ (0.5,-64) [-64|63.5] "dBsm"  ADAS
 SG_ DET_VALID_FLAG_081 : 119|1@1+ (1,0) [0|1] ""  ADAS
 SG_ DET_BI_STATIC_FLAG_081 : 504|1@1+ (1,0) [0|1] ""  ADAS
 SG_ DET_SUPER_RES_TARGET_081 : 104|1@1+ (1,0) [0|1] ""  ADAS
 SG_ DET_SNR_081 : 128|8@1+ (0.35156,0) [0|89.6478] "dB"  ADAS
 SG_ DET_POINT_TARGET_PROB_081 : 114|4@1+ (6.67,0) [0|100] "%"  ADAS
 SG_ DET_EXISTENCE_PROB_081 : 120|6@1+ (1.588,0) [0|100] "%"  ADAS
 SG_ DET_OUTSIDE_SECTOR_081 : 159|1@1+ (1,0) [0|1] ""  ADAS
 SG_ DET_HVC_FLAG_081 : 118|1@1+ (1,0) [0|1] ""  ADAS
 SG_ DET_CONFD_AZIMUTH_081 : 126|2@1+ (1,0) [0|3] ""  ADAS
 SG_ DET_CONFD_ELEVATION_081 : 112|2@1+ (1,0) [0|3] ""  ADAS
 SG_ DET_RANGE_082 : 144|15@1+ (0.015625,0) [0|500] "m"  ADAS
 SG_ DET_RANGE_ERR_082 : 160|7@1+ (0.0075,0) [0|0.9525] "m"  ADAS
 SG_ DET_RANGE_VELOCITY_082 : 168|15@1+ (0.0078125,-128) [-128|127.9921875] "m/s"  ADAS
 SG_ DET_RANGE_VELOCITY_ERR_082 : 184|8@1+ (0.003,0) [0|0.765] "m/s"  ADAS
 SG_ DET_AZIMUTH_082 : 208|13@1+ (0.0004,-1.5708) [-1.5708|1.5708] "rad"  ADAS
 SG_ DET_AZIMUTH_ERR_082 : 224|7@1+ (0.00087267,0) [0|0.11082909] "rad"  ADAS
 SG_ DET_ELEVATION_082 : 192|8@1+ (0.00275,-0.34925) [-0.34925|0.34925] "rad"  ADAS
 SG_ DET_ELEVATION_ERR_082 : 200|6@1+ (0.00174533,0) [0|0.10995579] "rad"  ADAS
 SG_ DET_RCS_082 : 256|8@1+ (0.5,-64) [-64|63.5] "dBsm"  ADAS
 SG_ DET_VALID_FLAG_082 : 167|1@1+ (1,0) [0|1] ""  ADAS
 SG_ DET_BI_STATIC_FLAG_082 : 505|1@1+ (1,0) [0|1] ""  ADAS
 SG_ DET_SUPER_RES_TARGET_082 : 247|1@1+ (1,0) [0|1] ""  ADAS
 SG_ DET_SNR_082 : 248|8@1+ (0.35156,0) [0|89.6478] "dB"  ADAS
 SG_ DET_POINT_TARGET_PROB_082 : 240|4@1+ (6.67,0) [0|100] "%"  ADAS
 SG_ DET_EXISTENCE_PROB_082 : 232|6@1+ (1.588,0) [0|100] "%"  ADAS
 SG_ DET_OUTSIDE_SECTOR_082 : 183|1@1+ (1,0) [0|1] ""  ADAS
 SG_ DET_HVC_FLAG_082 : 246|1@1+ (1,0) [0|1] ""  ADAS
 SG_ DET_CONFD_AZIMUTH_082 : 206|2@1+ (1,0) [0|3] ""  ADAS
 SG_ DET_CONFD_ELEVATION_082 : 244|2@1+ (1,0) [0|3] ""  ADAS
 SG_ DET_RANGE_083 : 264|15@1+ (0.015625,0) [0|500] "m"  ADAS
 SG_ DET_RANGE_ERR_083 : 280|7@1+ (0.0075,0) [0|0.9525] "m"  ADAS
 SG_ DET_RANGE_VELOCITY_083 : 288|15@1+ (0.0078125,-128) [-128|127.9921875] "m/s"  ADAS
 SG_ DET_RANGE_VELOCITY_ERR_083 : 304|8@1+ (0.003,0) [0|0.765] "m/s"  ADAS
 SG_ DET_AZIMUTH_083 : 328|13@1+ (0.0004,-1.5708) [-1.5708|1.5708] "rad"  ADAS
 SG_ DET_AZIMUTH_ERR_083 : 345|7@1+ (0.00087267,0) [0|0.11082909] "rad"  ADAS
 SG_ DET_ELEVATION_083 : 312|8@1+ (0.00275,-0.34925) [-0.34925|0.34925] "rad"  ADAS
 SG_ DET_ELEVATION_ERR_083 : 320|6@1+ (0.00174533,0) [0|0.10995579] "rad"  ADAS
 SG_ DET_RCS_083 : 376|8@1+ (0.5,-64) [-64|63.5] "dBsm"  ADAS
 SG_ DET_VALID_FLAG_083 : 399|1@1+ (1,0) [0|1] ""  ADAS
 SG_ DET_BI_STATIC_FLAG_083 : 482|1@1+ (1,0) [0|1] ""  ADAS
 SG_ DET_SUPER_RES_TARGET_083 : 344|1@1+ (1,0) [0|1] ""  ADAS
 SG_ DET_SNR_083 : 368|8@1+ (0.35156,0) [0|89.6478] "dB"  ADAS
 SG_ DET_POINT_TARGET_PROB_083 : 360|4@1+ (6.67,0) [0|100] "%"  ADAS
 SG_ DET_EXISTENCE_PROB_083 : 352|6@1+ (1.588,0) [0|100] "%"  ADAS
 SG_ DET_OUTSIDE_SECTOR_083 : 407|1@1+ (1,0) [0|1] ""  ADAS
 SG_ DET_HVC_FLAG_083 : 364|1@1+ (1,0) [0|1] ""  ADAS
 SG_ DET_CONFD_AZIMUTH_083 : 365|2@1+ (1,0) [0|3] ""  ADAS
 SG_ DET_CONFD_ELEVATION_083 : 358|2@1+ (1,0) [0|3] ""  ADAS
 SG_ DET_RANGE_084 : 384|15@1+ (0.015625,0) [0|500] "m"  ADAS
 SG_ DET_RANGE_ERR_084 : 400|7@1+ (0.0075,0) [0|0.9525] "m"  ADAS
 SG_ DET_RANGE_VELOCITY_084 : 408|15@1+ (0.0078125,-128) [-128|127.9921875] "m/s"  ADAS
 SG_ DET_RANGE_VELOCITY_ERR_084 : 424|8@1+ (0.003,0) [0|0.765] "m/s"  ADAS
 SG_ DET_AZIMUTH_084 : 448|13@1+ (0.0004,-1.5708) [-1.5708|1.5708] "rad"  ADAS
 SG_ DET_AZIMUTH_ERR_084 : 465|7@1+ (0.00087267,0) [0|0.11082909] "rad"  ADAS
 SG_ DET_ELEVATION_084 : 432|8@1+ (0.00275,-0.34925) [-0.34925|0.34925] "rad"  ADAS
 SG_ DET_ELEVATION_ERR_084 : 440|6@1+ (0.00174533,0) [0|0.10995579] "rad"  ADAS
 SG_ DET_RCS_084 : 496|8@1+ (0.5,-64) [-64|63.5] "dBsm"  ADAS
 SG_ DET_VALID_FLAG_084 : 485|1@1+ (1,0) [0|1] ""  ADAS
 SG_ DET_BI_STATIC_FLAG_084 : 483|1@1+ (1,0) [0|1] ""  ADAS
 SG_ DET_SUPER_RES_TARGET_084 : 446|1@1+ (1,0) [0|1] ""  ADAS
 SG_ DET_SNR_084 : 488|8@1+ (0.35156,0) [0|89.6478] "dB"  ADAS
 SG_ DET_POINT_TARGET_PROB_084 : 472|4@1+ (6.67,0) [0|100] "%"  ADAS
 SG_ DET_EXISTENCE_PROB_084 : 506|6@1+ (1.588,0) [0|100] "%"  ADAS
 SG_ DET_OUTSIDE_SECTOR_084 : 481|1@1+ (1,0) [0|1] ""  ADAS
 SG_ DET_HVC_FLAG_084 : 464|1@1+ (1,0) [0|1] ""  ADAS
 SG_ DET_CONFD_AZIMUTH_084 : 486|2@1+ (1,0) [0|3] ""  ADAS
 SG_ DET_CONFD_ELEVATION_084 : 461|2@1+ (1,0) [0|3] ""  ADAS
 SG_ DET_MH_SCAN_INDEX_4LSB_081_084 : 476|4@1+ (1,0) [0|15] ""  ADAS
 SG_ DET_MH_CYCLE_COUNTER_081_084 : 16|8@1+ (1,0) [0|255] ""  ADAS
 SG_ DET_MH_CRC16_081_084 : 0|16@1+ (1,0) [0|65535] ""  ADAS

BO_ 1173 RDR_DETECTION_085_088: 64 RDR08
 SG_ DET_RANGE_085 : 24|15@1+ (0.015625,0) [0|500] "m"  ADAS
 SG_ DET_RANGE_ERR_085 : 40|7@1+ (0.0075,0) [0|0.9525] "m"  ADAS
 SG_ DET_RANGE_VELOCITY_085 : 48|15@1+ (0.0078125,-128) [-128|127.9921875] "m/s"  ADAS
 SG_ DET_RANGE_VELOCITY_ERR_085 : 64|8@1+ (0.003,0) [0|0.765] "m/s"  ADAS
 SG_ DET_AZIMUTH_085 : 88|13@1+ (0.0004,-1.5708) [-1.5708|1.5708] "rad"  ADAS
 SG_ DET_AZIMUTH_ERR_085 : 105|7@1+ (0.00087267,0) [0|0.11082909] "rad"  ADAS
 SG_ DET_ELEVATION_085 : 72|8@1+ (0.00275,-0.34925) [-0.34925|0.34925] "rad"  ADAS
 SG_ DET_ELEVATION_ERR_085 : 80|6@1+ (0.00174533,0) [0|0.10995579] "rad"  ADAS
 SG_ DET_RCS_085 : 136|8@1+ (0.5,-64) [-64|63.5] "dBsm"  ADAS
 SG_ DET_VALID_FLAG_085 : 119|1@1+ (1,0) [0|1] ""  ADAS
 SG_ DET_BI_STATIC_FLAG_085 : 504|1@1+ (1,0) [0|1] ""  ADAS
 SG_ DET_SUPER_RES_TARGET_085 : 104|1@1+ (1,0) [0|1] ""  ADAS
 SG_ DET_SNR_085 : 128|8@1+ (0.35156,0) [0|89.6478] "dB"  ADAS
 SG_ DET_POINT_TARGET_PROB_085 : 114|4@1+ (6.67,0) [0|100] "%"  ADAS
 SG_ DET_EXISTENCE_PROB_085 : 120|6@1+ (1.588,0) [0|100] "%"  ADAS
 SG_ DET_OUTSIDE_SECTOR_085 : 159|1@1+ (1,0) [0|1] ""  ADAS
 SG_ DET_HVC_FLAG_085 : 118|1@1+ (1,0) [0|1] ""  ADAS
 SG_ DET_CONFD_AZIMUTH_085 : 126|2@1+ (1,0) [0|3] ""  ADAS
 SG_ DET_CONFD_ELEVATION_085 : 112|2@1+ (1,0) [0|3] ""  ADAS
 SG_ DET_RANGE_086 : 144|15@1+ (0.015625,0) [0|500] "m"  ADAS
 SG_ DET_RANGE_ERR_086 : 160|7@1+ (0.0075,0) [0|0.9525] "m"  ADAS
 SG_ DET_RANGE_VELOCITY_086 : 168|15@1+ (0.0078125,-128) [-128|127.9921875] "m/s"  ADAS
 SG_ DET_RANGE_VELOCITY_ERR_086 : 184|8@1+ (0.003,0) [0|0.765] "m/s"  ADAS
 SG_ DET_AZIMUTH_086 : 208|13@1+ (0.0004,-1.5708) [-1.5708|1.5708] "rad"  ADAS
 SG_ DET_AZIMUTH_ERR_086 : 224|7@1+ (0.00087267,0) [0|0.11082909] "rad"  ADAS
 SG_ DET_ELEVATION_086 : 192|8@1+ (0.00275,-0.34925) [-0.34925|0.34925] "rad"  ADAS
 SG_ DET_ELEVATION_ERR_086 : 200|6@1+ (0.00174533,0) [0|0.10995579] "rad"  ADAS
 SG_ DET_RCS_086 : 256|8@1+ (0.5,-64) [-64|63.5] "dBsm"  ADAS
 SG_ DET_VALID_FLAG_086 : 167|1@1+ (1,0) [0|1] ""  ADAS
 SG_ DET_BI_STATIC_FLAG_086 : 505|1@1+ (1,0) [0|1] ""  ADAS
 SG_ DET_SUPER_RES_TARGET_086 : 247|1@1+ (1,0) [0|1] ""  ADAS
 SG_ DET_SNR_086 : 248|8@1+ (0.35156,0) [0|89.6478] "dB"  ADAS
 SG_ DET_POINT_TARGET_PROB_086 : 240|4@1+ (6.67,0) [0|100] "%"  ADAS
 SG_ DET_EXISTENCE_PROB_086 : 232|6@1+ (1.588,0) [0|100] "%"  ADAS
 SG_ DET_OUTSIDE_SECTOR_086 : 183|1@1+ (1,0) [0|1] ""  ADAS
 SG_ DET_HVC_FLAG_086 : 246|1@1+ (1,0) [0|1] ""  ADAS
 SG_ DET_CONFD_AZIMUTH_086 : 206|2@1+ (1,0) [0|3] ""  ADAS
 SG_ DET_CONFD_ELEVATION_086 : 244|2@1+ (1,0) [0|3] ""  ADAS
 SG_ DET_RANGE_087 : 264|15@1+ (0.015625,0) [0|500] "m"  ADAS
 SG_ DET_RANGE_ERR_087 : 280|7@1+ (0.0075,0) [0|0.9525] "m"  ADAS
 SG_ DET_RANGE_VELOCITY_087 : 288|15@1+ (0.0078125,-128) [-128|127.9921875] "m/s"  ADAS
 SG_ DET_RANGE_VELOCITY_ERR_087 : 304|8@1+ (0.003,0) [0|0.765] "m/s"  ADAS
 SG_ DET_AZIMUTH_087 : 328|13@1+ (0.0004,-1.5708) [-1.5708|1.5708] "rad"  ADAS
 SG_ DET_AZIMUTH_ERR_087 : 345|7@1+ (0.00087267,0) [0|0.11082909] "rad"  ADAS
 SG_ DET_ELEVATION_087 : 312|8@1+ (0.00275,-0.34925) [-0.34925|0.34925] "rad"  ADAS
 SG_ DET_ELEVATION_ERR_087 : 320|6@1+ (0.00174533,0) [0|0.10995579] "rad"  ADAS
 SG_ DET_RCS_087 : 376|8@1+ (0.5,-64) [-64|63.5] "dBsm"  ADAS
 SG_ DET_VALID_FLAG_087 : 399|1@1+ (1,0) [0|1] ""  ADAS
 SG_ DET_BI_STATIC_FLAG_087 : 482|1@1+ (1,0) [0|1] ""  ADAS
 SG_ DET_SUPER_RES_TARGET_087 : 344|1@1+ (1,0) [0|1] ""  ADAS
 SG_ DET_SNR_087 : 368|8@1+ (0.35156,0) [0|89.6478] "dB"  ADAS
 SG_ DET_POINT_TARGET_PROB_087 : 360|4@1+ (6.67,0) [0|100] "%"  ADAS
 SG_ DET_EXISTENCE_PROB_087 : 352|6@1+ (1.588,0) [0|100] "%"  ADAS
 SG_ DET_OUTSIDE_SECTOR_087 : 407|1@1+ (1,0) [0|1] ""  ADAS
 SG_ DET_HVC_FLAG_087 : 364|1@1+ (1,0) [0|1] ""  ADAS
 SG_ DET_CONFD_AZIMUTH_087 : 365|2@1+ (1,0) [0|3] ""  ADAS
 SG_ DET_CONFD_ELEVATION_087 : 358|2@1+ (1,0) [0|3] ""  ADAS
 SG_ DET_RANGE_088 : 384|15@1+ (0.015625,0) [0|500] "m"  ADAS
 SG_ DET_RANGE_ERR_088 : 400|7@1+ (0.0075,0) [0|0.9525] "m"  ADAS
 SG_ DET_RANGE_VELOCITY_088 : 408|15@1+ (0.0078125,-128) [-128|127.9921875] "m/s"  ADAS
 SG_ DET_RANGE_VELOCITY_ERR_088 : 424|8@1+ (0.003,0) [0|0.765] "m/s"  ADAS
 SG_ DET_AZIMUTH_088 : 448|13@1+ (0.0004,-1.5708) [-1.5708|1.5708] "rad"  ADAS
 SG_ DET_AZIMUTH_ERR_088 : 465|7@1+ (0.00087267,0) [0|0.11082909] "rad"  ADAS
 SG_ DET_ELEVATION_088 : 432|8@1+ (0.00275,-0.34925) [-0.34925|0.34925] "rad"  ADAS
 SG_ DET_ELEVATION_ERR_088 : 440|6@1+ (0.00174533,0) [0|0.10995579] "rad"  ADAS
 SG_ DET_RCS_088 : 496|8@1+ (0.5,-64) [-64|63.5] "dBsm"  ADAS
 SG_ DET_VALID_FLAG_088 : 485|1@1+ (1,0) [0|1] ""  ADAS
 SG_ DET_BI_STATIC_FLAG_088 : 483|1@1+ (1,0) [0|1] ""  ADAS
 SG_ DET_SUPER_RES_TARGET_088 : 446|1@1+ (1,0) [0|1] ""  ADAS
 SG_ DET_SNR_088 : 488|8@1+ (0.35156,0) [0|89.6478] "dB"  ADAS
 SG_ DET_POINT_TARGET_PROB_088 : 472|4@1+ (6.67,0) [0|100] "%"  ADAS
 SG_ DET_EXISTENCE_PROB_088 : 506|6@1+ (1.588,0) [0|100] "%"  ADAS
 SG_ DET_OUTSIDE_SECTOR_088 : 481|1@1+ (1,0) [0|1] ""  ADAS
 SG_ DET_HVC_FLAG_088 : 464|1@1+ (1,0) [0|1] ""  ADAS
 SG_ DET_CONFD_AZIMUTH_088 : 486|2@1+ (1,0) [0|3] ""  ADAS
 SG_ DET_CONFD_ELEVATION_088 : 461|2@1+ (1,0) [0|3] ""  ADAS
 SG_ DET_MH_SCAN_INDEX_4LSB_085_088 : 476|4@1+ (1,0) [0|15] ""  ADAS
 SG_ DET_MH_CYCLE_COUNTER_085_088 : 16|8@1+ (1,0) [0|255] ""  ADAS
 SG_ DET_MH_CRC16_085_088 : 0|16@1+ (1,0) [0|65535] ""  ADAS

BO_ 1174 RDR_DETECTION_089_092: 64 RDR08
 SG_ DET_RANGE_089 : 24|15@1+ (0.015625,0) [0|500] "m"  ADAS
 SG_ DET_RANGE_ERR_089 : 40|7@1+ (0.0075,0) [0|0.9525] "m"  ADAS
 SG_ DET_RANGE_VELOCITY_089 : 48|15@1+ (0.0078125,-128) [-128|127.9921875] "m/s"  ADAS
 SG_ DET_RANGE_VELOCITY_ERR_089 : 64|8@1+ (0.003,0) [0|0.765] "m/s"  ADAS
 SG_ DET_AZIMUTH_089 : 88|13@1+ (0.0004,-1.5708) [-1.5708|1.5708] "rad"  ADAS
 SG_ DET_AZIMUTH_ERR_089 : 105|7@1+ (0.00087267,0) [0|0.11082909] "rad"  ADAS
 SG_ DET_ELEVATION_089 : 72|8@1+ (0.00275,-0.34925) [-0.34925|0.34925] "rad"  ADAS
 SG_ DET_ELEVATION_ERR_089 : 80|6@1+ (0.00174533,0) [0|0.10995579] "rad"  ADAS
 SG_ DET_RCS_089 : 136|8@1+ (0.5,-64) [-64|63.5] "dBsm"  ADAS
 SG_ DET_VALID_FLAG_089 : 119|1@1+ (1,0) [0|1] ""  ADAS
 SG_ DET_BI_STATIC_FLAG_089 : 504|1@1+ (1,0) [0|1] ""  ADAS
 SG_ DET_SUPER_RES_TARGET_089 : 104|1@1+ (1,0) [0|1] ""  ADAS
 SG_ DET_SNR_089 : 128|8@1+ (0.35156,0) [0|89.6478] "dB"  ADAS
 SG_ DET_POINT_TARGET_PROB_089 : 114|4@1+ (6.67,0) [0|100] "%"  ADAS
 SG_ DET_EXISTENCE_PROB_089 : 120|6@1+ (1.588,0) [0|100] "%"  ADAS
 SG_ DET_OUTSIDE_SECTOR_089 : 159|1@1+ (1,0) [0|1] ""  ADAS
 SG_ DET_HVC_FLAG_089 : 118|1@1+ (1,0) [0|1] ""  ADAS
 SG_ DET_CONFD_AZIMUTH_089 : 126|2@1+ (1,0) [0|3] ""  ADAS
 SG_ DET_CONFD_ELEVATION_089 : 112|2@1+ (1,0) [0|3] ""  ADAS
 SG_ DET_RANGE_090 : 144|15@1+ (0.015625,0) [0|500] "m"  ADAS
 SG_ DET_RANGE_ERR_090 : 160|7@1+ (0.0075,0) [0|0.9525] "m"  ADAS
 SG_ DET_RANGE_VELOCITY_090 : 168|15@1+ (0.0078125,-128) [-128|127.9921875] "m/s"  ADAS
 SG_ DET_RANGE_VELOCITY_ERR_090 : 184|8@1+ (0.003,0) [0|0.765] "m/s"  ADAS
 SG_ DET_AZIMUTH_090 : 208|13@1+ (0.0004,-1.5708) [-1.5708|1.5708] "rad"  ADAS
 SG_ DET_AZIMUTH_ERR_090 : 224|7@1+ (0.00087267,0) [0|0.11082909] "rad"  ADAS
 SG_ DET_ELEVATION_090 : 192|8@1+ (0.00275,-0.34925) [-0.34925|0.34925] "rad"  ADAS
 SG_ DET_ELEVATION_ERR_090 : 200|6@1+ (0.00174533,0) [0|0.10995579] "rad"  ADAS
 SG_ DET_RCS_090 : 256|8@1+ (0.5,-64) [-64|63.5] "dBsm"  ADAS
 SG_ DET_VALID_FLAG_090 : 167|1@1+ (1,0) [0|1] ""  ADAS
 SG_ DET_BI_STATIC_FLAG_090 : 505|1@1+ (1,0) [0|1] ""  ADAS
 SG_ DET_SUPER_RES_TARGET_090 : 247|1@1+ (1,0) [0|1] ""  ADAS
 SG_ DET_SNR_090 : 248|8@1+ (0.35156,0) [0|89.6478] "dB"  ADAS
 SG_ DET_POINT_TARGET_PROB_090 : 240|4@1+ (6.67,0) [0|100] "%"  ADAS
 SG_ DET_EXISTENCE_PROB_090 : 232|6@1+ (1.588,0) [0|100] "%"  ADAS
 SG_ DET_OUTSIDE_SECTOR_090 : 183|1@1+ (1,0) [0|1] ""  ADAS
 SG_ DET_HVC_FLAG_090 : 246|1@1+ (1,0) [0|1] ""  ADAS
 SG_ DET_CONFD_AZIMUTH_090 : 206|2@1+ (1,0) [0|3] ""  ADAS
 SG_ DET_CONFD_ELEVATION_090 : 244|2@1+ (1,0) [0|3] ""  ADAS
 SG_ DET_RANGE_091 : 264|15@1+ (0.015625,0) [0|500] "m"  ADAS
 SG_ DET_RANGE_ERR_091 : 280|7@1+ (0.0075,0) [0|0.9525] "m"  ADAS
 SG_ DET_RANGE_VELOCITY_091 : 288|15@1+ (0.0078125,-128) [-128|127.9921875] "m/s"  ADAS
 SG_ DET_RANGE_VELOCITY_ERR_091 : 304|8@1+ (0.003,0) [0|0.765] "m/s"  ADAS
 SG_ DET_AZIMUTH_091 : 328|13@1+ (0.0004,-1.5708) [-1.5708|1.5708] "rad"  ADAS
 SG_ DET_AZIMUTH_ERR_091 : 345|7@1+ (0.00087267,0) [0|0.11082909] "rad"  ADAS
 SG_ DET_ELEVATION_091 : 312|8@1+ (0.00275,-0.34925) [-0.34925|0.34925] "rad"  ADAS
 SG_ DET_ELEVATION_ERR_091 : 320|6@1+ (0.00174533,0) [0|0.10995579] "rad"  ADAS
 SG_ DET_RCS_091 : 376|8@1+ (0.5,-64) [-64|63.5] "dBsm"  ADAS
 SG_ DET_VALID_FLAG_091 : 399|1@1+ (1,0) [0|1] ""  ADAS
 SG_ DET_BI_STATIC_FLAG_091 : 482|1@1+ (1,0) [0|1] ""  ADAS
 SG_ DET_SUPER_RES_TARGET_091 : 344|1@1+ (1,0) [0|1] ""  ADAS
 SG_ DET_SNR_091 : 368|8@1+ (0.35156,0) [0|89.6478] "dB"  ADAS
 SG_ DET_POINT_TARGET_PROB_091 : 360|4@1+ (6.67,0) [0|100] "%"  ADAS
 SG_ DET_EXISTENCE_PROB_091 : 352|6@1+ (1.588,0) [0|100] "%"  ADAS
 SG_ DET_OUTSIDE_SECTOR_091 : 407|1@1+ (1,0) [0|1] ""  ADAS
 SG_ DET_HVC_FLAG_091 : 364|1@1+ (1,0) [0|1] ""  ADAS
 SG_ DET_CONFD_AZIMUTH_091 : 365|2@1+ (1,0) [0|3] ""  ADAS
 SG_ DET_CONFD_ELEVATION_091 : 358|2@1+ (1,0) [0|3] ""  ADAS
 SG_ DET_RANGE_092 : 384|15@1+ (0.015625,0) [0|500] "m"  ADAS
 SG_ DET_RANGE_ERR_092 : 400|7@1+ (0.0075,0) [0|0.9525] "m"  ADAS
 SG_ DET_RANGE_VELOCITY_092 : 408|15@1+ (0.0078125,-128) [-128|127.9921875] "m/s"  ADAS
 SG_ DET_RANGE_VELOCITY_ERR_092 : 424|8@1+ (0.003,0) [0|0.765] "m/s"  ADAS
 SG_ DET_AZIMUTH_092 : 448|13@1+ (0.0004,-1.5708) [-1.5708|1.5708] "rad"  ADAS
 SG_ DET_AZIMUTH_ERR_092 : 465|7@1+ (0.00087267,0) [0|0.11082909] "rad"  ADAS
 SG_ DET_ELEVATION_092 : 432|8@1+ (0.00275,-0.34925) [-0.34925|0.34925] "rad"  ADAS
 SG_ DET_ELEVATION_ERR_092 : 440|6@1+ (0.00174533,0) [0|0.10995579] "rad"  ADAS
 SG_ DET_RCS_092 : 496|8@1+ (0.5,-64) [-64|63.5] "dBsm"  ADAS
 SG_ DET_VALID_FLAG_092 : 485|1@1+ (1,0) [0|1] ""  ADAS
 SG_ DET_BI_STATIC_FLAG_092 : 483|1@1+ (1,0) [0|1] ""  ADAS
 SG_ DET_SUPER_RES_TARGET_092 : 446|1@1+ (1,0) [0|1] ""  ADAS
 SG_ DET_SNR_092 : 488|8@1+ (0.35156,0) [0|89.6478] "dB"  ADAS
 SG_ DET_POINT_TARGET_PROB_092 : 472|4@1+ (6.67,0) [0|100] "%"  ADAS
 SG_ DET_EXISTENCE_PROB_092 : 506|6@1+ (1.588,0) [0|100] "%"  ADAS
 SG_ DET_OUTSIDE_SECTOR_092 : 481|1@1+ (1,0) [0|1] ""  ADAS
 SG_ DET_HVC_FLAG_092 : 464|1@1+ (1,0) [0|1] ""  ADAS
 SG_ DET_CONFD_AZIMUTH_092 : 486|2@1+ (1,0) [0|3] ""  ADAS
 SG_ DET_CONFD_ELEVATION_092 : 461|2@1+ (1,0) [0|3] ""  ADAS
 SG_ DET_MH_SCAN_INDEX_4LSB_089_092 : 476|4@1+ (1,0) [0|15] ""  ADAS
 SG_ DET_MH_CYCLE_COUNTER_089_092 : 16|8@1+ (1,0) [0|255] ""  ADAS
 SG_ DET_MH_CRC16_089_092 : 0|16@1+ (1,0) [0|65535] ""  ADAS

BO_ 1175 RDR_DETECTION_093_096: 64 RDR08
 SG_ DET_RANGE_093 : 24|15@1+ (0.015625,0) [0|500] "m"  ADAS
 SG_ DET_RANGE_ERR_093 : 40|7@1+ (0.0075,0) [0|0.9525] "m"  ADAS
 SG_ DET_RANGE_VELOCITY_093 : 48|15@1+ (0.0078125,-128) [-128|127.9921875] "m/s"  ADAS
 SG_ DET_RANGE_VELOCITY_ERR_093 : 64|8@1+ (0.003,0) [0|0.765] "m/s"  ADAS
 SG_ DET_AZIMUTH_093 : 88|13@1+ (0.0004,-1.5708) [-1.5708|1.5708] "rad"  ADAS
 SG_ DET_AZIMUTH_ERR_093 : 105|7@1+ (0.00087267,0) [0|0.11082909] "rad"  ADAS
 SG_ DET_ELEVATION_093 : 72|8@1+ (0.00275,-0.34925) [-0.34925|0.34925] "rad"  ADAS
 SG_ DET_ELEVATION_ERR_093 : 80|6@1+ (0.00174533,0) [0|0.10995579] "rad"  ADAS
 SG_ DET_RCS_093 : 136|8@1+ (0.5,-64) [-64|63.5] "dBsm"  ADAS
 SG_ DET_VALID_FLAG_093 : 119|1@1+ (1,0) [0|1] ""  ADAS
 SG_ DET_BI_STATIC_FLAG_093 : 504|1@1+ (1,0) [0|1] ""  ADAS
 SG_ DET_SUPER_RES_TARGET_093 : 104|1@1+ (1,0) [0|1] ""  ADAS
 SG_ DET_SNR_093 : 128|8@1+ (0.35156,0) [0|89.6478] "dB"  ADAS
 SG_ DET_POINT_TARGET_PROB_093 : 114|4@1+ (6.67,0) [0|100] "%"  ADAS
 SG_ DET_EXISTENCE_PROB_093 : 120|6@1+ (1.588,0) [0|100] "%"  ADAS
 SG_ DET_OUTSIDE_SECTOR_093 : 159|1@1+ (1,0) [0|1] ""  ADAS
 SG_ DET_HVC_FLAG_093 : 118|1@1+ (1,0) [0|1] ""  ADAS
 SG_ DET_CONFD_AZIMUTH_093 : 126|2@1+ (1,0) [0|3] ""  ADAS
 SG_ DET_CONFD_ELEVATION_093 : 112|2@1+ (1,0) [0|3] ""  ADAS
 SG_ DET_RANGE_094 : 144|15@1+ (0.015625,0) [0|500] "m"  ADAS
 SG_ DET_RANGE_ERR_094 : 160|7@1+ (0.0075,0) [0|0.9525] "m"  ADAS
 SG_ DET_RANGE_VELOCITY_094 : 168|15@1+ (0.0078125,-128) [-128|127.9921875] "m/s"  ADAS
 SG_ DET_RANGE_VELOCITY_ERR_094 : 184|8@1+ (0.003,0) [0|0.765] "m/s"  ADAS
 SG_ DET_AZIMUTH_094 : 208|13@1+ (0.0004,-1.5708) [-1.5708|1.5708] "rad"  ADAS
 SG_ DET_AZIMUTH_ERR_094 : 224|7@1+ (0.00087267,0) [0|0.11082909] "rad"  ADAS
 SG_ DET_ELEVATION_094 : 192|8@1+ (0.00275,-0.34925) [-0.34925|0.34925] "rad"  ADAS
 SG_ DET_ELEVATION_ERR_094 : 200|6@1+ (0.00174533,0) [0|0.10995579] "rad"  ADAS
 SG_ DET_RCS_094 : 256|8@1+ (0.5,-64) [-64|63.5] "dBsm"  ADAS
 SG_ DET_VALID_FLAG_094 : 167|1@1+ (1,0) [0|1] ""  ADAS
 SG_ DET_BI_STATIC_FLAG_094 : 505|1@1+ (1,0) [0|1] ""  ADAS
 SG_ DET_SUPER_RES_TARGET_094 : 247|1@1+ (1,0) [0|1] ""  ADAS
 SG_ DET_SNR_094 : 248|8@1+ (0.35156,0) [0|89.6478] "dB"  ADAS
 SG_ DET_POINT_TARGET_PROB_094 : 240|4@1+ (6.67,0) [0|100] "%"  ADAS
 SG_ DET_EXISTENCE_PROB_094 : 232|6@1+ (1.588,0) [0|100] "%"  ADAS
 SG_ DET_OUTSIDE_SECTOR_094 : 183|1@1+ (1,0) [0|1] ""  ADAS
 SG_ DET_HVC_FLAG_094 : 246|1@1+ (1,0) [0|1] ""  ADAS
 SG_ DET_CONFD_AZIMUTH_094 : 206|2@1+ (1,0) [0|3] ""  ADAS
 SG_ DET_CONFD_ELEVATION_094 : 244|2@1+ (1,0) [0|3] ""  ADAS
 SG_ DET_RANGE_095 : 264|15@1+ (0.015625,0) [0|500] "m"  ADAS
 SG_ DET_RANGE_ERR_095 : 280|7@1+ (0.0075,0) [0|0.9525] "m"  ADAS
 SG_ DET_RANGE_VELOCITY_095 : 288|15@1+ (0.0078125,-128) [-128|127.9921875] "m/s"  ADAS
 SG_ DET_RANGE_VELOCITY_ERR_095 : 304|8@1+ (0.003,0) [0|0.765] "m/s"  ADAS
 SG_ DET_AZIMUTH_095 : 328|13@1+ (0.0004,-1.5708) [-1.5708|1.5708] "rad"  ADAS
 SG_ DET_AZIMUTH_ERR_095 : 345|7@1+ (0.00087267,0) [0|0.11082909] "rad"  ADAS
 SG_ DET_ELEVATION_095 : 312|8@1+ (0.00275,-0.34925) [-0.34925|0.34925] "rad"  ADAS
 SG_ DET_ELEVATION_ERR_095 : 320|6@1+ (0.00174533,0) [0|0.10995579] "rad"  ADAS
 SG_ DET_RCS_095 : 376|8@1+ (0.5,-64) [-64|63.5] "dBsm"  ADAS
 SG_ DET_VALID_FLAG_095 : 399|1@1+ (1,0) [0|1] ""  ADAS
 SG_ DET_BI_STATIC_FLAG_095 : 482|1@1+ (1,0) [0|1] ""  ADAS
 SG_ DET_SUPER_RES_TARGET_095 : 344|1@1+ (1,0) [0|1] ""  ADAS
 SG_ DET_SNR_095 : 368|8@1+ (0.35156,0) [0|89.6478] "dB"  ADAS
 SG_ DET_POINT_TARGET_PROB_095 : 360|4@1+ (6.67,0) [0|100] "%"  ADAS
 SG_ DET_EXISTENCE_PROB_095 : 352|6@1+ (1.588,0) [0|100] "%"  ADAS
 SG_ DET_OUTSIDE_SECTOR_095 : 407|1@1+ (1,0) [0|1] ""  ADAS
 SG_ DET_HVC_FLAG_095 : 364|1@1+ (1,0) [0|1] ""  ADAS
 SG_ DET_CONFD_AZIMUTH_095 : 365|2@1+ (1,0) [0|3] ""  ADAS
 SG_ DET_CONFD_ELEVATION_095 : 358|2@1+ (1,0) [0|3] ""  ADAS
 SG_ DET_RANGE_096 : 384|15@1+ (0.015625,0) [0|500] "m"  ADAS
 SG_ DET_RANGE_ERR_096 : 400|7@1+ (0.0075,0) [0|0.9525] "m"  ADAS
 SG_ DET_RANGE_VELOCITY_096 : 408|15@1+ (0.0078125,-128) [-128|127.9921875] "m/s"  ADAS
 SG_ DET_RANGE_VELOCITY_ERR_096 : 424|8@1+ (0.003,0) [0|0.765] "m/s"  ADAS
 SG_ DET_AZIMUTH_096 : 448|13@1+ (0.0004,-1.5708) [-1.5708|1.5708] "rad"  ADAS
 SG_ DET_AZIMUTH_ERR_096 : 465|7@1+ (0.00087267,0) [0|0.11082909] "rad"  ADAS
 SG_ DET_ELEVATION_096 : 432|8@1+ (0.00275,-0.34925) [-0.34925|0.34925] "rad"  ADAS
 SG_ DET_ELEVATION_ERR_096 : 440|6@1+ (0.00174533,0) [0|0.10995579] "rad"  ADAS
 SG_ DET_RCS_096 : 496|8@1+ (0.5,-64) [-64|63.5] "dBsm"  ADAS
 SG_ DET_VALID_FLAG_096 : 485|1@1+ (1,0) [0|1] ""  ADAS
 SG_ DET_BI_STATIC_FLAG_096 : 483|1@1+ (1,0) [0|1] ""  ADAS
 SG_ DET_SUPER_RES_TARGET_096 : 446|1@1+ (1,0) [0|1] ""  ADAS
 SG_ DET_SNR_096 : 488|8@1+ (0.35156,0) [0|89.6478] "dB"  ADAS
 SG_ DET_POINT_TARGET_PROB_096 : 472|4@1+ (6.67,0) [0|100] "%"  ADAS
 SG_ DET_EXISTENCE_PROB_096 : 506|6@1+ (1.588,0) [0|100] "%"  ADAS
 SG_ DET_OUTSIDE_SECTOR_096 : 481|1@1+ (1,0) [0|1] ""  ADAS
 SG_ DET_HVC_FLAG_096 : 464|1@1+ (1,0) [0|1] ""  ADAS
 SG_ DET_CONFD_AZIMUTH_096 : 486|2@1+ (1,0) [0|3] ""  ADAS
 SG_ DET_CONFD_ELEVATION_096 : 461|2@1+ (1,0) [0|3] ""  ADAS
 SG_ DET_MH_SCAN_INDEX_4LSB_093_096 : 476|4@1+ (1,0) [0|15] ""  ADAS
 SG_ DET_MH_CYCLE_COUNTER_093_096 : 16|8@1+ (1,0) [0|255] ""  ADAS
 SG_ DET_MH_CRC16_093_096 : 0|16@1+ (1,0) [0|65535] ""  ADAS

BO_ 1176 RDR_DETECTION_097_100: 64 RDR08
 SG_ DET_RANGE_097 : 24|15@1+ (0.015625,0) [0|500] "m"  ADAS
 SG_ DET_RANGE_ERR_097 : 40|7@1+ (0.0075,0) [0|0.9525] "m"  ADAS
 SG_ DET_RANGE_VELOCITY_097 : 48|15@1+ (0.0078125,-128) [-128|127.9921875] "m/s"  ADAS
 SG_ DET_RANGE_VELOCITY_ERR_097 : 64|8@1+ (0.003,0) [0|0.765] "m/s"  ADAS
 SG_ DET_AZIMUTH_097 : 88|13@1+ (0.0004,-1.5708) [-1.5708|1.5708] "rad"  ADAS
 SG_ DET_AZIMUTH_ERR_097 : 105|7@1+ (0.00087267,0) [0|0.11082909] "rad"  ADAS
 SG_ DET_ELEVATION_097 : 72|8@1+ (0.00275,-0.34925) [-0.34925|0.34925] "rad"  ADAS
 SG_ DET_ELEVATION_ERR_097 : 80|6@1+ (0.00174533,0) [0|0.10995579] "rad"  ADAS
 SG_ DET_RCS_097 : 136|8@1+ (0.5,-64) [-64|63.5] "dBsm"  ADAS
 SG_ DET_VALID_FLAG_097 : 119|1@1+ (1,0) [0|1] ""  ADAS
 SG_ DET_BI_STATIC_FLAG_097 : 504|1@1+ (1,0) [0|1] ""  ADAS
 SG_ DET_SUPER_RES_TARGET_097 : 104|1@1+ (1,0) [0|1] ""  ADAS
 SG_ DET_SNR_097 : 128|8@1+ (0.35156,0) [0|89.6478] "dB"  ADAS
 SG_ DET_POINT_TARGET_PROB_097 : 114|4@1+ (6.67,0) [0|100] "%"  ADAS
 SG_ DET_EXISTENCE_PROB_097 : 120|6@1+ (1.588,0) [0|100] "%"  ADAS
 SG_ DET_OUTSIDE_SECTOR_097 : 159|1@1+ (1,0) [0|1] ""  ADAS
 SG_ DET_HVC_FLAG_097 : 118|1@1+ (1,0) [0|1] ""  ADAS
 SG_ DET_CONFD_AZIMUTH_097 : 126|2@1+ (1,0) [0|3] ""  ADAS
 SG_ DET_CONFD_ELEVATION_097 : 112|2@1+ (1,0) [0|3] ""  ADAS
 SG_ DET_RANGE_098 : 144|15@1+ (0.015625,0) [0|500] "m"  ADAS
 SG_ DET_RANGE_ERR_098 : 160|7@1+ (0.0075,0) [0|0.9525] "m"  ADAS
 SG_ DET_RANGE_VELOCITY_098 : 168|15@1+ (0.0078125,-128) [-128|127.9921875] "m/s"  ADAS
 SG_ DET_RANGE_VELOCITY_ERR_098 : 184|8@1+ (0.003,0) [0|0.765] "m/s"  ADAS
 SG_ DET_AZIMUTH_098 : 208|13@1+ (0.0004,-1.5708) [-1.5708|1.5708] "rad"  ADAS
 SG_ DET_AZIMUTH_ERR_098 : 224|7@1+ (0.00087267,0) [0|0.11082909] "rad"  ADAS
 SG_ DET_ELEVATION_098 : 192|8@1+ (0.00275,-0.34925) [-0.34925|0.34925] "rad"  ADAS
 SG_ DET_ELEVATION_ERR_098 : 200|6@1+ (0.00174533,0) [0|0.10995579] "rad"  ADAS
 SG_ DET_RCS_098 : 256|8@1+ (0.5,-64) [-64|63.5] "dBsm"  ADAS
 SG_ DET_VALID_FLAG_098 : 167|1@1+ (1,0) [0|1] ""  ADAS
 SG_ DET_BI_STATIC_FLAG_098 : 505|1@1+ (1,0) [0|1] ""  ADAS
 SG_ DET_SUPER_RES_TARGET_098 : 247|1@1+ (1,0) [0|1] ""  ADAS
 SG_ DET_SNR_098 : 248|8@1+ (0.35156,0) [0|89.6478] "dB"  ADAS
 SG_ DET_POINT_TARGET_PROB_098 : 240|4@1+ (6.67,0) [0|100] "%"  ADAS
 SG_ DET_EXISTENCE_PROB_098 : 232|6@1+ (1.588,0) [0|100] "%"  ADAS
 SG_ DET_OUTSIDE_SECTOR_098 : 183|1@1+ (1,0) [0|1] ""  ADAS
 SG_ DET_HVC_FLAG_098 : 246|1@1+ (1,0) [0|1] ""  ADAS
 SG_ DET_CONFD_AZIMUTH_098 : 206|2@1+ (1,0) [0|3] ""  ADAS
 SG_ DET_CONFD_ELEVATION_098 : 244|2@1+ (1,0) [0|3] ""  ADAS
 SG_ DET_RANGE_099 : 264|15@1+ (0.015625,0) [0|500] "m"  ADAS
 SG_ DET_RANGE_ERR_099 : 280|7@1+ (0.0075,0) [0|0.9525] "m"  ADAS
 SG_ DET_RANGE_VELOCITY_099 : 288|15@1+ (0.0078125,-128) [-128|127.9921875] "m/s"  ADAS
 SG_ DET_RANGE_VELOCITY_ERR_099 : 304|8@1+ (0.003,0) [0|0.765] "m/s"  ADAS
 SG_ DET_AZIMUTH_099 : 328|13@1+ (0.0004,-1.5708) [-1.5708|1.5708] "rad"  ADAS
 SG_ DET_AZIMUTH_ERR_099 : 345|7@1+ (0.00087267,0) [0|0.11082909] "rad"  ADAS
 SG_ DET_ELEVATION_099 : 312|8@1+ (0.00275,-0.34925) [-0.34925|0.34925] "rad"  ADAS
 SG_ DET_ELEVATION_ERR_099 : 320|6@1+ (0.00174533,0) [0|0.10995579] "rad"  ADAS
 SG_ DET_RCS_099 : 376|8@1+ (0.5,-64) [-64|63.5] "dBsm"  ADAS
 SG_ DET_VALID_FLAG_099 : 399|1@1+ (1,0) [0|1] ""  ADAS
 SG_ DET_BI_STATIC_FLAG_099 : 482|1@1+ (1,0) [0|1] ""  ADAS
 SG_ DET_SUPER_RES_TARGET_099 : 344|1@1+ (1,0) [0|1] ""  ADAS
 SG_ DET_SNR_099 : 368|8@1+ (0.35156,0) [0|89.6478] "dB"  ADAS
 SG_ DET_POINT_TARGET_PROB_099 : 360|4@1+ (6.67,0) [0|100] "%"  ADAS
 SG_ DET_EXISTENCE_PROB_099 : 352|6@1+ (1.588,0) [0|100] "%"  ADAS
 SG_ DET_OUTSIDE_SECTOR_099 : 407|1@1+ (1,0) [0|1] ""  ADAS
 SG_ DET_HVC_FLAG_099 : 364|1@1+ (1,0) [0|1] ""  ADAS
 SG_ DET_CONFD_AZIMUTH_099 : 365|2@1+ (1,0) [0|3] ""  ADAS
 SG_ DET_CONFD_ELEVATION_099 : 358|2@1+ (1,0) [0|3] ""  ADAS
 SG_ DET_RANGE_100 : 384|15@1+ (0.015625,0) [0|500] "m"  ADAS
 SG_ DET_RANGE_ERR_100 : 400|7@1+ (0.0075,0) [0|0.9525] "m"  ADAS
 SG_ DET_RANGE_VELOCITY_100 : 408|15@1+ (0.0078125,-128) [-128|127.9921875] "m/s"  ADAS
 SG_ DET_RANGE_VELOCITY_ERR_100 : 424|8@1+ (0.003,0) [0|0.765] "m/s"  ADAS
 SG_ DET_AZIMUTH_100 : 448|13@1+ (0.0004,-1.5708) [-1.5708|1.5708] "rad"  ADAS
 SG_ DET_AZIMUTH_ERR_100 : 465|7@1+ (0.00087267,0) [0|0.11082909] "rad"  ADAS
 SG_ DET_ELEVATION_100 : 432|8@1+ (0.00275,-0.34925) [-0.34925|0.34925] "rad"  ADAS
 SG_ DET_ELEVATION_ERR_100 : 440|6@1+ (0.00174533,0) [0|0.10995579] "rad"  ADAS
 SG_ DET_RCS_100 : 496|8@1+ (0.5,-64) [-64|63.5] "dBsm"  ADAS
 SG_ DET_VALID_FLAG_100 : 485|1@1+ (1,0) [0|1] ""  ADAS
 SG_ DET_BI_STATIC_FLAG_100 : 483|1@1+ (1,0) [0|1] ""  ADAS
 SG_ DET_SUPER_RES_TARGET_100 : 446|1@1+ (1,0) [0|1] ""  ADAS
 SG_ DET_SNR_100 : 488|8@1+ (0.35156,0) [0|89.6478] "dB"  ADAS
 SG_ DET_POINT_TARGET_PROB_100 : 472|4@1+ (6.67,0) [0|100] "%"  ADAS
 SG_ DET_EXISTENCE_PROB_100 : 506|6@1+ (1.588,0) [0|100] "%"  ADAS
 SG_ DET_OUTSIDE_SECTOR_100 : 481|1@1+ (1,0) [0|1] ""  ADAS
 SG_ DET_HVC_FLAG_100 : 464|1@1+ (1,0) [0|1] ""  ADAS
 SG_ DET_CONFD_AZIMUTH_100 : 486|2@1+ (1,0) [0|3] ""  ADAS
 SG_ DET_CONFD_ELEVATION_100 : 461|2@1+ (1,0) [0|3] ""  ADAS
 SG_ DET_MH_SCAN_INDEX_4LSB_097_100 : 476|4@1+ (1,0) [0|15] ""  ADAS
 SG_ DET_MH_CYCLE_COUNTER_097_100 : 16|8@1+ (1,0) [0|255] ""  ADAS
 SG_ DET_MH_CRC16_097_100 : 0|16@1+ (1,0) [0|65535] ""  ADAS

BO_ 1177 RDR_DETECTION_101_104: 64 RDR08
 SG_ DET_RANGE_101 : 24|15@1+ (0.015625,0) [0|500] "m"  ADAS
 SG_ DET_RANGE_ERR_101 : 40|7@1+ (0.0075,0) [0|0.9525] "m"  ADAS
 SG_ DET_RANGE_VELOCITY_101 : 48|15@1+ (0.0078125,-128) [-128|127.9921875] "m/s"  ADAS
 SG_ DET_RANGE_VELOCITY_ERR_101 : 64|8@1+ (0.003,0) [0|0.765] "m/s"  ADAS
 SG_ DET_AZIMUTH_101 : 88|13@1+ (0.0004,-1.5708) [-1.5708|1.5708] "rad"  ADAS
 SG_ DET_AZIMUTH_ERR_101 : 105|7@1+ (0.00087267,0) [0|0.11082909] "rad"  ADAS
 SG_ DET_ELEVATION_101 : 72|8@1+ (0.00275,-0.34925) [-0.34925|0.34925] "rad"  ADAS
 SG_ DET_ELEVATION_ERR_101 : 80|6@1+ (0.00174533,0) [0|0.10995579] "rad"  ADAS
 SG_ DET_RCS_101 : 136|8@1+ (0.5,-64) [-64|63.5] "dBsm"  ADAS
 SG_ DET_VALID_FLAG_101 : 119|1@1+ (1,0) [0|1] ""  ADAS
 SG_ DET_BI_STATIC_FLAG_101 : 504|1@1+ (1,0) [0|1] ""  ADAS
 SG_ DET_SUPER_RES_TARGET_101 : 104|1@1+ (1,0) [0|1] ""  ADAS
 SG_ DET_SNR_101 : 128|8@1+ (0.35156,0) [0|89.6478] "dB"  ADAS
 SG_ DET_POINT_TARGET_PROB_101 : 114|4@1+ (6.67,0) [0|100] "%"  ADAS
 SG_ DET_EXISTENCE_PROB_101 : 120|6@1+ (1.588,0) [0|100] "%"  ADAS
 SG_ DET_OUTSIDE_SECTOR_101 : 159|1@1+ (1,0) [0|1] ""  ADAS
 SG_ DET_HVC_FLAG_101 : 118|1@1+ (1,0) [0|1] ""  ADAS
 SG_ DET_CONFD_AZIMUTH_101 : 126|2@1+ (1,0) [0|3] ""  ADAS
 SG_ DET_CONFD_ELEVATION_101 : 112|2@1+ (1,0) [0|3] ""  ADAS
 SG_ DET_RANGE_102 : 144|15@1+ (0.015625,0) [0|500] "m"  ADAS
 SG_ DET_RANGE_ERR_102 : 160|7@1+ (0.0075,0) [0|0.9525] "m"  ADAS
 SG_ DET_RANGE_VELOCITY_102 : 168|15@1+ (0.0078125,-128) [-128|127.9921875] "m/s"  ADAS
 SG_ DET_RANGE_VELOCITY_ERR_102 : 184|8@1+ (0.003,0) [0|0.765] "m/s"  ADAS
 SG_ DET_AZIMUTH_102 : 208|13@1+ (0.0004,-1.5708) [-1.5708|1.5708] "rad"  ADAS
 SG_ DET_AZIMUTH_ERR_102 : 224|7@1+ (0.00087267,0) [0|0.11082909] "rad"  ADAS
 SG_ DET_ELEVATION_102 : 192|8@1+ (0.00275,-0.34925) [-0.34925|0.34925] "rad"  ADAS
 SG_ DET_ELEVATION_ERR_102 : 200|6@1+ (0.00174533,0) [0|0.10995579] "rad"  ADAS
 SG_ DET_RCS_102 : 256|8@1+ (0.5,-64) [-64|63.5] "dBsm"  ADAS
 SG_ DET_VALID_FLAG_102 : 167|1@1+ (1,0) [0|1] ""  ADAS
 SG_ DET_BI_STATIC_FLAG_102 : 505|1@1+ (1,0) [0|1] ""  ADAS
 SG_ DET_SUPER_RES_TARGET_102 : 247|1@1+ (1,0) [0|1] ""  ADAS
 SG_ DET_SNR_102 : 248|8@1+ (0.35156,0) [0|89.6478] "dB"  ADAS
 SG_ DET_POINT_TARGET_PROB_102 : 240|4@1+ (6.67,0) [0|100] "%"  ADAS
 SG_ DET_EXISTENCE_PROB_102 : 232|6@1+ (1.588,0) [0|100] "%"  ADAS
 SG_ DET_OUTSIDE_SECTOR_102 : 183|1@1+ (1,0) [0|1] ""  ADAS
 SG_ DET_HVC_FLAG_102 : 246|1@1+ (1,0) [0|1] ""  ADAS
 SG_ DET_CONFD_AZIMUTH_102 : 206|2@1+ (1,0) [0|3] ""  ADAS
 SG_ DET_CONFD_ELEVATION_102 : 244|2@1+ (1,0) [0|3] ""  ADAS
 SG_ DET_RANGE_103 : 264|15@1+ (0.015625,0) [0|500] "m"  ADAS
 SG_ DET_RANGE_ERR_103 : 280|7@1+ (0.0075,0) [0|0.9525] "m"  ADAS
 SG_ DET_RANGE_VELOCITY_103 : 288|15@1+ (0.0078125,-128) [-128|127.9921875] "m/s"  ADAS
 SG_ DET_RANGE_VELOCITY_ERR_103 : 304|8@1+ (0.003,0) [0|0.765] "m/s"  ADAS
 SG_ DET_AZIMUTH_103 : 328|13@1+ (0.0004,-1.5708) [-1.5708|1.5708] "rad"  ADAS
 SG_ DET_AZIMUTH_ERR_103 : 345|7@1+ (0.00087267,0) [0|0.11082909] "rad"  ADAS
 SG_ DET_ELEVATION_103 : 312|8@1+ (0.00275,-0.34925) [-0.34925|0.34925] "rad"  ADAS
 SG_ DET_ELEVATION_ERR_103 : 320|6@1+ (0.00174533,0) [0|0.10995579] "rad"  ADAS
 SG_ DET_RCS_103 : 376|8@1+ (0.5,-64) [-64|63.5] "dBsm"  ADAS
 SG_ DET_VALID_FLAG_103 : 399|1@1+ (1,0) [0|1] ""  ADAS
 SG_ DET_BI_STATIC_FLAG_103 : 482|1@1+ (1,0) [0|1] ""  ADAS
 SG_ DET_SUPER_RES_TARGET_103 : 344|1@1+ (1,0) [0|1] ""  ADAS
 SG_ DET_SNR_103 : 368|8@1+ (0.35156,0) [0|89.6478] "dB"  ADAS
 SG_ DET_POINT_TARGET_PROB_103 : 360|4@1+ (6.67,0) [0|100] "%"  ADAS
 SG_ DET_EXISTENCE_PROB_103 : 352|6@1+ (1.588,0) [0|100] "%"  ADAS
 SG_ DET_OUTSIDE_SECTOR_103 : 407|1@1+ (1,0) [0|1] ""  ADAS
 SG_ DET_HVC_FLAG_103 : 364|1@1+ (1,0) [0|1] ""  ADAS
 SG_ DET_CONFD_AZIMUTH_103 : 365|2@1+ (1,0) [0|3] ""  ADAS
 SG_ DET_CONFD_ELEVATION_103 : 358|2@1+ (1,0) [0|3] ""  ADAS
 SG_ DET_RANGE_104 : 384|15@1+ (0.015625,0) [0|500] "m"  ADAS
 SG_ DET_RANGE_ERR_104 : 400|7@1+ (0.0075,0) [0|0.9525] "m"  ADAS
 SG_ DET_RANGE_VELOCITY_104 : 408|15@1+ (0.0078125,-128) [-128|127.9921875] "m/s"  ADAS
 SG_ DET_RANGE_VELOCITY_ERR_104 : 424|8@1+ (0.003,0) [0|0.765] "m/s"  ADAS
 SG_ DET_AZIMUTH_104 : 448|13@1+ (0.0004,-1.5708) [-1.5708|1.5708] "rad"  ADAS
 SG_ DET_AZIMUTH_ERR_104 : 465|7@1+ (0.00087267,0) [0|0.11082909] "rad"  ADAS
 SG_ DET_ELEVATION_104 : 432|8@1+ (0.00275,-0.34925) [-0.34925|0.34925] "rad"  ADAS
 SG_ DET_ELEVATION_ERR_104 : 440|6@1+ (0.00174533,0) [0|0.10995579] "rad"  ADAS
 SG_ DET_RCS_104 : 496|8@1+ (0.5,-64) [-64|63.5] "dBsm"  ADAS
 SG_ DET_VALID_FLAG_104 : 485|1@1+ (1,0) [0|1] ""  ADAS
 SG_ DET_BI_STATIC_FLAG_104 : 483|1@1+ (1,0) [0|1] ""  ADAS
 SG_ DET_SUPER_RES_TARGET_104 : 446|1@1+ (1,0) [0|1] ""  ADAS
 SG_ DET_SNR_104 : 488|8@1+ (0.35156,0) [0|89.6478] "dB"  ADAS
 SG_ DET_POINT_TARGET_PROB_104 : 472|4@1+ (6.67,0) [0|100] "%"  ADAS
 SG_ DET_EXISTENCE_PROB_104 : 506|6@1+ (1.588,0) [0|100] "%"  ADAS
 SG_ DET_OUTSIDE_SECTOR_104 : 481|1@1+ (1,0) [0|1] ""  ADAS
 SG_ DET_HVC_FLAG_104 : 464|1@1+ (1,0) [0|1] ""  ADAS
 SG_ DET_CONFD_AZIMUTH_104 : 486|2@1+ (1,0) [0|3] ""  ADAS
 SG_ DET_CONFD_ELEVATION_104 : 461|2@1+ (1,0) [0|3] ""  ADAS
 SG_ DET_MH_SCAN_INDEX_4LSB_101_104 : 476|4@1+ (1,0) [0|15] ""  ADAS
 SG_ DET_MH_CYCLE_COUNTER_101_104 : 16|8@1+ (1,0) [0|255] ""  ADAS
 SG_ DET_MH_CRC16_101_104 : 0|16@1+ (1,0) [0|65535] ""  ADAS

BO_ 1178 RDR_DETECTION_105_108: 64 RDR08
 SG_ DET_RANGE_105 : 24|15@1+ (0.015625,0) [0|500] "m"  ADAS
 SG_ DET_RANGE_ERR_105 : 40|7@1+ (0.0075,0) [0|0.9525] "m"  ADAS
 SG_ DET_RANGE_VELOCITY_105 : 48|15@1+ (0.0078125,-128) [-128|127.9921875] "m/s"  ADAS
 SG_ DET_RANGE_VELOCITY_ERR_105 : 64|8@1+ (0.003,0) [0|0.765] "m/s"  ADAS
 SG_ DET_AZIMUTH_105 : 88|13@1+ (0.0004,-1.5708) [-1.5708|1.5708] "rad"  ADAS
 SG_ DET_AZIMUTH_ERR_105 : 105|7@1+ (0.00087267,0) [0|0.11082909] "rad"  ADAS
 SG_ DET_ELEVATION_105 : 72|8@1+ (0.00275,-0.34925) [-0.34925|0.34925] "rad"  ADAS
 SG_ DET_ELEVATION_ERR_105 : 80|6@1+ (0.00174533,0) [0|0.10995579] "rad"  ADAS
 SG_ DET_RCS_105 : 136|8@1+ (0.5,-64) [-64|63.5] "dBsm"  ADAS
 SG_ DET_VALID_FLAG_105 : 119|1@1+ (1,0) [0|1] ""  ADAS
 SG_ DET_BI_STATIC_FLAG_105 : 504|1@1+ (1,0) [0|1] ""  ADAS
 SG_ DET_SUPER_RES_TARGET_105 : 104|1@1+ (1,0) [0|1] ""  ADAS
 SG_ DET_SNR_105 : 128|8@1+ (0.35156,0) [0|89.6478] "dB"  ADAS
 SG_ DET_POINT_TARGET_PROB_105 : 114|4@1+ (6.67,0) [0|100] "%"  ADAS
 SG_ DET_EXISTENCE_PROB_105 : 120|6@1+ (1.588,0) [0|100] "%"  ADAS
 SG_ DET_OUTSIDE_SECTOR_105 : 159|1@1+ (1,0) [0|1] ""  ADAS
 SG_ DET_HVC_FLAG_105 : 118|1@1+ (1,0) [0|1] ""  ADAS
 SG_ DET_CONFD_AZIMUTH_105 : 126|2@1+ (1,0) [0|3] ""  ADAS
 SG_ DET_CONFD_ELEVATION_105 : 112|2@1+ (1,0) [0|3] ""  ADAS
 SG_ DET_RANGE_106 : 144|15@1+ (0.015625,0) [0|500] "m"  ADAS
 SG_ DET_RANGE_ERR_106 : 160|7@1+ (0.0075,0) [0|0.9525] "m"  ADAS
 SG_ DET_RANGE_VELOCITY_106 : 168|15@1+ (0.0078125,-128) [-128|127.9921875] "m/s"  ADAS
 SG_ DET_RANGE_VELOCITY_ERR_106 : 184|8@1+ (0.003,0) [0|0.765] "m/s"  ADAS
 SG_ DET_AZIMUTH_106 : 208|13@1+ (0.0004,-1.5708) [-1.5708|1.5708] "rad"  ADAS
 SG_ DET_AZIMUTH_ERR_106 : 224|7@1+ (0.00087267,0) [0|0.11082909] "rad"  ADAS
 SG_ DET_ELEVATION_106 : 192|8@1+ (0.00275,-0.34925) [-0.34925|0.34925] "rad"  ADAS
 SG_ DET_ELEVATION_ERR_106 : 200|6@1+ (0.00174533,0) [0|0.10995579] "rad"  ADAS
 SG_ DET_RCS_106 : 256|8@1+ (0.5,-64) [-64|63.5] "dBsm"  ADAS
 SG_ DET_VALID_FLAG_106 : 167|1@1+ (1,0) [0|1] ""  ADAS
 SG_ DET_BI_STATIC_FLAG_106 : 505|1@1+ (1,0) [0|1] ""  ADAS
 SG_ DET_SUPER_RES_TARGET_106 : 247|1@1+ (1,0) [0|1] ""  ADAS
 SG_ DET_SNR_106 : 248|8@1+ (0.35156,0) [0|89.6478] "dB"  ADAS
 SG_ DET_POINT_TARGET_PROB_106 : 240|4@1+ (6.67,0) [0|100] "%"  ADAS
 SG_ DET_EXISTENCE_PROB_106 : 232|6@1+ (1.588,0) [0|100] "%"  ADAS
 SG_ DET_OUTSIDE_SECTOR_106 : 183|1@1+ (1,0) [0|1] ""  ADAS
 SG_ DET_HVC_FLAG_106 : 246|1@1+ (1,0) [0|1] ""  ADAS
 SG_ DET_CONFD_AZIMUTH_106 : 206|2@1+ (1,0) [0|3] ""  ADAS
 SG_ DET_CONFD_ELEVATION_106 : 244|2@1+ (1,0) [0|3] ""  ADAS
 SG_ DET_RANGE_107 : 264|15@1+ (0.015625,0) [0|500] "m"  ADAS
 SG_ DET_RANGE_ERR_107 : 280|7@1+ (0.0075,0) [0|0.9525] "m"  ADAS
 SG_ DET_RANGE_VELOCITY_107 : 288|15@1+ (0.0078125,-128) [-128|127.9921875] "m/s"  ADAS
 SG_ DET_RANGE_VELOCITY_ERR_107 : 304|8@1+ (0.003,0) [0|0.765] "m/s"  ADAS
 SG_ DET_AZIMUTH_107 : 328|13@1+ (0.0004,-1.5708) [-1.5708|1.5708] "rad"  ADAS
 SG_ DET_AZIMUTH_ERR_107 : 345|7@1+ (0.00087267,0) [0|0.11082909] "rad"  ADAS
 SG_ DET_ELEVATION_107 : 312|8@1+ (0.00275,-0.34925) [-0.34925|0.34925] "rad"  ADAS
 SG_ DET_ELEVATION_ERR_107 : 320|6@1+ (0.00174533,0) [0|0.10995579] "rad"  ADAS
 SG_ DET_RCS_107 : 376|8@1+ (0.5,-64) [-64|63.5] "dBsm"  ADAS
 SG_ DET_VALID_FLAG_107 : 399|1@1+ (1,0) [0|1] ""  ADAS
 SG_ DET_BI_STATIC_FLAG_107 : 482|1@1+ (1,0) [0|1] ""  ADAS
 SG_ DET_SUPER_RES_TARGET_107 : 344|1@1+ (1,0) [0|1] ""  ADAS
 SG_ DET_SNR_107 : 368|8@1+ (0.35156,0) [0|89.6478] "dB"  ADAS
 SG_ DET_POINT_TARGET_PROB_107 : 360|4@1+ (6.67,0) [0|100] "%"  ADAS
 SG_ DET_EXISTENCE_PROB_107 : 352|6@1+ (1.588,0) [0|100] "%"  ADAS
 SG_ DET_OUTSIDE_SECTOR_107 : 407|1@1+ (1,0) [0|1] ""  ADAS
 SG_ DET_HVC_FLAG_107 : 364|1@1+ (1,0) [0|1] ""  ADAS
 SG_ DET_CONFD_AZIMUTH_107 : 365|2@1+ (1,0) [0|3] ""  ADAS
 SG_ DET_CONFD_ELEVATION_107 : 358|2@1+ (1,0) [0|3] ""  ADAS
 SG_ DET_RANGE_108 : 384|15@1+ (0.015625,0) [0|500] "m"  ADAS
 SG_ DET_RANGE_ERR_108 : 400|7@1+ (0.0075,0) [0|0.9525] "m"  ADAS
 SG_ DET_RANGE_VELOCITY_108 : 408|15@1+ (0.0078125,-128) [-128|127.9921875] "m/s"  ADAS
 SG_ DET_RANGE_VELOCITY_ERR_108 : 424|8@1+ (0.003,0) [0|0.765] "m/s"  ADAS
 SG_ DET_AZIMUTH_108 : 448|13@1+ (0.0004,-1.5708) [-1.5708|1.5708] "rad"  ADAS
 SG_ DET_AZIMUTH_ERR_108 : 465|7@1+ (0.00087267,0) [0|0.11082909] "rad"  ADAS
 SG_ DET_ELEVATION_108 : 432|8@1+ (0.00275,-0.34925) [-0.34925|0.34925] "rad"  ADAS
 SG_ DET_ELEVATION_ERR_108 : 440|6@1+ (0.00174533,0) [0|0.10995579] "rad"  ADAS
 SG_ DET_RCS_108 : 496|8@1+ (0.5,-64) [-64|63.5] "dBsm"  ADAS
 SG_ DET_VALID_FLAG_108 : 485|1@1+ (1,0) [0|1] ""  ADAS
 SG_ DET_BI_STATIC_FLAG_108 : 483|1@1+ (1,0) [0|1] ""  ADAS
 SG_ DET_SUPER_RES_TARGET_108 : 446|1@1+ (1,0) [0|1] ""  ADAS
 SG_ DET_SNR_108 : 488|8@1+ (0.35156,0) [0|89.6478] "dB"  ADAS
 SG_ DET_POINT_TARGET_PROB_108 : 472|4@1+ (6.67,0) [0|100] "%"  ADAS
 SG_ DET_EXISTENCE_PROB_108 : 506|6@1+ (1.588,0) [0|100] "%"  ADAS
 SG_ DET_OUTSIDE_SECTOR_108 : 481|1@1+ (1,0) [0|1] ""  ADAS
 SG_ DET_HVC_FLAG_108 : 464|1@1+ (1,0) [0|1] ""  ADAS
 SG_ DET_CONFD_AZIMUTH_108 : 486|2@1+ (1,0) [0|3] ""  ADAS
 SG_ DET_CONFD_ELEVATION_108 : 461|2@1+ (1,0) [0|3] ""  ADAS
 SG_ DET_MH_SCAN_INDEX_4LSB_105_108 : 476|4@1+ (1,0) [0|15] ""  ADAS
 SG_ DET_MH_CYCLE_COUNTER_105_108 : 16|8@1+ (1,0) [0|255] ""  ADAS
 SG_ DET_MH_CRC16_105_108 : 0|16@1+ (1,0) [0|65535] ""  ADAS

BO_ 1179 RDR_DETECTION_109_112: 64 RDR08
 SG_ DET_RANGE_109 : 24|15@1+ (0.015625,0) [0|500] "m"  ADAS
 SG_ DET_RANGE_ERR_109 : 40|7@1+ (0.0075,0) [0|0.9525] "m"  ADAS
 SG_ DET_RANGE_VELOCITY_109 : 48|15@1+ (0.0078125,-128) [-128|127.9921875] "m/s"  ADAS
 SG_ DET_RANGE_VELOCITY_ERR_109 : 64|8@1+ (0.003,0) [0|0.765] "m/s"  ADAS
 SG_ DET_AZIMUTH_109 : 88|13@1+ (0.0004,-1.5708) [-1.5708|1.5708] "rad"  ADAS
 SG_ DET_AZIMUTH_ERR_109 : 105|7@1+ (0.00087267,0) [0|0.11082909] "rad"  ADAS
 SG_ DET_ELEVATION_109 : 72|8@1+ (0.00275,-0.34925) [-0.34925|0.34925] "rad"  ADAS
 SG_ DET_ELEVATION_ERR_109 : 80|6@1+ (0.00174533,0) [0|0.10995579] "rad"  ADAS
 SG_ DET_RCS_109 : 136|8@1+ (0.5,-64) [-64|63.5] "dBsm"  ADAS
 SG_ DET_VALID_FLAG_109 : 119|1@1+ (1,0) [0|1] ""  ADAS
 SG_ DET_BI_STATIC_FLAG_109 : 504|1@1+ (1,0) [0|1] ""  ADAS
 SG_ DET_SUPER_RES_TARGET_109 : 104|1@1+ (1,0) [0|1] ""  ADAS
 SG_ DET_SNR_109 : 128|8@1+ (0.35156,0) [0|89.6478] "dB"  ADAS
 SG_ DET_POINT_TARGET_PROB_109 : 114|4@1+ (6.67,0) [0|100] "%"  ADAS
 SG_ DET_EXISTENCE_PROB_109 : 120|6@1+ (1.588,0) [0|100] "%"  ADAS
 SG_ DET_OUTSIDE_SECTOR_109 : 159|1@1+ (1,0) [0|1] ""  ADAS
 SG_ DET_HVC_FLAG_109 : 118|1@1+ (1,0) [0|1] ""  ADAS
 SG_ DET_CONFD_AZIMUTH_109 : 126|2@1+ (1,0) [0|3] ""  ADAS
 SG_ DET_CONFD_ELEVATION_109 : 112|2@1+ (1,0) [0|3] ""  ADAS
 SG_ DET_RANGE_110 : 144|15@1+ (0.015625,0) [0|500] "m"  ADAS
 SG_ DET_RANGE_ERR_110 : 160|7@1+ (0.0075,0) [0|0.9525] "m"  ADAS
 SG_ DET_RANGE_VELOCITY_110 : 168|15@1+ (0.0078125,-128) [-128|127.9921875] "m/s"  ADAS
 SG_ DET_RANGE_VELOCITY_ERR_110 : 184|8@1+ (0.003,0) [0|0.765] "m/s"  ADAS
 SG_ DET_AZIMUTH_110 : 208|13@1+ (0.0004,-1.5708) [-1.5708|1.5708] "rad"  ADAS
 SG_ DET_AZIMUTH_ERR_110 : 224|7@1+ (0.00087267,0) [0|0.11082909] "rad"  ADAS
 SG_ DET_ELEVATION_110 : 192|8@1+ (0.00275,-0.34925) [-0.34925|0.34925] "rad"  ADAS
 SG_ DET_ELEVATION_ERR_110 : 200|6@1+ (0.00174533,0) [0|0.10995579] "rad"  ADAS
 SG_ DET_RCS_110 : 256|8@1+ (0.5,-64) [-64|63.5] "dBsm"  ADAS
 SG_ DET_VALID_FLAG_110 : 167|1@1+ (1,0) [0|1] ""  ADAS
 SG_ DET_BI_STATIC_FLAG_110 : 505|1@1+ (1,0) [0|1] ""  ADAS
 SG_ DET_SUPER_RES_TARGET_110 : 247|1@1+ (1,0) [0|1] ""  ADAS
 SG_ DET_SNR_110 : 248|8@1+ (0.35156,0) [0|89.6478] "dB"  ADAS
 SG_ DET_POINT_TARGET_PROB_110 : 240|4@1+ (6.67,0) [0|100] "%"  ADAS
 SG_ DET_EXISTENCE_PROB_110 : 232|6@1+ (1.588,0) [0|100] "%"  ADAS
 SG_ DET_OUTSIDE_SECTOR_110 : 183|1@1+ (1,0) [0|1] ""  ADAS
 SG_ DET_HVC_FLAG_110 : 246|1@1+ (1,0) [0|1] ""  ADAS
 SG_ DET_CONFD_AZIMUTH_110 : 206|2@1+ (1,0) [0|3] ""  ADAS
 SG_ DET_CONFD_ELEVATION_110 : 244|2@1+ (1,0) [0|3] ""  ADAS
 SG_ DET_RANGE_111 : 264|15@1+ (0.015625,0) [0|500] "m"  ADAS
 SG_ DET_RANGE_ERR_111 : 280|7@1+ (0.0075,0) [0|0.9525] "m"  ADAS
 SG_ DET_RANGE_VELOCITY_111 : 288|15@1+ (0.0078125,-128) [-128|127.9921875] "m/s"  ADAS
 SG_ DET_RANGE_VELOCITY_ERR_111 : 304|8@1+ (0.003,0) [0|0.765] "m/s"  ADAS
 SG_ DET_AZIMUTH_111 : 328|13@1+ (0.0004,-1.5708) [-1.5708|1.5708] "rad"  ADAS
 SG_ DET_AZIMUTH_ERR_111 : 345|7@1+ (0.00087267,0) [0|0.11082909] "rad"  ADAS
 SG_ DET_ELEVATION_111 : 312|8@1+ (0.00275,-0.34925) [-0.34925|0.34925] "rad"  ADAS
 SG_ DET_ELEVATION_ERR_111 : 320|6@1+ (0.00174533,0) [0|0.10995579] "rad"  ADAS
 SG_ DET_RCS_111 : 376|8@1+ (0.5,-64) [-64|63.5] "dBsm"  ADAS
 SG_ DET_VALID_FLAG_111 : 399|1@1+ (1,0) [0|1] ""  ADAS
 SG_ DET_BI_STATIC_FLAG_111 : 482|1@1+ (1,0) [0|1] ""  ADAS
 SG_ DET_SUPER_RES_TARGET_111 : 344|1@1+ (1,0) [0|1] ""  ADAS
 SG_ DET_SNR_111 : 368|8@1+ (0.35156,0) [0|89.6478] "dB"  ADAS
 SG_ DET_POINT_TARGET_PROB_111 : 360|4@1+ (6.67,0) [0|100] "%"  ADAS
 SG_ DET_EXISTENCE_PROB_111 : 352|6@1+ (1.588,0) [0|100] "%"  ADAS
 SG_ DET_OUTSIDE_SECTOR_111 : 407|1@1+ (1,0) [0|1] ""  ADAS
 SG_ DET_HVC_FLAG_111 : 364|1@1+ (1,0) [0|1] ""  ADAS
 SG_ DET_CONFD_AZIMUTH_111 : 365|2@1+ (1,0) [0|3] ""  ADAS
 SG_ DET_CONFD_ELEVATION_111 : 358|2@1+ (1,0) [0|3] ""  ADAS
 SG_ DET_RANGE_112 : 384|15@1+ (0.015625,0) [0|500] "m"  ADAS
 SG_ DET_RANGE_ERR_112 : 400|7@1+ (0.0075,0) [0|0.9525] "m"  ADAS
 SG_ DET_RANGE_VELOCITY_112 : 408|15@1+ (0.0078125,-128) [-128|127.9921875] "m/s"  ADAS
 SG_ DET_RANGE_VELOCITY_ERR_112 : 424|8@1+ (0.003,0) [0|0.765] "m/s"  ADAS
 SG_ DET_AZIMUTH_112 : 448|13@1+ (0.0004,-1.5708) [-1.5708|1.5708] "rad"  ADAS
 SG_ DET_AZIMUTH_ERR_112 : 465|7@1+ (0.00087267,0) [0|0.11082909] "rad"  ADAS
 SG_ DET_ELEVATION_112 : 432|8@1+ (0.00275,-0.34925) [-0.34925|0.34925] "rad"  ADAS
 SG_ DET_ELEVATION_ERR_112 : 440|6@1+ (0.00174533,0) [0|0.10995579] "rad"  ADAS
 SG_ DET_RCS_112 : 496|8@1+ (0.5,-64) [-64|63.5] "dBsm"  ADAS
 SG_ DET_VALID_FLAG_112 : 485|1@1+ (1,0) [0|1] ""  ADAS
 SG_ DET_BI_STATIC_FLAG_112 : 483|1@1+ (1,0) [0|1] ""  ADAS
 SG_ DET_SUPER_RES_TARGET_112 : 446|1@1+ (1,0) [0|1] ""  ADAS
 SG_ DET_SNR_112 : 488|8@1+ (0.35156,0) [0|89.6478] "dB"  ADAS
 SG_ DET_POINT_TARGET_PROB_112 : 472|4@1+ (6.67,0) [0|100] "%"  ADAS
 SG_ DET_EXISTENCE_PROB_112 : 506|6@1+ (1.588,0) [0|100] "%"  ADAS
 SG_ DET_OUTSIDE_SECTOR_112 : 481|1@1+ (1,0) [0|1] ""  ADAS
 SG_ DET_HVC_FLAG_112 : 464|1@1+ (1,0) [0|1] ""  ADAS
 SG_ DET_CONFD_AZIMUTH_112 : 486|2@1+ (1,0) [0|3] ""  ADAS
 SG_ DET_CONFD_ELEVATION_112 : 461|2@1+ (1,0) [0|3] ""  ADAS
 SG_ DET_MH_SCAN_INDEX_4LSB_109_112 : 476|4@1+ (1,0) [0|15] ""  ADAS
 SG_ DET_MH_CYCLE_COUNTER_109_112 : 16|8@1+ (1,0) [0|255] ""  ADAS
 SG_ DET_MH_CRC16_109_112 : 0|16@1+ (1,0) [0|65535] ""  ADAS

BO_ 1180 RDR_DETECTION_113_116: 64 RDR08
 SG_ DET_RANGE_113 : 24|15@1+ (0.015625,0) [0|500] "m"  ADAS
 SG_ DET_RANGE_ERR_113 : 40|7@1+ (0.0075,0) [0|0.9525] "m"  ADAS
 SG_ DET_RANGE_VELOCITY_113 : 48|15@1+ (0.0078125,-128) [-128|127.9921875] "m/s"  ADAS
 SG_ DET_RANGE_VELOCITY_ERR_113 : 64|8@1+ (0.003,0) [0|0.765] "m/s"  ADAS
 SG_ DET_AZIMUTH_113 : 88|13@1+ (0.0004,-1.5708) [-1.5708|1.5708] "rad"  ADAS
 SG_ DET_AZIMUTH_ERR_113 : 105|7@1+ (0.00087267,0) [0|0.11082909] "rad"  ADAS
 SG_ DET_ELEVATION_113 : 72|8@1+ (0.00275,-0.34925) [-0.34925|0.34925] "rad"  ADAS
 SG_ DET_ELEVATION_ERR_113 : 80|6@1+ (0.00174533,0) [0|0.10995579] "rad"  ADAS
 SG_ DET_RCS_113 : 136|8@1+ (0.5,-64) [-64|63.5] "dBsm"  ADAS
 SG_ DET_VALID_FLAG_113 : 119|1@1+ (1,0) [0|1] ""  ADAS
 SG_ DET_BI_STATIC_FLAG_113 : 504|1@1+ (1,0) [0|1] ""  ADAS
 SG_ DET_SUPER_RES_TARGET_113 : 104|1@1+ (1,0) [0|1] ""  ADAS
 SG_ DET_SNR_113 : 128|8@1+ (0.35156,0) [0|89.6478] "dB"  ADAS
 SG_ DET_POINT_TARGET_PROB_113 : 114|4@1+ (6.67,0) [0|100] "%"  ADAS
 SG_ DET_EXISTENCE_PROB_113 : 120|6@1+ (1.588,0) [0|100] "%"  ADAS
 SG_ DET_OUTSIDE_SECTOR_113 : 159|1@1+ (1,0) [0|1] ""  ADAS
 SG_ DET_HVC_FLAG_113 : 118|1@1+ (1,0) [0|1] ""  ADAS
 SG_ DET_CONFD_AZIMUTH_113 : 126|2@1+ (1,0) [0|3] ""  ADAS
 SG_ DET_CONFD_ELEVATION_113 : 112|2@1+ (1,0) [0|3] ""  ADAS
 SG_ DET_RANGE_114 : 144|15@1+ (0.015625,0) [0|500] "m"  ADAS
 SG_ DET_RANGE_ERR_114 : 160|7@1+ (0.0075,0) [0|0.9525] "m"  ADAS
 SG_ DET_RANGE_VELOCITY_114 : 168|15@1+ (0.0078125,-128) [-128|127.9921875] "m/s"  ADAS
 SG_ DET_RANGE_VELOCITY_ERR_114 : 184|8@1+ (0.003,0) [0|0.765] "m/s"  ADAS
 SG_ DET_AZIMUTH_114 : 208|13@1+ (0.0004,-1.5708) [-1.5708|1.5708] "rad"  ADAS
 SG_ DET_AZIMUTH_ERR_114 : 224|7@1+ (0.00087267,0) [0|0.11082909] "rad"  ADAS
 SG_ DET_ELEVATION_114 : 192|8@1+ (0.00275,-0.34925) [-0.34925|0.34925] "rad"  ADAS
 SG_ DET_ELEVATION_ERR_114 : 200|6@1+ (0.00174533,0) [0|0.10995579] "rad"  ADAS
 SG_ DET_RCS_114 : 256|8@1+ (0.5,-64) [-64|63.5] "dBsm"  ADAS
 SG_ DET_VALID_FLAG_114 : 167|1@1+ (1,0) [0|1] ""  ADAS
 SG_ DET_BI_STATIC_FLAG_114 : 505|1@1+ (1,0) [0|1] ""  ADAS
 SG_ DET_SUPER_RES_TARGET_114 : 247|1@1+ (1,0) [0|1] ""  ADAS
 SG_ DET_SNR_114 : 248|8@1+ (0.35156,0) [0|89.6478] "dB"  ADAS
 SG_ DET_POINT_TARGET_PROB_114 : 240|4@1+ (6.67,0) [0|100] "%"  ADAS
 SG_ DET_EXISTENCE_PROB_114 : 232|6@1+ (1.588,0) [0|100] "%"  ADAS
 SG_ DET_OUTSIDE_SECTOR_114 : 183|1@1+ (1,0) [0|1] ""  ADAS
 SG_ DET_HVC_FLAG_114 : 246|1@1+ (1,0) [0|1] ""  ADAS
 SG_ DET_CONFD_AZIMUTH_114 : 206|2@1+ (1,0) [0|3] ""  ADAS
 SG_ DET_CONFD_ELEVATION_114 : 244|2@1+ (1,0) [0|3] ""  ADAS
 SG_ DET_RANGE_115 : 264|15@1+ (0.015625,0) [0|500] "m"  ADAS
 SG_ DET_RANGE_ERR_115 : 280|7@1+ (0.0075,0) [0|0.9525] "m"  ADAS
 SG_ DET_RANGE_VELOCITY_115 : 288|15@1+ (0.0078125,-128) [-128|127.9921875] "m/s"  ADAS
 SG_ DET_RANGE_VELOCITY_ERR_115 : 304|8@1+ (0.003,0) [0|0.765] "m/s"  ADAS
 SG_ DET_AZIMUTH_115 : 328|13@1+ (0.0004,-1.5708) [-1.5708|1.5708] "rad"  ADAS
 SG_ DET_AZIMUTH_ERR_115 : 345|7@1+ (0.00087267,0) [0|0.11082909] "rad"  ADAS
 SG_ DET_ELEVATION_115 : 312|8@1+ (0.00275,-0.34925) [-0.34925|0.34925] "rad"  ADAS
 SG_ DET_ELEVATION_ERR_115 : 320|6@1+ (0.00174533,0) [0|0.10995579] "rad"  ADAS
 SG_ DET_RCS_115 : 376|8@1+ (0.5,-64) [-64|63.5] "dBsm"  ADAS
 SG_ DET_VALID_FLAG_115 : 399|1@1+ (1,0) [0|1] ""  ADAS
 SG_ DET_BI_STATIC_FLAG_115 : 482|1@1+ (1,0) [0|1] ""  ADAS
 SG_ DET_SUPER_RES_TARGET_115 : 344|1@1+ (1,0) [0|1] ""  ADAS
 SG_ DET_SNR_115 : 368|8@1+ (0.35156,0) [0|89.6478] "dB"  ADAS
 SG_ DET_POINT_TARGET_PROB_115 : 360|4@1+ (6.67,0) [0|100] "%"  ADAS
 SG_ DET_EXISTENCE_PROB_115 : 352|6@1+ (1.588,0) [0|100] "%"  ADAS
 SG_ DET_OUTSIDE_SECTOR_115 : 407|1@1+ (1,0) [0|1] ""  ADAS
 SG_ DET_HVC_FLAG_115 : 364|1@1+ (1,0) [0|1] ""  ADAS
 SG_ DET_CONFD_AZIMUTH_115 : 365|2@1+ (1,0) [0|3] ""  ADAS
 SG_ DET_CONFD_ELEVATION_115 : 358|2@1+ (1,0) [0|3] ""  ADAS
 SG_ DET_RANGE_116 : 384|15@1+ (0.015625,0) [0|500] "m"  ADAS
 SG_ DET_RANGE_ERR_116 : 400|7@1+ (0.0075,0) [0|0.9525] "m"  ADAS
 SG_ DET_RANGE_VELOCITY_116 : 408|15@1+ (0.0078125,-128) [-128|127.9921875] "m/s"  ADAS
 SG_ DET_RANGE_VELOCITY_ERR_116 : 424|8@1+ (0.003,0) [0|0.765] "m/s"  ADAS
 SG_ DET_AZIMUTH_116 : 448|13@1+ (0.0004,-1.5708) [-1.5708|1.5708] "rad"  ADAS
 SG_ DET_AZIMUTH_ERR_116 : 465|7@1+ (0.00087267,0) [0|0.11082909] "rad"  ADAS
 SG_ DET_ELEVATION_116 : 432|8@1+ (0.00275,-0.34925) [-0.34925|0.34925] "rad"  ADAS
 SG_ DET_ELEVATION_ERR_116 : 440|6@1+ (0.00174533,0) [0|0.10995579] "rad"  ADAS
 SG_ DET_RCS_116 : 496|8@1+ (0.5,-64) [-64|63.5] "dBsm"  ADAS
 SG_ DET_VALID_FLAG_116 : 485|1@1+ (1,0) [0|1] ""  ADAS
 SG_ DET_BI_STATIC_FLAG_116 : 483|1@1+ (1,0) [0|1] ""  ADAS
 SG_ DET_SUPER_RES_TARGET_116 : 446|1@1+ (1,0) [0|1] ""  ADAS
 SG_ DET_SNR_116 : 488|8@1+ (0.35156,0) [0|89.6478] "dB"  ADAS
 SG_ DET_POINT_TARGET_PROB_116 : 472|4@1+ (6.67,0) [0|100] "%"  ADAS
 SG_ DET_EXISTENCE_PROB_116 : 506|6@1+ (1.588,0) [0|100] "%"  ADAS
 SG_ DET_OUTSIDE_SECTOR_116 : 481|1@1+ (1,0) [0|1] ""  ADAS
 SG_ DET_HVC_FLAG_116 : 464|1@1+ (1,0) [0|1] ""  ADAS
 SG_ DET_CONFD_AZIMUTH_116 : 486|2@1+ (1,0) [0|3] ""  ADAS
 SG_ DET_CONFD_ELEVATION_116 : 461|2@1+ (1,0) [0|3] ""  ADAS
 SG_ DET_MH_SCAN_INDEX_4LSB_113_116 : 476|4@1+ (1,0) [0|15] ""  ADAS
 SG_ DET_MH_CYCLE_COUNTER_113_116 : 16|8@1+ (1,0) [0|255] ""  ADAS
 SG_ DET_MH_CRC16_113_116 : 0|16@1+ (1,0) [0|65535] ""  ADAS

CM_ SG_ 1163 DET_RANGE_045 " measured position  of the detection";
CM_ SG_ 1163 DET_RANGE_ERR_045 "RMSE or standard deviation of the measured angle  of the detection";
CM_ SG_ 1163 DET_RANGE_VELOCITY_045 "Radial velocity of the detection positive in direction to the sensor";
CM_ SG_ 1163 DET_RANGE_VELOCITY_ERR_045 "RMSE or standard deviation of the measure radial velocity of the detection";
CM_ SG_ 1163 DET_AZIMUTH_045 "Measured angle  of the detection";
CM_ SG_ 1163 DET_AZIMUTH_ERR_045 "RMSE or standard deviation of the measured angle  of the detection";
CM_ SG_ 1163 DET_ELEVATION_045 "measured elevation of the detection";
CM_ SG_ 1163 DET_ELEVATION_ERR_045 "RMSE or standard deviation of the measured elevation  of the detection";
CM_ SG_ 1163 DET_RCS_045 "Radar Cross Section or Amplitude, is a measure of how detectable an object is by radar. A larger RCS indicates that an object is more easily detected.";
CM_ SG_ 1163 DET_VALID_FLAG_045 "is set if the measured detection is valid";
CM_ SG_ 1163 DET_BI_STATIC_FLAG_045 "1 if detection is bi-static 0 otherwise";
CM_ SG_ 1163 DET_SUPER_RES_TARGET_045 "flasg is set if the detection is super resolution target";
CM_ SG_ 1163 DET_SNR_045 "The signal to noise ratio (SNR) of the radar detection";
CM_ SG_ 1163 DET_POINT_TARGET_PROB_045 "Describes the possibility if more than one real-world object has led to this detection. 0[%] := 100[%] Multi target probability";
CM_ SG_ 1163 DET_EXISTENCE_PROB_045 "Existence probability of the detection not based on history. Value does  not depend on any past experience with similar detections.
\note Use as confidence measure where a low value means less confidence
and a high value indicates strong confidence.";
CM_ SG_ 1163 DET_OUTSIDE_SECTOR_045 "Flag to indicate detections outside the sector, set if the wrong sector calibration matrix was used";
CM_ SG_ 1163 DET_HVC_FLAG_045 "Core2 Vehicle clutter flag";
CM_ SG_ 1163 DET_CONFD_AZIMUTH_045 "Define the Confidence of Azimuth for Detection ";
CM_ SG_ 1163 DET_CONFD_ELEVATION_045 "Define the Confidence of Elevation for the Detection ";
CM_ SG_ 1163 DET_BI_STATIC_FLAG_046 "1 if detection is bi-static 0 otherwise";
CM_ SG_ 1163 DET_BI_STATIC_FLAG_047 "1 if detection is bi-static 0 otherwise";
CM_ SG_ 1163 DET_BI_STATIC_FLAG_048 "1 if detection is bi-static 0 otherwise";
CM_ SG_ 1163 DET_MH_SCAN_INDEX_4LSB_045_048 "Scan index of the measured detection";
CM_ SG_ 1163 DET_MH_CYCLE_COUNTER_045_048 "Detection Alive Counter";
CM_ SG_ 1164 DET_RANGE_049 " measured position  of the detection";
CM_ SG_ 1164 DET_RANGE_ERR_049 "RMSE or standard deviation of the measured angle  of the detection";
CM_ SG_ 1164 DET_RANGE_VELOCITY_049 "Radial velocity of the detection positive in direction to the sensor";
CM_ SG_ 1164 DET_RANGE_VELOCITY_ERR_049 "RMSE or standard deviation of the measure radial velocity of the detection";
CM_ SG_ 1164 DET_AZIMUTH_049 "Measured angle  of the detection";
CM_ SG_ 1164 DET_AZIMUTH_ERR_049 "RMSE or standard deviation of the measured angle  of the detection";
CM_ SG_ 1164 DET_ELEVATION_049 "measured elevation of the detection";
CM_ SG_ 1164 DET_ELEVATION_ERR_049 "RMSE or standard deviation of the measured elevation  of the detection";
CM_ SG_ 1164 DET_RCS_049 "Radar Cross Section or Amplitude, is a measure of how detectable an object is by radar. A larger RCS indicates that an object is more easily detected.";
CM_ SG_ 1164 DET_VALID_FLAG_049 "is set if the measured detection is valid";
CM_ SG_ 1164 DET_BI_STATIC_FLAG_049 "1 if detection is bi-static 0 otherwise";
CM_ SG_ 1164 DET_SUPER_RES_TARGET_049 "flasg is set if the detection is super resolution target";
CM_ SG_ 1164 DET_SNR_049 "The signal to noise ratio (SNR) of the radar detection";
CM_ SG_ 1164 DET_POINT_TARGET_PROB_049 "Describes the possibility if more than one real-world object has led to this detection. 0[%] := 100[%] Multi target probability";
CM_ SG_ 1164 DET_EXISTENCE_PROB_049 "Existence probability of the detection not based on history. Value does  not depend on any past experience with similar detections.
\note Use as confidence measure where a low value means less confidence
and a high value indicates strong confidence.";
CM_ SG_ 1164 DET_OUTSIDE_SECTOR_049 "Flag to indicate detections outside the sector, set if the wrong sector calibration matrix was used";
CM_ SG_ 1164 DET_HVC_FLAG_049 "Core2 Vehicle clutter flag";
CM_ SG_ 1164 DET_CONFD_AZIMUTH_049 "Define the Confidence of Azimuth for Detection ";
CM_ SG_ 1164 DET_CONFD_ELEVATION_049 "Define the Confidence of Elevation for the Detection ";
CM_ SG_ 1164 DET_BI_STATIC_FLAG_050 "1 if detection is bi-static 0 otherwise";
CM_ SG_ 1164 DET_BI_STATIC_FLAG_051 "1 if detection is bi-static 0 otherwise";
CM_ SG_ 1164 DET_BI_STATIC_FLAG_052 "1 if detection is bi-static 0 otherwise";
CM_ SG_ 1164 DET_MH_SCAN_INDEX_4LSB_049_052 "Scan index of the measured detection";
CM_ SG_ 1164 DET_MH_CYCLE_COUNTER_049_052 "Detection Alive Counter";
CM_ SG_ 1165 DET_RANGE_053 " measured position  of the detection";
CM_ SG_ 1165 DET_RANGE_ERR_053 "RMSE or standard deviation of the measured angle  of the detection";
CM_ SG_ 1165 DET_RANGE_VELOCITY_053 "Radial velocity of the detection positive in direction to the sensor";
CM_ SG_ 1165 DET_RANGE_VELOCITY_ERR_053 "RMSE or standard deviation of the measure radial velocity of the detection";
CM_ SG_ 1165 DET_AZIMUTH_053 "Measured angle  of the detection";
CM_ SG_ 1165 DET_AZIMUTH_ERR_053 "RMSE or standard deviation of the measured angle  of the detection";
CM_ SG_ 1165 DET_ELEVATION_053 "measured elevation of the detection";
CM_ SG_ 1165 DET_ELEVATION_ERR_053 "RMSE or standard deviation of the measured elevation  of the detection";
CM_ SG_ 1165 DET_RCS_053 "Radar Cross Section or Amplitude, is a measure of how detectable an object is by radar. A larger RCS indicates that an object is more easily detected.";
CM_ SG_ 1165 DET_VALID_FLAG_053 "is set if the measured detection is valid";
CM_ SG_ 1165 DET_BI_STATIC_FLAG_053 "1 if detection is bi-static 0 otherwise";
CM_ SG_ 1165 DET_SUPER_RES_TARGET_053 "flasg is set if the detection is super resolution target";
CM_ SG_ 1165 DET_SNR_053 "The signal to noise ratio (SNR) of the radar detection";
CM_ SG_ 1165 DET_POINT_TARGET_PROB_053 "Describes the possibility if more than one real-world object has led to this detection. 0[%] := 100[%] Multi target probability";
CM_ SG_ 1165 DET_EXISTENCE_PROB_053 "Existence probability of the detection not based on history. Value does  not depend on any past experience with similar detections.
\note Use as confidence measure where a low value means less confidence
and a high value indicates strong confidence.";
CM_ SG_ 1165 DET_OUTSIDE_SECTOR_053 "Flag to indicate detections outside the sector, set if the wrong sector calibration matrix was used";
CM_ SG_ 1165 DET_HVC_FLAG_053 "Core2 Vehicle clutter flag";
CM_ SG_ 1165 DET_CONFD_AZIMUTH_053 "Define the Confidence of Azimuth for Detection ";
CM_ SG_ 1165 DET_CONFD_ELEVATION_053 "Define the Confidence of Elevation for the Detection ";
CM_ SG_ 1165 DET_BI_STATIC_FLAG_054 "1 if detection is bi-static 0 otherwise";
CM_ SG_ 1165 DET_BI_STATIC_FLAG_055 "1 if detection is bi-static 0 otherwise";
CM_ SG_ 1165 DET_BI_STATIC_FLAG_056 "1 if detection is bi-static 0 otherwise";
CM_ SG_ 1165 DET_MH_SCAN_INDEX_4LSB_053_056 "Scan index of the measured detection";
CM_ SG_ 1165 DET_MH_CYCLE_COUNTER_053_056 "Detection Alive Counter";
CM_ SG_ 1166 DET_RANGE_057 " measured position  of the detection";
CM_ SG_ 1166 DET_RANGE_ERR_057 "RMSE or standard deviation of the measured angle  of the detection";
CM_ SG_ 1166 DET_RANGE_VELOCITY_057 "Radial velocity of the detection positive in direction to the sensor";
CM_ SG_ 1166 DET_RANGE_VELOCITY_ERR_057 "RMSE or standard deviation of the measure radial velocity of the detection";
CM_ SG_ 1166 DET_AZIMUTH_057 "Measured angle  of the detection";
CM_ SG_ 1166 DET_AZIMUTH_ERR_057 "RMSE or standard deviation of the measured angle  of the detection";
CM_ SG_ 1166 DET_ELEVATION_057 "measured elevation of the detection";
CM_ SG_ 1166 DET_ELEVATION_ERR_057 "RMSE or standard deviation of the measured elevation  of the detection";
CM_ SG_ 1166 DET_RCS_057 "Radar Cross Section or Amplitude, is a measure of how detectable an object is by radar. A larger RCS indicates that an object is more easily detected.";
CM_ SG_ 1166 DET_VALID_FLAG_057 "is set if the measured detection is valid";
CM_ SG_ 1166 DET_BI_STATIC_FLAG_057 "1 if detection is bi-static 0 otherwise";
CM_ SG_ 1166 DET_SUPER_RES_TARGET_057 "flasg is set if the detection is super resolution target";
CM_ SG_ 1166 DET_SNR_057 "The signal to noise ratio (SNR) of the radar detection";
CM_ SG_ 1166 DET_POINT_TARGET_PROB_057 "Describes the possibility if more than one real-world object has led to this detection. 0[%] := 100[%] Multi target probability";
CM_ SG_ 1166 DET_EXISTENCE_PROB_057 "Existence probability of the detection not based on history. Value does  not depend on any past experience with similar detections.
\note Use as confidence measure where a low value means less confidence
and a high value indicates strong confidence.";
CM_ SG_ 1166 DET_OUTSIDE_SECTOR_057 "Flag to indicate detections outside the sector, set if the wrong sector calibration matrix was used";
CM_ SG_ 1166 DET_HVC_FLAG_057 "Core2 Vehicle clutter flag";
CM_ SG_ 1166 DET_CONFD_AZIMUTH_057 "Define the Confidence of Azimuth for Detection ";
CM_ SG_ 1166 DET_CONFD_ELEVATION_057 "Define the Confidence of Elevation for the Detection ";
CM_ SG_ 1166 DET_BI_STATIC_FLAG_058 "1 if detection is bi-static 0 otherwise";
CM_ SG_ 1166 DET_BI_STATIC_FLAG_059 "1 if detection is bi-static 0 otherwise";
CM_ SG_ 1166 DET_BI_STATIC_FLAG_060 "1 if detection is bi-static 0 otherwise";
CM_ SG_ 1166 DET_MH_SCAN_INDEX_4LSB_057_060 "Scan index of the measured detection";
CM_ SG_ 1166 DET_MH_CYCLE_COUNTER_057_060 "Detection Alive Counter";
CM_ SG_ 1167 DET_RANGE_061 " measured position  of the detection";
CM_ SG_ 1167 DET_RANGE_ERR_061 "RMSE or standard deviation of the measured angle  of the detection";
CM_ SG_ 1167 DET_RANGE_VELOCITY_061 "Radial velocity of the detection positive in direction to the sensor";
CM_ SG_ 1167 DET_RANGE_VELOCITY_ERR_061 "RMSE or standard deviation of the measure radial velocity of the detection";
CM_ SG_ 1167 DET_AZIMUTH_061 "Measured angle  of the detection";
CM_ SG_ 1167 DET_AZIMUTH_ERR_061 "RMSE or standard deviation of the measured angle  of the detection";
CM_ SG_ 1167 DET_ELEVATION_061 "measured elevation of the detection";
CM_ SG_ 1167 DET_ELEVATION_ERR_061 "RMSE or standard deviation of the measured elevation  of the detection";
CM_ SG_ 1167 DET_RCS_061 "Radar Cross Section or Amplitude, is a measure of how detectable an object is by radar. A larger RCS indicates that an object is more easily detected.";
CM_ SG_ 1167 DET_VALID_FLAG_061 "is set if the measured detection is valid";
CM_ SG_ 1167 DET_BI_STATIC_FLAG_061 "1 if detection is bi-static 0 otherwise";
CM_ SG_ 1167 DET_SUPER_RES_TARGET_061 "flasg is set if the detection is super resolution target";
CM_ SG_ 1167 DET_SNR_061 "The signal to noise ratio (SNR) of the radar detection";
CM_ SG_ 1167 DET_POINT_TARGET_PROB_061 "Describes the possibility if more than one real-world object has led to this detection. 0[%] := 100[%] Multi target probability";
CM_ SG_ 1167 DET_EXISTENCE_PROB_061 "Existence probability of the detection not based on history. Value does  not depend on any past experience with similar detections.
\note Use as confidence measure where a low value means less confidence
and a high value indicates strong confidence.";
CM_ SG_ 1167 DET_OUTSIDE_SECTOR_061 "Flag to indicate detections outside the sector, set if the wrong sector calibration matrix was used";
CM_ SG_ 1167 DET_HVC_FLAG_061 "Core2 Vehicle clutter flag";
CM_ SG_ 1167 DET_CONFD_AZIMUTH_061 "Define the Confidence of Azimuth for Detection ";
CM_ SG_ 1167 DET_CONFD_ELEVATION_061 "Define the Confidence of Elevation for the Detection ";
CM_ SG_ 1167 DET_BI_STATIC_FLAG_062 "1 if detection is bi-static 0 otherwise";
CM_ SG_ 1167 DET_BI_STATIC_FLAG_063 "1 if detection is bi-static 0 otherwise";
CM_ SG_ 1167 DET_BI_STATIC_FLAG_064 "1 if detection is bi-static 0 otherwise";
CM_ SG_ 1167 DET_MH_SCAN_INDEX_4LSB_061_064 "Scan index of the measured detection";
CM_ SG_ 1167 DET_MH_CYCLE_COUNTER_061_064 "Detection Alive Counter";
CM_ SG_ 1168 DET_RANGE_065 " measured position  of the detection";
CM_ SG_ 1168 DET_RANGE_ERR_065 "RMSE or standard deviation of the measured angle  of the detection";
CM_ SG_ 1168 DET_RANGE_VELOCITY_065 "Radial velocity of the detection positive in direction to the sensor";
CM_ SG_ 1168 DET_RANGE_VELOCITY_ERR_065 "RMSE or standard deviation of the measure radial velocity of the detection";
CM_ SG_ 1168 DET_AZIMUTH_065 "Measured angle  of the detection";
CM_ SG_ 1168 DET_AZIMUTH_ERR_065 "RMSE or standard deviation of the measured angle  of the detection";
CM_ SG_ 1168 DET_ELEVATION_065 "measured elevation of the detection";
CM_ SG_ 1168 DET_ELEVATION_ERR_065 "RMSE or standard deviation of the measured elevation  of the detection";
CM_ SG_ 1168 DET_RCS_065 "Radar Cross Section or Amplitude, is a measure of how detectable an object is by radar. A larger RCS indicates that an object is more easily detected.";
CM_ SG_ 1168 DET_VALID_FLAG_065 "is set if the measured detection is valid";
CM_ SG_ 1168 DET_BI_STATIC_FLAG_065 "1 if detection is bi-static 0 otherwise";
CM_ SG_ 1168 DET_SUPER_RES_TARGET_065 "flasg is set if the detection is super resolution target";
CM_ SG_ 1168 DET_SNR_065 "The signal to noise ratio (SNR) of the radar detection";
CM_ SG_ 1168 DET_POINT_TARGET_PROB_065 "Describes the possibility if more than one real-world object has led to this detection. 0[%] := 100[%] Multi target probability";
CM_ SG_ 1168 DET_EXISTENCE_PROB_065 "Existence probability of the detection not based on history. Value does  not depend on any past experience with similar detections.
\note Use as confidence measure where a low value means less confidence
and a high value indicates strong confidence.";
CM_ SG_ 1168 DET_OUTSIDE_SECTOR_065 "Flag to indicate detections outside the sector, set if the wrong sector calibration matrix was used";
CM_ SG_ 1168 DET_HVC_FLAG_065 "Core2 Vehicle clutter flag";
CM_ SG_ 1168 DET_CONFD_AZIMUTH_065 "Define the Confidence of Azimuth for Detection ";
CM_ SG_ 1168 DET_CONFD_ELEVATION_065 "Define the Confidence of Elevation for the Detection ";
CM_ SG_ 1168 DET_BI_STATIC_FLAG_066 "1 if detection is bi-static 0 otherwise";
CM_ SG_ 1168 DET_BI_STATIC_FLAG_067 "1 if detection is bi-static 0 otherwise";
CM_ SG_ 1168 DET_BI_STATIC_FLAG_068 "1 if detection is bi-static 0 otherwise";
CM_ SG_ 1168 DET_MH_SCAN_INDEX_4LSB_065_068 "Scan index of the measured detection";
CM_ SG_ 1168 DET_MH_CYCLE_COUNTER_065_068 "Detection Alive Counter";
CM_ SG_ 1169 DET_RANGE_069 " measured position  of the detection";
CM_ SG_ 1169 DET_RANGE_ERR_069 "RMSE or standard deviation of the measured angle  of the detection";
CM_ SG_ 1169 DET_RANGE_VELOCITY_069 "Radial velocity of the detection positive in direction to the sensor";
CM_ SG_ 1169 DET_RANGE_VELOCITY_ERR_069 "RMSE or standard deviation of the measure radial velocity of the detection";
CM_ SG_ 1169 DET_AZIMUTH_069 "Measured angle  of the detection";
CM_ SG_ 1169 DET_AZIMUTH_ERR_069 "RMSE or standard deviation of the measured angle  of the detection";
CM_ SG_ 1169 DET_ELEVATION_069 "measured elevation of the detection";
CM_ SG_ 1169 DET_ELEVATION_ERR_069 "RMSE or standard deviation of the measured elevation  of the detection";
CM_ SG_ 1169 DET_RCS_069 "Radar Cross Section or Amplitude, is a measure of how detectable an object is by radar. A larger RCS indicates that an object is more easily detected.";
CM_ SG_ 1169 DET_VALID_FLAG_069 "is set if the measured detection is valid";
CM_ SG_ 1169 DET_BI_STATIC_FLAG_069 "1 if detection is bi-static 0 otherwise";
CM_ SG_ 1169 DET_SUPER_RES_TARGET_069 "flasg is set if the detection is super resolution target";
CM_ SG_ 1169 DET_SNR_069 "The signal to noise ratio (SNR) of the radar detection";
CM_ SG_ 1169 DET_POINT_TARGET_PROB_069 "Describes the possibility if more than one real-world object has led to this detection. 0[%] := 100[%] Multi target probability";
CM_ SG_ 1169 DET_EXISTENCE_PROB_069 "Existence probability of the detection not based on history. Value does  not depend on any past experience with similar detections.
\note Use as confidence measure where a low value means less confidence
and a high value indicates strong confidence.";
CM_ SG_ 1169 DET_OUTSIDE_SECTOR_069 "Flag to indicate detections outside the sector, set if the wrong sector calibration matrix was used";
CM_ SG_ 1169 DET_HVC_FLAG_069 "Core2 Vehicle clutter flag";
CM_ SG_ 1169 DET_CONFD_AZIMUTH_069 "Define the Confidence of Azimuth for Detection ";
CM_ SG_ 1169 DET_CONFD_ELEVATION_069 "Define the Confidence of Elevation for the Detection ";
CM_ SG_ 1169 DET_BI_STATIC_FLAG_070 "1 if detection is bi-static 0 otherwise";
CM_ SG_ 1169 DET_BI_STATIC_FLAG_071 "1 if detection is bi-static 0 otherwise";
CM_ SG_ 1169 DET_BI_STATIC_FLAG_072 "1 if detection is bi-static 0 otherwise";
CM_ SG_ 1169 DET_MH_SCAN_INDEX_4LSB_069_072 "Scan index of the measured detection";
CM_ SG_ 1169 DET_MH_CYCLE_COUNTER_069_072 "Detection Alive Counter";
CM_ SG_ 1170 DET_RANGE_073 " measured position  of the detection";
CM_ SG_ 1170 DET_RANGE_ERR_073 "RMSE or standard deviation of the measured angle  of the detection";
CM_ SG_ 1170 DET_RANGE_VELOCITY_073 "Radial velocity of the detection positive in direction to the sensor";
CM_ SG_ 1170 DET_RANGE_VELOCITY_ERR_073 "RMSE or standard deviation of the measure radial velocity of the detection";
CM_ SG_ 1170 DET_AZIMUTH_073 "Measured angle  of the detection";
CM_ SG_ 1170 DET_AZIMUTH_ERR_073 "RMSE or standard deviation of the measured angle  of the detection";
CM_ SG_ 1170 DET_ELEVATION_073 "measured elevation of the detection";
CM_ SG_ 1170 DET_ELEVATION_ERR_073 "RMSE or standard deviation of the measured elevation  of the detection";
CM_ SG_ 1170 DET_RCS_073 "Radar Cross Section or Amplitude, is a measure of how detectable an object is by radar. A larger RCS indicates that an object is more easily detected.";
CM_ SG_ 1170 DET_VALID_FLAG_073 "is set if the measured detection is valid";
CM_ SG_ 1170 DET_BI_STATIC_FLAG_073 "1 if detection is bi-static 0 otherwise";
CM_ SG_ 1170 DET_SUPER_RES_TARGET_073 "flasg is set if the detection is super resolution target";
CM_ SG_ 1170 DET_SNR_073 "The signal to noise ratio (SNR) of the radar detection";
CM_ SG_ 1170 DET_POINT_TARGET_PROB_073 "Describes the possibility if more than one real-world object has led to this detection. 0[%] := 100[%] Multi target probability";
CM_ SG_ 1170 DET_EXISTENCE_PROB_073 "Existence probability of the detection not based on history. Value does  not depend on any past experience with similar detections.
\note Use as confidence measure where a low value means less confidence
and a high value indicates strong confidence.";
CM_ SG_ 1170 DET_OUTSIDE_SECTOR_073 "Flag to indicate detections outside the sector, set if the wrong sector calibration matrix was used";
CM_ SG_ 1170 DET_HVC_FLAG_073 "Core2 Vehicle clutter flag";
CM_ SG_ 1170 DET_CONFD_AZIMUTH_073 "Define the Confidence of Azimuth for Detection ";
CM_ SG_ 1170 DET_CONFD_ELEVATION_073 "Define the Confidence of Elevation for the Detection ";
CM_ SG_ 1170 DET_BI_STATIC_FLAG_074 "1 if detection is bi-static 0 otherwise";
CM_ SG_ 1170 DET_BI_STATIC_FLAG_075 "1 if detection is bi-static 0 otherwise";
CM_ SG_ 1170 DET_BI_STATIC_FLAG_076 "1 if detection is bi-static 0 otherwise";
CM_ SG_ 1170 DET_MH_SCAN_INDEX_4LSB_073_076 "Scan index of the measured detection";
CM_ SG_ 1170 DET_MH_CYCLE_COUNTER_073_076 "Detection Alive Counter";
CM_ SG_ 1171 DET_RANGE_077 " measured position  of the detection";
CM_ SG_ 1171 DET_RANGE_ERR_077 "RMSE or standard deviation of the measured angle  of the detection";
CM_ SG_ 1171 DET_RANGE_VELOCITY_077 "Radial velocity of the detection positive in direction to the sensor";
CM_ SG_ 1171 DET_RANGE_VELOCITY_ERR_077 "RMSE or standard deviation of the measure radial velocity of the detection";
CM_ SG_ 1171 DET_AZIMUTH_077 "Measured angle  of the detection";
CM_ SG_ 1171 DET_AZIMUTH_ERR_077 "RMSE or standard deviation of the measured angle  of the detection";
CM_ SG_ 1171 DET_ELEVATION_077 "measured elevation of the detection";
CM_ SG_ 1171 DET_ELEVATION_ERR_077 "RMSE or standard deviation of the measured elevation  of the detection";
CM_ SG_ 1171 DET_RCS_077 "Radar Cross Section or Amplitude, is a measure of how detectable an object is by radar. A larger RCS indicates that an object is more easily detected.";
CM_ SG_ 1171 DET_VALID_FLAG_077 "is set if the measured detection is valid";
CM_ SG_ 1171 DET_BI_STATIC_FLAG_077 "1 if detection is bi-static 0 otherwise";
CM_ SG_ 1171 DET_SUPER_RES_TARGET_077 "flasg is set if the detection is super resolution target";
CM_ SG_ 1171 DET_SNR_077 "The signal to noise ratio (SNR) of the radar detection";
CM_ SG_ 1171 DET_POINT_TARGET_PROB_077 "Describes the possibility if more than one real-world object has led to this detection. 0[%] := 100[%] Multi target probability";
CM_ SG_ 1171 DET_EXISTENCE_PROB_077 "Existence probability of the detection not based on history. Value does  not depend on any past experience with similar detections.
\note Use as confidence measure where a low value means less confidence
and a high value indicates strong confidence.";
CM_ SG_ 1171 DET_OUTSIDE_SECTOR_077 "Flag to indicate detections outside the sector, set if the wrong sector calibration matrix was used";
CM_ SG_ 1171 DET_HVC_FLAG_077 "Core2 Vehicle clutter flag";
CM_ SG_ 1171 DET_CONFD_AZIMUTH_077 "Define the Confidence of Azimuth for Detection ";
CM_ SG_ 1171 DET_CONFD_ELEVATION_077 "Define the Confidence of Elevation for the Detection ";
CM_ SG_ 1171 DET_BI_STATIC_FLAG_078 "1 if detection is bi-static 0 otherwise";
CM_ SG_ 1171 DET_BI_STATIC_FLAG_079 "1 if detection is bi-static 0 otherwise";
CM_ SG_ 1171 DET_BI_STATIC_FLAG_080 "1 if detection is bi-static 0 otherwise";
CM_ SG_ 1171 DET_MH_SCAN_INDEX_4LSB_077_080 "Scan index of the measured detection";
CM_ SG_ 1171 DET_MH_CYCLE_COUNTER_077_080 "Detection Alive Counter";
CM_ SG_ 1172 DET_RANGE_081 " measured position  of the detection";
CM_ SG_ 1172 DET_RANGE_ERR_081 "RMSE or standard deviation of the measured angle  of the detection";
CM_ SG_ 1172 DET_RANGE_VELOCITY_081 "Radial velocity of the detection positive in direction to the sensor";
CM_ SG_ 1172 DET_RANGE_VELOCITY_ERR_081 "RMSE or standard deviation of the measure radial velocity of the detection";
CM_ SG_ 1172 DET_AZIMUTH_081 "Measured angle  of the detection";
CM_ SG_ 1172 DET_AZIMUTH_ERR_081 "RMSE or standard deviation of the measured angle  of the detection";
CM_ SG_ 1172 DET_ELEVATION_081 "measured elevation of the detection";
CM_ SG_ 1172 DET_ELEVATION_ERR_081 "RMSE or standard deviation of the measured elevation  of the detection";
CM_ SG_ 1172 DET_RCS_081 "Radar Cross Section or Amplitude, is a measure of how detectable an object is by radar. A larger RCS indicates that an object is more easily detected.";
CM_ SG_ 1172 DET_VALID_FLAG_081 "is set if the measured detection is valid";
CM_ SG_ 1172 DET_BI_STATIC_FLAG_081 "1 if detection is bi-static 0 otherwise";
CM_ SG_ 1172 DET_SUPER_RES_TARGET_081 "flasg is set if the detection is super resolution target";
CM_ SG_ 1172 DET_SNR_081 "The signal to noise ratio (SNR) of the radar detection";
CM_ SG_ 1172 DET_POINT_TARGET_PROB_081 "Describes the possibility if more than one real-world object has led to this detection. 0[%] := 100[%] Multi target probability";
CM_ SG_ 1172 DET_EXISTENCE_PROB_081 "Existence probability of the detection not based on history. Value does  not depend on any past experience with similar detections.
\note Use as confidence measure where a low value means less confidence
and a high value indicates strong confidence.";
CM_ SG_ 1172 DET_OUTSIDE_SECTOR_081 "Flag to indicate detections outside the sector, set if the wrong sector calibration matrix was used";
CM_ SG_ 1172 DET_HVC_FLAG_081 "Core2 Vehicle clutter flag";
CM_ SG_ 1172 DET_CONFD_AZIMUTH_081 "Define the Confidence of Azimuth for Detection ";
CM_ SG_ 1172 DET_CONFD_ELEVATION_081 "Define the Confidence of Elevation for the Detection ";
CM_ SG_ 1172 DET_BI_STATIC_FLAG_082 "1 if detection is bi-static 0 otherwise";
CM_ SG_ 1172 DET_BI_STATIC_FLAG_083 "1 if detection is bi-static 0 otherwise";
CM_ SG_ 1172 DET_BI_STATIC_FLAG_084 "1 if detection is bi-static 0 otherwise";
CM_ SG_ 1172 DET_MH_SCAN_INDEX_4LSB_081_084 "Scan index of the measured detection";
CM_ SG_ 1172 DET_MH_CYCLE_COUNTER_081_084 "Detection Alive Counter";
CM_ SG_ 1173 DET_RANGE_085 " measured position  of the detection";
CM_ SG_ 1173 DET_RANGE_ERR_085 "RMSE or standard deviation of the measured angle  of the detection";
CM_ SG_ 1173 DET_RANGE_VELOCITY_085 "Radial velocity of the detection positive in direction to the sensor";
CM_ SG_ 1173 DET_RANGE_VELOCITY_ERR_085 "RMSE or standard deviation of the measure radial velocity of the detection";
CM_ SG_ 1173 DET_AZIMUTH_085 "Measured angle  of the detection";
CM_ SG_ 1173 DET_AZIMUTH_ERR_085 "RMSE or standard deviation of the measured angle  of the detection";
CM_ SG_ 1173 DET_ELEVATION_085 "measured elevation of the detection";
CM_ SG_ 1173 DET_ELEVATION_ERR_085 "RMSE or standard deviation of the measured elevation  of the detection";
CM_ SG_ 1173 DET_RCS_085 "Radar Cross Section or Amplitude, is a measure of how detectable an object is by radar. A larger RCS indicates that an object is more easily detected.";
CM_ SG_ 1173 DET_VALID_FLAG_085 "is set if the measured detection is valid";
CM_ SG_ 1173 DET_BI_STATIC_FLAG_085 "1 if detection is bi-static 0 otherwise";
CM_ SG_ 1173 DET_SUPER_RES_TARGET_085 "flasg is set if the detection is super resolution target";
CM_ SG_ 1173 DET_SNR_085 "The signal to noise ratio (SNR) of the radar detection";
CM_ SG_ 1173 DET_POINT_TARGET_PROB_085 "Describes the possibility if more than one real-world object has led to this detection. 0[%] := 100[%] Multi target probability";
CM_ SG_ 1173 DET_EXISTENCE_PROB_085 "Existence probability of the detection not based on history. Value does  not depend on any past experience with similar detections.
\note Use as confidence measure where a low value means less confidence
and a high value indicates strong confidence.";
CM_ SG_ 1173 DET_OUTSIDE_SECTOR_085 "Flag to indicate detections outside the sector, set if the wrong sector calibration matrix was used";
CM_ SG_ 1173 DET_HVC_FLAG_085 "Core2 Vehicle clutter flag";
CM_ SG_ 1173 DET_CONFD_AZIMUTH_085 "Define the Confidence of Azimuth for Detection ";
CM_ SG_ 1173 DET_CONFD_ELEVATION_085 "Define the Confidence of Elevation for the Detection ";
CM_ SG_ 1173 DET_BI_STATIC_FLAG_086 "1 if detection is bi-static 0 otherwise";
CM_ SG_ 1173 DET_BI_STATIC_FLAG_087 "1 if detection is bi-static 0 otherwise";
CM_ SG_ 1173 DET_BI_STATIC_FLAG_088 "1 if detection is bi-static 0 otherwise";
CM_ SG_ 1173 DET_MH_SCAN_INDEX_4LSB_085_088 "Scan index of the measured detection";
CM_ SG_ 1173 DET_MH_CYCLE_COUNTER_085_088 "Detection Alive Counter";
CM_ SG_ 1174 DET_RANGE_089 " measured position  of the detection";
CM_ SG_ 1174 DET_RANGE_ERR_089 "RMSE or standard deviation of the measured angle  of the detection";
CM_ SG_ 1174 DET_RANGE_VELOCITY_089 "Radial velocity of the detection positive in direction to the sensor";
CM_ SG_ 1174 DET_RANGE_VELOCITY_ERR_089 "RMSE or standard deviation of the measure radial velocity of the detection";
CM_ SG_ 1174 DET_AZIMUTH_089 "Measured angle  of the detection";
CM_ SG_ 1174 DET_AZIMUTH_ERR_089 "RMSE or standard deviation of the measured angle  of the detection";
CM_ SG_ 1174 DET_ELEVATION_089 "measured elevation of the detection";
CM_ SG_ 1174 DET_ELEVATION_ERR_089 "RMSE or standard deviation of the measured elevation  of the detection";
CM_ SG_ 1174 DET_RCS_089 "Radar Cross Section or Amplitude, is a measure of how detectable an object is by radar. A larger RCS indicates that an object is more easily detected.";
CM_ SG_ 1174 DET_VALID_FLAG_089 "is set if the measured detection is valid";
CM_ SG_ 1174 DET_BI_STATIC_FLAG_089 "1 if detection is bi-static 0 otherwise";
CM_ SG_ 1174 DET_SUPER_RES_TARGET_089 "flasg is set if the detection is super resolution target";
CM_ SG_ 1174 DET_SNR_089 "The signal to noise ratio (SNR) of the radar detection";
CM_ SG_ 1174 DET_POINT_TARGET_PROB_089 "Describes the possibility if more than one real-world object has led to this detection. 0[%] := 100[%] Multi target probability";
CM_ SG_ 1174 DET_EXISTENCE_PROB_089 "Existence probability of the detection not based on history. Value does  not depend on any past experience with similar detections.
\note Use as confidence measure where a low value means less confidence
and a high value indicates strong confidence.";
CM_ SG_ 1174 DET_OUTSIDE_SECTOR_089 "Flag to indicate detections outside the sector, set if the wrong sector calibration matrix was used";
CM_ SG_ 1174 DET_HVC_FLAG_089 "Core2 Vehicle clutter flag";
CM_ SG_ 1174 DET_CONFD_AZIMUTH_089 "Define the Confidence of Azimuth for Detection ";
CM_ SG_ 1174 DET_CONFD_ELEVATION_089 "Define the Confidence of Elevation for the Detection ";
CM_ SG_ 1174 DET_BI_STATIC_FLAG_090 "1 if detection is bi-static 0 otherwise";
CM_ SG_ 1174 DET_BI_STATIC_FLAG_091 "1 if detection is bi-static 0 otherwise";
CM_ SG_ 1174 DET_BI_STATIC_FLAG_092 "1 if detection is bi-static 0 otherwise";
CM_ SG_ 1174 DET_MH_SCAN_INDEX_4LSB_089_092 "Scan index of the measured detection";
CM_ SG_ 1174 DET_MH_CYCLE_COUNTER_089_092 "Detection Alive Counter";
CM_ SG_ 1175 DET_RANGE_093 " measured position  of the detection";
CM_ SG_ 1175 DET_RANGE_ERR_093 "RMSE or standard deviation of the measured angle  of the detection";
CM_ SG_ 1175 DET_RANGE_VELOCITY_093 "Radial velocity of the detection positive in direction to the sensor";
CM_ SG_ 1175 DET_RANGE_VELOCITY_ERR_093 "RMSE or standard deviation of the measure radial velocity of the detection";
CM_ SG_ 1175 DET_AZIMUTH_093 "Measured angle  of the detection";
CM_ SG_ 1175 DET_AZIMUTH_ERR_093 "RMSE or standard deviation of the measured angle  of the detection";
CM_ SG_ 1175 DET_ELEVATION_093 "measured elevation of the detection";
CM_ SG_ 1175 DET_ELEVATION_ERR_093 "RMSE or standard deviation of the measured elevation  of the detection";
CM_ SG_ 1175 DET_RCS_093 "Radar Cross Section or Amplitude, is a measure of how detectable an object is by radar. A larger RCS indicates that an object is more easily detected.";
CM_ SG_ 1175 DET_VALID_FLAG_093 "is set if the measured detection is valid";
CM_ SG_ 1175 DET_BI_STATIC_FLAG_093 "1 if detection is bi-static 0 otherwise";
CM_ SG_ 1175 DET_SUPER_RES_TARGET_093 "flasg is set if the detection is super resolution target";
CM_ SG_ 1175 DET_SNR_093 "The signal to noise ratio (SNR) of the radar detection";
CM_ SG_ 1175 DET_POINT_TARGET_PROB_093 "Describes the possibility if more than one real-world object has led to this detection. 0[%] := 100[%] Multi target probability";
CM_ SG_ 1175 DET_EXISTENCE_PROB_093 "Existence probability of the detection not based on history. Value does  not depend on any past experience with similar detections.
\note Use as confidence measure where a low value means less confidence
and a high value indicates strong confidence.";
CM_ SG_ 1175 DET_OUTSIDE_SECTOR_093 "Flag to indicate detections outside the sector, set if the wrong sector calibration matrix was used";
CM_ SG_ 1175 DET_HVC_FLAG_093 "Core2 Vehicle clutter flag";
CM_ SG_ 1175 DET_CONFD_AZIMUTH_093 "Define the Confidence of Azimuth for Detection ";
CM_ SG_ 1175 DET_CONFD_ELEVATION_093 "Define the Confidence of Elevation for the Detection ";
CM_ SG_ 1175 DET_BI_STATIC_FLAG_094 "1 if detection is bi-static 0 otherwise";
CM_ SG_ 1175 DET_BI_STATIC_FLAG_095 "1 if detection is bi-static 0 otherwise";
CM_ SG_ 1175 DET_BI_STATIC_FLAG_096 "1 if detection is bi-static 0 otherwise";
CM_ SG_ 1175 DET_MH_SCAN_INDEX_4LSB_093_096 "Scan index of the measured detection";
CM_ SG_ 1175 DET_MH_CYCLE_COUNTER_093_096 "Detection Alive Counter";
CM_ SG_ 1176 DET_RANGE_097 " measured position  of the detection";
CM_ SG_ 1176 DET_RANGE_ERR_097 "RMSE or standard deviation of the measured angle  of the detection";
CM_ SG_ 1176 DET_RANGE_VELOCITY_097 "Radial velocity of the detection positive in direction to the sensor";
CM_ SG_ 1176 DET_RANGE_VELOCITY_ERR_097 "RMSE or standard deviation of the measure radial velocity of the detection";
CM_ SG_ 1176 DET_AZIMUTH_097 "Measured angle  of the detection";
CM_ SG_ 1176 DET_AZIMUTH_ERR_097 "RMSE or standard deviation of the measured angle  of the detection";
CM_ SG_ 1176 DET_ELEVATION_097 "measured elevation of the detection";
CM_ SG_ 1176 DET_ELEVATION_ERR_097 "RMSE or standard deviation of the measured elevation  of the detection";
CM_ SG_ 1176 DET_RCS_097 "Radar Cross Section or Amplitude, is a measure of how detectable an object is by radar. A larger RCS indicates that an object is more easily detected.";
CM_ SG_ 1176 DET_VALID_FLAG_097 "is set if the measured detection is valid";
CM_ SG_ 1176 DET_BI_STATIC_FLAG_097 "1 if detection is bi-static 0 otherwise";
CM_ SG_ 1176 DET_SUPER_RES_TARGET_097 "flasg is set if the detection is super resolution target";
CM_ SG_ 1176 DET_SNR_097 "The signal to noise ratio (SNR) of the radar detection";
CM_ SG_ 1176 DET_POINT_TARGET_PROB_097 "Describes the possibility if more than one real-world object has led to this detection. 0[%] := 100[%] Multi target probability";
CM_ SG_ 1176 DET_EXISTENCE_PROB_097 "Existence probability of the detection not based on history. Value does  not depend on any past experience with similar detections.
\note Use as confidence measure where a low value means less confidence
and a high value indicates strong confidence.";
CM_ SG_ 1176 DET_OUTSIDE_SECTOR_097 "Flag to indicate detections outside the sector, set if the wrong sector calibration matrix was used";
CM_ SG_ 1176 DET_HVC_FLAG_097 "Core2 Vehicle clutter flag";
CM_ SG_ 1176 DET_CONFD_AZIMUTH_097 "Define the Confidence of Azimuth for Detection ";
CM_ SG_ 1176 DET_CONFD_ELEVATION_097 "Define the Confidence of Elevation for the Detection ";
CM_ SG_ 1176 DET_BI_STATIC_FLAG_098 "1 if detection is bi-static 0 otherwise";
CM_ SG_ 1176 DET_BI_STATIC_FLAG_099 "1 if detection is bi-static 0 otherwise";
CM_ SG_ 1176 DET_BI_STATIC_FLAG_100 "1 if detection is bi-static 0 otherwise";
CM_ SG_ 1176 DET_MH_SCAN_INDEX_4LSB_097_100 "Scan index of the measured detection";
CM_ SG_ 1176 DET_MH_CYCLE_COUNTER_097_100 "Detection Alive Counter";
CM_ SG_ 1177 DET_RANGE_101 " measured position  of the detection";
CM_ SG_ 1177 DET_RANGE_ERR_101 "RMSE or standard deviation of the measured angle  of the detection";
CM_ SG_ 1177 DET_RANGE_VELOCITY_101 "Radial velocity of the detection positive in direction to the sensor";
CM_ SG_ 1177 DET_RANGE_VELOCITY_ERR_101 "RMSE or standard deviation of the measure radial velocity of the detection";
CM_ SG_ 1177 DET_AZIMUTH_101 "Measured angle  of the detection";
CM_ SG_ 1177 DET_AZIMUTH_ERR_101 "RMSE or standard deviation of the measured angle  of the detection";
CM_ SG_ 1177 DET_ELEVATION_101 "measured elevation of the detection";
CM_ SG_ 1177 DET_ELEVATION_ERR_101 "RMSE or standard deviation of the measured elevation  of the detection";
CM_ SG_ 1177 DET_RCS_101 "Radar Cross Section or Amplitude, is a measure of how detectable an object is by radar. A larger RCS indicates that an object is more easily detected.";
CM_ SG_ 1177 DET_VALID_FLAG_101 "is set if the measured detection is valid";
CM_ SG_ 1177 DET_BI_STATIC_FLAG_101 "1 if detection is bi-static 0 otherwise";
CM_ SG_ 1177 DET_SUPER_RES_TARGET_101 "flasg is set if the detection is super resolution target";
CM_ SG_ 1177 DET_SNR_101 "The signal to noise ratio (SNR) of the radar detection";
CM_ SG_ 1177 DET_POINT_TARGET_PROB_101 "Describes the possibility if more than one real-world object has led to this detection. 0[%] := 100[%] Multi target probability";
CM_ SG_ 1177 DET_EXISTENCE_PROB_101 "Existence probability of the detection not based on history. Value does  not depend on any past experience with similar detections.
\note Use as confidence measure where a low value means less confidence
and a high value indicates strong confidence.";
CM_ SG_ 1177 DET_OUTSIDE_SECTOR_101 "Flag to indicate detections outside the sector, set if the wrong sector calibration matrix was used";
CM_ SG_ 1177 DET_HVC_FLAG_101 "Core2 Vehicle clutter flag";
CM_ SG_ 1177 DET_CONFD_AZIMUTH_101 "Define the Confidence of Azimuth for Detection ";
CM_ SG_ 1177 DET_CONFD_ELEVATION_101 "Define the Confidence of Elevation for the Detection ";
CM_ SG_ 1177 DET_BI_STATIC_FLAG_102 "1 if detection is bi-static 0 otherwise";
CM_ SG_ 1177 DET_BI_STATIC_FLAG_103 "1 if detection is bi-static 0 otherwise";
CM_ SG_ 1177 DET_BI_STATIC_FLAG_104 "1 if detection is bi-static 0 otherwise";
CM_ SG_ 1177 DET_MH_SCAN_INDEX_4LSB_101_104 "Scan index of the measured detection";
CM_ SG_ 1177 DET_MH_CYCLE_COUNTER_101_104 "Detection Alive Counter";
CM_ SG_ 1178 DET_RANGE_105 " measured position  of the detection";
CM_ SG_ 1178 DET_RANGE_ERR_105 "RMSE or standard deviation of the measured angle  of the detection";
CM_ SG_ 1178 DET_RANGE_VELOCITY_105 "Radial velocity of the detection positive in direction to the sensor";
CM_ SG_ 1178 DET_RANGE_VELOCITY_ERR_105 "RMSE or standard deviation of the measure radial velocity of the detection";
CM_ SG_ 1178 DET_AZIMUTH_105 "Measured angle  of the detection";
CM_ SG_ 1178 DET_AZIMUTH_ERR_105 "RMSE or standard deviation of the measured angle  of the detection";
CM_ SG_ 1178 DET_ELEVATION_105 "measured elevation of the detection";
CM_ SG_ 1178 DET_ELEVATION_ERR_105 "RMSE or standard deviation of the measured elevation  of the detection";
CM_ SG_ 1178 DET_RCS_105 "Radar Cross Section or Amplitude, is a measure of how detectable an object is by radar. A larger RCS indicates that an object is more easily detected.";
CM_ SG_ 1178 DET_VALID_FLAG_105 "is set if the measured detection is valid";
CM_ SG_ 1178 DET_BI_STATIC_FLAG_105 "1 if detection is bi-static 0 otherwise";
CM_ SG_ 1178 DET_SUPER_RES_TARGET_105 "flasg is set if the detection is super resolution target";
CM_ SG_ 1178 DET_SNR_105 "The signal to noise ratio (SNR) of the radar detection";
CM_ SG_ 1178 DET_POINT_TARGET_PROB_105 "Describes the possibility if more than one real-world object has led to this detection. 0[%] := 100[%] Multi target probability";
CM_ SG_ 1178 DET_EXISTENCE_PROB_105 "Existence probability of the detection not based on history. Value does  not depend on any past experience with similar detections.
\note Use as confidence measure where a low value means less confidence
and a high value indicates strong confidence.";
CM_ SG_ 1178 DET_OUTSIDE_SECTOR_105 "Flag to indicate detections outside the sector, set if the wrong sector calibration matrix was used";
CM_ SG_ 1178 DET_HVC_FLAG_105 "Core2 Vehicle clutter flag";
CM_ SG_ 1178 DET_CONFD_AZIMUTH_105 "Define the Confidence of Azimuth for Detection ";
CM_ SG_ 1178 DET_CONFD_ELEVATION_105 "Define the Confidence of Elevation for the Detection ";
CM_ SG_ 1178 DET_BI_STATIC_FLAG_106 "1 if detection is bi-static 0 otherwise";
CM_ SG_ 1178 DET_BI_STATIC_FLAG_107 "1 if detection is bi-static 0 otherwise";
CM_ SG_ 1178 DET_BI_STATIC_FLAG_108 "1 if detection is bi-static 0 otherwise";
CM_ SG_ 1178 DET_MH_SCAN_INDEX_4LSB_105_108 "Scan index of the measured detection";
CM_ SG_ 1178 DET_MH_CYCLE_COUNTER_105_108 "Detection Alive Counter";
CM_ SG_ 1179 DET_RANGE_109 " measured position  of the detection";
CM_ SG_ 1179 DET_RANGE_ERR_109 "RMSE or standard deviation of the measured angle  of the detection";
CM_ SG_ 1179 DET_RANGE_VELOCITY_109 "Radial velocity of the detection positive in direction to the sensor";
CM_ SG_ 1179 DET_RANGE_VELOCITY_ERR_109 "RMSE or standard deviation of the measure radial velocity of the detection";
CM_ SG_ 1179 DET_AZIMUTH_109 "Measured angle  of the detection";
CM_ SG_ 1179 DET_AZIMUTH_ERR_109 "RMSE or standard deviation of the measured angle  of the detection";
CM_ SG_ 1179 DET_ELEVATION_109 "measured elevation of the detection";
CM_ SG_ 1179 DET_ELEVATION_ERR_109 "RMSE or standard deviation of the measured elevation  of the detection";
CM_ SG_ 1179 DET_RCS_109 "Radar Cross Section or Amplitude, is a measure of how detectable an object is by radar. A larger RCS indicates that an object is more easily detected.";
CM_ SG_ 1179 DET_VALID_FLAG_109 "is set if the measured detection is valid";
CM_ SG_ 1179 DET_BI_STATIC_FLAG_109 "1 if detection is bi-static 0 otherwise";
CM_ SG_ 1179 DET_SUPER_RES_TARGET_109 "flasg is set if the detection is super resolution target";
CM_ SG_ 1179 DET_SNR_109 "The signal to noise ratio (SNR) of the radar detection";
CM_ SG_ 1179 DET_POINT_TARGET_PROB_109 "Describes the possibility if more than one real-world object has led to this detection. 0[%] := 100[%] Multi target probability";
CM_ SG_ 1179 DET_EXISTENCE_PROB_109 "Existence probability of the detection not based on history. Value does  not depend on any past experience with similar detections.
\note Use as confidence measure where a low value means less confidence
and a high value indicates strong confidence.";
CM_ SG_ 1179 DET_OUTSIDE_SECTOR_109 "Flag to indicate detections outside the sector, set if the wrong sector calibration matrix was used";
CM_ SG_ 1179 DET_HVC_FLAG_109 "Core2 Vehicle clutter flag";
CM_ SG_ 1179 DET_CONFD_AZIMUTH_109 "Define the Confidence of Azimuth for Detection ";
CM_ SG_ 1179 DET_CONFD_ELEVATION_109 "Define the Confidence of Elevation for the Detection ";
CM_ SG_ 1179 DET_BI_STATIC_FLAG_110 "1 if detection is bi-static 0 otherwise";
CM_ SG_ 1179 DET_BI_STATIC_FLAG_111 "1 if detection is bi-static 0 otherwise";
CM_ SG_ 1179 DET_BI_STATIC_FLAG_112 "1 if detection is bi-static 0 otherwise";
CM_ SG_ 1179 DET_MH_SCAN_INDEX_4LSB_109_112 "Scan index of the measured detection";
CM_ SG_ 1179 DET_MH_CYCLE_COUNTER_109_112 "Detection Alive Counter";
CM_ SG_ 1180 DET_RANGE_113 " measured position  of the detection";
CM_ SG_ 1180 DET_RANGE_ERR_113 "RMSE or standard deviation of the measured angle  of the detection";
CM_ SG_ 1180 DET_RANGE_VELOCITY_113 "Radial velocity of the detection positive in direction to the sensor";
CM_ SG_ 1180 DET_RANGE_VELOCITY_ERR_113 "RMSE or standard deviation of the measure radial velocity of the detection";
CM_ SG_ 1180 DET_AZIMUTH_113 "Measured angle  of the detection";
CM_ SG_ 1180 DET_AZIMUTH_ERR_113 "RMSE or standard deviation of the measured angle  of the detection";
CM_ SG_ 1180 DET_ELEVATION_113 "measured elevation of the detection";
CM_ SG_ 1180 DET_ELEVATION_ERR_113 "RMSE or standard deviation of the measured elevation  of the detection";
CM_ SG_ 1180 DET_RCS_113 "Radar Cross Section or Amplitude, is a measure of how detectable an object is by radar. A larger RCS indicates that an object is more easily detected.";
CM_ SG_ 1180 DET_VALID_FLAG_113 "is set if the measured detection is valid";
CM_ SG_ 1180 DET_BI_STATIC_FLAG_113 "1 if detection is bi-static 0 otherwise";
CM_ SG_ 1180 DET_SUPER_RES_TARGET_113 "flasg is set if the detection is super resolution target";
CM_ SG_ 1180 DET_SNR_113 "The signal to noise ratio (SNR) of the radar detection";
CM_ SG_ 1180 DET_POINT_TARGET_PROB_113 "Describes the possibility if more than one real-world object has led to this detection. 0[%] := 100[%] Multi target probability";
CM_ SG_ 1180 DET_EXISTENCE_PROB_113 "Existence probability of the detection not based on history. Value does  not depend on any past experience with similar detections.
\note Use as confidence measure where a low value means less confidence
and a high value indicates strong confidence.";
CM_ SG_ 1180 DET_OUTSIDE_SECTOR_113 "Flag to indicate detections outside the sector, set if the wrong sector calibration matrix was used";
CM_ SG_ 1180 DET_HVC_FLAG_113 "Core2 Vehicle clutter flag";
CM_ SG_ 1180 DET_CONFD_AZIMUTH_113 "Define the Confidence of Azimuth for Detection ";
CM_ SG_ 1180 DET_CONFD_ELEVATION_113 "Define the Confidence of Elevation for the Detection ";
CM_ SG_ 1180 DET_BI_STATIC_FLAG_114 "1 if detection is bi-static 0 otherwise";
CM_ SG_ 1180 DET_BI_STATIC_FLAG_115 "1 if detection is bi-static 0 otherwise";
CM_ SG_ 1180 DET_BI_STATIC_FLAG_116 "1 if detection is bi-static 0 otherwise";
CM_ SG_ 1180 DET_MH_SCAN_INDEX_4LSB_113_116 "Scan index of the measured detection";
CM_ SG_ 1180 DET_MH_CYCLE_COUNTER_113_116 "Detection Alive Counter";
BA_DEF_ BO_  "CanTpBs" INT 0 255;
BA_DEF_ BO_  "DiagRequest" ENUM  "No","Yes";
BA_DEF_ BO_  "DiagResponse" ENUM  "No","Yes";
BA_DEF_ BO_  "E2EDataId" INT 0 65535;
BA_DEF_ BO_  "E2EDataLength" INT 0 65535;
BA_DEF_ BO_  "E2EProfile" STRING ;
BA_DEF_ BO_  "EventRateOfChange" INT 10 10000;
BA_DEF_ BO_  "GenMsgCycleTime" INT 0 100000;
BA_DEF_ BO_  "GenMsgILSupport" ENUM  "No","Yes";
BA_DEF_ BO_  "GenMsgNrOfRepetition" INT 0 100;
BA_DEF_ BO_  "GenMsgSendType" ENUM  "FixedPeriodic","Event","EnabledPeriodic","NotUsed","NotUsed","EventPeriodic","NotUsed","NotUsed","NoMsgSendType";
BA_DEF_ BO_  "NetworkInitialization" ENUM  "No","Yes";
BA_DEF_ BO_  "NmAsrMessage" ENUM  "No","Yes";
BA_DEF_ BO_  "NmMessage" ENUM  "No","Yes";
BA_DEF_ BO_  "SCP_AuthInfoTxLength" INT 0 512;
BA_DEF_ BO_  "SCP_DataId" INT 0 65535;
BA_DEF_ BO_  "SCP_FreshnessValueId" INT 0 65535;
BA_DEF_ BO_  "SCP_FreshnessValueLength" INT 0 512;
BA_DEF_ BO_  "SCP_FreshnessValueTxLength" INT 0 512;
BA_DEF_ BO_  "SC_Message" ENUM  "No","Yes","Yes, split message";
BA_DEF_ BO_  "TpTxIndex" INT 0 255;
BA_DEF_ BO_  "VFrameFormat" ENUM  "StandardCAN","ExtendedCAN","reserved","reserved","reserved","reserved","reserved","reserved","reserved","reserved","reserved","reserved","reserved","reserved","StandardCAN_FD","ExtendedCAN_FD";
BA_DEF_ SG_  "GenSigCmt" STRING ;
BA_DEF_ SG_  "GenSigCycleTime" INT 0 0;
BA_DEF_ SG_  "GenSigSendType" ENUM  "Cyclic","OnWrite","vector_leerstring","OnChange","vector_leerstring","IfActive","vector_leerstring","NoSigSendType";
BA_DEF_ SG_  "GenSigStartValue" INT 0 1000000000;
BA_DEF_ SG_  "GenSigTimeoutTime" INT 0 0;
BA_DEF_ SG_  "GenSigVtEn" STRING ;
BA_DEF_ SG_  "GenSigVtName" STRING ;
BA_DEF_ SG_  "InvalidValue" STRING ;
BA_DEF_DEF_  "CanTpBs" 255;
BA_DEF_DEF_  "DiagRequest" "No";
BA_DEF_DEF_  "DiagResponse" "No";
BA_DEF_DEF_  "E2EDataId" 0;
BA_DEF_DEF_  "E2EDataLength" 0;
BA_DEF_DEF_  "E2EProfile" "";
BA_DEF_DEF_  "EventRateOfChange" 10000;
BA_DEF_DEF_  "GenMsgCycleTime" 0;
BA_DEF_DEF_  "GenMsgILSupport" "Yes";
BA_DEF_DEF_  "GenMsgNrOfRepetition" 0;
BA_DEF_DEF_  "GenMsgSendType" "NoMsgSendType";
BA_DEF_DEF_  "NetworkInitialization" "Yes";
BA_DEF_DEF_  "NmAsrMessage" "No";
BA_DEF_DEF_  "NmMessage" "No";
BA_DEF_DEF_  "SCP_AuthInfoTxLength" 28;
BA_DEF_DEF_  "SCP_DataId" 0;
BA_DEF_DEF_  "SCP_FreshnessValueId" 0;
BA_DEF_DEF_  "SCP_FreshnessValueLength" 48;
BA_DEF_DEF_  "SCP_FreshnessValueTxLength" 4;
BA_DEF_DEF_  "SC_Message" "No";
BA_DEF_DEF_  "TpTxIndex" 0;
BA_DEF_DEF_  "VFrameFormat" "StandardCAN_FD";
BA_DEF_DEF_  "GenSigCmt" "";
BA_DEF_DEF_  "GenSigCycleTime" 0;
BA_DEF_DEF_  "GenSigSendType" "NoSigSendType";
BA_DEF_DEF_  "GenSigStartValue" 0;
BA_DEF_DEF_  "GenSigTimeoutTime" 0;
BA_DEF_DEF_  "GenSigVtEn" "";
BA_DEF_DEF_  "GenSigVtName" "";
BA_DEF_DEF_  "InvalidValue" "";
BA_ "GenMsgSendType" BO_ 1163 1;
BA_ "GenMsgSendType" BO_ 1164 1;
BA_ "GenMsgSendType" BO_ 1165 1;
BA_ "GenMsgSendType" BO_ 1166 1;
BA_ "GenMsgSendType" BO_ 1167 1;
BA_ "GenMsgSendType" BO_ 1168 1;
BA_ "GenMsgSendType" BO_ 1169 1;
BA_ "GenMsgSendType" BO_ 1170 1;
BA_ "GenMsgSendType" BO_ 1171 1;
BA_ "GenMsgSendType" BO_ 1172 1;
BA_ "GenMsgSendType" BO_ 1173 1;
BA_ "GenMsgSendType" BO_ 1174 1;
BA_ "GenMsgSendType" BO_ 1175 1;
BA_ "GenMsgSendType" BO_ 1176 1;
BA_ "GenMsgSendType" BO_ 1177 1;
BA_ "GenMsgSendType" BO_ 1178 1;
BA_ "GenMsgSendType" BO_ 1179 1;
BA_ "GenMsgSendType" BO_ 1180 1;
BA_ "GenSigStartValue" SG_ 1163 DET_RANGE_VELOCITY_045 16384;
BA_ "GenSigStartValue" SG_ 1163 DET_RCS_045 128;
BA_ "GenSigStartValue" SG_ 1163 DET_RANGE_VELOCITY_046 16384;
BA_ "GenSigStartValue" SG_ 1163 DET_RCS_046 128;
BA_ "GenSigStartValue" SG_ 1163 DET_RANGE_VELOCITY_047 16384;
BA_ "GenSigStartValue" SG_ 1163 DET_RCS_047 128;
BA_ "GenSigStartValue" SG_ 1163 DET_RANGE_VELOCITY_048 16384;
BA_ "GenSigStartValue" SG_ 1163 DET_RCS_048 128;
BA_ "GenSigStartValue" SG_ 1164 DET_RANGE_VELOCITY_049 16384;
BA_ "GenSigStartValue" SG_ 1164 DET_RCS_049 128;
BA_ "GenSigStartValue" SG_ 1164 DET_RANGE_VELOCITY_050 16384;
BA_ "GenSigStartValue" SG_ 1164 DET_RCS_050 128;
BA_ "GenSigStartValue" SG_ 1164 DET_RANGE_VELOCITY_051 16384;
BA_ "GenSigStartValue" SG_ 1164 DET_RCS_051 128;
BA_ "GenSigStartValue" SG_ 1164 DET_RANGE_VELOCITY_052 16384;
BA_ "GenSigStartValue" SG_ 1164 DET_RCS_052 128;
BA_ "GenSigStartValue" SG_ 1165 DET_RANGE_VELOCITY_053 16384;
BA_ "GenSigStartValue" SG_ 1165 DET_RCS_053 128;
BA_ "GenSigStartValue" SG_ 1165 DET_RANGE_VELOCITY_054 16384;
BA_ "GenSigStartValue" SG_ 1165 DET_RCS_054 128;
BA_ "GenSigStartValue" SG_ 1165 DET_RANGE_VELOCITY_055 16384;
BA_ "GenSigStartValue" SG_ 1165 DET_RCS_055 128;
BA_ "GenSigStartValue" SG_ 1165 DET_RANGE_VELOCITY_056 16384;
BA_ "GenSigStartValue" SG_ 1165 DET_RCS_056 128;
BA_ "GenSigStartValue" SG_ 1166 DET_RANGE_VELOCITY_057 16384;
BA_ "GenSigStartValue" SG_ 1166 DET_RCS_057 128;
BA_ "GenSigStartValue" SG_ 1166 DET_RANGE_VELOCITY_058 16384;
BA_ "GenSigStartValue" SG_ 1166 DET_RCS_058 128;
BA_ "GenSigStartValue" SG_ 1166 DET_RANGE_VELOCITY_059 16384;
BA_ "GenSigStartValue" SG_ 1166 DET_RCS_059 128;
BA_ "GenSigStartValue" SG_ 1166 DET_RANGE_VELOCITY_060 16384;
BA_ "GenSigStartValue" SG_ 1166 DET_RCS_060 128;
BA_ "GenSigStartValue" SG_ 1167 DET_RANGE_VELOCITY_061 16384;
BA_ "GenSigStartValue" SG_ 1167 DET_RCS_061 128;
BA_ "GenSigStartValue" SG_ 1167 DET_RANGE_VELOCITY_062 16384;
BA_ "GenSigStartValue" SG_ 1167 DET_RCS_062 128;
BA_ "GenSigStartValue" SG_ 1167 DET_RANGE_VELOCITY_063 16384;
BA_ "GenSigStartValue" SG_ 1167 DET_RCS_063 128;
BA_ "GenSigStartValue" SG_ 1167 DET_RANGE_VELOCITY_064 16384;
BA_ "GenSigStartValue" SG_ 1167 DET_RCS_064 128;
BA_ "GenSigStartValue" SG_ 1168 DET_RANGE_VELOCITY_065 16384;
BA_ "GenSigStartValue" SG_ 1168 DET_RCS_065 128;
BA_ "GenSigStartValue" SG_ 1168 DET_RANGE_VELOCITY_066 16384;
BA_ "GenSigStartValue" SG_ 1168 DET_RCS_066 128;
BA_ "GenSigStartValue" SG_ 1168 DET_RANGE_VELOCITY_067 16384;
BA_ "GenSigStartValue" SG_ 1168 DET_RCS_067 128;
BA_ "GenSigStartValue" SG_ 1168 DET_RANGE_VELOCITY_068 16384;
BA_ "GenSigStartValue" SG_ 1168 DET_RCS_068 128;
BA_ "GenSigStartValue" SG_ 1169 DET_RANGE_VELOCITY_069 16384;
BA_ "GenSigStartValue" SG_ 1169 DET_RCS_069 128;
BA_ "GenSigStartValue" SG_ 1169 DET_RANGE_VELOCITY_070 16384;
BA_ "GenSigStartValue" SG_ 1169 DET_RCS_070 128;
BA_ "GenSigStartValue" SG_ 1169 DET_RANGE_VELOCITY_071 16384;
BA_ "GenSigStartValue" SG_ 1169 DET_RCS_071 128;
BA_ "GenSigStartValue" SG_ 1169 DET_RANGE_VELOCITY_072 16384;
BA_ "GenSigStartValue" SG_ 1169 DET_RCS_072 128;
BA_ "GenSigStartValue" SG_ 1170 DET_RANGE_VELOCITY_073 16384;
BA_ "GenSigStartValue" SG_ 1170 DET_RCS_073 128;
BA_ "GenSigStartValue" SG_ 1170 DET_RANGE_VELOCITY_074 16384;
BA_ "GenSigStartValue" SG_ 1170 DET_RCS_074 128;
BA_ "GenSigStartValue" SG_ 1170 DET_RANGE_VELOCITY_075 16384;
BA_ "GenSigStartValue" SG_ 1170 DET_RCS_075 128;
BA_ "GenSigStartValue" SG_ 1170 DET_RANGE_VELOCITY_076 16384;
BA_ "GenSigStartValue" SG_ 1170 DET_RCS_076 128;
BA_ "GenSigStartValue" SG_ 1171 DET_RANGE_VELOCITY_077 16384;
BA_ "GenSigStartValue" SG_ 1171 DET_RCS_077 128;
BA_ "GenSigStartValue" SG_ 1171 DET_RANGE_VELOCITY_078 16384;
BA_ "GenSigStartValue" SG_ 1171 DET_RCS_078 128;
BA_ "GenSigStartValue" SG_ 1171 DET_RANGE_VELOCITY_079 16384;
BA_ "GenSigStartValue" SG_ 1171 DET_RCS_079 128;
BA_ "GenSigStartValue" SG_ 1171 DET_RANGE_VELOCITY_080 16384;
BA_ "GenSigStartValue" SG_ 1171 DET_RCS_080 128;
BA_ "GenSigStartValue" SG_ 1172 DET_RANGE_VELOCITY_081 16384;
BA_ "GenSigStartValue" SG_ 1172 DET_RCS_081 128;
BA_ "GenSigStartValue" SG_ 1172 DET_RANGE_VELOCITY_082 16384;
BA_ "GenSigStartValue" SG_ 1172 DET_RCS_082 128;
BA_ "GenSigStartValue" SG_ 1172 DET_RANGE_VELOCITY_083 16384;
BA_ "GenSigStartValue" SG_ 1172 DET_RCS_083 128;
BA_ "GenSigStartValue" SG_ 1172 DET_RANGE_VELOCITY_084 16384;
BA_ "GenSigStartValue" SG_ 1172 DET_RCS_084 128;
BA_ "GenSigStartValue" SG_ 1173 DET_RANGE_VELOCITY_085 16384;
BA_ "GenSigStartValue" SG_ 1173 DET_RCS_085 128;
BA_ "GenSigStartValue" SG_ 1173 DET_RANGE_VELOCITY_086 16384;
BA_ "GenSigStartValue" SG_ 1173 DET_RCS_086 128;
BA_ "GenSigStartValue" SG_ 1173 DET_RANGE_VELOCITY_087 16384;
BA_ "GenSigStartValue" SG_ 1173 DET_RCS_087 128;
BA_ "GenSigStartValue" SG_ 1173 DET_RANGE_VELOCITY_088 16384;
BA_ "GenSigStartValue" SG_ 1173 DET_RCS_088 128;
BA_ "GenSigStartValue" SG_ 1174 DET_RANGE_VELOCITY_089 16384;
BA_ "GenSigStartValue" SG_ 1174 DET_RCS_089 128;
BA_ "GenSigStartValue" SG_ 1174 DET_RANGE_VELOCITY_090 16384;
BA_ "GenSigStartValue" SG_ 1174 DET_RCS_090 128;
BA_ "GenSigStartValue" SG_ 1174 DET_RANGE_VELOCITY_091 16384;
BA_ "GenSigStartValue" SG_ 1174 DET_RCS_091 128;
BA_ "GenSigStartValue" SG_ 1174 DET_RANGE_VELOCITY_092 16384;
BA_ "GenSigStartValue" SG_ 1174 DET_RCS_092 128;
BA_ "GenSigStartValue" SG_ 1175 DET_RANGE_VELOCITY_093 16384;
BA_ "GenSigStartValue" SG_ 1175 DET_RCS_093 128;
BA_ "GenSigStartValue" SG_ 1175 DET_RANGE_VELOCITY_094 16384;
BA_ "GenSigStartValue" SG_ 1175 DET_RCS_094 128;
BA_ "GenSigStartValue" SG_ 1175 DET_RANGE_VELOCITY_095 16384;
BA_ "GenSigStartValue" SG_ 1175 DET_RCS_095 128;
BA_ "GenSigStartValue" SG_ 1175 DET_RANGE_VELOCITY_096 16384;
BA_ "GenSigStartValue" SG_ 1175 DET_RCS_096 128;
BA_ "GenSigStartValue" SG_ 1176 DET_RANGE_VELOCITY_097 16384;
BA_ "GenSigStartValue" SG_ 1176 DET_RCS_097 128;
BA_ "GenSigStartValue" SG_ 1176 DET_RANGE_VELOCITY_098 16384;
BA_ "GenSigStartValue" SG_ 1176 DET_RCS_098 128;
BA_ "GenSigStartValue" SG_ 1176 DET_RANGE_VELOCITY_099 16384;
BA_ "GenSigStartValue" SG_ 1176 DET_RCS_099 128;
BA_ "GenSigStartValue" SG_ 1176 DET_RANGE_VELOCITY_100 16384;
BA_ "GenSigStartValue" SG_ 1176 DET_RCS_100 128;
BA_ "GenSigStartValue" SG_ 1177 DET_RANGE_VELOCITY_101 16384;
BA_ "GenSigStartValue" SG_ 1177 DET_RCS_101 128;
BA_ "GenSigStartValue" SG_ 1177 DET_RANGE_VELOCITY_102 16384;
BA_ "GenSigStartValue" SG_ 1177 DET_RCS_102 128;
BA_ "GenSigStartValue" SG_ 1177 DET_RANGE_VELOCITY_103 16384;
BA_ "GenSigStartValue" SG_ 1177 DET_RCS_103 128;
BA_ "GenSigStartValue" SG_ 1177 DET_RANGE_VELOCITY_104 16384;
BA_ "GenSigStartValue" SG_ 1177 DET_RCS_104 128;
BA_ "GenSigStartValue" SG_ 1178 DET_RANGE_VELOCITY_105 16384;
BA_ "GenSigStartValue" SG_ 1178 DET_RCS_105 128;
BA_ "GenSigStartValue" SG_ 1178 DET_RANGE_VELOCITY_106 16384;
BA_ "GenSigStartValue" SG_ 1178 DET_RCS_106 128;
BA_ "GenSigStartValue" SG_ 1178 DET_RANGE_VELOCITY_107 16384;
BA_ "GenSigStartValue" SG_ 1178 DET_RCS_107 128;
BA_ "GenSigStartValue" SG_ 1178 DET_RANGE_VELOCITY_108 16384;
BA_ "GenSigStartValue" SG_ 1178 DET_RCS_108 128;
BA_ "GenSigStartValue" SG_ 1179 DET_RANGE_VELOCITY_109 16384;
BA_ "GenSigStartValue" SG_ 1179 DET_RCS_109 128;
BA_ "GenSigStartValue" SG_ 1179 DET_RANGE_VELOCITY_110 16384;
BA_ "GenSigStartValue" SG_ 1179 DET_RCS_110 128;
BA_ "GenSigStartValue" SG_ 1179 DET_RANGE_VELOCITY_111 16384;
BA_ "GenSigStartValue" SG_ 1179 DET_RCS_111 128;
BA_ "GenSigStartValue" SG_ 1179 DET_RANGE_VELOCITY_112 16384;
BA_ "GenSigStartValue" SG_ 1179 DET_RCS_112 128;
BA_ "GenSigStartValue" SG_ 1180 DET_RANGE_VELOCITY_113 16384;
BA_ "GenSigStartValue" SG_ 1180 DET_RCS_113 128;
BA_ "GenSigStartValue" SG_ 1180 DET_RANGE_VELOCITY_114 16384;
BA_ "GenSigStartValue" SG_ 1180 DET_RCS_114 128;
BA_ "GenSigStartValue" SG_ 1180 DET_RANGE_VELOCITY_115 16384;
BA_ "GenSigStartValue" SG_ 1180 DET_RCS_115 128;
BA_ "GenSigStartValue" SG_ 1180 DET_RANGE_VELOCITY_116 16384;
BA_ "GenSigStartValue" SG_ 1180 DET_RCS_116 128;
VAL_ 1163 DET_CONFD_AZIMUTH_045 0 "High" 1 "MidHigh" 2 "MidLow" 3 "Low" ;
VAL_ 1163 DET_CONFD_ELEVATION_045 0 "High" 1 "MidHigh" 2 "MidLow" 3 "Low" ;
VAL_ 1163 DET_CONFD_AZIMUTH_046 0 "High" 1 "MidHigh" 2 "MidLow" 3 "Low" ;
VAL_ 1163 DET_CONFD_ELEVATION_046 0 "High" 1 "MidHigh" 2 "MidLow" 3 "Low" ;
VAL_ 1163 DET_CONFD_AZIMUTH_047 0 "High" 1 "MidHigh" 2 "MidLow" 3 "Low" ;
VAL_ 1163 DET_CONFD_ELEVATION_047 0 "High" 1 "MidHigh" 2 "MidLow" 3 "Low" ;
VAL_ 1164 DET_CONFD_AZIMUTH_049 0 "High" 1 "MidHigh" 2 "MidLow" 3 "Low" ;
VAL_ 1164 DET_CONFD_ELEVATION_049 0 "High" 1 "MidHigh" 2 "MidLow" 3 "Low" ;
VAL_ 1164 DET_CONFD_AZIMUTH_050 0 "High" 1 "MidHigh" 2 "MidLow" 3 "Low" ;
VAL_ 1164 DET_CONFD_ELEVATION_050 0 "High" 1 "MidHigh" 2 "MidLow" 3 "Low" ;
VAL_ 1164 DET_CONFD_AZIMUTH_051 0 "High" 1 "MidHigh" 2 "MidLow" 3 "Low" ;
VAL_ 1164 DET_CONFD_ELEVATION_051 0 "High" 1 "MidHigh" 2 "MidLow" 3 "Low" ;
VAL_ 1165 DET_CONFD_AZIMUTH_053 0 "High" 1 "MidHigh" 2 "MidLow" 3 "Low" ;
VAL_ 1165 DET_CONFD_ELEVATION_053 0 "High" 1 "MidHigh" 2 "MidLow" 3 "Low" ;
VAL_ 1165 DET_CONFD_AZIMUTH_054 0 "High" 1 "MidHigh" 2 "MidLow" 3 "Low" ;
VAL_ 1165 DET_CONFD_ELEVATION_054 0 "High" 1 "MidHigh" 2 "MidLow" 3 "Low" ;
VAL_ 1165 DET_CONFD_AZIMUTH_055 0 "High" 1 "MidHigh" 2 "MidLow" 3 "Low" ;
VAL_ 1165 DET_CONFD_ELEVATION_055 0 "High" 1 "MidHigh" 2 "MidLow" 3 "Low" ;
VAL_ 1166 DET_CONFD_AZIMUTH_057 0 "High" 1 "MidHigh" 2 "MidLow" 3 "Low" ;
VAL_ 1166 DET_CONFD_ELEVATION_057 0 "High" 1 "MidHigh" 2 "MidLow" 3 "Low" ;
VAL_ 1166 DET_CONFD_AZIMUTH_058 0 "High" 1 "MidHigh" 2 "MidLow" 3 "Low" ;
VAL_ 1166 DET_CONFD_ELEVATION_058 0 "High" 1 "MidHigh" 2 "MidLow" 3 "Low" ;
VAL_ 1166 DET_CONFD_AZIMUTH_059 0 "High" 1 "MidHigh" 2 "MidLow" 3 "Low" ;
VAL_ 1166 DET_CONFD_ELEVATION_059 0 "High" 1 "MidHigh" 2 "MidLow" 3 "Low" ;
VAL_ 1167 DET_CONFD_AZIMUTH_061 0 "High" 1 "MidHigh" 2 "MidLow" 3 "Low" ;
VAL_ 1167 DET_CONFD_ELEVATION_061 0 "High" 1 "MidHigh" 2 "MidLow" 3 "Low" ;
VAL_ 1167 DET_CONFD_AZIMUTH_062 0 "High" 1 "MidHigh" 2 "MidLow" 3 "Low" ;
VAL_ 1167 DET_CONFD_ELEVATION_062 0 "High" 1 "MidHigh" 2 "MidLow" 3 "Low" ;
VAL_ 1167 DET_CONFD_AZIMUTH_063 0 "High" 1 "MidHigh" 2 "MidLow" 3 "Low" ;
VAL_ 1167 DET_CONFD_ELEVATION_063 0 "High" 1 "MidHigh" 2 "MidLow" 3 "Low" ;
VAL_ 1168 DET_CONFD_AZIMUTH_065 0 "High" 1 "MidHigh" 2 "MidLow" 3 "Low" ;
VAL_ 1168 DET_CONFD_ELEVATION_065 0 "High" 1 "MidHigh" 2 "MidLow" 3 "Low" ;
VAL_ 1168 DET_CONFD_AZIMUTH_066 0 "High" 1 "MidHigh" 2 "MidLow" 3 "Low" ;
VAL_ 1168 DET_CONFD_ELEVATION_066 0 "High" 1 "MidHigh" 2 "MidLow" 3 "Low" ;
VAL_ 1168 DET_CONFD_AZIMUTH_067 0 "High" 1 "MidHigh" 2 "MidLow" 3 "Low" ;
VAL_ 1168 DET_CONFD_ELEVATION_067 0 "High" 1 "MidHigh" 2 "MidLow" 3 "Low" ;
VAL_ 1169 DET_CONFD_AZIMUTH_069 0 "High" 1 "MidHigh" 2 "MidLow" 3 "Low" ;
VAL_ 1169 DET_CONFD_ELEVATION_069 0 "High" 1 "MidHigh" 2 "MidLow" 3 "Low" ;
VAL_ 1169 DET_CONFD_AZIMUTH_070 0 "High" 1 "MidHigh" 2 "MidLow" 3 "Low" ;
VAL_ 1169 DET_CONFD_ELEVATION_070 0 "High" 1 "MidHigh" 2 "MidLow" 3 "Low" ;
VAL_ 1169 DET_CONFD_AZIMUTH_071 0 "High" 1 "MidHigh" 2 "MidLow" 3 "Low" ;
VAL_ 1169 DET_CONFD_ELEVATION_071 0 "High" 1 "MidHigh" 2 "MidLow" 3 "Low" ;
VAL_ 1170 DET_CONFD_AZIMUTH_073 0 "High" 1 "MidHigh" 2 "MidLow" 3 "Low" ;
VAL_ 1170 DET_CONFD_ELEVATION_073 0 "High" 1 "MidHigh" 2 "MidLow" 3 "Low" ;
VAL_ 1170 DET_CONFD_AZIMUTH_074 0 "High" 1 "MidHigh" 2 "MidLow" 3 "Low" ;
VAL_ 1170 DET_CONFD_ELEVATION_074 0 "High" 1 "MidHigh" 2 "MidLow" 3 "Low" ;
VAL_ 1170 DET_CONFD_AZIMUTH_075 0 "High" 1 "MidHigh" 2 "MidLow" 3 "Low" ;
VAL_ 1170 DET_CONFD_ELEVATION_075 0 "High" 1 "MidHigh" 2 "MidLow" 3 "Low" ;
VAL_ 1171 DET_CONFD_AZIMUTH_077 0 "High" 1 "MidHigh" 2 "MidLow" 3 "Low" ;
VAL_ 1171 DET_CONFD_ELEVATION_077 0 "High" 1 "MidHigh" 2 "MidLow" 3 "Low" ;
VAL_ 1171 DET_CONFD_AZIMUTH_078 0 "High" 1 "MidHigh" 2 "MidLow" 3 "Low" ;
VAL_ 1171 DET_CONFD_ELEVATION_078 0 "High" 1 "MidHigh" 2 "MidLow" 3 "Low" ;
VAL_ 1171 DET_CONFD_AZIMUTH_079 0 "High" 1 "MidHigh" 2 "MidLow" 3 "Low" ;
VAL_ 1171 DET_CONFD_ELEVATION_079 0 "High" 1 "MidHigh" 2 "MidLow" 3 "Low" ;
VAL_ 1172 DET_CONFD_AZIMUTH_081 0 "High" 1 "MidHigh" 2 "MidLow" 3 "Low" ;
VAL_ 1172 DET_CONFD_ELEVATION_081 0 "High" 1 "MidHigh" 2 "MidLow" 3 "Low" ;
VAL_ 1172 DET_CONFD_AZIMUTH_082 0 "High" 1 "MidHigh" 2 "MidLow" 3 "Low" ;
VAL_ 1172 DET_CONFD_ELEVATION_082 0 "High" 1 "MidHigh" 2 "MidLow" 3 "Low" ;
VAL_ 1172 DET_CONFD_AZIMUTH_083 0 "High" 1 "MidHigh" 2 "MidLow" 3 "Low" ;
VAL_ 1172 DET_CONFD_ELEVATION_083 0 "High" 1 "MidHigh" 2 "MidLow" 3 "Low" ;
VAL_ 1173 DET_CONFD_AZIMUTH_085 0 "High" 1 "MidHigh" 2 "MidLow" 3 "Low" ;
VAL_ 1173 DET_CONFD_ELEVATION_085 0 "High" 1 "MidHigh" 2 "MidLow" 3 "Low" ;
VAL_ 1173 DET_CONFD_AZIMUTH_086 0 "High" 1 "MidHigh" 2 "MidLow" 3 "Low" ;
VAL_ 1173 DET_CONFD_ELEVATION_086 0 "High" 1 "MidHigh" 2 "MidLow" 3 "Low" ;
VAL_ 1173 DET_CONFD_AZIMUTH_087 0 "High" 1 "MidHigh" 2 "MidLow" 3 "Low" ;
VAL_ 1173 DET_CONFD_ELEVATION_087 0 "High" 1 "MidHigh" 2 "MidLow" 3 "Low" ;
VAL_ 1174 DET_CONFD_AZIMUTH_089 0 "High" 1 "MidHigh" 2 "MidLow" 3 "Low" ;
VAL_ 1174 DET_CONFD_ELEVATION_089 0 "High" 1 "MidHigh" 2 "MidLow" 3 "Low" ;
VAL_ 1174 DET_CONFD_AZIMUTH_090 0 "High" 1 "MidHigh" 2 "MidLow" 3 "Low" ;
VAL_ 1174 DET_CONFD_ELEVATION_090 0 "High" 1 "MidHigh" 2 "MidLow" 3 "Low" ;
VAL_ 1174 DET_CONFD_AZIMUTH_091 0 "High" 1 "MidHigh" 2 "MidLow" 3 "Low" ;
VAL_ 1174 DET_CONFD_ELEVATION_091 0 "High" 1 "MidHigh" 2 "MidLow" 3 "Low" ;
VAL_ 1175 DET_CONFD_AZIMUTH_093 0 "High" 1 "MidHigh" 2 "MidLow" 3 "Low" ;
VAL_ 1175 DET_CONFD_ELEVATION_093 0 "High" 1 "MidHigh" 2 "MidLow" 3 "Low" ;
VAL_ 1175 DET_CONFD_AZIMUTH_094 0 "High" 1 "MidHigh" 2 "MidLow" 3 "Low" ;
VAL_ 1175 DET_CONFD_ELEVATION_094 0 "High" 1 "MidHigh" 2 "MidLow" 3 "Low" ;
VAL_ 1175 DET_CONFD_AZIMUTH_095 0 "High" 1 "MidHigh" 2 "MidLow" 3 "Low" ;
VAL_ 1175 DET_CONFD_ELEVATION_095 0 "High" 1 "MidHigh" 2 "MidLow" 3 "Low" ;
VAL_ 1176 DET_CONFD_AZIMUTH_097 0 "High" 1 "MidHigh" 2 "MidLow" 3 "Low" ;
VAL_ 1176 DET_CONFD_ELEVATION_097 0 "High" 1 "MidHigh" 2 "MidLow" 3 "Low" ;
VAL_ 1176 DET_CONFD_AZIMUTH_098 0 "High" 1 "MidHigh" 2 "MidLow" 3 "Low" ;
VAL_ 1176 DET_CONFD_ELEVATION_098 0 "High" 1 "MidHigh" 2 "MidLow" 3 "Low" ;
VAL_ 1176 DET_CONFD_AZIMUTH_099 0 "High" 1 "MidHigh" 2 "MidLow" 3 "Low" ;
VAL_ 1176 DET_CONFD_ELEVATION_099 0 "High" 1 "MidHigh" 2 "MidLow" 3 "Low" ;
VAL_ 1177 DET_CONFD_AZIMUTH_101 0 "High" 1 "MidHigh" 2 "MidLow" 3 "Low" ;
VAL_ 1177 DET_CONFD_ELEVATION_101 0 "High" 1 "MidHigh" 2 "MidLow" 3 "Low" ;
VAL_ 1177 DET_CONFD_AZIMUTH_102 0 "High" 1 "MidHigh" 2 "MidLow" 3 "Low" ;
VAL_ 1177 DET_CONFD_ELEVATION_102 0 "High" 1 "MidHigh" 2 "MidLow" 3 "Low" ;
VAL_ 1177 DET_CONFD_AZIMUTH_103 0 "High" 1 "MidHigh" 2 "MidLow" 3 "Low" ;
VAL_ 1177 DET_CONFD_ELEVATION_103 0 "High" 1 "MidHigh" 2 "MidLow" 3 "Low" ;
VAL_ 1178 DET_CONFD_AZIMUTH_105 0 "High" 1 "MidHigh" 2 "MidLow" 3 "Low" ;
VAL_ 1178 DET_CONFD_ELEVATION_105 0 "High" 1 "MidHigh" 2 "MidLow" 3 "Low" ;
VAL_ 1178 DET_CONFD_AZIMUTH_106 0 "High" 1 "MidHigh" 2 "MidLow" 3 "Low" ;
VAL_ 1178 DET_CONFD_ELEVATION_106 0 "High" 1 "MidHigh" 2 "MidLow" 3 "Low" ;
VAL_ 1178 DET_CONFD_AZIMUTH_107 0 "High" 1 "MidHigh" 2 "MidLow" 3 "Low" ;
VAL_ 1178 DET_CONFD_ELEVATION_107 0 "High" 1 "MidHigh" 2 "MidLow" 3 "Low" ;
VAL_ 1179 DET_CONFD_AZIMUTH_109 0 "High" 1 "MidHigh" 2 "MidLow" 3 "Low" ;
VAL_ 1179 DET_CONFD_ELEVATION_109 0 "High" 1 "MidHigh" 2 "MidLow" 3 "Low" ;
VAL_ 1179 DET_CONFD_AZIMUTH_110 0 "High" 1 "MidHigh" 2 "MidLow" 3 "Low" ;
VAL_ 1179 DET_CONFD_ELEVATION_110 0 "High" 1 "MidHigh" 2 "MidLow" 3 "Low" ;
VAL_ 1179 DET_CONFD_AZIMUTH_111 0 "High" 1 "MidHigh" 2 "MidLow" 3 "Low" ;
VAL_ 1179 DET_CONFD_ELEVATION_111 0 "High" 1 "MidHigh" 2 "MidLow" 3 "Low" ;
VAL_ 1180 DET_CONFD_AZIMUTH_113 0 "High" 1 "MidHigh" 2 "MidLow" 3 "Low" ;
VAL_ 1180 DET_CONFD_ELEVATION_113 0 "High" 1 "MidHigh" 2 "MidLow" 3 "Low" ;
VAL_ 1180 DET_CONFD_AZIMUTH_114 0 "High" 1 "MidHigh" 2 "MidLow" 3 "Low" ;
VAL_ 1180 DET_CONFD_ELEVATION_114 0 "High" 1 "MidHigh" 2 "MidLow" 3 "Low" ;
VAL_ 1180 DET_CONFD_AZIMUTH_115 0 "High" 1 "MidHigh" 2 "MidLow" 3 "Low" ;
VAL_ 1180 DET_CONFD_ELEVATION_115 0 "High" 1 "MidHigh" 2 "MidLow" 3 "Low" ;
SIG_GROUP_ 1163 Detections_045_048 1 : DET_MH_CRC16_045_048 DET_MH_CYCLE_COUNTER_045_048 DET_MH_SCAN_INDEX_4LSB_045_048 DET_CONFD_ELEVATION_045 DET_CONFD_AZIMUTH_045 DET_HVC_FLAG_045 DET_OUTSIDE_SECTOR_045 DET_EXISTENCE_PROB_045 DET_POINT_TARGET_PROB_045 DET_SNR_045 DET_SUPER_RES_TARGET_045 DET_BI_STATIC_FLAG_045 DET_VALID_FLAG_045 DET_RCS_045 DET_ELEVATION_ERR_045 DET_ELEVATION_045 DET_AZIMUTH_ERR_045 DET_AZIMUTH_045 DET_RANGE_VELOCITY_ERR_045 DET_RANGE_VELOCITY_045 DET_RANGE_ERR_045 DET_RANGE_045 DET_CONFD_ELEVATION_046 DET_CONFD_AZIMUTH_046 DET_HVC_FLAG_046 DET_OUTSIDE_SECTOR_046 DET_EXISTENCE_PROB_046 DET_POINT_TARGET_PROB_046 DET_SNR_046 DET_SUPER_RES_TARGET_046 DET_BI_STATIC_FLAG_046 DET_VALID_FLAG_046 DET_RCS_046 DET_ELEVATION_ERR_046 DET_ELEVATION_046 DET_AZIMUTH_ERR_046 DET_AZIMUTH_046 DET_RANGE_VELOCITY_ERR_046 DET_RANGE_VELOCITY_046 DET_RANGE_ERR_046 DET_RANGE_046 DET_CONFD_ELEVATION_047 DET_CONFD_AZIMUTH_047 DET_HVC_FLAG_047 DET_OUTSIDE_SECTOR_047 DET_EXISTENCE_PROB_047 DET_POINT_TARGET_PROB_047 DET_SNR_047 DET_SUPER_RES_TARGET_047 DET_BI_STATIC_FLAG_047 DET_VALID_FLAG_047 DET_RCS_047 DET_ELEVATION_ERR_047 DET_ELEVATION_047 DET_AZIMUTH_ERR_047 DET_AZIMUTH_047 DET_RANGE_VELOCITY_ERR_047 DET_RANGE_VELOCITY_047 DET_RANGE_ERR_047 DET_RANGE_047 DET_CONFD_ELEVATION_048 DET_CONFD_AZIMUTH_048 DET_HVC_FLAG_048 DET_OUTSIDE_SECTOR_048 DET_EXISTENCE_PROB_048 DET_POINT_TARGET_PROB_048 DET_SNR_048 DET_SUPER_RES_TARGET_048 DET_BI_STATIC_FLAG_048 DET_VALID_FLAG_048 DET_RCS_048 DET_ELEVATION_ERR_048 DET_ELEVATION_048 DET_AZIMUTH_ERR_048 DET_AZIMUTH_048 DET_RANGE_VELOCITY_ERR_048 DET_RANGE_VELOCITY_048 DET_RANGE_ERR_048 DET_RANGE_048;
SIG_GROUP_ 1164 Detections_049_052 1 : DET_MH_CRC16_049_052 DET_MH_CYCLE_COUNTER_049_052 DET_MH_SCAN_INDEX_4LSB_049_052 DET_CONFD_ELEVATION_049 DET_CONFD_AZIMUTH_049 DET_HVC_FLAG_049 DET_OUTSIDE_SECTOR_049 DET_EXISTENCE_PROB_049 DET_POINT_TARGET_PROB_049 DET_SNR_049 DET_SUPER_RES_TARGET_049 DET_BI_STATIC_FLAG_049 DET_VALID_FLAG_049 DET_RCS_049 DET_ELEVATION_ERR_049 DET_ELEVATION_049 DET_AZIMUTH_ERR_049 DET_AZIMUTH_049 DET_RANGE_VELOCITY_ERR_049 DET_RANGE_VELOCITY_049 DET_RANGE_ERR_049 DET_RANGE_049 DET_CONFD_ELEVATION_050 DET_CONFD_AZIMUTH_050 DET_HVC_FLAG_050 DET_OUTSIDE_SECTOR_050 DET_EXISTENCE_PROB_050 DET_POINT_TARGET_PROB_050 DET_SNR_050 DET_SUPER_RES_TARGET_050 DET_BI_STATIC_FLAG_050 DET_VALID_FLAG_050 DET_RCS_050 DET_ELEVATION_ERR_050 DET_ELEVATION_050 DET_AZIMUTH_ERR_050 DET_AZIMUTH_050 DET_RANGE_VELOCITY_ERR_050 DET_RANGE_VELOCITY_050 DET_RANGE_ERR_050 DET_RANGE_050 DET_CONFD_ELEVATION_051 DET_CONFD_AZIMUTH_051 DET_HVC_FLAG_051 DET_OUTSIDE_SECTOR_051 DET_EXISTENCE_PROB_051 DET_POINT_TARGET_PROB_051 DET_SNR_051 DET_SUPER_RES_TARGET_051 DET_BI_STATIC_FLAG_051 DET_VALID_FLAG_051 DET_RCS_051 DET_ELEVATION_ERR_051 DET_ELEVATION_051 DET_AZIMUTH_ERR_051 DET_AZIMUTH_051 DET_RANGE_VELOCITY_ERR_051 DET_RANGE_VELOCITY_051 DET_RANGE_ERR_051 DET_RANGE_051 DET_CONFD_ELEVATION_052 DET_CONFD_AZIMUTH_052 DET_HVC_FLAG_052 DET_OUTSIDE_SECTOR_052 DET_EXISTENCE_PROB_052 DET_POINT_TARGET_PROB_052 DET_SNR_052 DET_SUPER_RES_TARGET_052 DET_BI_STATIC_FLAG_052 DET_VALID_FLAG_052 DET_RCS_052 DET_ELEVATION_ERR_052 DET_ELEVATION_052 DET_AZIMUTH_ERR_052 DET_AZIMUTH_052 DET_RANGE_VELOCITY_ERR_052 DET_RANGE_VELOCITY_052 DET_RANGE_ERR_052 DET_RANGE_052;
SIG_GROUP_ 1165 Detections_053_056 1 : DET_MH_CRC16_053_056 DET_MH_CYCLE_COUNTER_053_056 DET_MH_SCAN_INDEX_4LSB_053_056 DET_CONFD_ELEVATION_053 DET_CONFD_AZIMUTH_053 DET_HVC_FLAG_053 DET_OUTSIDE_SECTOR_053 DET_EXISTENCE_PROB_053 DET_POINT_TARGET_PROB_053 DET_SNR_053 DET_SUPER_RES_TARGET_053 DET_BI_STATIC_FLAG_053 DET_VALID_FLAG_053 DET_RCS_053 DET_ELEVATION_ERR_053 DET_ELEVATION_053 DET_AZIMUTH_ERR_053 DET_AZIMUTH_053 DET_RANGE_VELOCITY_ERR_053 DET_RANGE_VELOCITY_053 DET_RANGE_ERR_053 DET_RANGE_053 DET_CONFD_ELEVATION_054 DET_CONFD_AZIMUTH_054 DET_HVC_FLAG_054 DET_OUTSIDE_SECTOR_054 DET_EXISTENCE_PROB_054 DET_POINT_TARGET_PROB_054 DET_SNR_054 DET_SUPER_RES_TARGET_054 DET_BI_STATIC_FLAG_054 DET_VALID_FLAG_054 DET_RCS_054 DET_ELEVATION_ERR_054 DET_ELEVATION_054 DET_AZIMUTH_ERR_054 DET_AZIMUTH_054 DET_RANGE_VELOCITY_ERR_054 DET_RANGE_VELOCITY_054 DET_RANGE_ERR_054 DET_RANGE_054 DET_CONFD_ELEVATION_055 DET_CONFD_AZIMUTH_055 DET_HVC_FLAG_055 DET_OUTSIDE_SECTOR_055 DET_EXISTENCE_PROB_055 DET_POINT_TARGET_PROB_055 DET_SNR_055 DET_SUPER_RES_TARGET_055 DET_BI_STATIC_FLAG_055 DET_VALID_FLAG_055 DET_RCS_055 DET_ELEVATION_ERR_055 DET_ELEVATION_055 DET_AZIMUTH_ERR_055 DET_AZIMUTH_055 DET_RANGE_VELOCITY_ERR_055 DET_RANGE_VELOCITY_055 DET_RANGE_ERR_055 DET_RANGE_055 DET_CONFD_ELEVATION_056 DET_CONFD_AZIMUTH_056 DET_HVC_FLAG_056 DET_OUTSIDE_SECTOR_056 DET_EXISTENCE_PROB_056 DET_POINT_TARGET_PROB_056 DET_SNR_056 DET_SUPER_RES_TARGET_056 DET_BI_STATIC_FLAG_056 DET_VALID_FLAG_056 DET_RCS_056 DET_ELEVATION_ERR_056 DET_ELEVATION_056 DET_AZIMUTH_ERR_056 DET_AZIMUTH_056 DET_RANGE_VELOCITY_ERR_056 DET_RANGE_VELOCITY_056 DET_RANGE_ERR_056 DET_RANGE_056;
SIG_GROUP_ 1166 Detections_057_060 1 : DET_MH_CRC16_057_060 DET_MH_CYCLE_COUNTER_057_060 DET_MH_SCAN_INDEX_4LSB_057_060 DET_CONFD_ELEVATION_057 DET_CONFD_AZIMUTH_057 DET_HVC_FLAG_057 DET_OUTSIDE_SECTOR_057 DET_EXISTENCE_PROB_057 DET_POINT_TARGET_PROB_057 DET_SNR_057 DET_SUPER_RES_TARGET_057 DET_BI_STATIC_FLAG_057 DET_VALID_FLAG_057 DET_RCS_057 DET_ELEVATION_ERR_057 DET_ELEVATION_057 DET_AZIMUTH_ERR_057 DET_AZIMUTH_057 DET_RANGE_VELOCITY_ERR_057 DET_RANGE_VELOCITY_057 DET_RANGE_ERR_057 DET_RANGE_057 DET_CONFD_ELEVATION_058 DET_CONFD_AZIMUTH_058 DET_HVC_FLAG_058 DET_OUTSIDE_SECTOR_058 DET_EXISTENCE_PROB_058 DET_POINT_TARGET_PROB_058 DET_SNR_058 DET_SUPER_RES_TARGET_058 DET_BI_STATIC_FLAG_058 DET_VALID_FLAG_058 DET_RCS_058 DET_ELEVATION_ERR_058 DET_ELEVATION_058 DET_AZIMUTH_ERR_058 DET_AZIMUTH_058 DET_RANGE_VELOCITY_ERR_058 DET_RANGE_VELOCITY_058 DET_RANGE_ERR_058 DET_RANGE_058 DET_CONFD_ELEVATION_059 DET_CONFD_AZIMUTH_059 DET_HVC_FLAG_059 DET_OUTSIDE_SECTOR_059 DET_EXISTENCE_PROB_059 DET_POINT_TARGET_PROB_059 DET_SNR_059 DET_SUPER_RES_TARGET_059 DET_BI_STATIC_FLAG_059 DET_VALID_FLAG_059 DET_RCS_059 DET_ELEVATION_ERR_059 DET_ELEVATION_059 DET_AZIMUTH_ERR_059 DET_AZIMUTH_059 DET_RANGE_VELOCITY_ERR_059 DET_RANGE_VELOCITY_059 DET_RANGE_ERR_059 DET_RANGE_059 DET_CONFD_ELEVATION_060 DET_CONFD_AZIMUTH_060 DET_HVC_FLAG_060 DET_OUTSIDE_SECTOR_060 DET_EXISTENCE_PROB_060 DET_POINT_TARGET_PROB_060 DET_SNR_060 DET_SUPER_RES_TARGET_060 DET_BI_STATIC_FLAG_060 DET_VALID_FLAG_060 DET_RCS_060 DET_ELEVATION_ERR_060 DET_ELEVATION_060 DET_AZIMUTH_ERR_060 DET_AZIMUTH_060 DET_RANGE_VELOCITY_ERR_060 DET_RANGE_VELOCITY_060 DET_RANGE_ERR_060 DET_RANGE_060;
SIG_GROUP_ 1167 Detections_061_064 1 : DET_MH_CRC16_061_064 DET_MH_CYCLE_COUNTER_061_064 DET_MH_SCAN_INDEX_4LSB_061_064 DET_CONFD_ELEVATION_061 DET_CONFD_AZIMUTH_061 DET_HVC_FLAG_061 DET_OUTSIDE_SECTOR_061 DET_EXISTENCE_PROB_061 DET_POINT_TARGET_PROB_061 DET_SNR_061 DET_SUPER_RES_TARGET_061 DET_BI_STATIC_FLAG_061 DET_VALID_FLAG_061 DET_RCS_061 DET_ELEVATION_ERR_061 DET_ELEVATION_061 DET_AZIMUTH_ERR_061 DET_AZIMUTH_061 DET_RANGE_VELOCITY_ERR_061 DET_RANGE_VELOCITY_061 DET_RANGE_ERR_061 DET_RANGE_061 DET_CONFD_ELEVATION_062 DET_CONFD_AZIMUTH_062 DET_HVC_FLAG_062 DET_OUTSIDE_SECTOR_062 DET_EXISTENCE_PROB_062 DET_POINT_TARGET_PROB_062 DET_SNR_062 DET_SUPER_RES_TARGET_062 DET_BI_STATIC_FLAG_062 DET_VALID_FLAG_062 DET_RCS_062 DET_ELEVATION_ERR_062 DET_ELEVATION_062 DET_AZIMUTH_ERR_062 DET_AZIMUTH_062 DET_RANGE_VELOCITY_ERR_062 DET_RANGE_VELOCITY_062 DET_RANGE_ERR_062 DET_RANGE_062 DET_CONFD_ELEVATION_063 DET_CONFD_AZIMUTH_063 DET_HVC_FLAG_063 DET_OUTSIDE_SECTOR_063 DET_EXISTENCE_PROB_063 DET_POINT_TARGET_PROB_063 DET_SNR_063 DET_SUPER_RES_TARGET_063 DET_BI_STATIC_FLAG_063 DET_VALID_FLAG_063 DET_RCS_063 DET_ELEVATION_ERR_063 DET_ELEVATION_063 DET_AZIMUTH_ERR_063 DET_AZIMUTH_063 DET_RANGE_VELOCITY_ERR_063 DET_RANGE_VELOCITY_063 DET_RANGE_ERR_063 DET_RANGE_063 DET_CONFD_ELEVATION_064 DET_CONFD_AZIMUTH_064 DET_HVC_FLAG_064 DET_OUTSIDE_SECTOR_064 DET_EXISTENCE_PROB_064 DET_POINT_TARGET_PROB_064 DET_SNR_064 DET_SUPER_RES_TARGET_064 DET_BI_STATIC_FLAG_064 DET_VALID_FLAG_064 DET_RCS_064 DET_ELEVATION_ERR_064 DET_ELEVATION_064 DET_AZIMUTH_ERR_064 DET_AZIMUTH_064 DET_RANGE_VELOCITY_ERR_064 DET_RANGE_VELOCITY_064 DET_RANGE_ERR_064 DET_RANGE_064;
SIG_GROUP_ 1168 Detections_065_068 1 : DET_MH_CRC16_065_068 DET_MH_CYCLE_COUNTER_065_068 DET_MH_SCAN_INDEX_4LSB_065_068 DET_CONFD_ELEVATION_065 DET_CONFD_AZIMUTH_065 DET_HVC_FLAG_065 DET_OUTSIDE_SECTOR_065 DET_EXISTENCE_PROB_065 DET_POINT_TARGET_PROB_065 DET_SNR_065 DET_SUPER_RES_TARGET_065 DET_BI_STATIC_FLAG_065 DET_VALID_FLAG_065 DET_RCS_065 DET_ELEVATION_ERR_065 DET_ELEVATION_065 DET_AZIMUTH_ERR_065 DET_AZIMUTH_065 DET_RANGE_VELOCITY_ERR_065 DET_RANGE_VELOCITY_065 DET_RANGE_ERR_065 DET_RANGE_065 DET_CONFD_ELEVATION_066 DET_CONFD_AZIMUTH_066 DET_HVC_FLAG_066 DET_OUTSIDE_SECTOR_066 DET_EXISTENCE_PROB_066 DET_POINT_TARGET_PROB_066 DET_SNR_066 DET_SUPER_RES_TARGET_066 DET_BI_STATIC_FLAG_066 DET_VALID_FLAG_066 DET_RCS_066 DET_ELEVATION_ERR_066 DET_ELEVATION_066 DET_AZIMUTH_ERR_066 DET_AZIMUTH_066 DET_RANGE_VELOCITY_ERR_066 DET_RANGE_VELOCITY_066 DET_RANGE_ERR_066 DET_RANGE_066 DET_CONFD_ELEVATION_067 DET_CONFD_AZIMUTH_067 DET_HVC_FLAG_067 DET_OUTSIDE_SECTOR_067 DET_EXISTENCE_PROB_067 DET_POINT_TARGET_PROB_067 DET_SNR_067 DET_SUPER_RES_TARGET_067 DET_BI_STATIC_FLAG_067 DET_VALID_FLAG_067 DET_RCS_067 DET_ELEVATION_ERR_067 DET_ELEVATION_067 DET_AZIMUTH_ERR_067 DET_AZIMUTH_067 DET_RANGE_VELOCITY_ERR_067 DET_RANGE_VELOCITY_067 DET_RANGE_ERR_067 DET_RANGE_067 DET_CONFD_ELEVATION_068 DET_CONFD_AZIMUTH_068 DET_HVC_FLAG_068 DET_OUTSIDE_SECTOR_068 DET_EXISTENCE_PROB_068 DET_POINT_TARGET_PROB_068 DET_SNR_068 DET_SUPER_RES_TARGET_068 DET_BI_STATIC_FLAG_068 DET_VALID_FLAG_068 DET_RCS_068 DET_ELEVATION_ERR_068 DET_ELEVATION_068 DET_AZIMUTH_ERR_068 DET_AZIMUTH_068 DET_RANGE_VELOCITY_ERR_068 DET_RANGE_VELOCITY_068 DET_RANGE_ERR_068 DET_RANGE_068;
SIG_GROUP_ 1169 Detections_069_072 1 : DET_MH_CRC16_069_072 DET_MH_CYCLE_COUNTER_069_072 DET_MH_SCAN_INDEX_4LSB_069_072 DET_CONFD_ELEVATION_069 DET_CONFD_AZIMUTH_069 DET_HVC_FLAG_069 DET_OUTSIDE_SECTOR_069 DET_EXISTENCE_PROB_069 DET_POINT_TARGET_PROB_069 DET_SNR_069 DET_SUPER_RES_TARGET_069 DET_BI_STATIC_FLAG_069 DET_VALID_FLAG_069 DET_RCS_069 DET_ELEVATION_ERR_069 DET_ELEVATION_069 DET_AZIMUTH_ERR_069 DET_AZIMUTH_069 DET_RANGE_VELOCITY_ERR_069 DET_RANGE_VELOCITY_069 DET_RANGE_ERR_069 DET_RANGE_069 DET_CONFD_ELEVATION_070 DET_CONFD_AZIMUTH_070 DET_HVC_FLAG_070 DET_OUTSIDE_SECTOR_070 DET_EXISTENCE_PROB_070 DET_POINT_TARGET_PROB_070 DET_SNR_070 DET_SUPER_RES_TARGET_070 DET_BI_STATIC_FLAG_070 DET_VALID_FLAG_070 DET_RCS_070 DET_ELEVATION_ERR_070 DET_ELEVATION_070 DET_AZIMUTH_ERR_070 DET_AZIMUTH_070 DET_RANGE_VELOCITY_ERR_070 DET_RANGE_VELOCITY_070 DET_RANGE_ERR_070 DET_RANGE_070 DET_CONFD_ELEVATION_071 DET_CONFD_AZIMUTH_071 DET_HVC_FLAG_071 DET_OUTSIDE_SECTOR_071 DET_EXISTENCE_PROB_071 DET_POINT_TARGET_PROB_071 DET_SNR_071 DET_SUPER_RES_TARGET_071 DET_BI_STATIC_FLAG_071 DET_VALID_FLAG_071 DET_RCS_071 DET_ELEVATION_ERR_071 DET_ELEVATION_071 DET_AZIMUTH_ERR_071 DET_AZIMUTH_071 DET_RANGE_VELOCITY_ERR_071 DET_RANGE_VELOCITY_071 DET_RANGE_ERR_071 DET_RANGE_071 DET_CONFD_ELEVATION_072 DET_CONFD_AZIMUTH_072 DET_HVC_FLAG_072 DET_OUTSIDE_SECTOR_072 DET_EXISTENCE_PROB_072 DET_POINT_TARGET_PROB_072 DET_SNR_072 DET_SUPER_RES_TARGET_072 DET_BI_STATIC_FLAG_072 DET_VALID_FLAG_072 DET_RCS_072 DET_ELEVATION_ERR_072 DET_ELEVATION_072 DET_AZIMUTH_ERR_072 DET_AZIMUTH_072 DET_RANGE_VELOCITY_ERR_072 DET_RANGE_VELOCITY_072 DET_RANGE_ERR_072 DET_RANGE_072;
SIG_GROUP_ 1170 Detections_073_076 1 : DET_MH_CRC16_073_076 DET_MH_CYCLE_COUNTER_073_076 DET_MH_SCAN_INDEX_4LSB_073_076 DET_CONFD_ELEVATION_073 DET_CONFD_AZIMUTH_073 DET_HVC_FLAG_073 DET_OUTSIDE_SECTOR_073 DET_EXISTENCE_PROB_073 DET_POINT_TARGET_PROB_073 DET_SNR_073 DET_SUPER_RES_TARGET_073 DET_BI_STATIC_FLAG_073 DET_VALID_FLAG_073 DET_RCS_073 DET_ELEVATION_ERR_073 DET_ELEVATION_073 DET_AZIMUTH_ERR_073 DET_AZIMUTH_073 DET_RANGE_VELOCITY_ERR_073 DET_RANGE_VELOCITY_073 DET_RANGE_ERR_073 DET_RANGE_073 DET_CONFD_ELEVATION_074 DET_CONFD_AZIMUTH_074 DET_HVC_FLAG_074 DET_OUTSIDE_SECTOR_074 DET_EXISTENCE_PROB_074 DET_POINT_TARGET_PROB_074 DET_SNR_074 DET_SUPER_RES_TARGET_074 DET_BI_STATIC_FLAG_074 DET_VALID_FLAG_074 DET_RCS_074 DET_ELEVATION_ERR_074 DET_ELEVATION_074 DET_AZIMUTH_ERR_074 DET_AZIMUTH_074 DET_RANGE_VELOCITY_ERR_074 DET_RANGE_VELOCITY_074 DET_RANGE_ERR_074 DET_RANGE_074 DET_CONFD_ELEVATION_075 DET_CONFD_AZIMUTH_075 DET_HVC_FLAG_075 DET_OUTSIDE_SECTOR_075 DET_EXISTENCE_PROB_075 DET_POINT_TARGET_PROB_075 DET_SNR_075 DET_SUPER_RES_TARGET_075 DET_BI_STATIC_FLAG_075 DET_VALID_FLAG_075 DET_RCS_075 DET_ELEVATION_ERR_075 DET_ELEVATION_075 DET_AZIMUTH_ERR_075 DET_AZIMUTH_075 DET_RANGE_VELOCITY_ERR_075 DET_RANGE_VELOCITY_075 DET_RANGE_ERR_075 DET_RANGE_075 DET_CONFD_ELEVATION_076 DET_CONFD_AZIMUTH_076 DET_HVC_FLAG_076 DET_OUTSIDE_SECTOR_076 DET_EXISTENCE_PROB_076 DET_POINT_TARGET_PROB_076 DET_SNR_076 DET_SUPER_RES_TARGET_076 DET_BI_STATIC_FLAG_076 DET_VALID_FLAG_076 DET_RCS_076 DET_ELEVATION_ERR_076 DET_ELEVATION_076 DET_AZIMUTH_ERR_076 DET_AZIMUTH_076 DET_RANGE_VELOCITY_ERR_076 DET_RANGE_VELOCITY_076 DET_RANGE_ERR_076 DET_RANGE_076;
SIG_GROUP_ 1171 Detections_077_080 1 : DET_MH_CRC16_077_080 DET_MH_CYCLE_COUNTER_077_080 DET_MH_SCAN_INDEX_4LSB_077_080 DET_CONFD_ELEVATION_077 DET_CONFD_AZIMUTH_077 DET_HVC_FLAG_077 DET_OUTSIDE_SECTOR_077 DET_EXISTENCE_PROB_077 DET_POINT_TARGET_PROB_077 DET_SNR_077 DET_SUPER_RES_TARGET_077 DET_BI_STATIC_FLAG_077 DET_VALID_FLAG_077 DET_RCS_077 DET_ELEVATION_ERR_077 DET_ELEVATION_077 DET_AZIMUTH_ERR_077 DET_AZIMUTH_077 DET_RANGE_VELOCITY_ERR_077 DET_RANGE_VELOCITY_077 DET_RANGE_ERR_077 DET_RANGE_077 DET_CONFD_ELEVATION_078 DET_CONFD_AZIMUTH_078 DET_HVC_FLAG_078 DET_OUTSIDE_SECTOR_078 DET_EXISTENCE_PROB_078 DET_POINT_TARGET_PROB_078 DET_SNR_078 DET_SUPER_RES_TARGET_078 DET_BI_STATIC_FLAG_078 DET_VALID_FLAG_078 DET_RCS_078 DET_ELEVATION_ERR_078 DET_ELEVATION_078 DET_AZIMUTH_ERR_078 DET_AZIMUTH_078 DET_RANGE_VELOCITY_ERR_078 DET_RANGE_VELOCITY_078 DET_RANGE_ERR_078 DET_RANGE_078 DET_CONFD_ELEVATION_079 DET_CONFD_AZIMUTH_079 DET_HVC_FLAG_079 DET_OUTSIDE_SECTOR_079 DET_EXISTENCE_PROB_079 DET_POINT_TARGET_PROB_079 DET_SNR_079 DET_SUPER_RES_TARGET_079 DET_BI_STATIC_FLAG_079 DET_VALID_FLAG_079 DET_RCS_079 DET_ELEVATION_ERR_079 DET_ELEVATION_079 DET_AZIMUTH_ERR_079 DET_AZIMUTH_079 DET_RANGE_VELOCITY_ERR_079 DET_RANGE_VELOCITY_079 DET_RANGE_ERR_079 DET_RANGE_079 DET_CONFD_ELEVATION_080 DET_CONFD_AZIMUTH_080 DET_HVC_FLAG_080 DET_OUTSIDE_SECTOR_080 DET_EXISTENCE_PROB_080 DET_POINT_TARGET_PROB_080 DET_SNR_080 DET_SUPER_RES_TARGET_080 DET_BI_STATIC_FLAG_080 DET_VALID_FLAG_080 DET_RCS_080 DET_ELEVATION_ERR_080 DET_ELEVATION_080 DET_AZIMUTH_ERR_080 DET_AZIMUTH_080 DET_RANGE_VELOCITY_ERR_080 DET_RANGE_VELOCITY_080 DET_RANGE_ERR_080 DET_RANGE_080;
SIG_GROUP_ 1172 Detections_081_084 1 : DET_MH_CRC16_081_084 DET_MH_CYCLE_COUNTER_081_084 DET_MH_SCAN_INDEX_4LSB_081_084 DET_CONFD_ELEVATION_081 DET_CONFD_AZIMUTH_081 DET_HVC_FLAG_081 DET_OUTSIDE_SECTOR_081 DET_EXISTENCE_PROB_081 DET_POINT_TARGET_PROB_081 DET_SNR_081 DET_SUPER_RES_TARGET_081 DET_BI_STATIC_FLAG_081 DET_VALID_FLAG_081 DET_RCS_081 DET_ELEVATION_ERR_081 DET_ELEVATION_081 DET_AZIMUTH_ERR_081 DET_AZIMUTH_081 DET_RANGE_VELOCITY_ERR_081 DET_RANGE_VELOCITY_081 DET_RANGE_ERR_081 DET_RANGE_081 DET_CONFD_ELEVATION_082 DET_CONFD_AZIMUTH_082 DET_HVC_FLAG_082 DET_OUTSIDE_SECTOR_082 DET_EXISTENCE_PROB_082 DET_POINT_TARGET_PROB_082 DET_SNR_082 DET_SUPER_RES_TARGET_082 DET_BI_STATIC_FLAG_082 DET_VALID_FLAG_082 DET_RCS_082 DET_ELEVATION_ERR_082 DET_ELEVATION_082 DET_AZIMUTH_ERR_082 DET_AZIMUTH_082 DET_RANGE_VELOCITY_ERR_082 DET_RANGE_VELOCITY_082 DET_RANGE_ERR_082 DET_RANGE_082 DET_CONFD_ELEVATION_083 DET_CONFD_AZIMUTH_083 DET_HVC_FLAG_083 DET_OUTSIDE_SECTOR_083 DET_EXISTENCE_PROB_083 DET_POINT_TARGET_PROB_083 DET_SNR_083 DET_SUPER_RES_TARGET_083 DET_BI_STATIC_FLAG_083 DET_VALID_FLAG_083 DET_RCS_083 DET_ELEVATION_ERR_083 DET_ELEVATION_083 DET_AZIMUTH_ERR_083 DET_AZIMUTH_083 DET_RANGE_VELOCITY_ERR_083 DET_RANGE_VELOCITY_083 DET_RANGE_ERR_083 DET_RANGE_083 DET_CONFD_ELEVATION_084 DET_CONFD_AZIMUTH_084 DET_HVC_FLAG_084 DET_OUTSIDE_SECTOR_084 DET_EXISTENCE_PROB_084 DET_POINT_TARGET_PROB_084 DET_SNR_084 DET_SUPER_RES_TARGET_084 DET_BI_STATIC_FLAG_084 DET_VALID_FLAG_084 DET_RCS_084 DET_ELEVATION_ERR_084 DET_ELEVATION_084 DET_AZIMUTH_ERR_084 DET_AZIMUTH_084 DET_RANGE_VELOCITY_ERR_084 DET_RANGE_VELOCITY_084 DET_RANGE_ERR_084 DET_RANGE_084;
SIG_GROUP_ 1173 Detections_085_088 1 : DET_MH_CRC16_085_088 DET_MH_CYCLE_COUNTER_085_088 DET_MH_SCAN_INDEX_4LSB_085_088 DET_CONFD_ELEVATION_085 DET_CONFD_AZIMUTH_085 DET_HVC_FLAG_085 DET_OUTSIDE_SECTOR_085 DET_EXISTENCE_PROB_085 DET_POINT_TARGET_PROB_085 DET_SNR_085 DET_SUPER_RES_TARGET_085 DET_BI_STATIC_FLAG_085 DET_VALID_FLAG_085 DET_RCS_085 DET_ELEVATION_ERR_085 DET_ELEVATION_085 DET_AZIMUTH_ERR_085 DET_AZIMUTH_085 DET_RANGE_VELOCITY_ERR_085 DET_RANGE_VELOCITY_085 DET_RANGE_ERR_085 DET_RANGE_085 DET_CONFD_ELEVATION_086 DET_CONFD_AZIMUTH_086 DET_HVC_FLAG_086 DET_OUTSIDE_SECTOR_086 DET_EXISTENCE_PROB_086 DET_POINT_TARGET_PROB_086 DET_SNR_086 DET_SUPER_RES_TARGET_086 DET_BI_STATIC_FLAG_086 DET_VALID_FLAG_086 DET_RCS_086 DET_ELEVATION_ERR_086 DET_ELEVATION_086 DET_AZIMUTH_ERR_086 DET_AZIMUTH_086 DET_RANGE_VELOCITY_ERR_086 DET_RANGE_VELOCITY_086 DET_RANGE_ERR_086 DET_RANGE_086 DET_CONFD_ELEVATION_087 DET_CONFD_AZIMUTH_087 DET_HVC_FLAG_087 DET_OUTSIDE_SECTOR_087 DET_EXISTENCE_PROB_087 DET_POINT_TARGET_PROB_087 DET_SNR_087 DET_SUPER_RES_TARGET_087 DET_BI_STATIC_FLAG_087 DET_VALID_FLAG_087 DET_RCS_087 DET_ELEVATION_ERR_087 DET_ELEVATION_087 DET_AZIMUTH_ERR_087 DET_AZIMUTH_087 DET_RANGE_VELOCITY_ERR_087 DET_RANGE_VELOCITY_087 DET_RANGE_ERR_087 DET_RANGE_087 DET_CONFD_ELEVATION_088 DET_CONFD_AZIMUTH_088 DET_HVC_FLAG_088 DET_OUTSIDE_SECTOR_088 DET_EXISTENCE_PROB_088 DET_POINT_TARGET_PROB_088 DET_SNR_088 DET_SUPER_RES_TARGET_088 DET_BI_STATIC_FLAG_088 DET_VALID_FLAG_088 DET_RCS_088 DET_ELEVATION_ERR_088 DET_ELEVATION_088 DET_AZIMUTH_ERR_088 DET_AZIMUTH_088 DET_RANGE_VELOCITY_ERR_088 DET_RANGE_VELOCITY_088 DET_RANGE_ERR_088 DET_RANGE_088;
SIG_GROUP_ 1174 Detections_089_092 1 : DET_MH_CRC16_089_092 DET_MH_CYCLE_COUNTER_089_092 DET_MH_SCAN_INDEX_4LSB_089_092 DET_CONFD_ELEVATION_089 DET_CONFD_AZIMUTH_089 DET_HVC_FLAG_089 DET_OUTSIDE_SECTOR_089 DET_EXISTENCE_PROB_089 DET_POINT_TARGET_PROB_089 DET_SNR_089 DET_SUPER_RES_TARGET_089 DET_BI_STATIC_FLAG_089 DET_VALID_FLAG_089 DET_RCS_089 DET_ELEVATION_ERR_089 DET_ELEVATION_089 DET_AZIMUTH_ERR_089 DET_AZIMUTH_089 DET_RANGE_VELOCITY_ERR_089 DET_RANGE_VELOCITY_089 DET_RANGE_ERR_089 DET_RANGE_089 DET_CONFD_ELEVATION_090 DET_CONFD_AZIMUTH_090 DET_HVC_FLAG_090 DET_OUTSIDE_SECTOR_090 DET_EXISTENCE_PROB_090 DET_POINT_TARGET_PROB_090 DET_SNR_090 DET_SUPER_RES_TARGET_090 DET_BI_STATIC_FLAG_090 DET_VALID_FLAG_090 DET_RCS_090 DET_ELEVATION_ERR_090 DET_ELEVATION_090 DET_AZIMUTH_ERR_090 DET_AZIMUTH_090 DET_RANGE_VELOCITY_ERR_090 DET_RANGE_VELOCITY_090 DET_RANGE_ERR_090 DET_RANGE_090 DET_CONFD_ELEVATION_091 DET_CONFD_AZIMUTH_091 DET_HVC_FLAG_091 DET_OUTSIDE_SECTOR_091 DET_EXISTENCE_PROB_091 DET_POINT_TARGET_PROB_091 DET_SNR_091 DET_SUPER_RES_TARGET_091 DET_BI_STATIC_FLAG_091 DET_VALID_FLAG_091 DET_RCS_091 DET_ELEVATION_ERR_091 DET_ELEVATION_091 DET_AZIMUTH_ERR_091 DET_AZIMUTH_091 DET_RANGE_VELOCITY_ERR_091 DET_RANGE_VELOCITY_091 DET_RANGE_ERR_091 DET_RANGE_091 DET_CONFD_ELEVATION_092 DET_CONFD_AZIMUTH_092 DET_HVC_FLAG_092 DET_OUTSIDE_SECTOR_092 DET_EXISTENCE_PROB_092 DET_POINT_TARGET_PROB_092 DET_SNR_092 DET_SUPER_RES_TARGET_092 DET_BI_STATIC_FLAG_092 DET_VALID_FLAG_092 DET_RCS_092 DET_ELEVATION_ERR_092 DET_ELEVATION_092 DET_AZIMUTH_ERR_092 DET_AZIMUTH_092 DET_RANGE_VELOCITY_ERR_092 DET_RANGE_VELOCITY_092 DET_RANGE_ERR_092 DET_RANGE_092;
SIG_GROUP_ 1175 Detections_093_096 1 : DET_MH_CRC16_093_096 DET_MH_CYCLE_COUNTER_093_096 DET_MH_SCAN_INDEX_4LSB_093_096 DET_CONFD_ELEVATION_093 DET_CONFD_AZIMUTH_093 DET_HVC_FLAG_093 DET_OUTSIDE_SECTOR_093 DET_EXISTENCE_PROB_093 DET_POINT_TARGET_PROB_093 DET_SNR_093 DET_SUPER_RES_TARGET_093 DET_BI_STATIC_FLAG_093 DET_VALID_FLAG_093 DET_RCS_093 DET_ELEVATION_ERR_093 DET_ELEVATION_093 DET_AZIMUTH_ERR_093 DET_AZIMUTH_093 DET_RANGE_VELOCITY_ERR_093 DET_RANGE_VELOCITY_093 DET_RANGE_ERR_093 DET_RANGE_093 DET_CONFD_ELEVATION_094 DET_CONFD_AZIMUTH_094 DET_HVC_FLAG_094 DET_OUTSIDE_SECTOR_094 DET_EXISTENCE_PROB_094 DET_POINT_TARGET_PROB_094 DET_SNR_094 DET_SUPER_RES_TARGET_094 DET_BI_STATIC_FLAG_094 DET_VALID_FLAG_094 DET_RCS_094 DET_ELEVATION_ERR_094 DET_ELEVATION_094 DET_AZIMUTH_ERR_094 DET_AZIMUTH_094 DET_RANGE_VELOCITY_ERR_094 DET_RANGE_VELOCITY_094 DET_RANGE_ERR_094 DET_RANGE_094 DET_CONFD_ELEVATION_095 DET_CONFD_AZIMUTH_095 DET_HVC_FLAG_095 DET_OUTSIDE_SECTOR_095 DET_EXISTENCE_PROB_095 DET_POINT_TARGET_PROB_095 DET_SNR_095 DET_SUPER_RES_TARGET_095 DET_BI_STATIC_FLAG_095 DET_VALID_FLAG_095 DET_RCS_095 DET_ELEVATION_ERR_095 DET_ELEVATION_095 DET_AZIMUTH_ERR_095 DET_AZIMUTH_095 DET_RANGE_VELOCITY_ERR_095 DET_RANGE_VELOCITY_095 DET_RANGE_ERR_095 DET_RANGE_095 DET_CONFD_ELEVATION_096 DET_CONFD_AZIMUTH_096 DET_HVC_FLAG_096 DET_OUTSIDE_SECTOR_096 DET_EXISTENCE_PROB_096 DET_POINT_TARGET_PROB_096 DET_SNR_096 DET_SUPER_RES_TARGET_096 DET_BI_STATIC_FLAG_096 DET_VALID_FLAG_096 DET_RCS_096 DET_ELEVATION_ERR_096 DET_ELEVATION_096 DET_AZIMUTH_ERR_096 DET_AZIMUTH_096 DET_RANGE_VELOCITY_ERR_096 DET_RANGE_VELOCITY_096 DET_RANGE_ERR_096 DET_RANGE_096;
SIG_GROUP_ 1176 Detections_097_100 1 : DET_MH_CRC16_097_100 DET_MH_CYCLE_COUNTER_097_100 DET_MH_SCAN_INDEX_4LSB_097_100 DET_CONFD_ELEVATION_097 DET_CONFD_AZIMUTH_097 DET_HVC_FLAG_097 DET_OUTSIDE_SECTOR_097 DET_EXISTENCE_PROB_097 DET_POINT_TARGET_PROB_097 DET_SNR_097 DET_SUPER_RES_TARGET_097 DET_BI_STATIC_FLAG_097 DET_VALID_FLAG_097 DET_RCS_097 DET_ELEVATION_ERR_097 DET_ELEVATION_097 DET_AZIMUTH_ERR_097 DET_AZIMUTH_097 DET_RANGE_VELOCITY_ERR_097 DET_RANGE_VELOCITY_097 DET_RANGE_ERR_097 DET_RANGE_097 DET_CONFD_ELEVATION_098 DET_CONFD_AZIMUTH_098 DET_HVC_FLAG_098 DET_OUTSIDE_SECTOR_098 DET_EXISTENCE_PROB_098 DET_POINT_TARGET_PROB_098 DET_SNR_098 DET_SUPER_RES_TARGET_098 DET_BI_STATIC_FLAG_098 DET_VALID_FLAG_098 DET_RCS_098 DET_ELEVATION_ERR_098 DET_ELEVATION_098 DET_AZIMUTH_ERR_098 DET_AZIMUTH_098 DET_RANGE_VELOCITY_ERR_098 DET_RANGE_VELOCITY_098 DET_RANGE_ERR_098 DET_RANGE_098 DET_CONFD_ELEVATION_099 DET_CONFD_AZIMUTH_099 DET_HVC_FLAG_099 DET_OUTSIDE_SECTOR_099 DET_EXISTENCE_PROB_099 DET_POINT_TARGET_PROB_099 DET_SNR_099 DET_SUPER_RES_TARGET_099 DET_BI_STATIC_FLAG_099 DET_VALID_FLAG_099 DET_RCS_099 DET_ELEVATION_ERR_099 DET_ELEVATION_099 DET_AZIMUTH_ERR_099 DET_AZIMUTH_099 DET_RANGE_VELOCITY_ERR_099 DET_RANGE_VELOCITY_099 DET_RANGE_ERR_099 DET_RANGE_099 DET_CONFD_ELEVATION_100 DET_CONFD_AZIMUTH_100 DET_HVC_FLAG_100 DET_OUTSIDE_SECTOR_100 DET_EXISTENCE_PROB_100 DET_POINT_TARGET_PROB_100 DET_SNR_100 DET_SUPER_RES_TARGET_100 DET_BI_STATIC_FLAG_100 DET_VALID_FLAG_100 DET_RCS_100 DET_ELEVATION_ERR_100 DET_ELEVATION_100 DET_AZIMUTH_ERR_100 DET_AZIMUTH_100 DET_RANGE_VELOCITY_ERR_100 DET_RANGE_VELOCITY_100 DET_RANGE_ERR_100 DET_RANGE_100;
SIG_GROUP_ 1177 Detections_101_104 1 : DET_MH_CRC16_101_104 DET_MH_CYCLE_COUNTER_101_104 DET_MH_SCAN_INDEX_4LSB_101_104 DET_CONFD_ELEVATION_101 DET_CONFD_AZIMUTH_101 DET_HVC_FLAG_101 DET_OUTSIDE_SECTOR_101 DET_EXISTENCE_PROB_101 DET_POINT_TARGET_PROB_101 DET_SNR_101 DET_SUPER_RES_TARGET_101 DET_BI_STATIC_FLAG_101 DET_VALID_FLAG_101 DET_RCS_101 DET_ELEVATION_ERR_101 DET_ELEVATION_101 DET_AZIMUTH_ERR_101 DET_AZIMUTH_101 DET_RANGE_VELOCITY_ERR_101 DET_RANGE_VELOCITY_101 DET_RANGE_ERR_101 DET_RANGE_101 DET_CONFD_ELEVATION_102 DET_CONFD_AZIMUTH_102 DET_HVC_FLAG_102 DET_OUTSIDE_SECTOR_102 DET_EXISTENCE_PROB_102 DET_POINT_TARGET_PROB_102 DET_SNR_102 DET_SUPER_RES_TARGET_102 DET_BI_STATIC_FLAG_102 DET_VALID_FLAG_102 DET_RCS_102 DET_ELEVATION_ERR_102 DET_ELEVATION_102 DET_AZIMUTH_ERR_102 DET_AZIMUTH_102 DET_RANGE_VELOCITY_ERR_102 DET_RANGE_VELOCITY_102 DET_RANGE_ERR_102 DET_RANGE_102 DET_CONFD_ELEVATION_103 DET_CONFD_AZIMUTH_103 DET_HVC_FLAG_103 DET_OUTSIDE_SECTOR_103 DET_EXISTENCE_PROB_103 DET_POINT_TARGET_PROB_103 DET_SNR_103 DET_SUPER_RES_TARGET_103 DET_BI_STATIC_FLAG_103 DET_VALID_FLAG_103 DET_RCS_103 DET_ELEVATION_ERR_103 DET_ELEVATION_103 DET_AZIMUTH_ERR_103 DET_AZIMUTH_103 DET_RANGE_VELOCITY_ERR_103 DET_RANGE_VELOCITY_103 DET_RANGE_ERR_103 DET_RANGE_103 DET_CONFD_ELEVATION_104 DET_CONFD_AZIMUTH_104 DET_HVC_FLAG_104 DET_OUTSIDE_SECTOR_104 DET_EXISTENCE_PROB_104 DET_POINT_TARGET_PROB_104 DET_SNR_104 DET_SUPER_RES_TARGET_104 DET_BI_STATIC_FLAG_104 DET_VALID_FLAG_104 DET_RCS_104 DET_ELEVATION_ERR_104 DET_ELEVATION_104 DET_AZIMUTH_ERR_104 DET_AZIMUTH_104 DET_RANGE_VELOCITY_ERR_104 DET_RANGE_VELOCITY_104 DET_RANGE_ERR_104 DET_RANGE_104;
SIG_GROUP_ 1178 Detections_105_108 1 : DET_MH_CRC16_105_108 DET_MH_CYCLE_COUNTER_105_108 DET_MH_SCAN_INDEX_4LSB_105_108 DET_CONFD_ELEVATION_105 DET_CONFD_AZIMUTH_105 DET_HVC_FLAG_105 DET_OUTSIDE_SECTOR_105 DET_EXISTENCE_PROB_105 DET_POINT_TARGET_PROB_105 DET_SNR_105 DET_SUPER_RES_TARGET_105 DET_BI_STATIC_FLAG_105 DET_VALID_FLAG_105 DET_RCS_105 DET_ELEVATION_ERR_105 DET_ELEVATION_105 DET_AZIMUTH_ERR_105 DET_AZIMUTH_105 DET_RANGE_VELOCITY_ERR_105 DET_RANGE_VELOCITY_105 DET_RANGE_ERR_105 DET_RANGE_105 DET_CONFD_ELEVATION_106 DET_CONFD_AZIMUTH_106 DET_HVC_FLAG_106 DET_OUTSIDE_SECTOR_106 DET_EXISTENCE_PROB_106 DET_POINT_TARGET_PROB_106 DET_SNR_106 DET_SUPER_RES_TARGET_106 DET_BI_STATIC_FLAG_106 DET_VALID_FLAG_106 DET_RCS_106 DET_ELEVATION_ERR_106 DET_ELEVATION_106 DET_AZIMUTH_ERR_106 DET_AZIMUTH_106 DET_RANGE_VELOCITY_ERR_106 DET_RANGE_VELOCITY_106 DET_RANGE_ERR_106 DET_RANGE_106 DET_CONFD_ELEVATION_107 DET_CONFD_AZIMUTH_107 DET_HVC_FLAG_107 DET_OUTSIDE_SECTOR_107 DET_EXISTENCE_PROB_107 DET_POINT_TARGET_PROB_107 DET_SNR_107 DET_SUPER_RES_TARGET_107 DET_BI_STATIC_FLAG_107 DET_VALID_FLAG_107 DET_RCS_107 DET_ELEVATION_ERR_107 DET_ELEVATION_107 DET_AZIMUTH_ERR_107 DET_AZIMUTH_107 DET_RANGE_VELOCITY_ERR_107 DET_RANGE_VELOCITY_107 DET_RANGE_ERR_107 DET_RANGE_107 DET_CONFD_ELEVATION_108 DET_CONFD_AZIMUTH_108 DET_HVC_FLAG_108 DET_OUTSIDE_SECTOR_108 DET_EXISTENCE_PROB_108 DET_POINT_TARGET_PROB_108 DET_SNR_108 DET_SUPER_RES_TARGET_108 DET_BI_STATIC_FLAG_108 DET_VALID_FLAG_108 DET_RCS_108 DET_ELEVATION_ERR_108 DET_ELEVATION_108 DET_AZIMUTH_ERR_108 DET_AZIMUTH_108 DET_RANGE_VELOCITY_ERR_108 DET_RANGE_VELOCITY_108 DET_RANGE_ERR_108 DET_RANGE_108;
SIG_GROUP_ 1179 Detections_109_112 1 : DET_MH_CRC16_109_112 DET_MH_CYCLE_COUNTER_109_112 DET_MH_SCAN_INDEX_4LSB_109_112 DET_CONFD_ELEVATION_109 DET_CONFD_AZIMUTH_109 DET_HVC_FLAG_109 DET_OUTSIDE_SECTOR_109 DET_EXISTENCE_PROB_109 DET_POINT_TARGET_PROB_109 DET_SNR_109 DET_SUPER_RES_TARGET_109 DET_BI_STATIC_FLAG_109 DET_VALID_FLAG_109 DET_RCS_109 DET_ELEVATION_ERR_109 DET_ELEVATION_109 DET_AZIMUTH_ERR_109 DET_AZIMUTH_109 DET_RANGE_VELOCITY_ERR_109 DET_RANGE_VELOCITY_109 DET_RANGE_ERR_109 DET_RANGE_109 DET_CONFD_ELEVATION_110 DET_CONFD_AZIMUTH_110 DET_HVC_FLAG_110 DET_OUTSIDE_SECTOR_110 DET_EXISTENCE_PROB_110 DET_POINT_TARGET_PROB_110 DET_SNR_110 DET_SUPER_RES_TARGET_110 DET_BI_STATIC_FLAG_110 DET_VALID_FLAG_110 DET_RCS_110 DET_ELEVATION_ERR_110 DET_ELEVATION_110 DET_AZIMUTH_ERR_110 DET_AZIMUTH_110 DET_RANGE_VELOCITY_ERR_110 DET_RANGE_VELOCITY_110 DET_RANGE_ERR_110 DET_RANGE_110 DET_CONFD_ELEVATION_111 DET_CONFD_AZIMUTH_111 DET_HVC_FLAG_111 DET_OUTSIDE_SECTOR_111 DET_EXISTENCE_PROB_111 DET_POINT_TARGET_PROB_111 DET_SNR_111 DET_SUPER_RES_TARGET_111 DET_BI_STATIC_FLAG_111 DET_VALID_FLAG_111 DET_RCS_111 DET_ELEVATION_ERR_111 DET_ELEVATION_111 DET_AZIMUTH_ERR_111 DET_AZIMUTH_111 DET_RANGE_VELOCITY_ERR_111 DET_RANGE_VELOCITY_111 DET_RANGE_ERR_111 DET_RANGE_111 DET_CONFD_ELEVATION_112 DET_CONFD_AZIMUTH_112 DET_HVC_FLAG_112 DET_OUTSIDE_SECTOR_112 DET_EXISTENCE_PROB_112 DET_POINT_TARGET_PROB_112 DET_SNR_112 DET_SUPER_RES_TARGET_112 DET_BI_STATIC_FLAG_112 DET_VALID_FLAG_112 DET_RCS_112 DET_ELEVATION_ERR_112 DET_ELEVATION_112 DET_AZIMUTH_ERR_112 DET_AZIMUTH_112 DET_RANGE_VELOCITY_ERR_112 DET_RANGE_VELOCITY_112 DET_RANGE_ERR_112 DET_RANGE_112;
SIG_GROUP_ 1180 Detections_113_116 1 : DET_MH_CRC16_113_116 DET_MH_CYCLE_COUNTER_113_116 DET_MH_SCAN_INDEX_4LSB_113_116 DET_CONFD_ELEVATION_113 DET_CONFD_AZIMUTH_113 DET_HVC_FLAG_113 DET_OUTSIDE_SECTOR_113 DET_EXISTENCE_PROB_113 DET_POINT_TARGET_PROB_113 DET_SNR_113 DET_SUPER_RES_TARGET_113 DET_BI_STATIC_FLAG_113 DET_VALID_FLAG_113 DET_RCS_113 DET_ELEVATION_ERR_113 DET_ELEVATION_113 DET_AZIMUTH_ERR_113 DET_AZIMUTH_113 DET_RANGE_VELOCITY_ERR_113 DET_RANGE_VELOCITY_113 DET_RANGE_ERR_113 DET_RANGE_113 DET_CONFD_ELEVATION_114 DET_CONFD_AZIMUTH_114 DET_HVC_FLAG_114 DET_OUTSIDE_SECTOR_114 DET_EXISTENCE_PROB_114 DET_POINT_TARGET_PROB_114 DET_SNR_114 DET_SUPER_RES_TARGET_114 DET_BI_STATIC_FLAG_114 DET_VALID_FLAG_114 DET_RCS_114 DET_ELEVATION_ERR_114 DET_ELEVATION_114 DET_AZIMUTH_ERR_114 DET_AZIMUTH_114 DET_RANGE_VELOCITY_ERR_114 DET_RANGE_VELOCITY_114 DET_RANGE_ERR_114 DET_RANGE_114 DET_CONFD_ELEVATION_115 DET_CONFD_AZIMUTH_115 DET_HVC_FLAG_115 DET_OUTSIDE_SECTOR_115 DET_EXISTENCE_PROB_115 DET_POINT_TARGET_PROB_115 DET_SNR_115 DET_SUPER_RES_TARGET_115 DET_BI_STATIC_FLAG_115 DET_VALID_FLAG_115 DET_RCS_115 DET_ELEVATION_ERR_115 DET_ELEVATION_115 DET_AZIMUTH_ERR_115 DET_AZIMUTH_115 DET_RANGE_VELOCITY_ERR_115 DET_RANGE_VELOCITY_115 DET_RANGE_ERR_115 DET_RANGE_115 DET_CONFD_ELEVATION_116 DET_CONFD_AZIMUTH_116 DET_HVC_FLAG_116 DET_OUTSIDE_SECTOR_116 DET_EXISTENCE_PROB_116 DET_POINT_TARGET_PROB_116 DET_SNR_116 DET_SUPER_RES_TARGET_116 DET_BI_STATIC_FLAG_116 DET_VALID_FLAG_116 DET_RCS_116 DET_ELEVATION_ERR_116 DET_ELEVATION_116 DET_AZIMUTH_ERR_116 DET_AZIMUTH_116 DET_RANGE_VELOCITY_ERR_116 DET_RANGE_VELOCITY_116 DET_RANGE_ERR_116 DET_RANGE_116;

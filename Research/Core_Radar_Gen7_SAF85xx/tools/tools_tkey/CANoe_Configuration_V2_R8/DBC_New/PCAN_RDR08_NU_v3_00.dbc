VERSION "created by canmatrix"

NS_ :

BS_:

BU_: External_Tool ADAS RDR08

BO_ 1181 RDR_DETECTION_117_120: 64 RDR08
 SG_ DET_RANGE_117 : 24|15@1+ (0.015625,0) [0|500] "m"  ADAS
 SG_ DET_RANGE_ERR_117 : 40|7@1+ (0.0075,0) [0|0.9525] "m"  ADAS
 SG_ DET_RANGE_VELOCITY_117 : 48|15@1+ (0.0078125,-128) [-128|127.9921875] "m/s"  ADAS
 SG_ DET_RANGE_VELOCITY_ERR_117 : 64|8@1+ (0.003,0) [0|0.765] "m/s"  ADAS
 SG_ DET_AZIMUTH_117 : 88|13@1+ (0.0004,-1.5708) [-1.5708|1.5708] "rad"  ADAS
 SG_ DET_AZIMUTH_ERR_117 : 105|7@1+ (0.00087267,0) [0|0.11082909] "rad"  ADAS
 SG_ DET_ELEVATION_117 : 72|8@1+ (0.00275,-0.34925) [-0.34925|0.34925] "rad"  ADAS
 SG_ DET_ELEVATION_ERR_117 : 80|6@1+ (0.00174533,0) [0|0.10995579] "rad"  ADAS
 SG_ DET_RCS_117 : 136|8@1+ (0.5,-64) [-64|63.5] "dBsm"  ADAS
 SG_ DET_VALID_FLAG_117 : 119|1@1+ (1,0) [0|1] ""  ADAS
 SG_ DET_BI_STATIC_FLAG_117 : 504|1@1+ (1,0) [0|1] ""  ADAS
 SG_ DET_SUPER_RES_TARGET_117 : 104|1@1+ (1,0) [0|1] ""  ADAS
 SG_ DET_SNR_117 : 128|8@1+ (0.35156,0) [0|89.6478] "dB"  ADAS
 SG_ DET_POINT_TARGET_PROB_117 : 114|4@1+ (6.67,0) [0|100] "%"  ADAS
 SG_ DET_EXISTENCE_PROB_117 : 120|6@1+ (1.588,0) [0|100] "%"  ADAS
 SG_ DET_OUTSIDE_SECTOR_117 : 159|1@1+ (1,0) [0|1] ""  ADAS
 SG_ DET_HVC_FLAG_117 : 118|1@1+ (1,0) [0|1] ""  ADAS
 SG_ DET_CONFD_AZIMUTH_117 : 126|2@1+ (1,0) [0|3] ""  ADAS
 SG_ DET_CONFD_ELEVATION_117 : 112|2@1+ (1,0) [0|3] ""  ADAS
 SG_ DET_RANGE_118 : 144|15@1+ (0.015625,0) [0|500] "m"  ADAS
 SG_ DET_RANGE_ERR_118 : 160|7@1+ (0.0075,0) [0|0.9525] "m"  ADAS
 SG_ DET_RANGE_VELOCITY_118 : 168|15@1+ (0.0078125,-128) [-128|127.9921875] "m/s"  ADAS
 SG_ DET_RANGE_VELOCITY_ERR_118 : 184|8@1+ (0.003,0) [0|0.765] "m/s"  ADAS
 SG_ DET_AZIMUTH_118 : 208|13@1+ (0.0004,-1.5708) [-1.5708|1.5708] "rad"  ADAS
 SG_ DET_AZIMUTH_ERR_118 : 224|7@1+ (0.00087267,0) [0|0.11082909] "rad"  ADAS
 SG_ DET_ELEVATION_118 : 192|8@1+ (0.00275,-0.34925) [-0.34925|0.34925] "rad"  ADAS
 SG_ DET_ELEVATION_ERR_118 : 200|6@1+ (0.00174533,0) [0|0.10995579] "rad"  ADAS
 SG_ DET_RCS_118 : 256|8@1+ (0.5,-64) [-64|63.5] "dBsm"  ADAS
 SG_ DET_VALID_FLAG_118 : 167|1@1+ (1,0) [0|1] ""  ADAS
 SG_ DET_BI_STATIC_FLAG_118 : 505|1@1+ (1,0) [0|1] ""  ADAS
 SG_ DET_SUPER_RES_TARGET_118 : 247|1@1+ (1,0) [0|1] ""  ADAS
 SG_ DET_SNR_118 : 248|8@1+ (0.35156,0) [0|89.6478] "dB"  ADAS
 SG_ DET_POINT_TARGET_PROB_118 : 240|4@1+ (6.67,0) [0|100] "%"  ADAS
 SG_ DET_EXISTENCE_PROB_118 : 232|6@1+ (1.588,0) [0|100] "%"  ADAS
 SG_ DET_OUTSIDE_SECTOR_118 : 183|1@1+ (1,0) [0|1] ""  ADAS
 SG_ DET_HVC_FLAG_118 : 246|1@1+ (1,0) [0|1] ""  ADAS
 SG_ DET_CONFD_AZIMUTH_118 : 206|2@1+ (1,0) [0|3] ""  ADAS
 SG_ DET_CONFD_ELEVATION_118 : 244|2@1+ (1,0) [0|3] ""  ADAS
 SG_ DET_RANGE_119 : 264|15@1+ (0.015625,0) [0|500] "m"  ADAS
 SG_ DET_RANGE_ERR_119 : 280|7@1+ (0.0075,0) [0|0.9525] "m"  ADAS
 SG_ DET_RANGE_VELOCITY_119 : 288|15@1+ (0.0078125,-128) [-128|127.9921875] "m/s"  ADAS
 SG_ DET_RANGE_VELOCITY_ERR_119 : 304|8@1+ (0.003,0) [0|0.765] "m/s"  ADAS
 SG_ DET_AZIMUTH_119 : 328|13@1+ (0.0004,-1.5708) [-1.5708|1.5708] "rad"  ADAS
 SG_ DET_AZIMUTH_ERR_119 : 345|7@1+ (0.00087267,0) [0|0.11082909] "rad"  ADAS
 SG_ DET_ELEVATION_119 : 312|8@1+ (0.00275,-0.34925) [-0.34925|0.34925] "rad"  ADAS
 SG_ DET_ELEVATION_ERR_119 : 320|6@1+ (0.00174533,0) [0|0.10995579] "rad"  ADAS
 SG_ DET_RCS_119 : 376|8@1+ (0.5,-64) [-64|63.5] "dBsm"  ADAS
 SG_ DET_VALID_FLAG_119 : 399|1@1+ (1,0) [0|1] ""  ADAS
 SG_ DET_BI_STATIC_FLAG_119 : 482|1@1+ (1,0) [0|1] ""  ADAS
 SG_ DET_SUPER_RES_TARGET_119 : 344|1@1+ (1,0) [0|1] ""  ADAS
 SG_ DET_SNR_119 : 368|8@1+ (0.35156,0) [0|89.6478] "dB"  ADAS
 SG_ DET_POINT_TARGET_PROB_119 : 360|4@1+ (6.67,0) [0|100] "%"  ADAS
 SG_ DET_EXISTENCE_PROB_119 : 352|6@1+ (1.588,0) [0|100] "%"  ADAS
 SG_ DET_OUTSIDE_SECTOR_119 : 407|1@1+ (1,0) [0|1] ""  ADAS
 SG_ DET_HVC_FLAG_119 : 364|1@1+ (1,0) [0|1] ""  ADAS
 SG_ DET_CONFD_AZIMUTH_119 : 365|2@1+ (1,0) [0|3] ""  ADAS
 SG_ DET_CONFD_ELEVATION_119 : 358|2@1+ (1,0) [0|3] ""  ADAS
 SG_ DET_RANGE_120 : 384|15@1+ (0.015625,0) [0|500] "m"  ADAS
 SG_ DET_RANGE_ERR_120 : 400|7@1+ (0.0075,0) [0|0.9525] "m"  ADAS
 SG_ DET_RANGE_VELOCITY_120 : 408|15@1+ (0.0078125,-128) [-128|127.9921875] "m/s"  ADAS
 SG_ DET_RANGE_VELOCITY_ERR_120 : 424|8@1+ (0.003,0) [0|0.765] "m/s"  ADAS
 SG_ DET_AZIMUTH_120 : 448|13@1+ (0.0004,-1.5708) [-1.5708|1.5708] "rad"  ADAS
 SG_ DET_AZIMUTH_ERR_120 : 465|7@1+ (0.00087267,0) [0|0.11082909] "rad"  ADAS
 SG_ DET_ELEVATION_120 : 432|8@1+ (0.00275,-0.34925) [-0.34925|0.34925] "rad"  ADAS
 SG_ DET_ELEVATION_ERR_120 : 440|6@1+ (0.00174533,0) [0|0.10995579] "rad"  ADAS
 SG_ DET_RCS_120 : 496|8@1+ (0.5,-64) [-64|63.5] "dBsm"  ADAS
 SG_ DET_VALID_FLAG_120 : 485|1@1+ (1,0) [0|1] ""  ADAS
 SG_ DET_BI_STATIC_FLAG_120 : 483|1@1+ (1,0) [0|1] ""  ADAS
 SG_ DET_SUPER_RES_TARGET_120 : 446|1@1+ (1,0) [0|1] ""  ADAS
 SG_ DET_SNR_120 : 488|8@1+ (0.35156,0) [0|89.6478] "dB"  ADAS
 SG_ DET_POINT_TARGET_PROB_120 : 472|4@1+ (6.67,0) [0|100] "%"  ADAS
 SG_ DET_EXISTENCE_PROB_120 : 506|6@1+ (1.588,0) [0|100] "%"  ADAS
 SG_ DET_OUTSIDE_SECTOR_120 : 481|1@1+ (1,0) [0|1] ""  ADAS
 SG_ DET_HVC_FLAG_120 : 464|1@1+ (1,0) [0|1] ""  ADAS
 SG_ DET_CONFD_AZIMUTH_120 : 486|2@1+ (1,0) [0|3] ""  ADAS
 SG_ DET_CONFD_ELEVATION_120 : 461|2@1+ (1,0) [0|3] ""  ADAS
 SG_ DET_MH_SCAN_INDEX_4LSB_117_120 : 476|4@1+ (1,0) [0|15] ""  ADAS
 SG_ DET_MH_CYCLE_COUNTER_117_120 : 16|8@1+ (1,0) [0|255] ""  ADAS
 SG_ DET_MH_CRC16_117_120 : 0|16@1+ (1,0) [0|65535] ""  ADAS

BO_ 1182 RDR_DETECTION_121_124: 64 RDR08
 SG_ DET_RANGE_121 : 24|15@1+ (0.015625,0) [0|500] "m"  ADAS
 SG_ DET_RANGE_ERR_121 : 40|7@1+ (0.0075,0) [0|0.9525] "m"  ADAS
 SG_ DET_RANGE_VELOCITY_121 : 48|15@1+ (0.0078125,-128) [-128|127.9921875] "m/s"  ADAS
 SG_ DET_RANGE_VELOCITY_ERR_121 : 64|8@1+ (0.003,0) [0|0.765] "m/s"  ADAS
 SG_ DET_AZIMUTH_121 : 88|13@1+ (0.0004,-1.5708) [-1.5708|1.5708] "rad"  ADAS
 SG_ DET_AZIMUTH_ERR_121 : 105|7@1+ (0.00087267,0) [0|0.11082909] "rad"  ADAS
 SG_ DET_ELEVATION_121 : 72|8@1+ (0.00275,-0.34925) [-0.34925|0.34925] "rad"  ADAS
 SG_ DET_ELEVATION_ERR_121 : 80|6@1+ (0.00174533,0) [0|0.10995579] "rad"  ADAS
 SG_ DET_RCS_121 : 136|8@1+ (0.5,-64) [-64|63.5] "dBsm"  ADAS
 SG_ DET_VALID_FLAG_121 : 119|1@1+ (1,0) [0|1] ""  ADAS
 SG_ DET_BI_STATIC_FLAG_121 : 504|1@1+ (1,0) [0|1] ""  ADAS
 SG_ DET_SUPER_RES_TARGET_121 : 104|1@1+ (1,0) [0|1] ""  ADAS
 SG_ DET_SNR_121 : 128|8@1+ (0.35156,0) [0|89.6478] "dB"  ADAS
 SG_ DET_POINT_TARGET_PROB_121 : 114|4@1+ (6.67,0) [0|100] "%"  ADAS
 SG_ DET_EXISTENCE_PROB_121 : 120|6@1+ (1.588,0) [0|100] "%"  ADAS
 SG_ DET_OUTSIDE_SECTOR_121 : 159|1@1+ (1,0) [0|1] ""  ADAS
 SG_ DET_HVC_FLAG_121 : 118|1@1+ (1,0) [0|1] ""  ADAS
 SG_ DET_CONFD_AZIMUTH_121 : 126|2@1+ (1,0) [0|3] ""  ADAS
 SG_ DET_CONFD_ELEVATION_121 : 112|2@1+ (1,0) [0|3] ""  ADAS
 SG_ DET_RANGE_122 : 144|15@1+ (0.015625,0) [0|500] "m"  ADAS
 SG_ DET_RANGE_ERR_122 : 160|7@1+ (0.0075,0) [0|0.9525] "m"  ADAS
 SG_ DET_RANGE_VELOCITY_122 : 168|15@1+ (0.0078125,-128) [-128|127.9921875] "m/s"  ADAS
 SG_ DET_RANGE_VELOCITY_ERR_122 : 184|8@1+ (0.003,0) [0|0.765] "m/s"  ADAS
 SG_ DET_AZIMUTH_122 : 208|13@1+ (0.0004,-1.5708) [-1.5708|1.5708] "rad"  ADAS
 SG_ DET_AZIMUTH_ERR_122 : 224|7@1+ (0.00087267,0) [0|0.11082909] "rad"  ADAS
 SG_ DET_ELEVATION_122 : 192|8@1+ (0.00275,-0.34925) [-0.34925|0.34925] "rad"  ADAS
 SG_ DET_ELEVATION_ERR_122 : 200|6@1+ (0.00174533,0) [0|0.10995579] "rad"  ADAS
 SG_ DET_RCS_122 : 256|8@1+ (0.5,-64) [-64|63.5] "dBsm"  ADAS
 SG_ DET_VALID_FLAG_122 : 167|1@1+ (1,0) [0|1] ""  ADAS
 SG_ DET_BI_STATIC_FLAG_122 : 505|1@1+ (1,0) [0|1] ""  ADAS
 SG_ DET_SUPER_RES_TARGET_122 : 247|1@1+ (1,0) [0|1] ""  ADAS
 SG_ DET_SNR_122 : 248|8@1+ (0.35156,0) [0|89.6478] "dB"  ADAS
 SG_ DET_POINT_TARGET_PROB_122 : 240|4@1+ (6.67,0) [0|100] "%"  ADAS
 SG_ DET_EXISTENCE_PROB_122 : 232|6@1+ (1.588,0) [0|100] "%"  ADAS
 SG_ DET_OUTSIDE_SECTOR_122 : 183|1@1+ (1,0) [0|1] ""  ADAS
 SG_ DET_HVC_FLAG_122 : 246|1@1+ (1,0) [0|1] ""  ADAS
 SG_ DET_CONFD_AZIMUTH_122 : 206|2@1+ (1,0) [0|3] ""  ADAS
 SG_ DET_CONFD_ELEVATION_122 : 244|2@1+ (1,0) [0|3] ""  ADAS
 SG_ DET_RANGE_123 : 264|15@1+ (0.015625,0) [0|500] "m"  ADAS
 SG_ DET_RANGE_ERR_123 : 280|7@1+ (0.0075,0) [0|0.9525] "m"  ADAS
 SG_ DET_RANGE_VELOCITY_123 : 288|15@1+ (0.0078125,-128) [-128|127.9921875] "m/s"  ADAS
 SG_ DET_RANGE_VELOCITY_ERR_123 : 304|8@1+ (0.003,0) [0|0.765] "m/s"  ADAS
 SG_ DET_AZIMUTH_123 : 328|13@1+ (0.0004,-1.5708) [-1.5708|1.5708] "rad"  ADAS
 SG_ DET_AZIMUTH_ERR_123 : 345|7@1+ (0.00087267,0) [0|0.11082909] "rad"  ADAS
 SG_ DET_ELEVATION_123 : 312|8@1+ (0.00275,-0.34925) [-0.34925|0.34925] "rad"  ADAS
 SG_ DET_ELEVATION_ERR_123 : 320|6@1+ (0.00174533,0) [0|0.10995579] "rad"  ADAS
 SG_ DET_RCS_123 : 376|8@1+ (0.5,-64) [-64|63.5] "dBsm"  ADAS
 SG_ DET_VALID_FLAG_123 : 399|1@1+ (1,0) [0|1] ""  ADAS
 SG_ DET_BI_STATIC_FLAG_123 : 482|1@1+ (1,0) [0|1] ""  ADAS
 SG_ DET_SUPER_RES_TARGET_123 : 344|1@1+ (1,0) [0|1] ""  ADAS
 SG_ DET_SNR_123 : 368|8@1+ (0.35156,0) [0|89.6478] "dB"  ADAS
 SG_ DET_POINT_TARGET_PROB_123 : 360|4@1+ (6.67,0) [0|100] "%"  ADAS
 SG_ DET_EXISTENCE_PROB_123 : 352|6@1+ (1.588,0) [0|100] "%"  ADAS
 SG_ DET_OUTSIDE_SECTOR_123 : 407|1@1+ (1,0) [0|1] ""  ADAS
 SG_ DET_HVC_FLAG_123 : 364|1@1+ (1,0) [0|1] ""  ADAS
 SG_ DET_CONFD_AZIMUTH_123 : 365|2@1+ (1,0) [0|3] ""  ADAS
 SG_ DET_CONFD_ELEVATION_123 : 358|2@1+ (1,0) [0|3] ""  ADAS
 SG_ DET_RANGE_124 : 384|15@1+ (0.015625,0) [0|500] "m"  ADAS
 SG_ DET_RANGE_ERR_124 : 400|7@1+ (0.0075,0) [0|0.9525] "m"  ADAS
 SG_ DET_RANGE_VELOCITY_124 : 408|15@1+ (0.0078125,-128) [-128|127.9921875] "m/s"  ADAS
 SG_ DET_RANGE_VELOCITY_ERR_124 : 424|8@1+ (0.003,0) [0|0.765] "m/s"  ADAS
 SG_ DET_AZIMUTH_124 : 448|13@1+ (0.0004,-1.5708) [-1.5708|1.5708] "rad"  ADAS
 SG_ DET_AZIMUTH_ERR_124 : 465|7@1+ (0.00087267,0) [0|0.11082909] "rad"  ADAS
 SG_ DET_ELEVATION_124 : 432|8@1+ (0.00275,-0.34925) [-0.34925|0.34925] "rad"  ADAS
 SG_ DET_ELEVATION_ERR_124 : 440|6@1+ (0.00174533,0) [0|0.10995579] "rad"  ADAS
 SG_ DET_RCS_124 : 496|8@1+ (0.5,-64) [-64|63.5] "dBsm"  ADAS
 SG_ DET_VALID_FLAG_124 : 485|1@1+ (1,0) [0|1] ""  ADAS
 SG_ DET_BI_STATIC_FLAG_124 : 483|1@1+ (1,0) [0|1] ""  ADAS
 SG_ DET_SUPER_RES_TARGET_124 : 446|1@1+ (1,0) [0|1] ""  ADAS
 SG_ DET_SNR_124 : 488|8@1+ (0.35156,0) [0|89.6478] "dB"  ADAS
 SG_ DET_POINT_TARGET_PROB_124 : 472|4@1+ (6.67,0) [0|100] "%"  ADAS
 SG_ DET_EXISTENCE_PROB_124 : 506|6@1+ (1.588,0) [0|100] "%"  ADAS
 SG_ DET_OUTSIDE_SECTOR_124 : 481|1@1+ (1,0) [0|1] ""  ADAS
 SG_ DET_HVC_FLAG_124 : 464|1@1+ (1,0) [0|1] ""  ADAS
 SG_ DET_CONFD_AZIMUTH_124 : 486|2@1+ (1,0) [0|3] ""  ADAS
 SG_ DET_CONFD_ELEVATION_124 : 461|2@1+ (1,0) [0|3] ""  ADAS
 SG_ DET_MH_SCAN_INDEX_4LSB_121_124 : 476|4@1+ (1,0) [0|15] ""  ADAS
 SG_ DET_MH_CYCLE_COUNTER_121_124 : 16|8@1+ (1,0) [0|255] ""  ADAS
 SG_ DET_MH_CRC16_121_124 : 0|16@1+ (1,0) [0|65535] ""  ADAS

BO_ 1183 RDR_DETECTION_125_128: 64 RDR08
 SG_ DET_RANGE_125 : 24|15@1+ (0.015625,0) [0|500] "m"  ADAS
 SG_ DET_RANGE_ERR_125 : 40|7@1+ (0.0075,0) [0|0.9525] "m"  ADAS
 SG_ DET_RANGE_VELOCITY_125 : 48|15@1+ (0.0078125,-128) [-128|127.9921875] "m/s"  ADAS
 SG_ DET_RANGE_VELOCITY_ERR_125 : 64|8@1+ (0.003,0) [0|0.765] "m/s"  ADAS
 SG_ DET_AZIMUTH_125 : 88|13@1+ (0.0004,-1.5708) [-1.5708|1.5708] "rad"  ADAS
 SG_ DET_AZIMUTH_ERR_125 : 105|7@1+ (0.00087267,0) [0|0.11082909] "rad"  ADAS
 SG_ DET_ELEVATION_125 : 72|8@1+ (0.00275,-0.34925) [-0.34925|0.34925] "rad"  ADAS
 SG_ DET_ELEVATION_ERR_125 : 80|6@1+ (0.00174533,0) [0|0.10995579] "rad"  ADAS
 SG_ DET_RCS_125 : 136|8@1+ (0.5,-64) [-64|63.5] "dBsm"  ADAS
 SG_ DET_VALID_FLAG_125 : 119|1@1+ (1,0) [0|1] ""  ADAS
 SG_ DET_BI_STATIC_FLAG_125 : 504|1@1+ (1,0) [0|1] ""  ADAS
 SG_ DET_SUPER_RES_TARGET_125 : 104|1@1+ (1,0) [0|1] ""  ADAS
 SG_ DET_SNR_125 : 128|8@1+ (0.35156,0) [0|89.6478] "dB"  ADAS
 SG_ DET_POINT_TARGET_PROB_125 : 114|4@1+ (6.67,0) [0|100] "%"  ADAS
 SG_ DET_EXISTENCE_PROB_125 : 120|6@1+ (1.588,0) [0|100] "%"  ADAS
 SG_ DET_OUTSIDE_SECTOR_125 : 159|1@1+ (1,0) [0|1] ""  ADAS
 SG_ DET_HVC_FLAG_125 : 118|1@1+ (1,0) [0|1] ""  ADAS
 SG_ DET_CONFD_AZIMUTH_125 : 126|2@1+ (1,0) [0|3] ""  ADAS
 SG_ DET_CONFD_ELEVATION_125 : 112|2@1+ (1,0) [0|3] ""  ADAS
 SG_ DET_RANGE_126 : 144|15@1+ (0.015625,0) [0|500] "m"  ADAS
 SG_ DET_RANGE_ERR_126 : 160|7@1+ (0.0075,0) [0|0.9525] "m"  ADAS
 SG_ DET_RANGE_VELOCITY_126 : 168|15@1+ (0.0078125,-128) [-128|127.9921875] "m/s"  ADAS
 SG_ DET_RANGE_VELOCITY_ERR_126 : 184|8@1+ (0.003,0) [0|0.765] "m/s"  ADAS
 SG_ DET_AZIMUTH_126 : 208|13@1+ (0.0004,-1.5708) [-1.5708|1.5708] "rad"  ADAS
 SG_ DET_AZIMUTH_ERR_126 : 224|7@1+ (0.00087267,0) [0|0.11082909] "rad"  ADAS
 SG_ DET_ELEVATION_126 : 192|8@1+ (0.00275,-0.34925) [-0.34925|0.34925] "rad"  ADAS
 SG_ DET_ELEVATION_ERR_126 : 200|6@1+ (0.00174533,0) [0|0.10995579] "rad"  ADAS
 SG_ DET_RCS_126 : 256|8@1+ (0.5,-64) [-64|63.5] "dBsm"  ADAS
 SG_ DET_VALID_FLAG_126 : 167|1@1+ (1,0) [0|1] ""  ADAS
 SG_ DET_BI_STATIC_FLAG_126 : 505|1@1+ (1,0) [0|1] ""  ADAS
 SG_ DET_SUPER_RES_TARGET_126 : 247|1@1+ (1,0) [0|1] ""  ADAS
 SG_ DET_SNR_126 : 248|8@1+ (0.35156,0) [0|89.6478] "dB"  ADAS
 SG_ DET_POINT_TARGET_PROB_126 : 240|4@1+ (6.67,0) [0|100] "%"  ADAS
 SG_ DET_EXISTENCE_PROB_126 : 232|6@1+ (1.588,0) [0|100] "%"  ADAS
 SG_ DET_OUTSIDE_SECTOR_126 : 183|1@1+ (1,0) [0|1] ""  ADAS
 SG_ DET_HVC_FLAG_126 : 246|1@1+ (1,0) [0|1] ""  ADAS
 SG_ DET_CONFD_AZIMUTH_126 : 206|2@1+ (1,0) [0|3] ""  ADAS
 SG_ DET_CONFD_ELEVATION_126 : 244|2@1+ (1,0) [0|3] ""  ADAS
 SG_ DET_RANGE_127 : 264|15@1+ (0.015625,0) [0|500] "m"  ADAS
 SG_ DET_RANGE_ERR_127 : 280|7@1+ (0.0075,0) [0|0.9525] "m"  ADAS
 SG_ DET_RANGE_VELOCITY_127 : 288|15@1+ (0.0078125,-128) [-128|127.9921875] "m/s"  ADAS
 SG_ DET_RANGE_VELOCITY_ERR_127 : 304|8@1+ (0.003,0) [0|0.765] "m/s"  ADAS
 SG_ DET_AZIMUTH_127 : 328|13@1+ (0.0004,-1.5708) [-1.5708|1.5708] "rad"  ADAS
 SG_ DET_AZIMUTH_ERR_127 : 345|7@1+ (0.00087267,0) [0|0.11082909] "rad"  ADAS
 SG_ DET_ELEVATION_127 : 312|8@1+ (0.00275,-0.34925) [-0.34925|0.34925] "rad"  ADAS
 SG_ DET_ELEVATION_ERR_127 : 320|6@1+ (0.00174533,0) [0|0.10995579] "rad"  ADAS
 SG_ DET_RCS_127 : 376|8@1+ (0.5,-64) [-64|63.5] "dBsm"  ADAS
 SG_ DET_VALID_FLAG_127 : 399|1@1+ (1,0) [0|1] ""  ADAS
 SG_ DET_BI_STATIC_FLAG_127 : 482|1@1+ (1,0) [0|1] ""  ADAS
 SG_ DET_SUPER_RES_TARGET_127 : 344|1@1+ (1,0) [0|1] ""  ADAS
 SG_ DET_SNR_127 : 368|8@1+ (0.35156,0) [0|89.6478] "dB"  ADAS
 SG_ DET_POINT_TARGET_PROB_127 : 360|4@1+ (6.67,0) [0|100] "%"  ADAS
 SG_ DET_EXISTENCE_PROB_127 : 352|6@1+ (1.588,0) [0|100] "%"  ADAS
 SG_ DET_OUTSIDE_SECTOR_127 : 407|1@1+ (1,0) [0|1] ""  ADAS
 SG_ DET_HVC_FLAG_127 : 364|1@1+ (1,0) [0|1] ""  ADAS
 SG_ DET_CONFD_AZIMUTH_127 : 365|2@1+ (1,0) [0|3] ""  ADAS
 SG_ DET_CONFD_ELEVATION_127 : 358|2@1+ (1,0) [0|3] ""  ADAS
 SG_ DET_RANGE_128 : 384|15@1+ (0.015625,0) [0|500] "m"  ADAS
 SG_ DET_RANGE_ERR_128 : 400|7@1+ (0.0075,0) [0|0.9525] "m"  ADAS
 SG_ DET_RANGE_VELOCITY_128 : 408|15@1+ (0.0078125,-128) [-128|127.9921875] "m/s"  ADAS
 SG_ DET_RANGE_VELOCITY_ERR_128 : 424|8@1+ (0.003,0) [0|0.765] "m/s"  ADAS
 SG_ DET_AZIMUTH_128 : 448|13@1+ (0.0004,-1.5708) [-1.5708|1.5708] "rad"  ADAS
 SG_ DET_AZIMUTH_ERR_128 : 465|7@1+ (0.00087267,0) [0|0.11082909] "rad"  ADAS
 SG_ DET_ELEVATION_128 : 432|8@1+ (0.00275,-0.34925) [-0.34925|0.34925] "rad"  ADAS
 SG_ DET_ELEVATION_ERR_128 : 440|6@1+ (0.00174533,0) [0|0.10995579] "rad"  ADAS
 SG_ DET_RCS_128 : 496|8@1+ (0.5,-64) [-64|63.5] "dBsm"  ADAS
 SG_ DET_VALID_FLAG_128 : 485|1@1+ (1,0) [0|1] ""  ADAS
 SG_ DET_BI_STATIC_FLAG_128 : 483|1@1+ (1,0) [0|1] ""  ADAS
 SG_ DET_SUPER_RES_TARGET_128 : 446|1@1+ (1,0) [0|1] ""  ADAS
 SG_ DET_SNR_128 : 488|8@1+ (0.35156,0) [0|89.6478] "dB"  ADAS
 SG_ DET_POINT_TARGET_PROB_128 : 472|4@1+ (6.67,0) [0|100] "%"  ADAS
 SG_ DET_EXISTENCE_PROB_128 : 506|6@1+ (1.588,0) [0|100] "%"  ADAS
 SG_ DET_OUTSIDE_SECTOR_128 : 481|1@1+ (1,0) [0|1] ""  ADAS
 SG_ DET_HVC_FLAG_128 : 464|1@1+ (1,0) [0|1] ""  ADAS
 SG_ DET_CONFD_AZIMUTH_128 : 486|2@1+ (1,0) [0|3] ""  ADAS
 SG_ DET_CONFD_ELEVATION_128 : 461|2@1+ (1,0) [0|3] ""  ADAS
 SG_ DET_MH_SCAN_INDEX_4LSB_125_128 : 476|4@1+ (1,0) [0|15] ""  ADAS
 SG_ DET_MH_CYCLE_COUNTER_125_128 : 16|8@1+ (1,0) [0|255] ""  ADAS
 SG_ DET_MH_CRC16_125_128 : 0|16@1+ (1,0) [0|65535] ""  ADAS

BO_ 1184 RDR_DETECTION_129_132: 64 RDR08
 SG_ DET_RANGE_129 : 24|15@1+ (0.015625,0) [0|500] "m"  ADAS
 SG_ DET_RANGE_ERR_129 : 40|7@1+ (0.0075,0) [0|0.9525] "m"  ADAS
 SG_ DET_RANGE_VELOCITY_129 : 48|15@1+ (0.0078125,-128) [-128|127.9921875] "m/s"  ADAS
 SG_ DET_RANGE_VELOCITY_ERR_129 : 64|8@1+ (0.003,0) [0|0.765] "m/s"  ADAS
 SG_ DET_AZIMUTH_129 : 88|13@1+ (0.0004,-1.5708) [-1.5708|1.5708] "rad"  ADAS
 SG_ DET_AZIMUTH_ERR_129 : 105|7@1+ (0.00087267,0) [0|0.11082909] "rad"  ADAS
 SG_ DET_ELEVATION_129 : 72|8@1+ (0.00275,-0.34925) [-0.34925|0.34925] "rad"  ADAS
 SG_ DET_ELEVATION_ERR_129 : 80|6@1+ (0.00174533,0) [0|0.10995579] "rad"  ADAS
 SG_ DET_RCS_129 : 136|8@1+ (0.5,-64) [-64|63.5] "dBsm"  ADAS
 SG_ DET_VALID_FLAG_129 : 119|1@1+ (1,0) [0|1] ""  ADAS
 SG_ DET_BI_STATIC_FLAG_129 : 504|1@1+ (1,0) [0|1] ""  ADAS
 SG_ DET_SUPER_RES_TARGET_129 : 104|1@1+ (1,0) [0|1] ""  ADAS
 SG_ DET_SNR_129 : 128|8@1+ (0.35156,0) [0|89.6478] "dB"  ADAS
 SG_ DET_POINT_TARGET_PROB_129 : 114|4@1+ (6.67,0) [0|100] "%"  ADAS
 SG_ DET_EXISTENCE_PROB_129 : 120|6@1+ (1.588,0) [0|100] "%"  ADAS
 SG_ DET_OUTSIDE_SECTOR_129 : 159|1@1+ (1,0) [0|1] ""  ADAS
 SG_ DET_HVC_FLAG_129 : 118|1@1+ (1,0) [0|1] ""  ADAS
 SG_ DET_CONFD_AZIMUTH_129 : 126|2@1+ (1,0) [0|3] ""  ADAS
 SG_ DET_CONFD_ELEVATION_129 : 112|2@1+ (1,0) [0|3] ""  ADAS
 SG_ DET_RANGE_130 : 144|15@1+ (0.015625,0) [0|500] "m"  ADAS
 SG_ DET_RANGE_ERR_130 : 160|7@1+ (0.0075,0) [0|0.9525] "m"  ADAS
 SG_ DET_RANGE_VELOCITY_130 : 168|15@1+ (0.0078125,-128) [-128|127.9921875] "m/s"  ADAS
 SG_ DET_RANGE_VELOCITY_ERR_130 : 184|8@1+ (0.003,0) [0|0.765] "m/s"  ADAS
 SG_ DET_AZIMUTH_130 : 208|13@1+ (0.0004,-1.5708) [-1.5708|1.5708] "rad"  ADAS
 SG_ DET_AZIMUTH_ERR_130 : 224|7@1+ (0.00087267,0) [0|0.11082909] "rad"  ADAS
 SG_ DET_ELEVATION_130 : 192|8@1+ (0.00275,-0.34925) [-0.34925|0.34925] "rad"  ADAS
 SG_ DET_ELEVATION_ERR_130 : 200|6@1+ (0.00174533,0) [0|0.10995579] "rad"  ADAS
 SG_ DET_RCS_130 : 256|8@1+ (0.5,-64) [-64|63.5] "dBsm"  ADAS
 SG_ DET_VALID_FLAG_130 : 167|1@1+ (1,0) [0|1] ""  ADAS
 SG_ DET_BI_STATIC_FLAG_130 : 505|1@1+ (1,0) [0|1] ""  ADAS
 SG_ DET_SUPER_RES_TARGET_130 : 247|1@1+ (1,0) [0|1] ""  ADAS
 SG_ DET_SNR_130 : 248|8@1+ (0.35156,0) [0|89.6478] "dB"  ADAS
 SG_ DET_POINT_TARGET_PROB_130 : 240|4@1+ (6.67,0) [0|100] "%"  ADAS
 SG_ DET_EXISTENCE_PROB_130 : 232|6@1+ (1.588,0) [0|100] "%"  ADAS
 SG_ DET_OUTSIDE_SECTOR_130 : 183|1@1+ (1,0) [0|1] ""  ADAS
 SG_ DET_HVC_FLAG_130 : 246|1@1+ (1,0) [0|1] ""  ADAS
 SG_ DET_CONFD_AZIMUTH_130 : 206|2@1+ (1,0) [0|3] ""  ADAS
 SG_ DET_CONFD_ELEVATION_130 : 244|2@1+ (1,0) [0|3] ""  ADAS
 SG_ DET_RANGE_131 : 264|15@1+ (0.015625,0) [0|500] "m"  ADAS
 SG_ DET_RANGE_ERR_131 : 280|7@1+ (0.0075,0) [0|0.9525] "m"  ADAS
 SG_ DET_RANGE_VELOCITY_131 : 288|15@1+ (0.0078125,-128) [-128|127.9921875] "m/s"  ADAS
 SG_ DET_RANGE_VELOCITY_ERR_131 : 304|8@1+ (0.003,0) [0|0.765] "m/s"  ADAS
 SG_ DET_AZIMUTH_131 : 328|13@1+ (0.0004,-1.5708) [-1.5708|1.5708] "rad"  ADAS
 SG_ DET_AZIMUTH_ERR_131 : 345|7@1+ (0.00087267,0) [0|0.11082909] "rad"  ADAS
 SG_ DET_ELEVATION_131 : 312|8@1+ (0.00275,-0.34925) [-0.34925|0.34925] "rad"  ADAS
 SG_ DET_ELEVATION_ERR_131 : 320|6@1+ (0.00174533,0) [0|0.10995579] "rad"  ADAS
 SG_ DET_RCS_131 : 376|8@1+ (0.5,-64) [-64|63.5] "dBsm"  ADAS
 SG_ DET_VALID_FLAG_131 : 399|1@1+ (1,0) [0|1] ""  ADAS
 SG_ DET_BI_STATIC_FLAG_131 : 482|1@1+ (1,0) [0|1] ""  ADAS
 SG_ DET_SUPER_RES_TARGET_131 : 344|1@1+ (1,0) [0|1] ""  ADAS
 SG_ DET_SNR_131 : 368|8@1+ (0.35156,0) [0|89.6478] "dB"  ADAS
 SG_ DET_POINT_TARGET_PROB_131 : 360|4@1+ (6.67,0) [0|100] "%"  ADAS
 SG_ DET_EXISTENCE_PROB_131 : 352|6@1+ (1.588,0) [0|100] "%"  ADAS
 SG_ DET_OUTSIDE_SECTOR_131 : 407|1@1+ (1,0) [0|1] ""  ADAS
 SG_ DET_HVC_FLAG_131 : 364|1@1+ (1,0) [0|1] ""  ADAS
 SG_ DET_CONFD_AZIMUTH_131 : 365|2@1+ (1,0) [0|3] ""  ADAS
 SG_ DET_CONFD_ELEVATION_131 : 358|2@1+ (1,0) [0|3] ""  ADAS
 SG_ DET_RANGE_132 : 384|15@1+ (0.015625,0) [0|500] "m"  ADAS
 SG_ DET_RANGE_ERR_132 : 400|7@1+ (0.0075,0) [0|0.9525] "m"  ADAS
 SG_ DET_RANGE_VELOCITY_132 : 408|15@1+ (0.0078125,-128) [-128|127.9921875] "m/s"  ADAS
 SG_ DET_RANGE_VELOCITY_ERR_132 : 424|8@1+ (0.003,0) [0|0.765] "m/s"  ADAS
 SG_ DET_AZIMUTH_132 : 448|13@1+ (0.0004,-1.5708) [-1.5708|1.5708] "rad"  ADAS
 SG_ DET_AZIMUTH_ERR_132 : 465|7@1+ (0.00087267,0) [0|0.11082909] "rad"  ADAS
 SG_ DET_ELEVATION_132 : 432|8@1+ (0.00275,-0.34925) [-0.34925|0.34925] "rad"  ADAS
 SG_ DET_ELEVATION_ERR_132 : 440|6@1+ (0.00174533,0) [0|0.10995579] "rad"  ADAS
 SG_ DET_RCS_132 : 496|8@1+ (0.5,-64) [-64|63.5] "dBsm"  ADAS
 SG_ DET_VALID_FLAG_132 : 485|1@1+ (1,0) [0|1] ""  ADAS
 SG_ DET_BI_STATIC_FLAG_132 : 483|1@1+ (1,0) [0|1] ""  ADAS
 SG_ DET_SUPER_RES_TARGET_132 : 446|1@1+ (1,0) [0|1] ""  ADAS
 SG_ DET_SNR_132 : 488|8@1+ (0.35156,0) [0|89.6478] "dB"  ADAS
 SG_ DET_POINT_TARGET_PROB_132 : 472|4@1+ (6.67,0) [0|100] "%"  ADAS
 SG_ DET_EXISTENCE_PROB_132 : 506|6@1+ (1.588,0) [0|100] "%"  ADAS
 SG_ DET_OUTSIDE_SECTOR_132 : 481|1@1+ (1,0) [0|1] ""  ADAS
 SG_ DET_HVC_FLAG_132 : 464|1@1+ (1,0) [0|1] ""  ADAS
 SG_ DET_CONFD_AZIMUTH_132 : 486|2@1+ (1,0) [0|3] ""  ADAS
 SG_ DET_CONFD_ELEVATION_132 : 461|2@1+ (1,0) [0|3] ""  ADAS
 SG_ DET_MH_SCAN_INDEX_4LSB_129_132 : 476|4@1+ (1,0) [0|15] ""  ADAS
 SG_ DET_MH_CYCLE_COUNTER_129_132 : 16|8@1+ (1,0) [0|255] ""  ADAS
 SG_ DET_MH_CRC16_129_132 : 0|16@1+ (1,0) [0|65535] ""  ADAS

BO_ 1185 RDR_DETECTION_133_136: 64 RDR08
 SG_ DET_RANGE_133 : 24|15@1+ (0.015625,0) [0|500] "m"  ADAS
 SG_ DET_RANGE_ERR_133 : 40|7@1+ (0.0075,0) [0|0.9525] "m"  ADAS
 SG_ DET_RANGE_VELOCITY_133 : 48|15@1+ (0.0078125,-128) [-128|127.9921875] "m/s"  ADAS
 SG_ DET_RANGE_VELOCITY_ERR_133 : 64|8@1+ (0.003,0) [0|0.765] "m/s"  ADAS
 SG_ DET_AZIMUTH_133 : 88|13@1+ (0.0004,-1.5708) [-1.5708|1.5708] "rad"  ADAS
 SG_ DET_AZIMUTH_ERR_133 : 105|7@1+ (0.00087267,0) [0|0.11082909] "rad"  ADAS
 SG_ DET_ELEVATION_133 : 72|8@1+ (0.00275,-0.34925) [-0.34925|0.34925] "rad"  ADAS
 SG_ DET_ELEVATION_ERR_133 : 80|6@1+ (0.00174533,0) [0|0.10995579] "rad"  ADAS
 SG_ DET_RCS_133 : 136|8@1+ (0.5,-64) [-64|63.5] "dBsm"  ADAS
 SG_ DET_VALID_FLAG_133 : 119|1@1+ (1,0) [0|1] ""  ADAS
 SG_ DET_BI_STATIC_FLAG_133 : 504|1@1+ (1,0) [0|1] ""  ADAS
 SG_ DET_SUPER_RES_TARGET_133 : 104|1@1+ (1,0) [0|1] ""  ADAS
 SG_ DET_SNR_133 : 128|8@1+ (0.35156,0) [0|89.6478] "dB"  ADAS
 SG_ DET_POINT_TARGET_PROB_133 : 114|4@1+ (6.67,0) [0|100] "%"  ADAS
 SG_ DET_EXISTENCE_PROB_133 : 120|6@1+ (1.588,0) [0|100] "%"  ADAS
 SG_ DET_OUTSIDE_SECTOR_133 : 159|1@1+ (1,0) [0|1] ""  ADAS
 SG_ DET_HVC_FLAG_133 : 118|1@1+ (1,0) [0|1] ""  ADAS
 SG_ DET_CONFD_AZIMUTH_133 : 126|2@1+ (1,0) [0|3] ""  ADAS
 SG_ DET_CONFD_ELEVATION_133 : 112|2@1+ (1,0) [0|3] ""  ADAS
 SG_ DET_RANGE_134 : 144|15@1+ (0.015625,0) [0|500] "m"  ADAS
 SG_ DET_RANGE_ERR_134 : 160|7@1+ (0.0075,0) [0|0.9525] "m"  ADAS
 SG_ DET_RANGE_VELOCITY_134 : 168|15@1+ (0.0078125,-128) [-128|127.9921875] "m/s"  ADAS
 SG_ DET_RANGE_VELOCITY_ERR_134 : 184|8@1+ (0.003,0) [0|0.765] "m/s"  ADAS
 SG_ DET_AZIMUTH_134 : 208|13@1+ (0.0004,-1.5708) [-1.5708|1.5708] "rad"  ADAS
 SG_ DET_AZIMUTH_ERR_134 : 224|7@1+ (0.00087267,0) [0|0.11082909] "rad"  ADAS
 SG_ DET_ELEVATION_134 : 192|8@1+ (0.00275,-0.34925) [-0.34925|0.34925] "rad"  ADAS
 SG_ DET_ELEVATION_ERR_134 : 200|6@1+ (0.00174533,0) [0|0.10995579] "rad"  ADAS
 SG_ DET_RCS_134 : 256|8@1+ (0.5,-64) [-64|63.5] "dBsm"  ADAS
 SG_ DET_VALID_FLAG_134 : 167|1@1+ (1,0) [0|1] ""  ADAS
 SG_ DET_BI_STATIC_FLAG_134 : 505|1@1+ (1,0) [0|1] ""  ADAS
 SG_ DET_SUPER_RES_TARGET_134 : 247|1@1+ (1,0) [0|1] ""  ADAS
 SG_ DET_SNR_134 : 248|8@1+ (0.35156,0) [0|89.6478] "dB"  ADAS
 SG_ DET_POINT_TARGET_PROB_134 : 240|4@1+ (6.67,0) [0|100] "%"  ADAS
 SG_ DET_EXISTENCE_PROB_134 : 232|6@1+ (1.588,0) [0|100] "%"  ADAS
 SG_ DET_OUTSIDE_SECTOR_134 : 183|1@1+ (1,0) [0|1] ""  ADAS
 SG_ DET_HVC_FLAG_134 : 246|1@1+ (1,0) [0|1] ""  ADAS
 SG_ DET_CONFD_AZIMUTH_134 : 206|2@1+ (1,0) [0|3] ""  ADAS
 SG_ DET_CONFD_ELEVATION_134 : 244|2@1+ (1,0) [0|3] ""  ADAS
 SG_ DET_RANGE_135 : 264|15@1+ (0.015625,0) [0|500] "m"  ADAS
 SG_ DET_RANGE_ERR_135 : 280|7@1+ (0.0075,0) [0|0.9525] "m"  ADAS
 SG_ DET_RANGE_VELOCITY_135 : 288|15@1+ (0.0078125,-128) [-128|127.9921875] "m/s"  ADAS
 SG_ DET_RANGE_VELOCITY_ERR_135 : 304|8@1+ (0.003,0) [0|0.765] "m/s"  ADAS
 SG_ DET_AZIMUTH_135 : 328|13@1+ (0.0004,-1.5708) [-1.5708|1.5708] "rad"  ADAS
 SG_ DET_AZIMUTH_ERR_135 : 345|7@1+ (0.00087267,0) [0|0.11082909] "rad"  ADAS
 SG_ DET_ELEVATION_135 : 312|8@1+ (0.00275,-0.34925) [-0.34925|0.34925] "rad"  ADAS
 SG_ DET_ELEVATION_ERR_135 : 320|6@1+ (0.00174533,0) [0|0.10995579] "rad"  ADAS
 SG_ DET_RCS_135 : 376|8@1+ (0.5,-64) [-64|63.5] "dBsm"  ADAS
 SG_ DET_VALID_FLAG_135 : 399|1@1+ (1,0) [0|1] ""  ADAS
 SG_ DET_BI_STATIC_FLAG_135 : 482|1@1+ (1,0) [0|1] ""  ADAS
 SG_ DET_SUPER_RES_TARGET_135 : 344|1@1+ (1,0) [0|1] ""  ADAS
 SG_ DET_SNR_135 : 368|8@1+ (0.35156,0) [0|89.6478] "dB"  ADAS
 SG_ DET_POINT_TARGET_PROB_135 : 360|4@1+ (6.67,0) [0|100] "%"  ADAS
 SG_ DET_EXISTENCE_PROB_135 : 352|6@1+ (1.588,0) [0|100] "%"  ADAS
 SG_ DET_OUTSIDE_SECTOR_135 : 407|1@1+ (1,0) [0|1] ""  ADAS
 SG_ DET_HVC_FLAG_135 : 364|1@1+ (1,0) [0|1] ""  ADAS
 SG_ DET_CONFD_AZIMUTH_135 : 365|2@1+ (1,0) [0|3] ""  ADAS
 SG_ DET_CONFD_ELEVATION_135 : 358|2@1+ (1,0) [0|3] ""  ADAS
 SG_ DET_RANGE_136 : 384|15@1+ (0.015625,0) [0|500] "m"  ADAS
 SG_ DET_RANGE_ERR_136 : 400|7@1+ (0.0075,0) [0|0.9525] "m"  ADAS
 SG_ DET_RANGE_VELOCITY_136 : 408|15@1+ (0.0078125,-128) [-128|127.9921875] "m/s"  ADAS
 SG_ DET_RANGE_VELOCITY_ERR_136 : 424|8@1+ (0.003,0) [0|0.765] "m/s"  ADAS
 SG_ DET_AZIMUTH_136 : 448|13@1+ (0.0004,-1.5708) [-1.5708|1.5708] "rad"  ADAS
 SG_ DET_AZIMUTH_ERR_136 : 465|7@1+ (0.00087267,0) [0|0.11082909] "rad"  ADAS
 SG_ DET_ELEVATION_136 : 432|8@1+ (0.00275,-0.34925) [-0.34925|0.34925] "rad"  ADAS
 SG_ DET_ELEVATION_ERR_136 : 440|6@1+ (0.00174533,0) [0|0.10995579] "rad"  ADAS
 SG_ DET_RCS_136 : 496|8@1+ (0.5,-64) [-64|63.5] "dBsm"  ADAS
 SG_ DET_VALID_FLAG_136 : 485|1@1+ (1,0) [0|1] ""  ADAS
 SG_ DET_BI_STATIC_FLAG_136 : 483|1@1+ (1,0) [0|1] ""  ADAS
 SG_ DET_SUPER_RES_TARGET_136 : 446|1@1+ (1,0) [0|1] ""  ADAS
 SG_ DET_SNR_136 : 488|8@1+ (0.35156,0) [0|89.6478] "dB"  ADAS
 SG_ DET_POINT_TARGET_PROB_136 : 472|4@1+ (6.67,0) [0|100] "%"  ADAS
 SG_ DET_EXISTENCE_PROB_136 : 506|6@1+ (1.588,0) [0|100] "%"  ADAS
 SG_ DET_OUTSIDE_SECTOR_136 : 481|1@1+ (1,0) [0|1] ""  ADAS
 SG_ DET_HVC_FLAG_136 : 464|1@1+ (1,0) [0|1] ""  ADAS
 SG_ DET_CONFD_AZIMUTH_136 : 486|2@1+ (1,0) [0|3] ""  ADAS
 SG_ DET_CONFD_ELEVATION_136 : 461|2@1+ (1,0) [0|3] ""  ADAS
 SG_ DET_MH_SCAN_INDEX_4LSB_133_136 : 476|4@1+ (1,0) [0|15] ""  ADAS
 SG_ DET_MH_CYCLE_COUNTER_133_136 : 16|8@1+ (1,0) [0|255] ""  ADAS
 SG_ DET_MH_CRC16_133_136 : 0|16@1+ (1,0) [0|65535] ""  ADAS

BO_ 1186 RDR_DETECTION_137_140: 64 RDR08
 SG_ DET_RANGE_137 : 24|15@1+ (0.015625,0) [0|500] "m"  ADAS
 SG_ DET_RANGE_ERR_137 : 40|7@1+ (0.0075,0) [0|0.9525] "m"  ADAS
 SG_ DET_RANGE_VELOCITY_137 : 48|15@1+ (0.0078125,-128) [-128|127.9921875] "m/s"  ADAS
 SG_ DET_RANGE_VELOCITY_ERR_137 : 64|8@1+ (0.003,0) [0|0.765] "m/s"  ADAS
 SG_ DET_AZIMUTH_137 : 88|13@1+ (0.0004,-1.5708) [-1.5708|1.5708] "rad"  ADAS
 SG_ DET_AZIMUTH_ERR_137 : 105|7@1+ (0.00087267,0) [0|0.11082909] "rad"  ADAS
 SG_ DET_ELEVATION_137 : 72|8@1+ (0.00275,-0.34925) [-0.34925|0.34925] "rad"  ADAS
 SG_ DET_ELEVATION_ERR_137 : 80|6@1+ (0.00174533,0) [0|0.10995579] "rad"  ADAS
 SG_ DET_RCS_137 : 136|8@1+ (0.5,-64) [-64|63.5] "dBsm"  ADAS
 SG_ DET_VALID_FLAG_137 : 119|1@1+ (1,0) [0|1] ""  ADAS
 SG_ DET_BI_STATIC_FLAG_137 : 504|1@1+ (1,0) [0|1] ""  ADAS
 SG_ DET_SUPER_RES_TARGET_137 : 104|1@1+ (1,0) [0|1] ""  ADAS
 SG_ DET_SNR_137 : 128|8@1+ (0.35156,0) [0|89.6478] "dB"  ADAS
 SG_ DET_POINT_TARGET_PROB_137 : 114|4@1+ (6.67,0) [0|100] "%"  ADAS
 SG_ DET_EXISTENCE_PROB_137 : 120|6@1+ (1.588,0) [0|100] "%"  ADAS
 SG_ DET_OUTSIDE_SECTOR_137 : 159|1@1+ (1,0) [0|1] ""  ADAS
 SG_ DET_HVC_FLAG_137 : 118|1@1+ (1,0) [0|1] ""  ADAS
 SG_ DET_CONFD_AZIMUTH_137 : 126|2@1+ (1,0) [0|3] ""  ADAS
 SG_ DET_CONFD_ELEVATION_137 : 112|2@1+ (1,0) [0|3] ""  ADAS
 SG_ DET_RANGE_138 : 144|15@1+ (0.015625,0) [0|500] "m"  ADAS
 SG_ DET_RANGE_ERR_138 : 160|7@1+ (0.0075,0) [0|0.9525] "m"  ADAS
 SG_ DET_RANGE_VELOCITY_138 : 168|15@1+ (0.0078125,-128) [-128|127.9921875] "m/s"  ADAS
 SG_ DET_RANGE_VELOCITY_ERR_138 : 184|8@1+ (0.003,0) [0|0.765] "m/s"  ADAS
 SG_ DET_AZIMUTH_138 : 208|13@1+ (0.0004,-1.5708) [-1.5708|1.5708] "rad"  ADAS
 SG_ DET_AZIMUTH_ERR_138 : 224|7@1+ (0.00087267,0) [0|0.11082909] "rad"  ADAS
 SG_ DET_ELEVATION_138 : 192|8@1+ (0.00275,-0.34925) [-0.34925|0.34925] "rad"  ADAS
 SG_ DET_ELEVATION_ERR_138 : 200|6@1+ (0.00174533,0) [0|0.10995579] "rad"  ADAS
 SG_ DET_RCS_138 : 256|8@1+ (0.5,-64) [-64|63.5] "dBsm"  ADAS
 SG_ DET_VALID_FLAG_138 : 167|1@1+ (1,0) [0|1] ""  ADAS
 SG_ DET_BI_STATIC_FLAG_138 : 505|1@1+ (1,0) [0|1] ""  ADAS
 SG_ DET_SUPER_RES_TARGET_138 : 247|1@1+ (1,0) [0|1] ""  ADAS
 SG_ DET_SNR_138 : 248|8@1+ (0.35156,0) [0|89.6478] "dB"  ADAS
 SG_ DET_POINT_TARGET_PROB_138 : 240|4@1+ (6.67,0) [0|100] "%"  ADAS
 SG_ DET_EXISTENCE_PROB_138 : 232|6@1+ (1.588,0) [0|100] "%"  ADAS
 SG_ DET_OUTSIDE_SECTOR_138 : 183|1@1+ (1,0) [0|1] ""  ADAS
 SG_ DET_HVC_FLAG_138 : 246|1@1+ (1,0) [0|1] ""  ADAS
 SG_ DET_CONFD_AZIMUTH_138 : 206|2@1+ (1,0) [0|3] ""  ADAS
 SG_ DET_CONFD_ELEVATION_138 : 244|2@1+ (1,0) [0|3] ""  ADAS
 SG_ DET_RANGE_139 : 264|15@1+ (0.015625,0) [0|500] "m"  ADAS
 SG_ DET_RANGE_ERR_139 : 280|7@1+ (0.0075,0) [0|0.9525] "m"  ADAS
 SG_ DET_RANGE_VELOCITY_139 : 288|15@1+ (0.0078125,-128) [-128|127.9921875] "m/s"  ADAS
 SG_ DET_RANGE_VELOCITY_ERR_139 : 304|8@1+ (0.003,0) [0|0.765] "m/s"  ADAS
 SG_ DET_AZIMUTH_139 : 328|13@1+ (0.0004,-1.5708) [-1.5708|1.5708] "rad"  ADAS
 SG_ DET_AZIMUTH_ERR_139 : 345|7@1+ (0.00087267,0) [0|0.11082909] "rad"  ADAS
 SG_ DET_ELEVATION_139 : 312|8@1+ (0.00275,-0.34925) [-0.34925|0.34925] "rad"  ADAS
 SG_ DET_ELEVATION_ERR_139 : 320|6@1+ (0.00174533,0) [0|0.10995579] "rad"  ADAS
 SG_ DET_RCS_139 : 376|8@1+ (0.5,-64) [-64|63.5] "dBsm"  ADAS
 SG_ DET_VALID_FLAG_139 : 399|1@1+ (1,0) [0|1] ""  ADAS
 SG_ DET_BI_STATIC_FLAG_139 : 482|1@1+ (1,0) [0|1] ""  ADAS
 SG_ DET_SUPER_RES_TARGET_139 : 344|1@1+ (1,0) [0|1] ""  ADAS
 SG_ DET_SNR_139 : 368|8@1+ (0.35156,0) [0|89.6478] "dB"  ADAS
 SG_ DET_POINT_TARGET_PROB_139 : 360|4@1+ (6.67,0) [0|100] "%"  ADAS
 SG_ DET_EXISTENCE_PROB_139 : 352|6@1+ (1.588,0) [0|100] "%"  ADAS
 SG_ DET_OUTSIDE_SECTOR_139 : 407|1@1+ (1,0) [0|1] ""  ADAS
 SG_ DET_HVC_FLAG_139 : 364|1@1+ (1,0) [0|1] ""  ADAS
 SG_ DET_CONFD_AZIMUTH_139 : 365|2@1+ (1,0) [0|3] ""  ADAS
 SG_ DET_CONFD_ELEVATION_139 : 358|2@1+ (1,0) [0|3] ""  ADAS
 SG_ DET_RANGE_140 : 384|15@1+ (0.015625,0) [0|500] "m"  ADAS
 SG_ DET_RANGE_ERR_140 : 400|7@1+ (0.0075,0) [0|0.9525] "m"  ADAS
 SG_ DET_RANGE_VELOCITY_140 : 408|15@1+ (0.0078125,-128) [-128|127.9921875] "m/s"  ADAS
 SG_ DET_RANGE_VELOCITY_ERR_140 : 424|8@1+ (0.003,0) [0|0.765] "m/s"  ADAS
 SG_ DET_AZIMUTH_140 : 448|13@1+ (0.0004,-1.5708) [-1.5708|1.5708] "rad"  ADAS
 SG_ DET_AZIMUTH_ERR_140 : 465|7@1+ (0.00087267,0) [0|0.11082909] "rad"  ADAS
 SG_ DET_ELEVATION_140 : 432|8@1+ (0.00275,-0.34925) [-0.34925|0.34925] "rad"  ADAS
 SG_ DET_ELEVATION_ERR_140 : 440|6@1+ (0.00174533,0) [0|0.10995579] "rad"  ADAS
 SG_ DET_RCS_140 : 496|8@1+ (0.5,-64) [-64|63.5] "dBsm"  ADAS
 SG_ DET_VALID_FLAG_140 : 485|1@1+ (1,0) [0|1] ""  ADAS
 SG_ DET_BI_STATIC_FLAG_140 : 483|1@1+ (1,0) [0|1] ""  ADAS
 SG_ DET_SUPER_RES_TARGET_140 : 446|1@1+ (1,0) [0|1] ""  ADAS
 SG_ DET_SNR_140 : 488|8@1+ (0.35156,0) [0|89.6478] "dB"  ADAS
 SG_ DET_POINT_TARGET_PROB_140 : 472|4@1+ (6.67,0) [0|100] "%"  ADAS
 SG_ DET_EXISTENCE_PROB_140 : 506|6@1+ (1.588,0) [0|100] "%"  ADAS
 SG_ DET_OUTSIDE_SECTOR_140 : 481|1@1+ (1,0) [0|1] ""  ADAS
 SG_ DET_HVC_FLAG_140 : 464|1@1+ (1,0) [0|1] ""  ADAS
 SG_ DET_CONFD_AZIMUTH_140 : 486|2@1+ (1,0) [0|3] ""  ADAS
 SG_ DET_CONFD_ELEVATION_140 : 461|2@1+ (1,0) [0|3] ""  ADAS
 SG_ DET_MH_SCAN_INDEX_4LSB_137_140 : 476|4@1+ (1,0) [0|15] ""  ADAS
 SG_ DET_MH_CYCLE_COUNTER_137_140 : 16|8@1+ (1,0) [0|255] ""  ADAS
 SG_ DET_MH_CRC16_137_140 : 0|16@1+ (1,0) [0|65535] ""  ADAS

BO_ 1187 RDR_DETECTION_141_144: 64 RDR08
 SG_ DET_RANGE_141 : 24|15@1+ (0.015625,0) [0|500] "m"  ADAS
 SG_ DET_RANGE_ERR_141 : 40|7@1+ (0.0075,0) [0|0.9525] "m"  ADAS
 SG_ DET_RANGE_VELOCITY_141 : 48|15@1+ (0.0078125,-128) [-128|127.9921875] "m/s"  ADAS
 SG_ DET_RANGE_VELOCITY_ERR_141 : 64|8@1+ (0.003,0) [0|0.765] "m/s"  ADAS
 SG_ DET_AZIMUTH_141 : 88|13@1+ (0.0004,-1.5708) [-1.5708|1.5708] "rad"  ADAS
 SG_ DET_AZIMUTH_ERR_141 : 105|7@1+ (0.00087267,0) [0|0.11082909] "rad"  ADAS
 SG_ DET_ELEVATION_141 : 72|8@1+ (0.00275,-0.34925) [-0.34925|0.34925] "rad"  ADAS
 SG_ DET_ELEVATION_ERR_141 : 80|6@1+ (0.00174533,0) [0|0.10995579] "rad"  ADAS
 SG_ DET_RCS_141 : 136|8@1+ (0.5,-64) [-64|63.5] "dBsm"  ADAS
 SG_ DET_VALID_FLAG_141 : 119|1@1+ (1,0) [0|1] ""  ADAS
 SG_ DET_BI_STATIC_FLAG_141 : 504|1@1+ (1,0) [0|1] ""  ADAS
 SG_ DET_SUPER_RES_TARGET_141 : 104|1@1+ (1,0) [0|1] ""  ADAS
 SG_ DET_SNR_141 : 128|8@1+ (0.35156,0) [0|89.6478] "dB"  ADAS
 SG_ DET_POINT_TARGET_PROB_141 : 114|4@1+ (6.67,0) [0|100] "%"  ADAS
 SG_ DET_EXISTENCE_PROB_141 : 120|6@1+ (1.588,0) [0|100] "%"  ADAS
 SG_ DET_OUTSIDE_SECTOR_141 : 159|1@1+ (1,0) [0|1] ""  ADAS
 SG_ DET_HVC_FLAG_141 : 118|1@1+ (1,0) [0|1] ""  ADAS
 SG_ DET_CONFD_AZIMUTH_141 : 126|2@1+ (1,0) [0|3] ""  ADAS
 SG_ DET_CONFD_ELEVATION_141 : 112|2@1+ (1,0) [0|3] ""  ADAS
 SG_ DET_RANGE_142 : 144|15@1+ (0.015625,0) [0|500] "m"  ADAS
 SG_ DET_RANGE_ERR_142 : 160|7@1+ (0.0075,0) [0|0.9525] "m"  ADAS
 SG_ DET_RANGE_VELOCITY_142 : 168|15@1+ (0.0078125,-128) [-128|127.9921875] "m/s"  ADAS
 SG_ DET_RANGE_VELOCITY_ERR_142 : 184|8@1+ (0.003,0) [0|0.765] "m/s"  ADAS
 SG_ DET_AZIMUTH_142 : 208|13@1+ (0.0004,-1.5708) [-1.5708|1.5708] "rad"  ADAS
 SG_ DET_AZIMUTH_ERR_142 : 224|7@1+ (0.00087267,0) [0|0.11082909] "rad"  ADAS
 SG_ DET_ELEVATION_142 : 192|8@1+ (0.00275,-0.34925) [-0.34925|0.34925] "rad"  ADAS
 SG_ DET_ELEVATION_ERR_142 : 200|6@1+ (0.00174533,0) [0|0.10995579] "rad"  ADAS
 SG_ DET_RCS_142 : 256|8@1+ (0.5,-64) [-64|63.5] "dBsm"  ADAS
 SG_ DET_VALID_FLAG_142 : 167|1@1+ (1,0) [0|1] ""  ADAS
 SG_ DET_BI_STATIC_FLAG_142 : 505|1@1+ (1,0) [0|1] ""  ADAS
 SG_ DET_SUPER_RES_TARGET_142 : 247|1@1+ (1,0) [0|1] ""  ADAS
 SG_ DET_SNR_142 : 248|8@1+ (0.35156,0) [0|89.6478] "dB"  ADAS
 SG_ DET_POINT_TARGET_PROB_142 : 240|4@1+ (6.67,0) [0|100] "%"  ADAS
 SG_ DET_EXISTENCE_PROB_142 : 232|6@1+ (1.588,0) [0|100] "%"  ADAS
 SG_ DET_OUTSIDE_SECTOR_142 : 183|1@1+ (1,0) [0|1] ""  ADAS
 SG_ DET_HVC_FLAG_142 : 246|1@1+ (1,0) [0|1] ""  ADAS
 SG_ DET_CONFD_AZIMUTH_142 : 206|2@1+ (1,0) [0|3] ""  ADAS
 SG_ DET_CONFD_ELEVATION_142 : 244|2@1+ (1,0) [0|3] ""  ADAS
 SG_ DET_RANGE_143 : 264|15@1+ (0.015625,0) [0|500] "m"  ADAS
 SG_ DET_RANGE_ERR_143 : 280|7@1+ (0.0075,0) [0|0.9525] "m"  ADAS
 SG_ DET_RANGE_VELOCITY_143 : 288|15@1+ (0.0078125,-128) [-128|127.9921875] "m/s"  ADAS
 SG_ DET_RANGE_VELOCITY_ERR_143 : 304|8@1+ (0.003,0) [0|0.765] "m/s"  ADAS
 SG_ DET_AZIMUTH_143 : 328|13@1+ (0.0004,-1.5708) [-1.5708|1.5708] "rad"  ADAS
 SG_ DET_AZIMUTH_ERR_143 : 345|7@1+ (0.00087267,0) [0|0.11082909] "rad"  ADAS
 SG_ DET_ELEVATION_143 : 312|8@1+ (0.00275,-0.34925) [-0.34925|0.34925] "rad"  ADAS
 SG_ DET_ELEVATION_ERR_143 : 320|6@1+ (0.00174533,0) [0|0.10995579] "rad"  ADAS
 SG_ DET_RCS_143 : 376|8@1+ (0.5,-64) [-64|63.5] "dBsm"  ADAS
 SG_ DET_VALID_FLAG_143 : 399|1@1+ (1,0) [0|1] ""  ADAS
 SG_ DET_BI_STATIC_FLAG_143 : 482|1@1+ (1,0) [0|1] ""  ADAS
 SG_ DET_SUPER_RES_TARGET_143 : 344|1@1+ (1,0) [0|1] ""  ADAS
 SG_ DET_SNR_143 : 368|8@1+ (0.35156,0) [0|89.6478] "dB"  ADAS
 SG_ DET_POINT_TARGET_PROB_143 : 360|4@1+ (6.67,0) [0|100] "%"  ADAS
 SG_ DET_EXISTENCE_PROB_143 : 352|6@1+ (1.588,0) [0|100] "%"  ADAS
 SG_ DET_OUTSIDE_SECTOR_143 : 407|1@1+ (1,0) [0|1] ""  ADAS
 SG_ DET_HVC_FLAG_143 : 364|1@1+ (1,0) [0|1] ""  ADAS
 SG_ DET_CONFD_AZIMUTH_143 : 365|2@1+ (1,0) [0|3] ""  ADAS
 SG_ DET_CONFD_ELEVATION_143 : 358|2@1+ (1,0) [0|3] ""  ADAS
 SG_ DET_RANGE_144 : 384|15@1+ (0.015625,0) [0|500] "m"  ADAS
 SG_ DET_RANGE_ERR_144 : 400|7@1+ (0.0075,0) [0|0.9525] "m"  ADAS
 SG_ DET_RANGE_VELOCITY_144 : 408|15@1+ (0.0078125,-128) [-128|127.9921875] "m/s"  ADAS
 SG_ DET_RANGE_VELOCITY_ERR_144 : 424|8@1+ (0.003,0) [0|0.765] "m/s"  ADAS
 SG_ DET_AZIMUTH_144 : 448|13@1+ (0.0004,-1.5708) [-1.5708|1.5708] "rad"  ADAS
 SG_ DET_AZIMUTH_ERR_144 : 465|7@1+ (0.00087267,0) [0|0.11082909] "rad"  ADAS
 SG_ DET_ELEVATION_144 : 432|8@1+ (0.00275,-0.34925) [-0.34925|0.34925] "rad"  ADAS
 SG_ DET_ELEVATION_ERR_144 : 440|6@1+ (0.00174533,0) [0|0.10995579] "rad"  ADAS
 SG_ DET_RCS_144 : 496|8@1+ (0.5,-64) [-64|63.5] "dBsm"  ADAS
 SG_ DET_VALID_FLAG_144 : 485|1@1+ (1,0) [0|1] ""  ADAS
 SG_ DET_BI_STATIC_FLAG_144 : 483|1@1+ (1,0) [0|1] ""  ADAS
 SG_ DET_SUPER_RES_TARGET_144 : 446|1@1+ (1,0) [0|1] ""  ADAS
 SG_ DET_SNR_144 : 488|8@1+ (0.35156,0) [0|89.6478] "dB"  ADAS
 SG_ DET_POINT_TARGET_PROB_144 : 472|4@1+ (6.67,0) [0|100] "%"  ADAS
 SG_ DET_EXISTENCE_PROB_144 : 506|6@1+ (1.588,0) [0|100] "%"  ADAS
 SG_ DET_OUTSIDE_SECTOR_144 : 481|1@1+ (1,0) [0|1] ""  ADAS
 SG_ DET_HVC_FLAG_144 : 464|1@1+ (1,0) [0|1] ""  ADAS
 SG_ DET_CONFD_AZIMUTH_144 : 486|2@1+ (1,0) [0|3] ""  ADAS
 SG_ DET_CONFD_ELEVATION_144 : 461|2@1+ (1,0) [0|3] ""  ADAS
 SG_ DET_MH_SCAN_INDEX_4LSB_141_144 : 476|4@1+ (1,0) [0|15] ""  ADAS
 SG_ DET_MH_CYCLE_COUNTER_141_144 : 16|8@1+ (1,0) [0|255] ""  ADAS
 SG_ DET_MH_CRC16_141_144 : 0|16@1+ (1,0) [0|65535] ""  ADAS

BO_ 1188 RDR_DETECTION_145_148: 64 RDR08
 SG_ DET_RANGE_145 : 24|15@1+ (0.015625,0) [0|500] "m"  ADAS
 SG_ DET_RANGE_ERR_145 : 40|7@1+ (0.0075,0) [0|0.9525] "m"  ADAS
 SG_ DET_RANGE_VELOCITY_145 : 48|15@1+ (0.0078125,-128) [-128|127.9921875] "m/s"  ADAS
 SG_ DET_RANGE_VELOCITY_ERR_145 : 64|8@1+ (0.003,0) [0|0.765] "m/s"  ADAS
 SG_ DET_AZIMUTH_145 : 88|13@1+ (0.0004,-1.5708) [-1.5708|1.5708] "rad"  ADAS
 SG_ DET_AZIMUTH_ERR_145 : 105|7@1+ (0.00087267,0) [0|0.11082909] "rad"  ADAS
 SG_ DET_ELEVATION_145 : 72|8@1+ (0.00275,-0.34925) [-0.34925|0.34925] "rad"  ADAS
 SG_ DET_ELEVATION_ERR_145 : 80|6@1+ (0.00174533,0) [0|0.10995579] "rad"  ADAS
 SG_ DET_RCS_145 : 136|8@1+ (0.5,-64) [-64|63.5] "dBsm"  ADAS
 SG_ DET_VALID_FLAG_145 : 119|1@1+ (1,0) [0|1] ""  ADAS
 SG_ DET_BI_STATIC_FLAG_145 : 504|1@1+ (1,0) [0|1] ""  ADAS
 SG_ DET_SUPER_RES_TARGET_145 : 104|1@1+ (1,0) [0|1] ""  ADAS
 SG_ DET_SNR_145 : 128|8@1+ (0.35156,0) [0|89.6478] "dB"  ADAS
 SG_ DET_POINT_TARGET_PROB_145 : 114|4@1+ (6.67,0) [0|100] "%"  ADAS
 SG_ DET_EXISTENCE_PROB_145 : 120|6@1+ (1.588,0) [0|100] "%"  ADAS
 SG_ DET_OUTSIDE_SECTOR_145 : 159|1@1+ (1,0) [0|1] ""  ADAS
 SG_ DET_HVC_FLAG_145 : 118|1@1+ (1,0) [0|1] ""  ADAS
 SG_ DET_CONFD_AZIMUTH_145 : 126|2@1+ (1,0) [0|3] ""  ADAS
 SG_ DET_CONFD_ELEVATION_145 : 112|2@1+ (1,0) [0|3] ""  ADAS
 SG_ DET_RANGE_146 : 144|15@1+ (0.015625,0) [0|500] "m"  ADAS
 SG_ DET_RANGE_ERR_146 : 160|7@1+ (0.0075,0) [0|0.9525] "m"  ADAS
 SG_ DET_RANGE_VELOCITY_146 : 168|15@1+ (0.0078125,-128) [-128|127.9921875] "m/s"  ADAS
 SG_ DET_RANGE_VELOCITY_ERR_146 : 184|8@1+ (0.003,0) [0|0.765] "m/s"  ADAS
 SG_ DET_AZIMUTH_146 : 208|13@1+ (0.0004,-1.5708) [-1.5708|1.5708] "rad"  ADAS
 SG_ DET_AZIMUTH_ERR_146 : 224|7@1+ (0.00087267,0) [0|0.11082909] "rad"  ADAS
 SG_ DET_ELEVATION_146 : 192|8@1+ (0.00275,-0.34925) [-0.34925|0.34925] "rad"  ADAS
 SG_ DET_ELEVATION_ERR_146 : 200|6@1+ (0.00174533,0) [0|0.10995579] "rad"  ADAS
 SG_ DET_RCS_146 : 256|8@1+ (0.5,-64) [-64|63.5] "dBsm"  ADAS
 SG_ DET_VALID_FLAG_146 : 167|1@1+ (1,0) [0|1] ""  ADAS
 SG_ DET_BI_STATIC_FLAG_146 : 505|1@1+ (1,0) [0|1] ""  ADAS
 SG_ DET_SUPER_RES_TARGET_146 : 247|1@1+ (1,0) [0|1] ""  ADAS
 SG_ DET_SNR_146 : 248|8@1+ (0.35156,0) [0|89.6478] "dB"  ADAS
 SG_ DET_POINT_TARGET_PROB_146 : 240|4@1+ (6.67,0) [0|100] "%"  ADAS
 SG_ DET_EXISTENCE_PROB_146 : 232|6@1+ (1.588,0) [0|100] "%"  ADAS
 SG_ DET_OUTSIDE_SECTOR_146 : 183|1@1+ (1,0) [0|1] ""  ADAS
 SG_ DET_HVC_FLAG_146 : 246|1@1+ (1,0) [0|1] ""  ADAS
 SG_ DET_CONFD_AZIMUTH_146 : 206|2@1+ (1,0) [0|3] ""  ADAS
 SG_ DET_CONFD_ELEVATION_146 : 244|2@1+ (1,0) [0|3] ""  ADAS
 SG_ DET_RANGE_147 : 264|15@1+ (0.015625,0) [0|500] "m"  ADAS
 SG_ DET_RANGE_ERR_147 : 280|7@1+ (0.0075,0) [0|0.9525] "m"  ADAS
 SG_ DET_RANGE_VELOCITY_147 : 288|15@1+ (0.0078125,-128) [-128|127.9921875] "m/s"  ADAS
 SG_ DET_RANGE_VELOCITY_ERR_147 : 304|8@1+ (0.003,0) [0|0.765] "m/s"  ADAS
 SG_ DET_AZIMUTH_147 : 328|13@1+ (0.0004,-1.5708) [-1.5708|1.5708] "rad"  ADAS
 SG_ DET_AZIMUTH_ERR_147 : 345|7@1+ (0.00087267,0) [0|0.11082909] "rad"  ADAS
 SG_ DET_ELEVATION_147 : 312|8@1+ (0.00275,-0.34925) [-0.34925|0.34925] "rad"  ADAS
 SG_ DET_ELEVATION_ERR_147 : 320|6@1+ (0.00174533,0) [0|0.10995579] "rad"  ADAS
 SG_ DET_RCS_147 : 376|8@1+ (0.5,-64) [-64|63.5] "dBsm"  ADAS
 SG_ DET_VALID_FLAG_147 : 399|1@1+ (1,0) [0|1] ""  ADAS
 SG_ DET_BI_STATIC_FLAG_147 : 482|1@1+ (1,0) [0|1] ""  ADAS
 SG_ DET_SUPER_RES_TARGET_147 : 344|1@1+ (1,0) [0|1] ""  ADAS
 SG_ DET_SNR_147 : 368|8@1+ (0.35156,0) [0|89.6478] "dB"  ADAS
 SG_ DET_POINT_TARGET_PROB_147 : 360|4@1+ (6.67,0) [0|100] "%"  ADAS
 SG_ DET_EXISTENCE_PROB_147 : 352|6@1+ (1.588,0) [0|100] "%"  ADAS
 SG_ DET_OUTSIDE_SECTOR_147 : 407|1@1+ (1,0) [0|1] ""  ADAS
 SG_ DET_HVC_FLAG_147 : 364|1@1+ (1,0) [0|1] ""  ADAS
 SG_ DET_CONFD_AZIMUTH_147 : 365|2@1+ (1,0) [0|3] ""  ADAS
 SG_ DET_CONFD_ELEVATION_147 : 358|2@1+ (1,0) [0|3] ""  ADAS
 SG_ DET_RANGE_148 : 384|15@1+ (0.015625,0) [0|500] "m"  ADAS
 SG_ DET_RANGE_ERR_148 : 400|7@1+ (0.0075,0) [0|0.9525] "m"  ADAS
 SG_ DET_RANGE_VELOCITY_148 : 408|15@1+ (0.0078125,-128) [-128|127.9921875] "m/s"  ADAS
 SG_ DET_RANGE_VELOCITY_ERR_148 : 424|8@1+ (0.003,0) [0|0.765] "m/s"  ADAS
 SG_ DET_AZIMUTH_148 : 448|13@1+ (0.0004,-1.5708) [-1.5708|1.5708] "rad"  ADAS
 SG_ DET_AZIMUTH_ERR_148 : 465|7@1+ (0.00087267,0) [0|0.11082909] "rad"  ADAS
 SG_ DET_ELEVATION_148 : 432|8@1+ (0.00275,-0.34925) [-0.34925|0.34925] "rad"  ADAS
 SG_ DET_ELEVATION_ERR_148 : 440|6@1+ (0.00174533,0) [0|0.10995579] "rad"  ADAS
 SG_ DET_RCS_148 : 496|8@1+ (0.5,-64) [-64|63.5] "dBsm"  ADAS
 SG_ DET_VALID_FLAG_148 : 485|1@1+ (1,0) [0|1] ""  ADAS
 SG_ DET_BI_STATIC_FLAG_148 : 483|1@1+ (1,0) [0|1] ""  ADAS
 SG_ DET_SUPER_RES_TARGET_148 : 446|1@1+ (1,0) [0|1] ""  ADAS
 SG_ DET_SNR_148 : 488|8@1+ (0.35156,0) [0|89.6478] "dB"  ADAS
 SG_ DET_POINT_TARGET_PROB_148 : 472|4@1+ (6.67,0) [0|100] "%"  ADAS
 SG_ DET_EXISTENCE_PROB_148 : 506|6@1+ (1.588,0) [0|100] "%"  ADAS
 SG_ DET_OUTSIDE_SECTOR_148 : 481|1@1+ (1,0) [0|1] ""  ADAS
 SG_ DET_HVC_FLAG_148 : 464|1@1+ (1,0) [0|1] ""  ADAS
 SG_ DET_CONFD_AZIMUTH_148 : 486|2@1+ (1,0) [0|3] ""  ADAS
 SG_ DET_CONFD_ELEVATION_148 : 461|2@1+ (1,0) [0|3] ""  ADAS
 SG_ DET_MH_SCAN_INDEX_4LSB_145_148 : 476|4@1+ (1,0) [0|15] ""  ADAS
 SG_ DET_MH_CYCLE_COUNTER_145_148 : 16|8@1+ (1,0) [0|255] ""  ADAS
 SG_ DET_MH_CRC16_145_148 : 0|16@1+ (1,0) [0|65535] ""  ADAS

BO_ 1189 RDR_DETECTION_149_152: 64 RDR08
 SG_ DET_RANGE_149 : 24|15@1+ (0.015625,0) [0|500] "m"  ADAS
 SG_ DET_RANGE_ERR_149 : 40|7@1+ (0.0075,0) [0|0.9525] "m"  ADAS
 SG_ DET_RANGE_VELOCITY_149 : 48|15@1+ (0.0078125,-128) [-128|127.9921875] "m/s"  ADAS
 SG_ DET_RANGE_VELOCITY_ERR_149 : 64|8@1+ (0.003,0) [0|0.765] "m/s"  ADAS
 SG_ DET_AZIMUTH_149 : 88|13@1+ (0.0004,-1.5708) [-1.5708|1.5708] "rad"  ADAS
 SG_ DET_AZIMUTH_ERR_149 : 105|7@1+ (0.00087267,0) [0|0.11082909] "rad"  ADAS
 SG_ DET_ELEVATION_149 : 72|8@1+ (0.00275,-0.34925) [-0.34925|0.34925] "rad"  ADAS
 SG_ DET_ELEVATION_ERR_149 : 80|6@1+ (0.00174533,0) [0|0.10995579] "rad"  ADAS
 SG_ DET_RCS_149 : 136|8@1+ (0.5,-64) [-64|63.5] "dBsm"  ADAS
 SG_ DET_VALID_FLAG_149 : 119|1@1+ (1,0) [0|1] ""  ADAS
 SG_ DET_BI_STATIC_FLAG_149 : 504|1@1+ (1,0) [0|1] ""  ADAS
 SG_ DET_SUPER_RES_TARGET_149 : 104|1@1+ (1,0) [0|1] ""  ADAS
 SG_ DET_SNR_149 : 128|8@1+ (0.35156,0) [0|89.6478] "dB"  ADAS
 SG_ DET_POINT_TARGET_PROB_149 : 114|4@1+ (6.67,0) [0|100] "%"  ADAS
 SG_ DET_EXISTENCE_PROB_149 : 120|6@1+ (1.588,0) [0|100] "%"  ADAS
 SG_ DET_OUTSIDE_SECTOR_149 : 159|1@1+ (1,0) [0|1] ""  ADAS
 SG_ DET_HVC_FLAG_149 : 118|1@1+ (1,0) [0|1] ""  ADAS
 SG_ DET_CONFD_AZIMUTH_149 : 126|2@1+ (1,0) [0|3] ""  ADAS
 SG_ DET_CONFD_ELEVATION_149 : 112|2@1+ (1,0) [0|3] ""  ADAS
 SG_ DET_RANGE_150 : 144|15@1+ (0.015625,0) [0|500] "m"  ADAS
 SG_ DET_RANGE_ERR_150 : 160|7@1+ (0.0075,0) [0|0.9525] "m"  ADAS
 SG_ DET_RANGE_VELOCITY_150 : 168|15@1+ (0.0078125,-128) [-128|127.9921875] "m/s"  ADAS
 SG_ DET_RANGE_VELOCITY_ERR_150 : 184|8@1+ (0.003,0) [0|0.765] "m/s"  ADAS
 SG_ DET_AZIMUTH_150 : 208|13@1+ (0.0004,-1.5708) [-1.5708|1.5708] "rad"  ADAS
 SG_ DET_AZIMUTH_ERR_150 : 224|7@1+ (0.00087267,0) [0|0.11082909] "rad"  ADAS
 SG_ DET_ELEVATION_150 : 192|8@1+ (0.00275,-0.34925) [-0.34925|0.34925] "rad"  ADAS
 SG_ DET_ELEVATION_ERR_150 : 200|6@1+ (0.00174533,0) [0|0.10995579] "rad"  ADAS
 SG_ DET_RCS_150 : 256|8@1+ (0.5,-64) [-64|63.5] "dBsm"  ADAS
 SG_ DET_VALID_FLAG_150 : 167|1@1+ (1,0) [0|1] ""  ADAS
 SG_ DET_BI_STATIC_FLAG_150 : 505|1@1+ (1,0) [0|1] ""  ADAS
 SG_ DET_SUPER_RES_TARGET_150 : 247|1@1+ (1,0) [0|1] ""  ADAS
 SG_ DET_SNR_150 : 248|8@1+ (0.35156,0) [0|89.6478] "dB"  ADAS
 SG_ DET_POINT_TARGET_PROB_150 : 240|4@1+ (6.67,0) [0|100] "%"  ADAS
 SG_ DET_EXISTENCE_PROB_150 : 232|6@1+ (1.588,0) [0|100] "%"  ADAS
 SG_ DET_OUTSIDE_SECTOR_150 : 183|1@1+ (1,0) [0|1] ""  ADAS
 SG_ DET_HVC_FLAG_150 : 246|1@1+ (1,0) [0|1] ""  ADAS
 SG_ DET_CONFD_AZIMUTH_150 : 206|2@1+ (1,0) [0|3] ""  ADAS
 SG_ DET_CONFD_ELEVATION_150 : 244|2@1+ (1,0) [0|3] ""  ADAS
 SG_ DET_RANGE_151 : 264|15@1+ (0.015625,0) [0|500] "m"  ADAS
 SG_ DET_RANGE_ERR_151 : 280|7@1+ (0.0075,0) [0|0.9525] "m"  ADAS
 SG_ DET_RANGE_VELOCITY_151 : 288|15@1+ (0.0078125,-128) [-128|127.9921875] "m/s"  ADAS
 SG_ DET_RANGE_VELOCITY_ERR_151 : 304|8@1+ (0.003,0) [0|0.765] "m/s"  ADAS
 SG_ DET_AZIMUTH_151 : 328|13@1+ (0.0004,-1.5708) [-1.5708|1.5708] "rad"  ADAS
 SG_ DET_AZIMUTH_ERR_151 : 345|7@1+ (0.00087267,0) [0|0.11082909] "rad"  ADAS
 SG_ DET_ELEVATION_151 : 312|8@1+ (0.00275,-0.34925) [-0.34925|0.34925] "rad"  ADAS
 SG_ DET_ELEVATION_ERR_151 : 320|6@1+ (0.00174533,0) [0|0.10995579] "rad"  ADAS
 SG_ DET_RCS_151 : 376|8@1+ (0.5,-64) [-64|63.5] "dBsm"  ADAS
 SG_ DET_VALID_FLAG_151 : 399|1@1+ (1,0) [0|1] ""  ADAS
 SG_ DET_BI_STATIC_FLAG_151 : 482|1@1+ (1,0) [0|1] ""  ADAS
 SG_ DET_SUPER_RES_TARGET_151 : 344|1@1+ (1,0) [0|1] ""  ADAS
 SG_ DET_SNR_151 : 368|8@1+ (0.35156,0) [0|89.6478] "dB"  ADAS
 SG_ DET_POINT_TARGET_PROB_151 : 360|4@1+ (6.67,0) [0|100] "%"  ADAS
 SG_ DET_EXISTENCE_PROB_151 : 352|6@1+ (1.588,0) [0|100] "%"  ADAS
 SG_ DET_OUTSIDE_SECTOR_151 : 407|1@1+ (1,0) [0|1] ""  ADAS
 SG_ DET_HVC_FLAG_151 : 364|1@1+ (1,0) [0|1] ""  ADAS
 SG_ DET_CONFD_AZIMUTH_151 : 365|2@1+ (1,0) [0|3] ""  ADAS
 SG_ DET_CONFD_ELEVATION_151 : 358|2@1+ (1,0) [0|3] ""  ADAS
 SG_ DET_RANGE_152 : 384|15@1+ (0.015625,0) [0|500] "m"  ADAS
 SG_ DET_RANGE_ERR_152 : 400|7@1+ (0.0075,0) [0|0.9525] "m"  ADAS
 SG_ DET_RANGE_VELOCITY_152 : 408|15@1+ (0.0078125,-128) [-128|127.9921875] "m/s"  ADAS
 SG_ DET_RANGE_VELOCITY_ERR_152 : 424|8@1+ (0.003,0) [0|0.765] "m/s"  ADAS
 SG_ DET_AZIMUTH_152 : 448|13@1+ (0.0004,-1.5708) [-1.5708|1.5708] "rad"  ADAS
 SG_ DET_AZIMUTH_ERR_152 : 465|7@1+ (0.00087267,0) [0|0.11082909] "rad"  ADAS
 SG_ DET_ELEVATION_152 : 432|8@1+ (0.00275,-0.34925) [-0.34925|0.34925] "rad"  ADAS
 SG_ DET_ELEVATION_ERR_152 : 440|6@1+ (0.00174533,0) [0|0.10995579] "rad"  ADAS
 SG_ DET_RCS_152 : 496|8@1+ (0.5,-64) [-64|63.5] "dBsm"  ADAS
 SG_ DET_VALID_FLAG_152 : 485|1@1+ (1,0) [0|1] ""  ADAS
 SG_ DET_BI_STATIC_FLAG_152 : 483|1@1+ (1,0) [0|1] ""  ADAS
 SG_ DET_SUPER_RES_TARGET_152 : 446|1@1+ (1,0) [0|1] ""  ADAS
 SG_ DET_SNR_152 : 488|8@1+ (0.35156,0) [0|89.6478] "dB"  ADAS
 SG_ DET_POINT_TARGET_PROB_152 : 472|4@1+ (6.67,0) [0|100] "%"  ADAS
 SG_ DET_EXISTENCE_PROB_152 : 506|6@1+ (1.588,0) [0|100] "%"  ADAS
 SG_ DET_OUTSIDE_SECTOR_152 : 481|1@1+ (1,0) [0|1] ""  ADAS
 SG_ DET_HVC_FLAG_152 : 464|1@1+ (1,0) [0|1] ""  ADAS
 SG_ DET_CONFD_AZIMUTH_152 : 486|2@1+ (1,0) [0|3] ""  ADAS
 SG_ DET_CONFD_ELEVATION_152 : 461|2@1+ (1,0) [0|3] ""  ADAS
 SG_ DET_MH_SCAN_INDEX_4LSB_149_152 : 476|4@1+ (1,0) [0|15] ""  ADAS
 SG_ DET_MH_CYCLE_COUNTER_149_152 : 16|8@1+ (1,0) [0|255] ""  ADAS
 SG_ DET_MH_CRC16_149_152 : 0|16@1+ (1,0) [0|65535] ""  ADAS

BO_ 1190 RDR_DETECTION_153_156: 64 RDR08
 SG_ DET_RANGE_153 : 24|15@1+ (0.015625,0) [0|500] "m"  ADAS
 SG_ DET_RANGE_ERR_153 : 40|7@1+ (0.0075,0) [0|0.9525] "m"  ADAS
 SG_ DET_RANGE_VELOCITY_153 : 48|15@1+ (0.0078125,-128) [-128|127.9921875] "m/s"  ADAS
 SG_ DET_RANGE_VELOCITY_ERR_153 : 64|8@1+ (0.003,0) [0|0.765] "m/s"  ADAS
 SG_ DET_AZIMUTH_153 : 88|13@1+ (0.0004,-1.5708) [-1.5708|1.5708] "rad"  ADAS
 SG_ DET_AZIMUTH_ERR_153 : 105|7@1+ (0.00087267,0) [0|0.11082909] "rad"  ADAS
 SG_ DET_ELEVATION_153 : 72|8@1+ (0.00275,-0.34925) [-0.34925|0.34925] "rad"  ADAS
 SG_ DET_ELEVATION_ERR_153 : 80|6@1+ (0.00174533,0) [0|0.10995579] "rad"  ADAS
 SG_ DET_RCS_153 : 136|8@1+ (0.5,-64) [-64|63.5] "dBsm"  ADAS
 SG_ DET_VALID_FLAG_153 : 119|1@1+ (1,0) [0|1] ""  ADAS
 SG_ DET_BI_STATIC_FLAG_153 : 504|1@1+ (1,0) [0|1] ""  ADAS
 SG_ DET_SUPER_RES_TARGET_153 : 104|1@1+ (1,0) [0|1] ""  ADAS
 SG_ DET_SNR_153 : 128|8@1+ (0.35156,0) [0|89.6478] "dB"  ADAS
 SG_ DET_POINT_TARGET_PROB_153 : 114|4@1+ (6.67,0) [0|100] "%"  ADAS
 SG_ DET_EXISTENCE_PROB_153 : 120|6@1+ (1.588,0) [0|100] "%"  ADAS
 SG_ DET_OUTSIDE_SECTOR_153 : 159|1@1+ (1,0) [0|1] ""  ADAS
 SG_ DET_HVC_FLAG_153 : 118|1@1+ (1,0) [0|1] ""  ADAS
 SG_ DET_CONFD_AZIMUTH_153 : 126|2@1+ (1,0) [0|3] ""  ADAS
 SG_ DET_CONFD_ELEVATION_153 : 112|2@1+ (1,0) [0|3] ""  ADAS
 SG_ DET_RANGE_154 : 144|15@1+ (0.015625,0) [0|500] "m"  ADAS
 SG_ DET_RANGE_ERR_154 : 160|7@1+ (0.0075,0) [0|0.9525] "m"  ADAS
 SG_ DET_RANGE_VELOCITY_154 : 168|15@1+ (0.0078125,-128) [-128|127.9921875] "m/s"  ADAS
 SG_ DET_RANGE_VELOCITY_ERR_154 : 184|8@1+ (0.003,0) [0|0.765] "m/s"  ADAS
 SG_ DET_AZIMUTH_154 : 208|13@1+ (0.0004,-1.5708) [-1.5708|1.5708] "rad"  ADAS
 SG_ DET_AZIMUTH_ERR_154 : 224|7@1+ (0.00087267,0) [0|0.11082909] "rad"  ADAS
 SG_ DET_ELEVATION_154 : 192|8@1+ (0.00275,-0.34925) [-0.34925|0.34925] "rad"  ADAS
 SG_ DET_ELEVATION_ERR_154 : 200|6@1+ (0.00174533,0) [0|0.10995579] "rad"  ADAS
 SG_ DET_RCS_154 : 256|8@1+ (0.5,-64) [-64|63.5] "dBsm"  ADAS
 SG_ DET_VALID_FLAG_154 : 167|1@1+ (1,0) [0|1] ""  ADAS
 SG_ DET_BI_STATIC_FLAG_154 : 505|1@1+ (1,0) [0|1] ""  ADAS
 SG_ DET_SUPER_RES_TARGET_154 : 247|1@1+ (1,0) [0|1] ""  ADAS
 SG_ DET_SNR_154 : 248|8@1+ (0.35156,0) [0|89.6478] "dB"  ADAS
 SG_ DET_POINT_TARGET_PROB_154 : 240|4@1+ (6.67,0) [0|100] "%"  ADAS
 SG_ DET_EXISTENCE_PROB_154 : 232|6@1+ (1.588,0) [0|100] "%"  ADAS
 SG_ DET_OUTSIDE_SECTOR_154 : 183|1@1+ (1,0) [0|1] ""  ADAS
 SG_ DET_HVC_FLAG_154 : 246|1@1+ (1,0) [0|1] ""  ADAS
 SG_ DET_CONFD_AZIMUTH_154 : 206|2@1+ (1,0) [0|3] ""  ADAS
 SG_ DET_CONFD_ELEVATION_154 : 244|2@1+ (1,0) [0|3] ""  ADAS
 SG_ DET_RANGE_155 : 264|15@1+ (0.015625,0) [0|500] "m"  ADAS
 SG_ DET_RANGE_ERR_155 : 280|7@1+ (0.0075,0) [0|0.9525] "m"  ADAS
 SG_ DET_RANGE_VELOCITY_155 : 288|15@1+ (0.0078125,-128) [-128|127.9921875] "m/s"  ADAS
 SG_ DET_RANGE_VELOCITY_ERR_155 : 304|8@1+ (0.003,0) [0|0.765] "m/s"  ADAS
 SG_ DET_AZIMUTH_155 : 328|13@1+ (0.0004,-1.5708) [-1.5708|1.5708] "rad"  ADAS
 SG_ DET_AZIMUTH_ERR_155 : 345|7@1+ (0.00087267,0) [0|0.11082909] "rad"  ADAS
 SG_ DET_ELEVATION_155 : 312|8@1+ (0.00275,-0.34925) [-0.34925|0.34925] "rad"  ADAS
 SG_ DET_ELEVATION_ERR_155 : 320|6@1+ (0.00174533,0) [0|0.10995579] "rad"  ADAS
 SG_ DET_RCS_155 : 376|8@1+ (0.5,-64) [-64|63.5] "dBsm"  ADAS
 SG_ DET_VALID_FLAG_155 : 399|1@1+ (1,0) [0|1] ""  ADAS
 SG_ DET_BI_STATIC_FLAG_155 : 482|1@1+ (1,0) [0|1] ""  ADAS
 SG_ DET_SUPER_RES_TARGET_155 : 344|1@1+ (1,0) [0|1] ""  ADAS
 SG_ DET_SNR_155 : 368|8@1+ (0.35156,0) [0|89.6478] "dB"  ADAS
 SG_ DET_POINT_TARGET_PROB_155 : 360|4@1+ (6.67,0) [0|100] "%"  ADAS
 SG_ DET_EXISTENCE_PROB_155 : 352|6@1+ (1.588,0) [0|100] "%"  ADAS
 SG_ DET_OUTSIDE_SECTOR_155 : 407|1@1+ (1,0) [0|1] ""  ADAS
 SG_ DET_HVC_FLAG_155 : 364|1@1+ (1,0) [0|1] ""  ADAS
 SG_ DET_CONFD_AZIMUTH_155 : 365|2@1+ (1,0) [0|3] ""  ADAS
 SG_ DET_CONFD_ELEVATION_155 : 358|2@1+ (1,0) [0|3] ""  ADAS
 SG_ DET_RANGE_156 : 384|15@1+ (0.015625,0) [0|500] "m"  ADAS
 SG_ DET_RANGE_ERR_156 : 400|7@1+ (0.0075,0) [0|0.9525] "m"  ADAS
 SG_ DET_RANGE_VELOCITY_156 : 408|15@1+ (0.0078125,-128) [-128|127.9921875] "m/s"  ADAS
 SG_ DET_RANGE_VELOCITY_ERR_156 : 424|8@1+ (0.003,0) [0|0.765] "m/s"  ADAS
 SG_ DET_AZIMUTH_156 : 448|13@1+ (0.0004,-1.5708) [-1.5708|1.5708] "rad"  ADAS
 SG_ DET_AZIMUTH_ERR_156 : 465|7@1+ (0.00087267,0) [0|0.11082909] "rad"  ADAS
 SG_ DET_ELEVATION_156 : 432|8@1+ (0.00275,-0.34925) [-0.34925|0.34925] "rad"  ADAS
 SG_ DET_ELEVATION_ERR_156 : 440|6@1+ (0.00174533,0) [0|0.10995579] "rad"  ADAS
 SG_ DET_RCS_156 : 496|8@1+ (0.5,-64) [-64|63.5] "dBsm"  ADAS
 SG_ DET_VALID_FLAG_156 : 485|1@1+ (1,0) [0|1] ""  ADAS
 SG_ DET_BI_STATIC_FLAG_156 : 483|1@1+ (1,0) [0|1] ""  ADAS
 SG_ DET_SUPER_RES_TARGET_156 : 446|1@1+ (1,0) [0|1] ""  ADAS
 SG_ DET_SNR_156 : 488|8@1+ (0.35156,0) [0|89.6478] "dB"  ADAS
 SG_ DET_POINT_TARGET_PROB_156 : 472|4@1+ (6.67,0) [0|100] "%"  ADAS
 SG_ DET_EXISTENCE_PROB_156 : 506|6@1+ (1.588,0) [0|100] "%"  ADAS
 SG_ DET_OUTSIDE_SECTOR_156 : 481|1@1+ (1,0) [0|1] ""  ADAS
 SG_ DET_HVC_FLAG_156 : 464|1@1+ (1,0) [0|1] ""  ADAS
 SG_ DET_CONFD_AZIMUTH_156 : 486|2@1+ (1,0) [0|3] ""  ADAS
 SG_ DET_CONFD_ELEVATION_156 : 461|2@1+ (1,0) [0|3] ""  ADAS
 SG_ DET_MH_SCAN_INDEX_4LSB_153_156 : 476|4@1+ (1,0) [0|15] ""  ADAS
 SG_ DET_MH_CYCLE_COUNTER_153_156 : 16|8@1+ (1,0) [0|255] ""  ADAS
 SG_ DET_MH_CRC16_153_156 : 0|16@1+ (1,0) [0|65535] ""  ADAS

BO_ 1191 RDR_DETECTION_157_160: 64 RDR08
 SG_ DET_RANGE_157 : 24|15@1+ (0.015625,0) [0|500] "m"  ADAS
 SG_ DET_RANGE_ERR_157 : 40|7@1+ (0.0075,0) [0|0.9525] "m"  ADAS
 SG_ DET_RANGE_VELOCITY_157 : 48|15@1+ (0.0078125,-128) [-128|127.9921875] "m/s"  ADAS
 SG_ DET_RANGE_VELOCITY_ERR_157 : 64|8@1+ (0.003,0) [0|0.765] "m/s"  ADAS
 SG_ DET_AZIMUTH_157 : 88|13@1+ (0.0004,-1.5708) [-1.5708|1.5708] "rad"  ADAS
 SG_ DET_AZIMUTH_ERR_157 : 105|7@1+ (0.00087267,0) [0|0.11082909] "rad"  ADAS
 SG_ DET_ELEVATION_157 : 72|8@1+ (0.00275,-0.34925) [-0.34925|0.34925] "rad"  ADAS
 SG_ DET_ELEVATION_ERR_157 : 80|6@1+ (0.00174533,0) [0|0.10995579] "rad"  ADAS
 SG_ DET_RCS_157 : 136|8@1+ (0.5,-64) [-64|63.5] "dBsm"  ADAS
 SG_ DET_VALID_FLAG_157 : 119|1@1+ (1,0) [0|1] ""  ADAS
 SG_ DET_BI_STATIC_FLAG_157 : 504|1@1+ (1,0) [0|1] ""  ADAS
 SG_ DET_SUPER_RES_TARGET_157 : 104|1@1+ (1,0) [0|1] ""  ADAS
 SG_ DET_SNR_157 : 128|8@1+ (0.35156,0) [0|89.6478] "dB"  ADAS
 SG_ DET_POINT_TARGET_PROB_157 : 114|4@1+ (6.67,0) [0|100] "%"  ADAS
 SG_ DET_EXISTENCE_PROB_157 : 120|6@1+ (1.588,0) [0|100] "%"  ADAS
 SG_ DET_OUTSIDE_SECTOR_157 : 159|1@1+ (1,0) [0|1] ""  ADAS
 SG_ DET_HVC_FLAG_157 : 118|1@1+ (1,0) [0|1] ""  ADAS
 SG_ DET_CONFD_AZIMUTH_157 : 126|2@1+ (1,0) [0|3] ""  ADAS
 SG_ DET_CONFD_ELEVATION_157 : 112|2@1+ (1,0) [0|3] ""  ADAS
 SG_ DET_RANGE_158 : 144|15@1+ (0.015625,0) [0|500] "m"  ADAS
 SG_ DET_RANGE_ERR_158 : 160|7@1+ (0.0075,0) [0|0.9525] "m"  ADAS
 SG_ DET_RANGE_VELOCITY_158 : 168|15@1+ (0.0078125,-128) [-128|127.9921875] "m/s"  ADAS
 SG_ DET_RANGE_VELOCITY_ERR_158 : 184|8@1+ (0.003,0) [0|0.765] "m/s"  ADAS
 SG_ DET_AZIMUTH_158 : 208|13@1+ (0.0004,-1.5708) [-1.5708|1.5708] "rad"  ADAS
 SG_ DET_AZIMUTH_ERR_158 : 224|7@1+ (0.00087267,0) [0|0.11082909] "rad"  ADAS
 SG_ DET_ELEVATION_158 : 192|8@1+ (0.00275,-0.34925) [-0.34925|0.34925] "rad"  ADAS
 SG_ DET_ELEVATION_ERR_158 : 200|6@1+ (0.00174533,0) [0|0.10995579] "rad"  ADAS
 SG_ DET_RCS_158 : 256|8@1+ (0.5,-64) [-64|63.5] "dBsm"  ADAS
 SG_ DET_VALID_FLAG_158 : 167|1@1+ (1,0) [0|1] ""  ADAS
 SG_ DET_BI_STATIC_FLAG_158 : 505|1@1+ (1,0) [0|1] ""  ADAS
 SG_ DET_SUPER_RES_TARGET_158 : 247|1@1+ (1,0) [0|1] ""  ADAS
 SG_ DET_SNR_158 : 248|8@1+ (0.35156,0) [0|89.6478] "dB"  ADAS
 SG_ DET_POINT_TARGET_PROB_158 : 240|4@1+ (6.67,0) [0|100] "%"  ADAS
 SG_ DET_EXISTENCE_PROB_158 : 232|6@1+ (1.588,0) [0|100] "%"  ADAS
 SG_ DET_OUTSIDE_SECTOR_158 : 183|1@1+ (1,0) [0|1] ""  ADAS
 SG_ DET_HVC_FLAG_158 : 246|1@1+ (1,0) [0|1] ""  ADAS
 SG_ DET_CONFD_AZIMUTH_158 : 206|2@1+ (1,0) [0|3] ""  ADAS
 SG_ DET_CONFD_ELEVATION_158 : 244|2@1+ (1,0) [0|3] ""  ADAS
 SG_ DET_RANGE_159 : 264|15@1+ (0.015625,0) [0|500] "m"  ADAS
 SG_ DET_RANGE_ERR_159 : 280|7@1+ (0.0075,0) [0|0.9525] "m"  ADAS
 SG_ DET_RANGE_VELOCITY_159 : 288|15@1+ (0.0078125,-128) [-128|127.9921875] "m/s"  ADAS
 SG_ DET_RANGE_VELOCITY_ERR_159 : 304|8@1+ (0.003,0) [0|0.765] "m/s"  ADAS
 SG_ DET_AZIMUTH_159 : 328|13@1+ (0.0004,-1.5708) [-1.5708|1.5708] "rad"  ADAS
 SG_ DET_AZIMUTH_ERR_159 : 345|7@1+ (0.00087267,0) [0|0.11082909] "rad"  ADAS
 SG_ DET_ELEVATION_159 : 312|8@1+ (0.00275,-0.34925) [-0.34925|0.34925] "rad"  ADAS
 SG_ DET_ELEVATION_ERR_159 : 320|6@1+ (0.00174533,0) [0|0.10995579] "rad"  ADAS
 SG_ DET_RCS_159 : 376|8@1+ (0.5,-64) [-64|63.5] "dBsm"  ADAS
 SG_ DET_VALID_FLAG_159 : 399|1@1+ (1,0) [0|1] ""  ADAS
 SG_ DET_BI_STATIC_FLAG_159 : 482|1@1+ (1,0) [0|1] ""  ADAS
 SG_ DET_SUPER_RES_TARGET_159 : 344|1@1+ (1,0) [0|1] ""  ADAS
 SG_ DET_SNR_159 : 368|8@1+ (0.35156,0) [0|89.6478] "dB"  ADAS
 SG_ DET_POINT_TARGET_PROB_159 : 360|4@1+ (6.67,0) [0|100] "%"  ADAS
 SG_ DET_EXISTENCE_PROB_159 : 352|6@1+ (1.588,0) [0|100] "%"  ADAS
 SG_ DET_OUTSIDE_SECTOR_159 : 407|1@1+ (1,0) [0|1] ""  ADAS
 SG_ DET_HVC_FLAG_159 : 364|1@1+ (1,0) [0|1] ""  ADAS
 SG_ DET_CONFD_AZIMUTH_159 : 365|2@1+ (1,0) [0|3] ""  ADAS
 SG_ DET_CONFD_ELEVATION_159 : 358|2@1+ (1,0) [0|3] ""  ADAS
 SG_ DET_RANGE_160 : 384|15@1+ (0.015625,0) [0|500] "m"  ADAS
 SG_ DET_RANGE_ERR_160 : 400|7@1+ (0.0075,0) [0|0.9525] "m"  ADAS
 SG_ DET_RANGE_VELOCITY_160 : 408|15@1+ (0.0078125,-128) [-128|127.9921875] "m/s"  ADAS
 SG_ DET_RANGE_VELOCITY_ERR_160 : 424|8@1+ (0.003,0) [0|0.765] "m/s"  ADAS
 SG_ DET_AZIMUTH_160 : 448|13@1+ (0.0004,-1.5708) [-1.5708|1.5708] "rad"  ADAS
 SG_ DET_AZIMUTH_ERR_160 : 465|7@1+ (0.00087267,0) [0|0.11082909] "rad"  ADAS
 SG_ DET_ELEVATION_160 : 432|8@1+ (0.00275,-0.34925) [-0.34925|0.34925] "rad"  ADAS
 SG_ DET_ELEVATION_ERR_160 : 440|6@1+ (0.00174533,0) [0|0.10995579] "rad"  ADAS
 SG_ DET_RCS_160 : 496|8@1+ (0.5,-64) [-64|63.5] "dBsm"  ADAS
 SG_ DET_VALID_FLAG_160 : 485|1@1+ (1,0) [0|1] ""  ADAS
 SG_ DET_BI_STATIC_FLAG_160 : 483|1@1+ (1,0) [0|1] ""  ADAS
 SG_ DET_SUPER_RES_TARGET_160 : 446|1@1+ (1,0) [0|1] ""  ADAS
 SG_ DET_SNR_160 : 488|8@1+ (0.35156,0) [0|89.6478] "dB"  ADAS
 SG_ DET_POINT_TARGET_PROB_160 : 472|4@1+ (6.67,0) [0|100] "%"  ADAS
 SG_ DET_EXISTENCE_PROB_160 : 506|6@1+ (1.588,0) [0|100] "%"  ADAS
 SG_ DET_OUTSIDE_SECTOR_160 : 481|1@1+ (1,0) [0|1] ""  ADAS
 SG_ DET_HVC_FLAG_160 : 464|1@1+ (1,0) [0|1] ""  ADAS
 SG_ DET_CONFD_AZIMUTH_160 : 486|2@1+ (1,0) [0|3] ""  ADAS
 SG_ DET_CONFD_ELEVATION_160 : 461|2@1+ (1,0) [0|3] ""  ADAS
 SG_ DET_MH_SCAN_INDEX_4LSB_157_160 : 476|4@1+ (1,0) [0|15] ""  ADAS
 SG_ DET_MH_CYCLE_COUNTER_157_160 : 16|8@1+ (1,0) [0|255] ""  ADAS
 SG_ DET_MH_CRC16_157_160 : 0|16@1+ (1,0) [0|65535] ""  ADAS

BO_ 1192 RDR_DETECTION_161_164: 64 RDR08
 SG_ DET_RANGE_161 : 24|15@1+ (0.015625,0) [0|500] "m"  ADAS
 SG_ DET_RANGE_ERR_161 : 40|7@1+ (0.0075,0) [0|0.9525] "m"  ADAS
 SG_ DET_RANGE_VELOCITY_161 : 48|15@1+ (0.0078125,-128) [-128|127.9921875] "m/s"  ADAS
 SG_ DET_RANGE_VELOCITY_ERR_161 : 64|8@1+ (0.003,0) [0|0.765] "m/s"  ADAS
 SG_ DET_AZIMUTH_161 : 88|13@1+ (0.0004,-1.5708) [-1.5708|1.5708] "rad"  ADAS
 SG_ DET_AZIMUTH_ERR_161 : 105|7@1+ (0.00087267,0) [0|0.11082909] "rad"  ADAS
 SG_ DET_ELEVATION_161 : 72|8@1+ (0.00275,-0.34925) [-0.34925|0.34925] "rad"  ADAS
 SG_ DET_ELEVATION_ERR_161 : 80|6@1+ (0.00174533,0) [0|0.10995579] "rad"  ADAS
 SG_ DET_RCS_161 : 136|8@1+ (0.5,-64) [-64|63.5] "dBsm"  ADAS
 SG_ DET_VALID_FLAG_161 : 119|1@1+ (1,0) [0|1] ""  ADAS
 SG_ DET_BI_STATIC_FLAG_161 : 504|1@1+ (1,0) [0|1] ""  ADAS
 SG_ DET_SUPER_RES_TARGET_161 : 104|1@1+ (1,0) [0|1] ""  ADAS
 SG_ DET_SNR_161 : 128|8@1+ (0.35156,0) [0|89.6478] "dB"  ADAS
 SG_ DET_POINT_TARGET_PROB_161 : 114|4@1+ (6.67,0) [0|100] "%"  ADAS
 SG_ DET_EXISTENCE_PROB_161 : 120|6@1+ (1.588,0) [0|100] "%"  ADAS
 SG_ DET_OUTSIDE_SECTOR_161 : 159|1@1+ (1,0) [0|1] ""  ADAS
 SG_ DET_HVC_FLAG_161 : 118|1@1+ (1,0) [0|1] ""  ADAS
 SG_ DET_CONFD_AZIMUTH_161 : 126|2@1+ (1,0) [0|3] ""  ADAS
 SG_ DET_CONFD_ELEVATION_161 : 112|2@1+ (1,0) [0|3] ""  ADAS
 SG_ DET_RANGE_162 : 144|15@1+ (0.015625,0) [0|500] "m"  ADAS
 SG_ DET_RANGE_ERR_162 : 160|7@1+ (0.0075,0) [0|0.9525] "m"  ADAS
 SG_ DET_RANGE_VELOCITY_162 : 168|15@1+ (0.0078125,-128) [-128|127.9921875] "m/s"  ADAS
 SG_ DET_RANGE_VELOCITY_ERR_162 : 184|8@1+ (0.003,0) [0|0.765] "m/s"  ADAS
 SG_ DET_AZIMUTH_162 : 208|13@1+ (0.0004,-1.5708) [-1.5708|1.5708] "rad"  ADAS
 SG_ DET_AZIMUTH_ERR_162 : 224|7@1+ (0.00087267,0) [0|0.11082909] "rad"  ADAS
 SG_ DET_ELEVATION_162 : 192|8@1+ (0.00275,-0.34925) [-0.34925|0.34925] "rad"  ADAS
 SG_ DET_ELEVATION_ERR_162 : 200|6@1+ (0.00174533,0) [0|0.10995579] "rad"  ADAS
 SG_ DET_RCS_162 : 256|8@1+ (0.5,-64) [-64|63.5] "dBsm"  ADAS
 SG_ DET_VALID_FLAG_162 : 167|1@1+ (1,0) [0|1] ""  ADAS
 SG_ DET_BI_STATIC_FLAG_162 : 505|1@1+ (1,0) [0|1] ""  ADAS
 SG_ DET_SUPER_RES_TARGET_162 : 247|1@1+ (1,0) [0|1] ""  ADAS
 SG_ DET_SNR_162 : 248|8@1+ (0.35156,0) [0|89.6478] "dB"  ADAS
 SG_ DET_POINT_TARGET_PROB_162 : 240|4@1+ (6.67,0) [0|100] "%"  ADAS
 SG_ DET_EXISTENCE_PROB_162 : 232|6@1+ (1.588,0) [0|100] "%"  ADAS
 SG_ DET_OUTSIDE_SECTOR_162 : 183|1@1+ (1,0) [0|1] ""  ADAS
 SG_ DET_HVC_FLAG_162 : 246|1@1+ (1,0) [0|1] ""  ADAS
 SG_ DET_CONFD_AZIMUTH_162 : 206|2@1+ (1,0) [0|3] ""  ADAS
 SG_ DET_CONFD_ELEVATION_162 : 244|2@1+ (1,0) [0|3] ""  ADAS
 SG_ DET_RANGE_163 : 264|15@1+ (0.015625,0) [0|500] "m"  ADAS
 SG_ DET_RANGE_ERR_163 : 280|7@1+ (0.0075,0) [0|0.9525] "m"  ADAS
 SG_ DET_RANGE_VELOCITY_163 : 288|15@1+ (0.0078125,-128) [-128|127.9921875] "m/s"  ADAS
 SG_ DET_RANGE_VELOCITY_ERR_163 : 304|8@1+ (0.003,0) [0|0.765] "m/s"  ADAS
 SG_ DET_AZIMUTH_163 : 328|13@1+ (0.0004,-1.5708) [-1.5708|1.5708] "rad"  ADAS
 SG_ DET_AZIMUTH_ERR_163 : 345|7@1+ (0.00087267,0) [0|0.11082909] "rad"  ADAS
 SG_ DET_ELEVATION_163 : 312|8@1+ (0.00275,-0.34925) [-0.34925|0.34925] "rad"  ADAS
 SG_ DET_ELEVATION_ERR_163 : 320|6@1+ (0.00174533,0) [0|0.10995579] "rad"  ADAS
 SG_ DET_RCS_163 : 376|8@1+ (0.5,-64) [-64|63.5] "dBsm"  ADAS
 SG_ DET_VALID_FLAG_163 : 399|1@1+ (1,0) [0|1] ""  ADAS
 SG_ DET_BI_STATIC_FLAG_163 : 482|1@1+ (1,0) [0|1] ""  ADAS
 SG_ DET_SUPER_RES_TARGET_163 : 344|1@1+ (1,0) [0|1] ""  ADAS
 SG_ DET_SNR_163 : 368|8@1+ (0.35156,0) [0|89.6478] "dB"  ADAS
 SG_ DET_POINT_TARGET_PROB_163 : 360|4@1+ (6.67,0) [0|100] "%"  ADAS
 SG_ DET_EXISTENCE_PROB_163 : 352|6@1+ (1.588,0) [0|100] "%"  ADAS
 SG_ DET_OUTSIDE_SECTOR_163 : 407|1@1+ (1,0) [0|1] ""  ADAS
 SG_ DET_HVC_FLAG_163 : 364|1@1+ (1,0) [0|1] ""  ADAS
 SG_ DET_CONFD_AZIMUTH_163 : 365|2@1+ (1,0) [0|3] ""  ADAS
 SG_ DET_CONFD_ELEVATION_163 : 358|2@1+ (1,0) [0|3] ""  ADAS
 SG_ DET_RANGE_164 : 384|15@1+ (0.015625,0) [0|500] "m"  ADAS
 SG_ DET_RANGE_ERR_164 : 400|7@1+ (0.0075,0) [0|0.9525] "m"  ADAS
 SG_ DET_RANGE_VELOCITY_164 : 408|15@1+ (0.0078125,-128) [-128|127.9921875] "m/s"  ADAS
 SG_ DET_RANGE_VELOCITY_ERR_164 : 424|8@1+ (0.003,0) [0|0.765] "m/s"  ADAS
 SG_ DET_AZIMUTH_164 : 448|13@1+ (0.0004,-1.5708) [-1.5708|1.5708] "rad"  ADAS
 SG_ DET_AZIMUTH_ERR_164 : 465|7@1+ (0.00087267,0) [0|0.11082909] "rad"  ADAS
 SG_ DET_ELEVATION_164 : 432|8@1+ (0.00275,-0.34925) [-0.34925|0.34925] "rad"  ADAS
 SG_ DET_ELEVATION_ERR_164 : 440|6@1+ (0.00174533,0) [0|0.10995579] "rad"  ADAS
 SG_ DET_RCS_164 : 496|8@1+ (0.5,-64) [-64|63.5] "dBsm"  ADAS
 SG_ DET_VALID_FLAG_164 : 485|1@1+ (1,0) [0|1] ""  ADAS
 SG_ DET_BI_STATIC_FLAG_164 : 483|1@1+ (1,0) [0|1] ""  ADAS
 SG_ DET_SUPER_RES_TARGET_164 : 446|1@1+ (1,0) [0|1] ""  ADAS
 SG_ DET_SNR_164 : 488|8@1+ (0.35156,0) [0|89.6478] "dB"  ADAS
 SG_ DET_POINT_TARGET_PROB_164 : 472|4@1+ (6.67,0) [0|100] "%"  ADAS
 SG_ DET_EXISTENCE_PROB_164 : 506|6@1+ (1.588,0) [0|100] "%"  ADAS
 SG_ DET_OUTSIDE_SECTOR_164 : 481|1@1+ (1,0) [0|1] ""  ADAS
 SG_ DET_HVC_FLAG_164 : 464|1@1+ (1,0) [0|1] ""  ADAS
 SG_ DET_CONFD_AZIMUTH_164 : 486|2@1+ (1,0) [0|3] ""  ADAS
 SG_ DET_CONFD_ELEVATION_164 : 461|2@1+ (1,0) [0|3] ""  ADAS
 SG_ DET_MH_SCAN_INDEX_4LSB_161_164 : 476|4@1+ (1,0) [0|15] ""  ADAS
 SG_ DET_MH_CYCLE_COUNTER_161_164 : 16|8@1+ (1,0) [0|255] ""  ADAS
 SG_ DET_MH_CRC16_161_164 : 0|16@1+ (1,0) [0|65535] ""  ADAS

BO_ 1193 RDR_DETECTION_165_168: 64 RDR08
 SG_ DET_RANGE_165 : 24|15@1+ (0.015625,0) [0|500] "m"  ADAS
 SG_ DET_RANGE_ERR_165 : 40|7@1+ (0.0075,0) [0|0.9525] "m"  ADAS
 SG_ DET_RANGE_VELOCITY_165 : 48|15@1+ (0.0078125,-128) [-128|127.9921875] "m/s"  ADAS
 SG_ DET_RANGE_VELOCITY_ERR_165 : 64|8@1+ (0.003,0) [0|0.765] "m/s"  ADAS
 SG_ DET_AZIMUTH_165 : 88|13@1+ (0.0004,-1.5708) [-1.5708|1.5708] "rad"  ADAS
 SG_ DET_AZIMUTH_ERR_165 : 105|7@1+ (0.00087267,0) [0|0.11082909] "rad"  ADAS
 SG_ DET_ELEVATION_165 : 72|8@1+ (0.00275,-0.34925) [-0.34925|0.34925] "rad"  ADAS
 SG_ DET_ELEVATION_ERR_165 : 80|6@1+ (0.00174533,0) [0|0.10995579] "rad"  ADAS
 SG_ DET_RCS_165 : 136|8@1+ (0.5,-64) [-64|63.5] "dBsm"  ADAS
 SG_ DET_VALID_FLAG_165 : 119|1@1+ (1,0) [0|1] ""  ADAS
 SG_ DET_BI_STATIC_FLAG_165 : 504|1@1+ (1,0) [0|1] ""  ADAS
 SG_ DET_SUPER_RES_TARGET_165 : 104|1@1+ (1,0) [0|1] ""  ADAS
 SG_ DET_SNR_165 : 128|8@1+ (0.35156,0) [0|89.6478] "dB"  ADAS
 SG_ DET_POINT_TARGET_PROB_165 : 114|4@1+ (6.67,0) [0|100] "%"  ADAS
 SG_ DET_EXISTENCE_PROB_165 : 120|6@1+ (1.588,0) [0|100] "%"  ADAS
 SG_ DET_OUTSIDE_SECTOR_165 : 159|1@1+ (1,0) [0|1] ""  ADAS
 SG_ DET_HVC_FLAG_165 : 118|1@1+ (1,0) [0|1] ""  ADAS
 SG_ DET_CONFD_AZIMUTH_165 : 126|2@1+ (1,0) [0|3] ""  ADAS
 SG_ DET_CONFD_ELEVATION_165 : 112|2@1+ (1,0) [0|3] ""  ADAS
 SG_ DET_RANGE_166 : 144|15@1+ (0.015625,0) [0|500] "m"  ADAS
 SG_ DET_RANGE_ERR_166 : 160|7@1+ (0.0075,0) [0|0.9525] "m"  ADAS
 SG_ DET_RANGE_VELOCITY_166 : 168|15@1+ (0.0078125,-128) [-128|127.9921875] "m/s"  ADAS
 SG_ DET_RANGE_VELOCITY_ERR_166 : 184|8@1+ (0.003,0) [0|0.765] "m/s"  ADAS
 SG_ DET_AZIMUTH_166 : 208|13@1+ (0.0004,-1.5708) [-1.5708|1.5708] "rad"  ADAS
 SG_ DET_AZIMUTH_ERR_166 : 224|7@1+ (0.00087267,0) [0|0.11082909] "rad"  ADAS
 SG_ DET_ELEVATION_166 : 192|8@1+ (0.00275,-0.34925) [-0.34925|0.34925] "rad"  ADAS
 SG_ DET_ELEVATION_ERR_166 : 200|6@1+ (0.00174533,0) [0|0.10995579] "rad"  ADAS
 SG_ DET_RCS_166 : 256|8@1+ (0.5,-64) [-64|63.5] "dBsm"  ADAS
 SG_ DET_VALID_FLAG_166 : 167|1@1+ (1,0) [0|1] ""  ADAS
 SG_ DET_BI_STATIC_FLAG_166 : 505|1@1+ (1,0) [0|1] ""  ADAS
 SG_ DET_SUPER_RES_TARGET_166 : 247|1@1+ (1,0) [0|1] ""  ADAS
 SG_ DET_SNR_166 : 248|8@1+ (0.35156,0) [0|89.6478] "dB"  ADAS
 SG_ DET_POINT_TARGET_PROB_166 : 240|4@1+ (6.67,0) [0|100] "%"  ADAS
 SG_ DET_EXISTENCE_PROB_166 : 232|6@1+ (1.588,0) [0|100] "%"  ADAS
 SG_ DET_OUTSIDE_SECTOR_166 : 183|1@1+ (1,0) [0|1] ""  ADAS
 SG_ DET_HVC_FLAG_166 : 246|1@1+ (1,0) [0|1] ""  ADAS
 SG_ DET_CONFD_AZIMUTH_166 : 206|2@1+ (1,0) [0|3] ""  ADAS
 SG_ DET_CONFD_ELEVATION_166 : 244|2@1+ (1,0) [0|3] ""  ADAS
 SG_ DET_RANGE_167 : 264|15@1+ (0.015625,0) [0|500] "m"  ADAS
 SG_ DET_RANGE_ERR_167 : 280|7@1+ (0.0075,0) [0|0.9525] "m"  ADAS
 SG_ DET_RANGE_VELOCITY_167 : 288|15@1+ (0.0078125,-128) [-128|127.9921875] "m/s"  ADAS
 SG_ DET_RANGE_VELOCITY_ERR_167 : 304|8@1+ (0.003,0) [0|0.765] "m/s"  ADAS
 SG_ DET_AZIMUTH_167 : 328|13@1+ (0.0004,-1.5708) [-1.5708|1.5708] "rad"  ADAS
 SG_ DET_AZIMUTH_ERR_167 : 345|7@1+ (0.00087267,0) [0|0.11082909] "rad"  ADAS
 SG_ DET_ELEVATION_167 : 312|8@1+ (0.00275,-0.34925) [-0.34925|0.34925] "rad"  ADAS
 SG_ DET_ELEVATION_ERR_167 : 320|6@1+ (0.00174533,0) [0|0.10995579] "rad"  ADAS
 SG_ DET_RCS_167 : 376|8@1+ (0.5,-64) [-64|63.5] "dBsm"  ADAS
 SG_ DET_VALID_FLAG_167 : 399|1@1+ (1,0) [0|1] ""  ADAS
 SG_ DET_BI_STATIC_FLAG_167 : 482|1@1+ (1,0) [0|1] ""  ADAS
 SG_ DET_SUPER_RES_TARGET_167 : 344|1@1+ (1,0) [0|1] ""  ADAS
 SG_ DET_SNR_167 : 368|8@1+ (0.35156,0) [0|89.6478] "dB"  ADAS
 SG_ DET_POINT_TARGET_PROB_167 : 360|4@1+ (6.67,0) [0|100] "%"  ADAS
 SG_ DET_EXISTENCE_PROB_167 : 352|6@1+ (1.588,0) [0|100] "%"  ADAS
 SG_ DET_OUTSIDE_SECTOR_167 : 407|1@1+ (1,0) [0|1] ""  ADAS
 SG_ DET_HVC_FLAG_167 : 364|1@1+ (1,0) [0|1] ""  ADAS
 SG_ DET_CONFD_AZIMUTH_167 : 365|2@1+ (1,0) [0|3] ""  ADAS
 SG_ DET_CONFD_ELEVATION_167 : 358|2@1+ (1,0) [0|3] ""  ADAS
 SG_ DET_RANGE_168 : 384|15@1+ (0.015625,0) [0|500] "m"  ADAS
 SG_ DET_RANGE_ERR_168 : 400|7@1+ (0.0075,0) [0|0.9525] "m"  ADAS
 SG_ DET_RANGE_VELOCITY_168 : 408|15@1+ (0.0078125,-128) [-128|127.9921875] "m/s"  ADAS
 SG_ DET_RANGE_VELOCITY_ERR_168 : 424|8@1+ (0.003,0) [0|0.765] "m/s"  ADAS
 SG_ DET_AZIMUTH_168 : 448|13@1+ (0.0004,-1.5708) [-1.5708|1.5708] "rad"  ADAS
 SG_ DET_AZIMUTH_ERR_168 : 465|7@1+ (0.00087267,0) [0|0.11082909] "rad"  ADAS
 SG_ DET_ELEVATION_168 : 432|8@1+ (0.00275,-0.34925) [-0.34925|0.34925] "rad"  ADAS
 SG_ DET_ELEVATION_ERR_168 : 440|6@1+ (0.00174533,0) [0|0.10995579] "rad"  ADAS
 SG_ DET_RCS_168 : 496|8@1+ (0.5,-64) [-64|63.5] "dBsm"  ADAS
 SG_ DET_VALID_FLAG_168 : 485|1@1+ (1,0) [0|1] ""  ADAS
 SG_ DET_BI_STATIC_FLAG_168 : 483|1@1+ (1,0) [0|1] ""  ADAS
 SG_ DET_SUPER_RES_TARGET_168 : 446|1@1+ (1,0) [0|1] ""  ADAS
 SG_ DET_SNR_168 : 488|8@1+ (0.35156,0) [0|89.6478] "dB"  ADAS
 SG_ DET_POINT_TARGET_PROB_168 : 472|4@1+ (6.67,0) [0|100] "%"  ADAS
 SG_ DET_EXISTENCE_PROB_168 : 506|6@1+ (1.588,0) [0|100] "%"  ADAS
 SG_ DET_OUTSIDE_SECTOR_168 : 481|1@1+ (1,0) [0|1] ""  ADAS
 SG_ DET_HVC_FLAG_168 : 464|1@1+ (1,0) [0|1] ""  ADAS
 SG_ DET_CONFD_AZIMUTH_168 : 486|2@1+ (1,0) [0|3] ""  ADAS
 SG_ DET_CONFD_ELEVATION_168 : 461|2@1+ (1,0) [0|3] ""  ADAS
 SG_ DET_MH_SCAN_INDEX_4LSB_165_168 : 476|4@1+ (1,0) [0|15] ""  ADAS
 SG_ DET_MH_CYCLE_COUNTER_165_168 : 16|8@1+ (1,0) [0|255] ""  ADAS
 SG_ DET_MH_CRC16_165_168 : 0|16@1+ (1,0) [0|65535] ""  ADAS

BO_ 1194 RDR_DETECTION_169_172: 64 RDR08
 SG_ DET_RANGE_169 : 24|15@1+ (0.015625,0) [0|500] "m"  ADAS
 SG_ DET_RANGE_ERR_169 : 40|7@1+ (0.0075,0) [0|0.9525] "m"  ADAS
 SG_ DET_RANGE_VELOCITY_169 : 48|15@1+ (0.0078125,-128) [-128|127.9921875] "m/s"  ADAS
 SG_ DET_RANGE_VELOCITY_ERR_169 : 64|8@1+ (0.003,0) [0|0.765] "m/s"  ADAS
 SG_ DET_AZIMUTH_169 : 88|13@1+ (0.0004,-1.5708) [-1.5708|1.5708] "rad"  ADAS
 SG_ DET_AZIMUTH_ERR_169 : 105|7@1+ (0.00087267,0) [0|0.11082909] "rad"  ADAS
 SG_ DET_ELEVATION_169 : 72|8@1+ (0.00275,-0.34925) [-0.34925|0.34925] "rad"  ADAS
 SG_ DET_ELEVATION_ERR_169 : 80|6@1+ (0.00174533,0) [0|0.10995579] "rad"  ADAS
 SG_ DET_RCS_169 : 136|8@1+ (0.5,-64) [-64|63.5] "dBsm"  ADAS
 SG_ DET_VALID_FLAG_169 : 119|1@1+ (1,0) [0|1] ""  ADAS
 SG_ DET_BI_STATIC_FLAG_169 : 504|1@1+ (1,0) [0|1] ""  ADAS
 SG_ DET_SUPER_RES_TARGET_169 : 104|1@1+ (1,0) [0|1] ""  ADAS
 SG_ DET_SNR_169 : 128|8@1+ (0.35156,0) [0|89.6478] "dB"  ADAS
 SG_ DET_POINT_TARGET_PROB_169 : 114|4@1+ (6.67,0) [0|100] "%"  ADAS
 SG_ DET_EXISTENCE_PROB_169 : 120|6@1+ (1.588,0) [0|100] "%"  ADAS
 SG_ DET_OUTSIDE_SECTOR_169 : 159|1@1+ (1,0) [0|1] ""  ADAS
 SG_ DET_HVC_FLAG_169 : 118|1@1+ (1,0) [0|1] ""  ADAS
 SG_ DET_CONFD_AZIMUTH_169 : 126|2@1+ (1,0) [0|3] ""  ADAS
 SG_ DET_CONFD_ELEVATION_169 : 112|2@1+ (1,0) [0|3] ""  ADAS
 SG_ DET_RANGE_170 : 144|15@1+ (0.015625,0) [0|500] "m"  ADAS
 SG_ DET_RANGE_ERR_170 : 160|7@1+ (0.0075,0) [0|0.9525] "m"  ADAS
 SG_ DET_RANGE_VELOCITY_170 : 168|15@1+ (0.0078125,-128) [-128|127.9921875] "m/s"  ADAS
 SG_ DET_RANGE_VELOCITY_ERR_170 : 184|8@1+ (0.003,0) [0|0.765] "m/s"  ADAS
 SG_ DET_AZIMUTH_170 : 208|13@1+ (0.0004,-1.5708) [-1.5708|1.5708] "rad"  ADAS
 SG_ DET_AZIMUTH_ERR_170 : 224|7@1+ (0.00087267,0) [0|0.11082909] "rad"  ADAS
 SG_ DET_ELEVATION_170 : 192|8@1+ (0.00275,-0.34925) [-0.34925|0.34925] "rad"  ADAS
 SG_ DET_ELEVATION_ERR_170 : 200|6@1+ (0.00174533,0) [0|0.10995579] "rad"  ADAS
 SG_ DET_RCS_170 : 256|8@1+ (0.5,-64) [-64|63.5] "dBsm"  ADAS
 SG_ DET_VALID_FLAG_170 : 167|1@1+ (1,0) [0|1] ""  ADAS
 SG_ DET_BI_STATIC_FLAG_170 : 505|1@1+ (1,0) [0|1] ""  ADAS
 SG_ DET_SUPER_RES_TARGET_170 : 247|1@1+ (1,0) [0|1] ""  ADAS
 SG_ DET_SNR_170 : 248|8@1+ (0.35156,0) [0|89.6478] "dB"  ADAS
 SG_ DET_POINT_TARGET_PROB_170 : 240|4@1+ (6.67,0) [0|100] "%"  ADAS
 SG_ DET_EXISTENCE_PROB_170 : 232|6@1+ (1.588,0) [0|100] "%"  ADAS
 SG_ DET_OUTSIDE_SECTOR_170 : 183|1@1+ (1,0) [0|1] ""  ADAS
 SG_ DET_HVC_FLAG_170 : 246|1@1+ (1,0) [0|1] ""  ADAS
 SG_ DET_CONFD_AZIMUTH_170 : 206|2@1+ (1,0) [0|3] ""  ADAS
 SG_ DET_CONFD_ELEVATION_170 : 244|2@1+ (1,0) [0|3] ""  ADAS
 SG_ DET_RANGE_171 : 264|15@1+ (0.015625,0) [0|500] "m"  ADAS
 SG_ DET_RANGE_ERR_171 : 280|7@1+ (0.0075,0) [0|0.9525] "m"  ADAS
 SG_ DET_RANGE_VELOCITY_171 : 288|15@1+ (0.0078125,-128) [-128|127.9921875] "m/s"  ADAS
 SG_ DET_RANGE_VELOCITY_ERR_171 : 304|8@1+ (0.003,0) [0|0.765] "m/s"  ADAS
 SG_ DET_AZIMUTH_171 : 328|13@1+ (0.0004,-1.5708) [-1.5708|1.5708] "rad"  ADAS
 SG_ DET_AZIMUTH_ERR_171 : 345|7@1+ (0.00087267,0) [0|0.11082909] "rad"  ADAS
 SG_ DET_ELEVATION_171 : 312|8@1+ (0.00275,-0.34925) [-0.34925|0.34925] "rad"  ADAS
 SG_ DET_ELEVATION_ERR_171 : 320|6@1+ (0.00174533,0) [0|0.10995579] "rad"  ADAS
 SG_ DET_RCS_171 : 376|8@1+ (0.5,-64) [-64|63.5] "dBsm"  ADAS
 SG_ DET_VALID_FLAG_171 : 399|1@1+ (1,0) [0|1] ""  ADAS
 SG_ DET_BI_STATIC_FLAG_171 : 482|1@1+ (1,0) [0|1] ""  ADAS
 SG_ DET_SUPER_RES_TARGET_171 : 344|1@1+ (1,0) [0|1] ""  ADAS
 SG_ DET_SNR_171 : 368|8@1+ (0.35156,0) [0|89.6478] "dB"  ADAS
 SG_ DET_POINT_TARGET_PROB_171 : 360|4@1+ (6.67,0) [0|100] "%"  ADAS
 SG_ DET_EXISTENCE_PROB_171 : 352|6@1+ (1.588,0) [0|100] "%"  ADAS
 SG_ DET_OUTSIDE_SECTOR_171 : 407|1@1+ (1,0) [0|1] ""  ADAS
 SG_ DET_HVC_FLAG_171 : 364|1@1+ (1,0) [0|1] ""  ADAS
 SG_ DET_CONFD_AZIMUTH_171 : 365|2@1+ (1,0) [0|3] ""  ADAS
 SG_ DET_CONFD_ELEVATION_171 : 358|2@1+ (1,0) [0|3] ""  ADAS
 SG_ DET_RANGE_172 : 384|15@1+ (0.015625,0) [0|500] "m"  ADAS
 SG_ DET_RANGE_ERR_172 : 400|7@1+ (0.0075,0) [0|0.9525] "m"  ADAS
 SG_ DET_RANGE_VELOCITY_172 : 408|15@1+ (0.0078125,-128) [-128|127.9921875] "m/s"  ADAS
 SG_ DET_RANGE_VELOCITY_ERR_172 : 424|8@1+ (0.003,0) [0|0.765] "m/s"  ADAS
 SG_ DET_AZIMUTH_172 : 448|13@1+ (0.0004,-1.5708) [-1.5708|1.5708] "rad"  ADAS
 SG_ DET_AZIMUTH_ERR_172 : 465|7@1+ (0.00087267,0) [0|0.11082909] "rad"  ADAS
 SG_ DET_ELEVATION_172 : 432|8@1+ (0.00275,-0.34925) [-0.34925|0.34925] "rad"  ADAS
 SG_ DET_ELEVATION_ERR_172 : 440|6@1+ (0.00174533,0) [0|0.10995579] "rad"  ADAS
 SG_ DET_RCS_172 : 496|8@1+ (0.5,-64) [-64|63.5] "dBsm"  ADAS
 SG_ DET_VALID_FLAG_172 : 485|1@1+ (1,0) [0|1] ""  ADAS
 SG_ DET_BI_STATIC_FLAG_172 : 483|1@1+ (1,0) [0|1] ""  ADAS
 SG_ DET_SUPER_RES_TARGET_172 : 446|1@1+ (1,0) [0|1] ""  ADAS
 SG_ DET_SNR_172 : 488|8@1+ (0.35156,0) [0|89.6478] "dB"  ADAS
 SG_ DET_POINT_TARGET_PROB_172 : 472|4@1+ (6.67,0) [0|100] "%"  ADAS
 SG_ DET_EXISTENCE_PROB_172 : 506|6@1+ (1.588,0) [0|100] "%"  ADAS
 SG_ DET_OUTSIDE_SECTOR_172 : 481|1@1+ (1,0) [0|1] ""  ADAS
 SG_ DET_HVC_FLAG_172 : 464|1@1+ (1,0) [0|1] ""  ADAS
 SG_ DET_CONFD_AZIMUTH_172 : 486|2@1+ (1,0) [0|3] ""  ADAS
 SG_ DET_CONFD_ELEVATION_172 : 461|2@1+ (1,0) [0|3] ""  ADAS
 SG_ DET_MH_SCAN_INDEX_4LSB_169_172 : 476|4@1+ (1,0) [0|15] ""  ADAS
 SG_ DET_MH_CYCLE_COUNTER_169_172 : 16|8@1+ (1,0) [0|255] ""  ADAS
 SG_ DET_MH_CRC16_169_172 : 0|16@1+ (1,0) [0|65535] ""  ADAS

BO_ 1195 RDR_DETECTION_173_176: 64 RDR08
 SG_ DET_RANGE_173 : 24|15@1+ (0.015625,0) [0|500] "m"  ADAS
 SG_ DET_RANGE_ERR_173 : 40|7@1+ (0.0075,0) [0|0.9525] "m"  ADAS
 SG_ DET_RANGE_VELOCITY_173 : 48|15@1+ (0.0078125,-128) [-128|127.9921875] "m/s"  ADAS
 SG_ DET_RANGE_VELOCITY_ERR_173 : 64|8@1+ (0.003,0) [0|0.765] "m/s"  ADAS
 SG_ DET_AZIMUTH_173 : 88|13@1+ (0.0004,-1.5708) [-1.5708|1.5708] "rad"  ADAS
 SG_ DET_AZIMUTH_ERR_173 : 105|7@1+ (0.00087267,0) [0|0.11082909] "rad"  ADAS
 SG_ DET_ELEVATION_173 : 72|8@1+ (0.00275,-0.34925) [-0.34925|0.34925] "rad"  ADAS
 SG_ DET_ELEVATION_ERR_173 : 80|6@1+ (0.00174533,0) [0|0.10995579] "rad"  ADAS
 SG_ DET_RCS_173 : 136|8@1+ (0.5,-64) [-64|63.5] "dBsm"  ADAS
 SG_ DET_VALID_FLAG_173 : 119|1@1+ (1,0) [0|1] ""  ADAS
 SG_ DET_BI_STATIC_FLAG_173 : 504|1@1+ (1,0) [0|1] ""  ADAS
 SG_ DET_SUPER_RES_TARGET_173 : 104|1@1+ (1,0) [0|1] ""  ADAS
 SG_ DET_SNR_173 : 128|8@1+ (0.35156,0) [0|89.6478] "dB"  ADAS
 SG_ DET_POINT_TARGET_PROB_173 : 114|4@1+ (6.67,0) [0|100] "%"  ADAS
 SG_ DET_EXISTENCE_PROB_173 : 120|6@1+ (1.588,0) [0|100] "%"  ADAS
 SG_ DET_OUTSIDE_SECTOR_173 : 159|1@1+ (1,0) [0|1] ""  ADAS
 SG_ DET_HVC_FLAG_173 : 118|1@1+ (1,0) [0|1] ""  ADAS
 SG_ DET_CONFD_AZIMUTH_173 : 126|2@1+ (1,0) [0|3] ""  ADAS
 SG_ DET_CONFD_ELEVATION_173 : 112|2@1+ (1,0) [0|3] ""  ADAS
 SG_ DET_RANGE_174 : 144|15@1+ (0.015625,0) [0|500] "m"  ADAS
 SG_ DET_RANGE_ERR_174 : 160|7@1+ (0.0075,0) [0|0.9525] "m"  ADAS
 SG_ DET_RANGE_VELOCITY_174 : 168|15@1+ (0.0078125,-128) [-128|127.9921875] "m/s"  ADAS
 SG_ DET_RANGE_VELOCITY_ERR_174 : 184|8@1+ (0.003,0) [0|0.765] "m/s"  ADAS
 SG_ DET_AZIMUTH_174 : 208|13@1+ (0.0004,-1.5708) [-1.5708|1.5708] "rad"  ADAS
 SG_ DET_AZIMUTH_ERR_174 : 224|7@1+ (0.00087267,0) [0|0.11082909] "rad"  ADAS
 SG_ DET_ELEVATION_174 : 192|8@1+ (0.00275,-0.34925) [-0.34925|0.34925] "rad"  ADAS
 SG_ DET_ELEVATION_ERR_174 : 200|6@1+ (0.00174533,0) [0|0.10995579] "rad"  ADAS
 SG_ DET_RCS_174 : 256|8@1+ (0.5,-64) [-64|63.5] "dBsm"  ADAS
 SG_ DET_VALID_FLAG_174 : 167|1@1+ (1,0) [0|1] ""  ADAS
 SG_ DET_BI_STATIC_FLAG_174 : 505|1@1+ (1,0) [0|1] ""  ADAS
 SG_ DET_SUPER_RES_TARGET_174 : 247|1@1+ (1,0) [0|1] ""  ADAS
 SG_ DET_SNR_174 : 248|8@1+ (0.35156,0) [0|89.6478] "dB"  ADAS
 SG_ DET_POINT_TARGET_PROB_174 : 240|4@1+ (6.67,0) [0|100] "%"  ADAS
 SG_ DET_EXISTENCE_PROB_174 : 232|6@1+ (1.588,0) [0|100] "%"  ADAS
 SG_ DET_OUTSIDE_SECTOR_174 : 183|1@1+ (1,0) [0|1] ""  ADAS
 SG_ DET_HVC_FLAG_174 : 246|1@1+ (1,0) [0|1] ""  ADAS
 SG_ DET_CONFD_AZIMUTH_174 : 206|2@1+ (1,0) [0|3] ""  ADAS
 SG_ DET_CONFD_ELEVATION_174 : 244|2@1+ (1,0) [0|3] ""  ADAS
 SG_ DET_RANGE_175 : 264|15@1+ (0.015625,0) [0|500] "m"  ADAS
 SG_ DET_RANGE_ERR_175 : 280|7@1+ (0.0075,0) [0|0.9525] "m"  ADAS
 SG_ DET_RANGE_VELOCITY_175 : 288|15@1+ (0.0078125,-128) [-128|127.9921875] "m/s"  ADAS
 SG_ DET_RANGE_VELOCITY_ERR_175 : 304|8@1+ (0.003,0) [0|0.765] "m/s"  ADAS
 SG_ DET_AZIMUTH_175 : 328|13@1+ (0.0004,-1.5708) [-1.5708|1.5708] "rad"  ADAS
 SG_ DET_AZIMUTH_ERR_175 : 345|7@1+ (0.00087267,0) [0|0.11082909] "rad"  ADAS
 SG_ DET_ELEVATION_175 : 312|8@1+ (0.00275,-0.34925) [-0.34925|0.34925] "rad"  ADAS
 SG_ DET_ELEVATION_ERR_175 : 320|6@1+ (0.00174533,0) [0|0.10995579] "rad"  ADAS
 SG_ DET_RCS_175 : 376|8@1+ (0.5,-64) [-64|63.5] "dBsm"  ADAS
 SG_ DET_VALID_FLAG_175 : 399|1@1+ (1,0) [0|1] ""  ADAS
 SG_ DET_BI_STATIC_FLAG_175 : 482|1@1+ (1,0) [0|1] ""  ADAS
 SG_ DET_SUPER_RES_TARGET_175 : 344|1@1+ (1,0) [0|1] ""  ADAS
 SG_ DET_SNR_175 : 368|8@1+ (0.35156,0) [0|89.6478] "dB"  ADAS
 SG_ DET_POINT_TARGET_PROB_175 : 360|4@1+ (6.67,0) [0|100] "%"  ADAS
 SG_ DET_EXISTENCE_PROB_175 : 352|6@1+ (1.588,0) [0|100] "%"  ADAS
 SG_ DET_OUTSIDE_SECTOR_175 : 407|1@1+ (1,0) [0|1] ""  ADAS
 SG_ DET_HVC_FLAG_175 : 364|1@1+ (1,0) [0|1] ""  ADAS
 SG_ DET_CONFD_AZIMUTH_175 : 365|2@1+ (1,0) [0|3] ""  ADAS
 SG_ DET_CONFD_ELEVATION_175 : 358|2@1+ (1,0) [0|3] ""  ADAS
 SG_ DET_RANGE_176 : 384|15@1+ (0.015625,0) [0|500] "m"  ADAS
 SG_ DET_RANGE_ERR_176 : 400|7@1+ (0.0075,0) [0|0.9525] "m"  ADAS
 SG_ DET_RANGE_VELOCITY_176 : 408|15@1+ (0.0078125,-128) [-128|127.9921875] "m/s"  ADAS
 SG_ DET_RANGE_VELOCITY_ERR_176 : 424|8@1+ (0.003,0) [0|0.765] "m/s"  ADAS
 SG_ DET_AZIMUTH_176 : 448|13@1+ (0.0004,-1.5708) [-1.5708|1.5708] "rad"  ADAS
 SG_ DET_AZIMUTH_ERR_176 : 465|7@1+ (0.00087267,0) [0|0.11082909] "rad"  ADAS
 SG_ DET_ELEVATION_176 : 432|8@1+ (0.00275,-0.34925) [-0.34925|0.34925] "rad"  ADAS
 SG_ DET_ELEVATION_ERR_176 : 440|6@1+ (0.00174533,0) [0|0.10995579] "rad"  ADAS
 SG_ DET_RCS_176 : 496|8@1+ (0.5,-64) [-64|63.5] "dBsm"  ADAS
 SG_ DET_VALID_FLAG_176 : 485|1@1+ (1,0) [0|1] ""  ADAS
 SG_ DET_BI_STATIC_FLAG_176 : 483|1@1+ (1,0) [0|1] ""  ADAS
 SG_ DET_SUPER_RES_TARGET_176 : 446|1@1+ (1,0) [0|1] ""  ADAS
 SG_ DET_SNR_176 : 488|8@1+ (0.35156,0) [0|89.6478] "dB"  ADAS
 SG_ DET_POINT_TARGET_PROB_176 : 472|4@1+ (6.67,0) [0|100] "%"  ADAS
 SG_ DET_EXISTENCE_PROB_176 : 506|6@1+ (1.588,0) [0|100] "%"  ADAS
 SG_ DET_OUTSIDE_SECTOR_176 : 481|1@1+ (1,0) [0|1] ""  ADAS
 SG_ DET_HVC_FLAG_176 : 464|1@1+ (1,0) [0|1] ""  ADAS
 SG_ DET_CONFD_AZIMUTH_176 : 486|2@1+ (1,0) [0|3] ""  ADAS
 SG_ DET_CONFD_ELEVATION_176 : 461|2@1+ (1,0) [0|3] ""  ADAS
 SG_ DET_MH_SCAN_INDEX_4LSB_173_176 : 476|4@1+ (1,0) [0|15] ""  ADAS
 SG_ DET_MH_CYCLE_COUNTER_173_176 : 16|8@1+ (1,0) [0|255] ""  ADAS
 SG_ DET_MH_CRC16_173_176 : 0|16@1+ (1,0) [0|65535] ""  ADAS

BO_ 1196 RDR_DETECTION_177_180: 64 RDR08
 SG_ DET_RANGE_177 : 24|15@1+ (0.015625,0) [0|500] "m"  ADAS
 SG_ DET_RANGE_ERR_177 : 40|7@1+ (0.0075,0) [0|0.9525] "m"  ADAS
 SG_ DET_RANGE_VELOCITY_177 : 48|15@1+ (0.0078125,-128) [-128|127.9921875] "m/s"  ADAS
 SG_ DET_RANGE_VELOCITY_ERR_177 : 64|8@1+ (0.003,0) [0|0.765] "m/s"  ADAS
 SG_ DET_AZIMUTH_177 : 88|13@1+ (0.0004,-1.5708) [-1.5708|1.5708] "rad"  ADAS
 SG_ DET_AZIMUTH_ERR_177 : 105|7@1+ (0.00087267,0) [0|0.11082909] "rad"  ADAS
 SG_ DET_ELEVATION_177 : 72|8@1+ (0.00275,-0.34925) [-0.34925|0.34925] "rad"  ADAS
 SG_ DET_ELEVATION_ERR_177 : 80|6@1+ (0.00174533,0) [0|0.10995579] "rad"  ADAS
 SG_ DET_RCS_177 : 136|8@1+ (0.5,-64) [-64|63.5] "dBsm"  ADAS
 SG_ DET_VALID_FLAG_177 : 119|1@1+ (1,0) [0|1] ""  ADAS
 SG_ DET_BI_STATIC_FLAG_177 : 504|1@1+ (1,0) [0|1] ""  ADAS
 SG_ DET_SUPER_RES_TARGET_177 : 104|1@1+ (1,0) [0|1] ""  ADAS
 SG_ DET_SNR_177 : 128|8@1+ (0.35156,0) [0|89.6478] "dB"  ADAS
 SG_ DET_POINT_TARGET_PROB_177 : 114|4@1+ (6.67,0) [0|100] "%"  ADAS
 SG_ DET_EXISTENCE_PROB_177 : 120|6@1+ (1.588,0) [0|100] "%"  ADAS
 SG_ DET_OUTSIDE_SECTOR_177 : 159|1@1+ (1,0) [0|1] ""  ADAS
 SG_ DET_HVC_FLAG_177 : 118|1@1+ (1,0) [0|1] ""  ADAS
 SG_ DET_CONFD_AZIMUTH_177 : 126|2@1+ (1,0) [0|3] ""  ADAS
 SG_ DET_CONFD_ELEVATION_177 : 112|2@1+ (1,0) [0|3] ""  ADAS
 SG_ DET_RANGE_178 : 144|15@1+ (0.015625,0) [0|500] "m"  ADAS
 SG_ DET_RANGE_ERR_178 : 160|7@1+ (0.0075,0) [0|0.9525] "m"  ADAS
 SG_ DET_RANGE_VELOCITY_178 : 168|15@1+ (0.0078125,-128) [-128|127.9921875] "m/s"  ADAS
 SG_ DET_RANGE_VELOCITY_ERR_178 : 184|8@1+ (0.003,0) [0|0.765] "m/s"  ADAS
 SG_ DET_AZIMUTH_178 : 208|13@1+ (0.0004,-1.5708) [-1.5708|1.5708] "rad"  ADAS
 SG_ DET_AZIMUTH_ERR_178 : 224|7@1+ (0.00087267,0) [0|0.11082909] "rad"  ADAS
 SG_ DET_ELEVATION_178 : 192|8@1+ (0.00275,-0.34925) [-0.34925|0.34925] "rad"  ADAS
 SG_ DET_ELEVATION_ERR_178 : 200|6@1+ (0.00174533,0) [0|0.10995579] "rad"  ADAS
 SG_ DET_RCS_178 : 256|8@1+ (0.5,-64) [-64|63.5] "dBsm"  ADAS
 SG_ DET_VALID_FLAG_178 : 167|1@1+ (1,0) [0|1] ""  ADAS
 SG_ DET_BI_STATIC_FLAG_178 : 505|1@1+ (1,0) [0|1] ""  ADAS
 SG_ DET_SUPER_RES_TARGET_178 : 247|1@1+ (1,0) [0|1] ""  ADAS
 SG_ DET_SNR_178 : 248|8@1+ (0.35156,0) [0|89.6478] "dB"  ADAS
 SG_ DET_POINT_TARGET_PROB_178 : 240|4@1+ (6.67,0) [0|100] "%"  ADAS
 SG_ DET_EXISTENCE_PROB_178 : 232|6@1+ (1.588,0) [0|100] "%"  ADAS
 SG_ DET_OUTSIDE_SECTOR_178 : 183|1@1+ (1,0) [0|1] ""  ADAS
 SG_ DET_HVC_FLAG_178 : 246|1@1+ (1,0) [0|1] ""  ADAS
 SG_ DET_CONFD_AZIMUTH_178 : 206|2@1+ (1,0) [0|3] ""  ADAS
 SG_ DET_CONFD_ELEVATION_178 : 244|2@1+ (1,0) [0|3] ""  ADAS
 SG_ DET_RANGE_179 : 264|15@1+ (0.015625,0) [0|500] "m"  ADAS
 SG_ DET_RANGE_ERR_179 : 280|7@1+ (0.0075,0) [0|0.9525] "m"  ADAS
 SG_ DET_RANGE_VELOCITY_179 : 288|15@1+ (0.0078125,-128) [-128|127.9921875] "m/s"  ADAS
 SG_ DET_RANGE_VELOCITY_ERR_179 : 304|8@1+ (0.003,0) [0|0.765] "m/s"  ADAS
 SG_ DET_AZIMUTH_179 : 328|13@1+ (0.0004,-1.5708) [-1.5708|1.5708] "rad"  ADAS
 SG_ DET_AZIMUTH_ERR_179 : 345|7@1+ (0.00087267,0) [0|0.11082909] "rad"  ADAS
 SG_ DET_ELEVATION_179 : 312|8@1+ (0.00275,-0.34925) [-0.34925|0.34925] "rad"  ADAS
 SG_ DET_ELEVATION_ERR_179 : 320|6@1+ (0.00174533,0) [0|0.10995579] "rad"  ADAS
 SG_ DET_RCS_179 : 376|8@1+ (0.5,-64) [-64|63.5] "dBsm"  ADAS
 SG_ DET_VALID_FLAG_179 : 399|1@1+ (1,0) [0|1] ""  ADAS
 SG_ DET_BI_STATIC_FLAG_179 : 482|1@1+ (1,0) [0|1] ""  ADAS
 SG_ DET_SUPER_RES_TARGET_179 : 344|1@1+ (1,0) [0|1] ""  ADAS
 SG_ DET_SNR_179 : 368|8@1+ (0.35156,0) [0|89.6478] "dB"  ADAS
 SG_ DET_POINT_TARGET_PROB_179 : 360|4@1+ (6.67,0) [0|100] "%"  ADAS
 SG_ DET_EXISTENCE_PROB_179 : 352|6@1+ (1.588,0) [0|100] "%"  ADAS
 SG_ DET_OUTSIDE_SECTOR_179 : 407|1@1+ (1,0) [0|1] ""  ADAS
 SG_ DET_HVC_FLAG_179 : 364|1@1+ (1,0) [0|1] ""  ADAS
 SG_ DET_CONFD_AZIMUTH_179 : 365|2@1+ (1,0) [0|3] ""  ADAS
 SG_ DET_CONFD_ELEVATION_179 : 358|2@1+ (1,0) [0|3] ""  ADAS
 SG_ DET_RANGE_180 : 384|15@1+ (0.015625,0) [0|500] "m"  ADAS
 SG_ DET_RANGE_ERR_180 : 400|7@1+ (0.0075,0) [0|0.9525] "m"  ADAS
 SG_ DET_RANGE_VELOCITY_180 : 408|15@1+ (0.0078125,-128) [-128|127.9921875] "m/s"  ADAS
 SG_ DET_RANGE_VELOCITY_ERR_180 : 424|8@1+ (0.003,0) [0|0.765] "m/s"  ADAS
 SG_ DET_AZIMUTH_180 : 448|13@1+ (0.0004,-1.5708) [-1.5708|1.5708] "rad"  ADAS
 SG_ DET_AZIMUTH_ERR_180 : 465|7@1+ (0.00087267,0) [0|0.11082909] "rad"  ADAS
 SG_ DET_ELEVATION_180 : 432|8@1+ (0.00275,-0.34925) [-0.34925|0.34925] "rad"  ADAS
 SG_ DET_ELEVATION_ERR_180 : 440|6@1+ (0.00174533,0) [0|0.10995579] "rad"  ADAS
 SG_ DET_RCS_180 : 496|8@1+ (0.5,-64) [-64|63.5] "dBsm"  ADAS
 SG_ DET_VALID_FLAG_180 : 485|1@1+ (1,0) [0|1] ""  ADAS
 SG_ DET_BI_STATIC_FLAG_180 : 483|1@1+ (1,0) [0|1] ""  ADAS
 SG_ DET_SUPER_RES_TARGET_180 : 446|1@1+ (1,0) [0|1] ""  ADAS
 SG_ DET_SNR_180 : 488|8@1+ (0.35156,0) [0|89.6478] "dB"  ADAS
 SG_ DET_POINT_TARGET_PROB_180 : 472|4@1+ (6.67,0) [0|100] "%"  ADAS
 SG_ DET_EXISTENCE_PROB_180 : 506|6@1+ (1.588,0) [0|100] "%"  ADAS
 SG_ DET_OUTSIDE_SECTOR_180 : 481|1@1+ (1,0) [0|1] ""  ADAS
 SG_ DET_HVC_FLAG_180 : 464|1@1+ (1,0) [0|1] ""  ADAS
 SG_ DET_CONFD_AZIMUTH_180 : 486|2@1+ (1,0) [0|3] ""  ADAS
 SG_ DET_CONFD_ELEVATION_180 : 461|2@1+ (1,0) [0|3] ""  ADAS
 SG_ DET_MH_SCAN_INDEX_4LSB_177_180 : 476|4@1+ (1,0) [0|15] ""  ADAS
 SG_ DET_MH_CYCLE_COUNTER_177_180 : 16|8@1+ (1,0) [0|255] ""  ADAS
 SG_ DET_MH_CRC16_177_180 : 0|16@1+ (1,0) [0|65535] ""  ADAS

BO_ 1197 RDR_DETECTION_181_184: 64 RDR08
 SG_ DET_RANGE_181 : 24|15@1+ (0.015625,0) [0|500] "m"  ADAS
 SG_ DET_RANGE_ERR_181 : 40|7@1+ (0.0075,0) [0|0.9525] "m"  ADAS
 SG_ DET_RANGE_VELOCITY_181 : 48|15@1+ (0.0078125,-128) [-128|127.9921875] "m/s"  ADAS
 SG_ DET_RANGE_VELOCITY_ERR_181 : 64|8@1+ (0.003,0) [0|0.765] "m/s"  ADAS
 SG_ DET_AZIMUTH_181 : 88|13@1+ (0.0004,-1.5708) [-1.5708|1.5708] "rad"  ADAS
 SG_ DET_AZIMUTH_ERR_181 : 105|7@1+ (0.00087267,0) [0|0.11082909] "rad"  ADAS
 SG_ DET_ELEVATION_181 : 72|8@1+ (0.00275,-0.34925) [-0.34925|0.34925] "rad"  ADAS
 SG_ DET_ELEVATION_ERR_181 : 80|6@1+ (0.00174533,0) [0|0.10995579] "rad"  ADAS
 SG_ DET_RCS_181 : 136|8@1+ (0.5,-64) [-64|63.5] "dBsm"  ADAS
 SG_ DET_VALID_FLAG_181 : 119|1@1+ (1,0) [0|1] ""  ADAS
 SG_ DET_BI_STATIC_FLAG_181 : 504|1@1+ (1,0) [0|1] ""  ADAS
 SG_ DET_SUPER_RES_TARGET_181 : 104|1@1+ (1,0) [0|1] ""  ADAS
 SG_ DET_SNR_181 : 128|8@1+ (0.35156,0) [0|89.6478] "dB"  ADAS
 SG_ DET_POINT_TARGET_PROB_181 : 114|4@1+ (6.67,0) [0|100] "%"  ADAS
 SG_ DET_EXISTENCE_PROB_181 : 120|6@1+ (1.588,0) [0|100] "%"  ADAS
 SG_ DET_OUTSIDE_SECTOR_181 : 159|1@1+ (1,0) [0|1] ""  ADAS
 SG_ DET_HVC_FLAG_181 : 118|1@1+ (1,0) [0|1] ""  ADAS
 SG_ DET_CONFD_AZIMUTH_181 : 126|2@1+ (1,0) [0|3] ""  ADAS
 SG_ DET_CONFD_ELEVATION_181 : 112|2@1+ (1,0) [0|3] ""  ADAS
 SG_ DET_RANGE_182 : 144|15@1+ (0.015625,0) [0|500] "m"  ADAS
 SG_ DET_RANGE_ERR_182 : 160|7@1+ (0.0075,0) [0|0.9525] "m"  ADAS
 SG_ DET_RANGE_VELOCITY_182 : 168|15@1+ (0.0078125,-128) [-128|127.9921875] "m/s"  ADAS
 SG_ DET_RANGE_VELOCITY_ERR_182 : 184|8@1+ (0.003,0) [0|0.765] "m/s"  ADAS
 SG_ DET_AZIMUTH_182 : 208|13@1+ (0.0004,-1.5708) [-1.5708|1.5708] "rad"  ADAS
 SG_ DET_AZIMUTH_ERR_182 : 224|7@1+ (0.00087267,0) [0|0.11082909] "rad"  ADAS
 SG_ DET_ELEVATION_182 : 192|8@1+ (0.00275,-0.34925) [-0.34925|0.34925] "rad"  ADAS
 SG_ DET_ELEVATION_ERR_182 : 200|6@1+ (0.00174533,0) [0|0.10995579] "rad"  ADAS
 SG_ DET_RCS_182 : 256|8@1+ (0.5,-64) [-64|63.5] "dBsm"  ADAS
 SG_ DET_VALID_FLAG_182 : 167|1@1+ (1,0) [0|1] ""  ADAS
 SG_ DET_BI_STATIC_FLAG_182 : 505|1@1+ (1,0) [0|1] ""  ADAS
 SG_ DET_SUPER_RES_TARGET_182 : 247|1@1+ (1,0) [0|1] ""  ADAS
 SG_ DET_SNR_182 : 248|8@1+ (0.35156,0) [0|89.6478] "dB"  ADAS
 SG_ DET_POINT_TARGET_PROB_182 : 240|4@1+ (6.67,0) [0|100] "%"  ADAS
 SG_ DET_EXISTENCE_PROB_182 : 232|6@1+ (1.588,0) [0|100] "%"  ADAS
 SG_ DET_OUTSIDE_SECTOR_182 : 183|1@1+ (1,0) [0|1] ""  ADAS
 SG_ DET_HVC_FLAG_182 : 246|1@1+ (1,0) [0|1] ""  ADAS
 SG_ DET_CONFD_AZIMUTH_182 : 206|2@1+ (1,0) [0|3] ""  ADAS
 SG_ DET_CONFD_ELEVATION_182 : 244|2@1+ (1,0) [0|3] ""  ADAS
 SG_ DET_RANGE_183 : 264|15@1+ (0.015625,0) [0|500] "m"  ADAS
 SG_ DET_RANGE_ERR_183 : 280|7@1+ (0.0075,0) [0|0.9525] "m"  ADAS
 SG_ DET_RANGE_VELOCITY_183 : 288|15@1+ (0.0078125,-128) [-128|127.9921875] "m/s"  ADAS
 SG_ DET_RANGE_VELOCITY_ERR_183 : 304|8@1+ (0.003,0) [0|0.765] "m/s"  ADAS
 SG_ DET_AZIMUTH_183 : 328|13@1+ (0.0004,-1.5708) [-1.5708|1.5708] "rad"  ADAS
 SG_ DET_AZIMUTH_ERR_183 : 345|7@1+ (0.00087267,0) [0|0.11082909] "rad"  ADAS
 SG_ DET_ELEVATION_183 : 312|8@1+ (0.00275,-0.34925) [-0.34925|0.34925] "rad"  ADAS
 SG_ DET_ELEVATION_ERR_183 : 320|6@1+ (0.00174533,0) [0|0.10995579] "rad"  ADAS
 SG_ DET_RCS_183 : 376|8@1+ (0.5,-64) [-64|63.5] "dBsm"  ADAS
 SG_ DET_VALID_FLAG_183 : 399|1@1+ (1,0) [0|1] ""  ADAS
 SG_ DET_BI_STATIC_FLAG_183 : 482|1@1+ (1,0) [0|1] ""  ADAS
 SG_ DET_SUPER_RES_TARGET_183 : 344|1@1+ (1,0) [0|1] ""  ADAS
 SG_ DET_SNR_183 : 368|8@1+ (0.35156,0) [0|89.6478] "dB"  ADAS
 SG_ DET_POINT_TARGET_PROB_183 : 360|4@1+ (6.67,0) [0|100] "%"  ADAS
 SG_ DET_EXISTENCE_PROB_183 : 352|6@1+ (1.588,0) [0|100] "%"  ADAS
 SG_ DET_OUTSIDE_SECTOR_183 : 407|1@1+ (1,0) [0|1] ""  ADAS
 SG_ DET_HVC_FLAG_183 : 364|1@1+ (1,0) [0|1] ""  ADAS
 SG_ DET_CONFD_AZIMUTH_183 : 365|2@1+ (1,0) [0|3] ""  ADAS
 SG_ DET_CONFD_ELEVATION_183 : 358|2@1+ (1,0) [0|3] ""  ADAS
 SG_ DET_RANGE_184 : 384|15@1+ (0.015625,0) [0|500] "m"  ADAS
 SG_ DET_RANGE_ERR_184 : 400|7@1+ (0.0075,0) [0|0.9525] "m"  ADAS
 SG_ DET_RANGE_VELOCITY_184 : 408|15@1+ (0.0078125,-128) [-128|127.9921875] "m/s"  ADAS
 SG_ DET_RANGE_VELOCITY_ERR_184 : 424|8@1+ (0.003,0) [0|0.765] "m/s"  ADAS
 SG_ DET_AZIMUTH_184 : 448|13@1+ (0.0004,-1.5708) [-1.5708|1.5708] "rad"  ADAS
 SG_ DET_AZIMUTH_ERR_184 : 465|7@1+ (0.00087267,0) [0|0.11082909] "rad"  ADAS
 SG_ DET_ELEVATION_184 : 432|8@1+ (0.00275,-0.34925) [-0.34925|0.34925] "rad"  ADAS
 SG_ DET_ELEVATION_ERR_184 : 440|6@1+ (0.00174533,0) [0|0.10995579] "rad"  ADAS
 SG_ DET_RCS_184 : 496|8@1+ (0.5,-64) [-64|63.5] "dBsm"  ADAS
 SG_ DET_VALID_FLAG_184 : 485|1@1+ (1,0) [0|1] ""  ADAS
 SG_ DET_BI_STATIC_FLAG_184 : 483|1@1+ (1,0) [0|1] ""  ADAS
 SG_ DET_SUPER_RES_TARGET_184 : 446|1@1+ (1,0) [0|1] ""  ADAS
 SG_ DET_SNR_184 : 488|8@1+ (0.35156,0) [0|89.6478] "dB"  ADAS
 SG_ DET_POINT_TARGET_PROB_184 : 472|4@1+ (6.67,0) [0|100] "%"  ADAS
 SG_ DET_EXISTENCE_PROB_184 : 506|6@1+ (1.588,0) [0|100] "%"  ADAS
 SG_ DET_OUTSIDE_SECTOR_184 : 481|1@1+ (1,0) [0|1] ""  ADAS
 SG_ DET_HVC_FLAG_184 : 464|1@1+ (1,0) [0|1] ""  ADAS
 SG_ DET_CONFD_AZIMUTH_184 : 486|2@1+ (1,0) [0|3] ""  ADAS
 SG_ DET_CONFD_ELEVATION_184 : 461|2@1+ (1,0) [0|3] ""  ADAS
 SG_ DET_MH_SCAN_INDEX_4LSB_181_184 : 476|4@1+ (1,0) [0|15] ""  ADAS
 SG_ DET_MH_CYCLE_COUNTER_181_184 : 16|8@1+ (1,0) [0|255] ""  ADAS
 SG_ DET_MH_CRC16_181_184 : 0|16@1+ (1,0) [0|65535] ""  ADAS

BO_ 1198 RDR_DETECTION_185_188: 64 RDR08
 SG_ DET_RANGE_185 : 24|15@1+ (0.015625,0) [0|500] "m"  ADAS
 SG_ DET_RANGE_ERR_185 : 40|7@1+ (0.0075,0) [0|0.9525] "m"  ADAS
 SG_ DET_RANGE_VELOCITY_185 : 48|15@1+ (0.0078125,-128) [-128|127.9921875] "m/s"  ADAS
 SG_ DET_RANGE_VELOCITY_ERR_185 : 64|8@1+ (0.003,0) [0|0.765] "m/s"  ADAS
 SG_ DET_AZIMUTH_185 : 88|13@1+ (0.0004,-1.5708) [-1.5708|1.5708] "rad"  ADAS
 SG_ DET_AZIMUTH_ERR_185 : 105|7@1+ (0.00087267,0) [0|0.11082909] "rad"  ADAS
 SG_ DET_ELEVATION_185 : 72|8@1+ (0.00275,-0.34925) [-0.34925|0.34925] "rad"  ADAS
 SG_ DET_ELEVATION_ERR_185 : 80|6@1+ (0.00174533,0) [0|0.10995579] "rad"  ADAS
 SG_ DET_RCS_185 : 136|8@1+ (0.5,-64) [-64|63.5] "dBsm"  ADAS
 SG_ DET_VALID_FLAG_185 : 119|1@1+ (1,0) [0|1] ""  ADAS
 SG_ DET_BI_STATIC_FLAG_185 : 504|1@1+ (1,0) [0|1] ""  ADAS
 SG_ DET_SUPER_RES_TARGET_185 : 104|1@1+ (1,0) [0|1] ""  ADAS
 SG_ DET_SNR_185 : 128|8@1+ (0.35156,0) [0|89.6478] "dB"  ADAS
 SG_ DET_POINT_TARGET_PROB_185 : 114|4@1+ (6.67,0) [0|100] "%"  ADAS
 SG_ DET_EXISTENCE_PROB_185 : 120|6@1+ (1.588,0) [0|100] "%"  ADAS
 SG_ DET_OUTSIDE_SECTOR_185 : 159|1@1+ (1,0) [0|1] ""  ADAS
 SG_ DET_HVC_FLAG_185 : 118|1@1+ (1,0) [0|1] ""  ADAS
 SG_ DET_CONFD_AZIMUTH_185 : 126|2@1+ (1,0) [0|3] ""  ADAS
 SG_ DET_CONFD_ELEVATION_185 : 112|2@1+ (1,0) [0|3] ""  ADAS
 SG_ DET_RANGE_186 : 144|15@1+ (0.015625,0) [0|500] "m"  ADAS
 SG_ DET_RANGE_ERR_186 : 160|7@1+ (0.0075,0) [0|0.9525] "m"  ADAS
 SG_ DET_RANGE_VELOCITY_186 : 168|15@1+ (0.0078125,-128) [-128|127.9921875] "m/s"  ADAS
 SG_ DET_RANGE_VELOCITY_ERR_186 : 184|8@1+ (0.003,0) [0|0.765] "m/s"  ADAS
 SG_ DET_AZIMUTH_186 : 208|13@1+ (0.0004,-1.5708) [-1.5708|1.5708] "rad"  ADAS
 SG_ DET_AZIMUTH_ERR_186 : 224|7@1+ (0.00087267,0) [0|0.11082909] "rad"  ADAS
 SG_ DET_ELEVATION_186 : 192|8@1+ (0.00275,-0.34925) [-0.34925|0.34925] "rad"  ADAS
 SG_ DET_ELEVATION_ERR_186 : 200|6@1+ (0.00174533,0) [0|0.10995579] "rad"  ADAS
 SG_ DET_RCS_186 : 256|8@1+ (0.5,-64) [-64|63.5] "dBsm"  ADAS
 SG_ DET_VALID_FLAG_186 : 167|1@1+ (1,0) [0|1] ""  ADAS
 SG_ DET_BI_STATIC_FLAG_186 : 505|1@1+ (1,0) [0|1] ""  ADAS
 SG_ DET_SUPER_RES_TARGET_186 : 247|1@1+ (1,0) [0|1] ""  ADAS
 SG_ DET_SNR_186 : 248|8@1+ (0.35156,0) [0|89.6478] "dB"  ADAS
 SG_ DET_POINT_TARGET_PROB_186 : 240|4@1+ (6.67,0) [0|100] "%"  ADAS
 SG_ DET_EXISTENCE_PROB_186 : 232|6@1+ (1.588,0) [0|100] "%"  ADAS
 SG_ DET_OUTSIDE_SECTOR_186 : 183|1@1+ (1,0) [0|1] ""  ADAS
 SG_ DET_HVC_FLAG_186 : 246|1@1+ (1,0) [0|1] ""  ADAS
 SG_ DET_CONFD_AZIMUTH_186 : 206|2@1+ (1,0) [0|3] ""  ADAS
 SG_ DET_CONFD_ELEVATION_186 : 244|2@1+ (1,0) [0|3] ""  ADAS
 SG_ DET_RANGE_187 : 264|15@1+ (0.015625,0) [0|500] "m"  ADAS
 SG_ DET_RANGE_ERR_187 : 280|7@1+ (0.0075,0) [0|0.9525] "m"  ADAS
 SG_ DET_RANGE_VELOCITY_187 : 288|15@1+ (0.0078125,-128) [-128|127.9921875] "m/s"  ADAS
 SG_ DET_RANGE_VELOCITY_ERR_187 : 304|8@1+ (0.003,0) [0|0.765] "m/s"  ADAS
 SG_ DET_AZIMUTH_187 : 328|13@1+ (0.0004,-1.5708) [-1.5708|1.5708] "rad"  ADAS
 SG_ DET_AZIMUTH_ERR_187 : 345|7@1+ (0.00087267,0) [0|0.11082909] "rad"  ADAS
 SG_ DET_ELEVATION_187 : 312|8@1+ (0.00275,-0.34925) [-0.34925|0.34925] "rad"  ADAS
 SG_ DET_ELEVATION_ERR_187 : 320|6@1+ (0.00174533,0) [0|0.10995579] "rad"  ADAS
 SG_ DET_RCS_187 : 376|8@1+ (0.5,-64) [-64|63.5] "dBsm"  ADAS
 SG_ DET_VALID_FLAG_187 : 399|1@1+ (1,0) [0|1] ""  ADAS
 SG_ DET_BI_STATIC_FLAG_187 : 482|1@1+ (1,0) [0|1] ""  ADAS
 SG_ DET_SUPER_RES_TARGET_187 : 344|1@1+ (1,0) [0|1] ""  ADAS
 SG_ DET_SNR_187 : 368|8@1+ (0.35156,0) [0|89.6478] "dB"  ADAS
 SG_ DET_POINT_TARGET_PROB_187 : 360|4@1+ (6.67,0) [0|100] "%"  ADAS
 SG_ DET_EXISTENCE_PROB_187 : 352|6@1+ (1.588,0) [0|100] "%"  ADAS
 SG_ DET_OUTSIDE_SECTOR_187 : 407|1@1+ (1,0) [0|1] ""  ADAS
 SG_ DET_HVC_FLAG_187 : 364|1@1+ (1,0) [0|1] ""  ADAS
 SG_ DET_CONFD_AZIMUTH_187 : 365|2@1+ (1,0) [0|3] ""  ADAS
 SG_ DET_CONFD_ELEVATION_187 : 358|2@1+ (1,0) [0|3] ""  ADAS
 SG_ DET_RANGE_188 : 384|15@1+ (0.015625,0) [0|500] "m"  ADAS
 SG_ DET_RANGE_ERR_188 : 400|7@1+ (0.0075,0) [0|0.9525] "m"  ADAS
 SG_ DET_RANGE_VELOCITY_188 : 408|15@1+ (0.0078125,-128) [-128|127.9921875] "m/s"  ADAS
 SG_ DET_RANGE_VELOCITY_ERR_188 : 424|8@1+ (0.003,0) [0|0.765] "m/s"  ADAS
 SG_ DET_AZIMUTH_188 : 448|13@1+ (0.0004,-1.5708) [-1.5708|1.5708] "rad"  ADAS
 SG_ DET_AZIMUTH_ERR_188 : 465|7@1+ (0.00087267,0) [0|0.11082909] "rad"  ADAS
 SG_ DET_ELEVATION_188 : 432|8@1+ (0.00275,-0.34925) [-0.34925|0.34925] "rad"  ADAS
 SG_ DET_ELEVATION_ERR_188 : 440|6@1+ (0.00174533,0) [0|0.10995579] "rad"  ADAS
 SG_ DET_RCS_188 : 496|8@1+ (0.5,-64) [-64|63.5] "dBsm"  ADAS
 SG_ DET_VALID_FLAG_188 : 485|1@1+ (1,0) [0|1] ""  ADAS
 SG_ DET_BI_STATIC_FLAG_188 : 483|1@1+ (1,0) [0|1] ""  ADAS
 SG_ DET_SUPER_RES_TARGET_188 : 446|1@1+ (1,0) [0|1] ""  ADAS
 SG_ DET_SNR_188 : 488|8@1+ (0.35156,0) [0|89.6478] "dB"  ADAS
 SG_ DET_POINT_TARGET_PROB_188 : 472|4@1+ (6.67,0) [0|100] "%"  ADAS
 SG_ DET_EXISTENCE_PROB_188 : 506|6@1+ (1.588,0) [0|100] "%"  ADAS
 SG_ DET_OUTSIDE_SECTOR_188 : 481|1@1+ (1,0) [0|1] ""  ADAS
 SG_ DET_HVC_FLAG_188 : 464|1@1+ (1,0) [0|1] ""  ADAS
 SG_ DET_CONFD_AZIMUTH_188 : 486|2@1+ (1,0) [0|3] ""  ADAS
 SG_ DET_CONFD_ELEVATION_188 : 461|2@1+ (1,0) [0|3] ""  ADAS
 SG_ DET_MH_SCAN_INDEX_4LSB_185_188 : 476|4@1+ (1,0) [0|15] ""  ADAS
 SG_ DET_MH_CYCLE_COUNTER_185_188 : 16|8@1+ (1,0) [0|255] ""  ADAS
 SG_ DET_MH_CRC16_185_188 : 0|16@1+ (1,0) [0|65535] ""  ADAS

CM_ SG_ 1181 DET_RANGE_117 " measured position  of the detection";
CM_ SG_ 1181 DET_RANGE_ERR_117 "RMSE or standard deviation of the measured angle  of the detection";
CM_ SG_ 1181 DET_RANGE_VELOCITY_117 "Radial velocity of the detection positive in direction to the sensor";
CM_ SG_ 1181 DET_RANGE_VELOCITY_ERR_117 "RMSE or standard deviation of the measure radial velocity of the detection";
CM_ SG_ 1181 DET_AZIMUTH_117 "Measured angle  of the detection";
CM_ SG_ 1181 DET_AZIMUTH_ERR_117 "RMSE or standard deviation of the measured angle  of the detection";
CM_ SG_ 1181 DET_ELEVATION_117 "measured elevation of the detection";
CM_ SG_ 1181 DET_ELEVATION_ERR_117 "RMSE or standard deviation of the measured elevation  of the detection";
CM_ SG_ 1181 DET_RCS_117 "Radar Cross Section or Amplitude, is a measure of how detectable an object is by radar. A larger RCS indicates that an object is more easily detected.";
CM_ SG_ 1181 DET_VALID_FLAG_117 "is set if the measured detection is valid";
CM_ SG_ 1181 DET_BI_STATIC_FLAG_117 "1 if detection is bi-static 0 otherwise";
CM_ SG_ 1181 DET_SUPER_RES_TARGET_117 "flasg is set if the detection is super resolution target";
CM_ SG_ 1181 DET_SNR_117 "The signal to noise ratio (SNR) of the radar detection";
CM_ SG_ 1181 DET_POINT_TARGET_PROB_117 "Describes the possibility if more than one real-world object has led to this detection. 0[%] := 100[%] Multi target probability";
CM_ SG_ 1181 DET_EXISTENCE_PROB_117 "Existence probability of the detection not based on history. Value does  not depend on any past experience with similar detections.
\note Use as confidence measure where a low value means less confidence
and a high value indicates strong confidence.";
CM_ SG_ 1181 DET_OUTSIDE_SECTOR_117 "Flag to indicate detections outside the sector, set if the wrong sector calibration matrix was used";
CM_ SG_ 1181 DET_HVC_FLAG_117 "Core2 Vehicle clutter flag";
CM_ SG_ 1181 DET_CONFD_AZIMUTH_117 "Define the Confidence of Azimuth for Detection ";
CM_ SG_ 1181 DET_CONFD_ELEVATION_117 "Define the Confidence of Elevation for the Detection ";
CM_ SG_ 1181 DET_BI_STATIC_FLAG_118 "1 if detection is bi-static 0 otherwise";
CM_ SG_ 1181 DET_BI_STATIC_FLAG_119 "1 if detection is bi-static 0 otherwise";
CM_ SG_ 1181 DET_BI_STATIC_FLAG_120 "1 if detection is bi-static 0 otherwise";
CM_ SG_ 1181 DET_MH_SCAN_INDEX_4LSB_117_120 "Scan index of the measured detection";
CM_ SG_ 1181 DET_MH_CYCLE_COUNTER_117_120 "Detection Alive Counter";
CM_ SG_ 1182 DET_RANGE_121 " measured position  of the detection";
CM_ SG_ 1182 DET_RANGE_ERR_121 "RMSE or standard deviation of the measured angle  of the detection";
CM_ SG_ 1182 DET_RANGE_VELOCITY_121 "Radial velocity of the detection positive in direction to the sensor";
CM_ SG_ 1182 DET_RANGE_VELOCITY_ERR_121 "RMSE or standard deviation of the measure radial velocity of the detection";
CM_ SG_ 1182 DET_AZIMUTH_121 "Measured angle  of the detection";
CM_ SG_ 1182 DET_AZIMUTH_ERR_121 "RMSE or standard deviation of the measured angle  of the detection";
CM_ SG_ 1182 DET_ELEVATION_121 "measured elevation of the detection";
CM_ SG_ 1182 DET_ELEVATION_ERR_121 "RMSE or standard deviation of the measured elevation  of the detection";
CM_ SG_ 1182 DET_RCS_121 "Radar Cross Section or Amplitude, is a measure of how detectable an object is by radar. A larger RCS indicates that an object is more easily detected.";
CM_ SG_ 1182 DET_VALID_FLAG_121 "is set if the measured detection is valid";
CM_ SG_ 1182 DET_BI_STATIC_FLAG_121 "1 if detection is bi-static 0 otherwise";
CM_ SG_ 1182 DET_SUPER_RES_TARGET_121 "flasg is set if the detection is super resolution target";
CM_ SG_ 1182 DET_SNR_121 "The signal to noise ratio (SNR) of the radar detection";
CM_ SG_ 1182 DET_POINT_TARGET_PROB_121 "Describes the possibility if more than one real-world object has led to this detection. 0[%] := 100[%] Multi target probability";
CM_ SG_ 1182 DET_EXISTENCE_PROB_121 "Existence probability of the detection not based on history. Value does  not depend on any past experience with similar detections.
\note Use as confidence measure where a low value means less confidence
and a high value indicates strong confidence.";
CM_ SG_ 1182 DET_OUTSIDE_SECTOR_121 "Flag to indicate detections outside the sector, set if the wrong sector calibration matrix was used";
CM_ SG_ 1182 DET_HVC_FLAG_121 "Core2 Vehicle clutter flag";
CM_ SG_ 1182 DET_CONFD_AZIMUTH_121 "Define the Confidence of Azimuth for Detection ";
CM_ SG_ 1182 DET_CONFD_ELEVATION_121 "Define the Confidence of Elevation for the Detection ";
CM_ SG_ 1182 DET_BI_STATIC_FLAG_122 "1 if detection is bi-static 0 otherwise";
CM_ SG_ 1182 DET_BI_STATIC_FLAG_123 "1 if detection is bi-static 0 otherwise";
CM_ SG_ 1182 DET_BI_STATIC_FLAG_124 "1 if detection is bi-static 0 otherwise";
CM_ SG_ 1182 DET_MH_SCAN_INDEX_4LSB_121_124 "Scan index of the measured detection";
CM_ SG_ 1182 DET_MH_CYCLE_COUNTER_121_124 "Detection Alive Counter";
CM_ SG_ 1183 DET_RANGE_125 " measured position  of the detection";
CM_ SG_ 1183 DET_RANGE_ERR_125 "RMSE or standard deviation of the measured angle  of the detection";
CM_ SG_ 1183 DET_RANGE_VELOCITY_125 "Radial velocity of the detection positive in direction to the sensor";
CM_ SG_ 1183 DET_RANGE_VELOCITY_ERR_125 "RMSE or standard deviation of the measure radial velocity of the detection";
CM_ SG_ 1183 DET_AZIMUTH_125 "Measured angle  of the detection";
CM_ SG_ 1183 DET_AZIMUTH_ERR_125 "RMSE or standard deviation of the measured angle  of the detection";
CM_ SG_ 1183 DET_ELEVATION_125 "measured elevation of the detection";
CM_ SG_ 1183 DET_ELEVATION_ERR_125 "RMSE or standard deviation of the measured elevation  of the detection";
CM_ SG_ 1183 DET_RCS_125 "Radar Cross Section or Amplitude, is a measure of how detectable an object is by radar. A larger RCS indicates that an object is more easily detected.";
CM_ SG_ 1183 DET_VALID_FLAG_125 "is set if the measured detection is valid";
CM_ SG_ 1183 DET_BI_STATIC_FLAG_125 "1 if detection is bi-static 0 otherwise";
CM_ SG_ 1183 DET_SUPER_RES_TARGET_125 "flasg is set if the detection is super resolution target";
CM_ SG_ 1183 DET_SNR_125 "The signal to noise ratio (SNR) of the radar detection";
CM_ SG_ 1183 DET_POINT_TARGET_PROB_125 "Describes the possibility if more than one real-world object has led to this detection. 0[%] := 100[%] Multi target probability";
CM_ SG_ 1183 DET_EXISTENCE_PROB_125 "Existence probability of the detection not based on history. Value does  not depend on any past experience with similar detections.
\note Use as confidence measure where a low value means less confidence
and a high value indicates strong confidence.";
CM_ SG_ 1183 DET_OUTSIDE_SECTOR_125 "Flag to indicate detections outside the sector, set if the wrong sector calibration matrix was used";
CM_ SG_ 1183 DET_HVC_FLAG_125 "Core2 Vehicle clutter flag";
CM_ SG_ 1183 DET_CONFD_AZIMUTH_125 "Define the Confidence of Azimuth for Detection ";
CM_ SG_ 1183 DET_CONFD_ELEVATION_125 "Define the Confidence of Elevation for the Detection ";
CM_ SG_ 1183 DET_BI_STATIC_FLAG_126 "1 if detection is bi-static 0 otherwise";
CM_ SG_ 1183 DET_BI_STATIC_FLAG_127 "1 if detection is bi-static 0 otherwise";
CM_ SG_ 1183 DET_BI_STATIC_FLAG_128 "1 if detection is bi-static 0 otherwise";
CM_ SG_ 1183 DET_MH_SCAN_INDEX_4LSB_125_128 "Scan index of the measured detection";
CM_ SG_ 1183 DET_MH_CYCLE_COUNTER_125_128 "Detection Alive Counter";
CM_ SG_ 1184 DET_RANGE_129 " measured position  of the detection";
CM_ SG_ 1184 DET_RANGE_ERR_129 "RMSE or standard deviation of the measured angle  of the detection";
CM_ SG_ 1184 DET_RANGE_VELOCITY_129 "Radial velocity of the detection positive in direction to the sensor";
CM_ SG_ 1184 DET_RANGE_VELOCITY_ERR_129 "RMSE or standard deviation of the measure radial velocity of the detection";
CM_ SG_ 1184 DET_AZIMUTH_129 "Measured angle  of the detection";
CM_ SG_ 1184 DET_AZIMUTH_ERR_129 "RMSE or standard deviation of the measured angle  of the detection";
CM_ SG_ 1184 DET_ELEVATION_129 "measured elevation of the detection";
CM_ SG_ 1184 DET_ELEVATION_ERR_129 "RMSE or standard deviation of the measured elevation  of the detection";
CM_ SG_ 1184 DET_RCS_129 "Radar Cross Section or Amplitude, is a measure of how detectable an object is by radar. A larger RCS indicates that an object is more easily detected.";
CM_ SG_ 1184 DET_VALID_FLAG_129 "is set if the measured detection is valid";
CM_ SG_ 1184 DET_BI_STATIC_FLAG_129 "1 if detection is bi-static 0 otherwise";
CM_ SG_ 1184 DET_SUPER_RES_TARGET_129 "flasg is set if the detection is super resolution target";
CM_ SG_ 1184 DET_SNR_129 "The signal to noise ratio (SNR) of the radar detection";
CM_ SG_ 1184 DET_POINT_TARGET_PROB_129 "Describes the possibility if more than one real-world object has led to this detection. 0[%] := 100[%] Multi target probability";
CM_ SG_ 1184 DET_EXISTENCE_PROB_129 "Existence probability of the detection not based on history. Value does  not depend on any past experience with similar detections.
\note Use as confidence measure where a low value means less confidence
and a high value indicates strong confidence.";
CM_ SG_ 1184 DET_OUTSIDE_SECTOR_129 "Flag to indicate detections outside the sector, set if the wrong sector calibration matrix was used";
CM_ SG_ 1184 DET_HVC_FLAG_129 "Core2 Vehicle clutter flag";
CM_ SG_ 1184 DET_CONFD_AZIMUTH_129 "Define the Confidence of Azimuth for Detection ";
CM_ SG_ 1184 DET_CONFD_ELEVATION_129 "Define the Confidence of Elevation for the Detection ";
CM_ SG_ 1184 DET_BI_STATIC_FLAG_130 "1 if detection is bi-static 0 otherwise";
CM_ SG_ 1184 DET_BI_STATIC_FLAG_131 "1 if detection is bi-static 0 otherwise";
CM_ SG_ 1184 DET_BI_STATIC_FLAG_132 "1 if detection is bi-static 0 otherwise";
CM_ SG_ 1184 DET_MH_SCAN_INDEX_4LSB_129_132 "Scan index of the measured detection";
CM_ SG_ 1184 DET_MH_CYCLE_COUNTER_129_132 "Detection Alive Counter";
CM_ SG_ 1185 DET_RANGE_133 " measured position  of the detection";
CM_ SG_ 1185 DET_RANGE_ERR_133 "RMSE or standard deviation of the measured angle  of the detection";
CM_ SG_ 1185 DET_RANGE_VELOCITY_133 "Radial velocity of the detection positive in direction to the sensor";
CM_ SG_ 1185 DET_RANGE_VELOCITY_ERR_133 "RMSE or standard deviation of the measure radial velocity of the detection";
CM_ SG_ 1185 DET_AZIMUTH_133 "Measured angle  of the detection";
CM_ SG_ 1185 DET_AZIMUTH_ERR_133 "RMSE or standard deviation of the measured angle  of the detection";
CM_ SG_ 1185 DET_ELEVATION_133 "measured elevation of the detection";
CM_ SG_ 1185 DET_ELEVATION_ERR_133 "RMSE or standard deviation of the measured elevation  of the detection";
CM_ SG_ 1185 DET_RCS_133 "Radar Cross Section or Amplitude, is a measure of how detectable an object is by radar. A larger RCS indicates that an object is more easily detected.";
CM_ SG_ 1185 DET_VALID_FLAG_133 "is set if the measured detection is valid";
CM_ SG_ 1185 DET_BI_STATIC_FLAG_133 "1 if detection is bi-static 0 otherwise";
CM_ SG_ 1185 DET_SUPER_RES_TARGET_133 "flasg is set if the detection is super resolution target";
CM_ SG_ 1185 DET_SNR_133 "The signal to noise ratio (SNR) of the radar detection";
CM_ SG_ 1185 DET_POINT_TARGET_PROB_133 "Describes the possibility if more than one real-world object has led to this detection. 0[%] := 100[%] Multi target probability";
CM_ SG_ 1185 DET_EXISTENCE_PROB_133 "Existence probability of the detection not based on history. Value does  not depend on any past experience with similar detections.
\note Use as confidence measure where a low value means less confidence
and a high value indicates strong confidence.";
CM_ SG_ 1185 DET_OUTSIDE_SECTOR_133 "Flag to indicate detections outside the sector, set if the wrong sector calibration matrix was used";
CM_ SG_ 1185 DET_HVC_FLAG_133 "Core2 Vehicle clutter flag";
CM_ SG_ 1185 DET_CONFD_AZIMUTH_133 "Define the Confidence of Azimuth for Detection ";
CM_ SG_ 1185 DET_CONFD_ELEVATION_133 "Define the Confidence of Elevation for the Detection ";
CM_ SG_ 1185 DET_BI_STATIC_FLAG_134 "1 if detection is bi-static 0 otherwise";
CM_ SG_ 1185 DET_BI_STATIC_FLAG_135 "1 if detection is bi-static 0 otherwise";
CM_ SG_ 1185 DET_BI_STATIC_FLAG_136 "1 if detection is bi-static 0 otherwise";
CM_ SG_ 1185 DET_MH_SCAN_INDEX_4LSB_133_136 "Scan index of the measured detection";
CM_ SG_ 1185 DET_MH_CYCLE_COUNTER_133_136 "Detection Alive Counter";
CM_ SG_ 1186 DET_RANGE_137 " measured position  of the detection";
CM_ SG_ 1186 DET_RANGE_ERR_137 "RMSE or standard deviation of the measured angle  of the detection";
CM_ SG_ 1186 DET_RANGE_VELOCITY_137 "Radial velocity of the detection positive in direction to the sensor";
CM_ SG_ 1186 DET_RANGE_VELOCITY_ERR_137 "RMSE or standard deviation of the measure radial velocity of the detection";
CM_ SG_ 1186 DET_AZIMUTH_137 "Measured angle  of the detection";
CM_ SG_ 1186 DET_AZIMUTH_ERR_137 "RMSE or standard deviation of the measured angle  of the detection";
CM_ SG_ 1186 DET_ELEVATION_137 "measured elevation of the detection";
CM_ SG_ 1186 DET_ELEVATION_ERR_137 "RMSE or standard deviation of the measured elevation  of the detection";
CM_ SG_ 1186 DET_RCS_137 "Radar Cross Section or Amplitude, is a measure of how detectable an object is by radar. A larger RCS indicates that an object is more easily detected.";
CM_ SG_ 1186 DET_VALID_FLAG_137 "is set if the measured detection is valid";
CM_ SG_ 1186 DET_BI_STATIC_FLAG_137 "1 if detection is bi-static 0 otherwise";
CM_ SG_ 1186 DET_SUPER_RES_TARGET_137 "flasg is set if the detection is super resolution target";
CM_ SG_ 1186 DET_SNR_137 "The signal to noise ratio (SNR) of the radar detection";
CM_ SG_ 1186 DET_POINT_TARGET_PROB_137 "Describes the possibility if more than one real-world object has led to this detection. 0[%] := 100[%] Multi target probability";
CM_ SG_ 1186 DET_EXISTENCE_PROB_137 "Existence probability of the detection not based on history. Value does  not depend on any past experience with similar detections.
\note Use as confidence measure where a low value means less confidence
and a high value indicates strong confidence.";
CM_ SG_ 1186 DET_OUTSIDE_SECTOR_137 "Flag to indicate detections outside the sector, set if the wrong sector calibration matrix was used";
CM_ SG_ 1186 DET_HVC_FLAG_137 "Core2 Vehicle clutter flag";
CM_ SG_ 1186 DET_CONFD_AZIMUTH_137 "Define the Confidence of Azimuth for Detection ";
CM_ SG_ 1186 DET_CONFD_ELEVATION_137 "Define the Confidence of Elevation for the Detection ";
CM_ SG_ 1186 DET_BI_STATIC_FLAG_138 "1 if detection is bi-static 0 otherwise";
CM_ SG_ 1186 DET_BI_STATIC_FLAG_139 "1 if detection is bi-static 0 otherwise";
CM_ SG_ 1186 DET_BI_STATIC_FLAG_140 "1 if detection is bi-static 0 otherwise";
CM_ SG_ 1186 DET_MH_SCAN_INDEX_4LSB_137_140 "Scan index of the measured detection";
CM_ SG_ 1186 DET_MH_CYCLE_COUNTER_137_140 "Detection Alive Counter";
CM_ SG_ 1187 DET_RANGE_141 " measured position  of the detection";
CM_ SG_ 1187 DET_RANGE_ERR_141 "RMSE or standard deviation of the measured angle  of the detection";
CM_ SG_ 1187 DET_RANGE_VELOCITY_141 "Radial velocity of the detection positive in direction to the sensor";
CM_ SG_ 1187 DET_RANGE_VELOCITY_ERR_141 "RMSE or standard deviation of the measure radial velocity of the detection";
CM_ SG_ 1187 DET_AZIMUTH_141 "Measured angle  of the detection";
CM_ SG_ 1187 DET_AZIMUTH_ERR_141 "RMSE or standard deviation of the measured angle  of the detection";
CM_ SG_ 1187 DET_ELEVATION_141 "measured elevation of the detection";
CM_ SG_ 1187 DET_ELEVATION_ERR_141 "RMSE or standard deviation of the measured elevation  of the detection";
CM_ SG_ 1187 DET_RCS_141 "Radar Cross Section or Amplitude, is a measure of how detectable an object is by radar. A larger RCS indicates that an object is more easily detected.";
CM_ SG_ 1187 DET_VALID_FLAG_141 "is set if the measured detection is valid";
CM_ SG_ 1187 DET_BI_STATIC_FLAG_141 "1 if detection is bi-static 0 otherwise";
CM_ SG_ 1187 DET_SUPER_RES_TARGET_141 "flasg is set if the detection is super resolution target";
CM_ SG_ 1187 DET_SNR_141 "The signal to noise ratio (SNR) of the radar detection";
CM_ SG_ 1187 DET_POINT_TARGET_PROB_141 "Describes the possibility if more than one real-world object has led to this detection. 0[%] := 100[%] Multi target probability";
CM_ SG_ 1187 DET_EXISTENCE_PROB_141 "Existence probability of the detection not based on history. Value does  not depend on any past experience with similar detections.
\note Use as confidence measure where a low value means less confidence
and a high value indicates strong confidence.";
CM_ SG_ 1187 DET_OUTSIDE_SECTOR_141 "Flag to indicate detections outside the sector, set if the wrong sector calibration matrix was used";
CM_ SG_ 1187 DET_HVC_FLAG_141 "Core2 Vehicle clutter flag";
CM_ SG_ 1187 DET_CONFD_AZIMUTH_141 "Define the Confidence of Azimuth for Detection ";
CM_ SG_ 1187 DET_CONFD_ELEVATION_141 "Define the Confidence of Elevation for the Detection ";
CM_ SG_ 1187 DET_BI_STATIC_FLAG_142 "1 if detection is bi-static 0 otherwise";
CM_ SG_ 1187 DET_BI_STATIC_FLAG_143 "1 if detection is bi-static 0 otherwise";
CM_ SG_ 1187 DET_BI_STATIC_FLAG_144 "1 if detection is bi-static 0 otherwise";
CM_ SG_ 1187 DET_MH_SCAN_INDEX_4LSB_141_144 "Scan index of the measured detection";
CM_ SG_ 1187 DET_MH_CYCLE_COUNTER_141_144 "Detection Alive Counter";
CM_ SG_ 1188 DET_RANGE_145 " measured position  of the detection";
CM_ SG_ 1188 DET_RANGE_ERR_145 "RMSE or standard deviation of the measured angle  of the detection";
CM_ SG_ 1188 DET_RANGE_VELOCITY_145 "Radial velocity of the detection positive in direction to the sensor";
CM_ SG_ 1188 DET_RANGE_VELOCITY_ERR_145 "RMSE or standard deviation of the measure radial velocity of the detection";
CM_ SG_ 1188 DET_AZIMUTH_145 "Measured angle  of the detection";
CM_ SG_ 1188 DET_AZIMUTH_ERR_145 "RMSE or standard deviation of the measured angle  of the detection";
CM_ SG_ 1188 DET_ELEVATION_145 "measured elevation of the detection";
CM_ SG_ 1188 DET_ELEVATION_ERR_145 "RMSE or standard deviation of the measured elevation  of the detection";
CM_ SG_ 1188 DET_RCS_145 "Radar Cross Section or Amplitude, is a measure of how detectable an object is by radar. A larger RCS indicates that an object is more easily detected.";
CM_ SG_ 1188 DET_VALID_FLAG_145 "is set if the measured detection is valid";
CM_ SG_ 1188 DET_BI_STATIC_FLAG_145 "1 if detection is bi-static 0 otherwise";
CM_ SG_ 1188 DET_SUPER_RES_TARGET_145 "flasg is set if the detection is super resolution target";
CM_ SG_ 1188 DET_SNR_145 "The signal to noise ratio (SNR) of the radar detection";
CM_ SG_ 1188 DET_POINT_TARGET_PROB_145 "Describes the possibility if more than one real-world object has led to this detection. 0[%] := 100[%] Multi target probability";
CM_ SG_ 1188 DET_EXISTENCE_PROB_145 "Existence probability of the detection not based on history. Value does  not depend on any past experience with similar detections.
\note Use as confidence measure where a low value means less confidence
and a high value indicates strong confidence.";
CM_ SG_ 1188 DET_OUTSIDE_SECTOR_145 "Flag to indicate detections outside the sector, set if the wrong sector calibration matrix was used";
CM_ SG_ 1188 DET_HVC_FLAG_145 "Core2 Vehicle clutter flag";
CM_ SG_ 1188 DET_CONFD_AZIMUTH_145 "Define the Confidence of Azimuth for Detection ";
CM_ SG_ 1188 DET_CONFD_ELEVATION_145 "Define the Confidence of Elevation for the Detection ";
CM_ SG_ 1188 DET_BI_STATIC_FLAG_146 "1 if detection is bi-static 0 otherwise";
CM_ SG_ 1188 DET_BI_STATIC_FLAG_147 "1 if detection is bi-static 0 otherwise";
CM_ SG_ 1188 DET_BI_STATIC_FLAG_148 "1 if detection is bi-static 0 otherwise";
CM_ SG_ 1188 DET_MH_SCAN_INDEX_4LSB_145_148 "Scan index of the measured detection";
CM_ SG_ 1188 DET_MH_CYCLE_COUNTER_145_148 "Detection Alive Counter";
CM_ SG_ 1189 DET_RANGE_149 " measured position  of the detection";
CM_ SG_ 1189 DET_RANGE_ERR_149 "RMSE or standard deviation of the measured angle  of the detection";
CM_ SG_ 1189 DET_RANGE_VELOCITY_149 "Radial velocity of the detection positive in direction to the sensor";
CM_ SG_ 1189 DET_RANGE_VELOCITY_ERR_149 "RMSE or standard deviation of the measure radial velocity of the detection";
CM_ SG_ 1189 DET_AZIMUTH_149 "Measured angle  of the detection";
CM_ SG_ 1189 DET_AZIMUTH_ERR_149 "RMSE or standard deviation of the measured angle  of the detection";
CM_ SG_ 1189 DET_ELEVATION_149 "measured elevation of the detection";
CM_ SG_ 1189 DET_ELEVATION_ERR_149 "RMSE or standard deviation of the measured elevation  of the detection";
CM_ SG_ 1189 DET_RCS_149 "Radar Cross Section or Amplitude, is a measure of how detectable an object is by radar. A larger RCS indicates that an object is more easily detected.";
CM_ SG_ 1189 DET_VALID_FLAG_149 "is set if the measured detection is valid";
CM_ SG_ 1189 DET_BI_STATIC_FLAG_149 "1 if detection is bi-static 0 otherwise";
CM_ SG_ 1189 DET_SUPER_RES_TARGET_149 "flasg is set if the detection is super resolution target";
CM_ SG_ 1189 DET_SNR_149 "The signal to noise ratio (SNR) of the radar detection";
CM_ SG_ 1189 DET_POINT_TARGET_PROB_149 "Describes the possibility if more than one real-world object has led to this detection. 0[%] := 100[%] Multi target probability";
CM_ SG_ 1189 DET_EXISTENCE_PROB_149 "Existence probability of the detection not based on history. Value does  not depend on any past experience with similar detections.
\note Use as confidence measure where a low value means less confidence
and a high value indicates strong confidence.";
CM_ SG_ 1189 DET_OUTSIDE_SECTOR_149 "Flag to indicate detections outside the sector, set if the wrong sector calibration matrix was used";
CM_ SG_ 1189 DET_HVC_FLAG_149 "Core2 Vehicle clutter flag";
CM_ SG_ 1189 DET_CONFD_AZIMUTH_149 "Define the Confidence of Azimuth for Detection ";
CM_ SG_ 1189 DET_CONFD_ELEVATION_149 "Define the Confidence of Elevation for the Detection ";
CM_ SG_ 1189 DET_BI_STATIC_FLAG_150 "1 if detection is bi-static 0 otherwise";
CM_ SG_ 1189 DET_BI_STATIC_FLAG_151 "1 if detection is bi-static 0 otherwise";
CM_ SG_ 1189 DET_BI_STATIC_FLAG_152 "1 if detection is bi-static 0 otherwise";
CM_ SG_ 1189 DET_MH_SCAN_INDEX_4LSB_149_152 "Scan index of the measured detection";
CM_ SG_ 1189 DET_MH_CYCLE_COUNTER_149_152 "Detection Alive Counter";
CM_ SG_ 1190 DET_RANGE_153 " measured position  of the detection";
CM_ SG_ 1190 DET_RANGE_ERR_153 "RMSE or standard deviation of the measured angle  of the detection";
CM_ SG_ 1190 DET_RANGE_VELOCITY_153 "Radial velocity of the detection positive in direction to the sensor";
CM_ SG_ 1190 DET_RANGE_VELOCITY_ERR_153 "RMSE or standard deviation of the measure radial velocity of the detection";
CM_ SG_ 1190 DET_AZIMUTH_153 "Measured angle  of the detection";
CM_ SG_ 1190 DET_AZIMUTH_ERR_153 "RMSE or standard deviation of the measured angle  of the detection";
CM_ SG_ 1190 DET_ELEVATION_153 "measured elevation of the detection";
CM_ SG_ 1190 DET_ELEVATION_ERR_153 "RMSE or standard deviation of the measured elevation  of the detection";
CM_ SG_ 1190 DET_RCS_153 "Radar Cross Section or Amplitude, is a measure of how detectable an object is by radar. A larger RCS indicates that an object is more easily detected.";
CM_ SG_ 1190 DET_VALID_FLAG_153 "is set if the measured detection is valid";
CM_ SG_ 1190 DET_BI_STATIC_FLAG_153 "1 if detection is bi-static 0 otherwise";
CM_ SG_ 1190 DET_SUPER_RES_TARGET_153 "flasg is set if the detection is super resolution target";
CM_ SG_ 1190 DET_SNR_153 "The signal to noise ratio (SNR) of the radar detection";
CM_ SG_ 1190 DET_POINT_TARGET_PROB_153 "Describes the possibility if more than one real-world object has led to this detection. 0[%] := 100[%] Multi target probability";
CM_ SG_ 1190 DET_EXISTENCE_PROB_153 "Existence probability of the detection not based on history. Value does  not depend on any past experience with similar detections.
\note Use as confidence measure where a low value means less confidence
and a high value indicates strong confidence.";
CM_ SG_ 1190 DET_OUTSIDE_SECTOR_153 "Flag to indicate detections outside the sector, set if the wrong sector calibration matrix was used";
CM_ SG_ 1190 DET_HVC_FLAG_153 "Core2 Vehicle clutter flag";
CM_ SG_ 1190 DET_CONFD_AZIMUTH_153 "Define the Confidence of Azimuth for Detection ";
CM_ SG_ 1190 DET_CONFD_ELEVATION_153 "Define the Confidence of Elevation for the Detection ";
CM_ SG_ 1190 DET_BI_STATIC_FLAG_154 "1 if detection is bi-static 0 otherwise";
CM_ SG_ 1190 DET_BI_STATIC_FLAG_155 "1 if detection is bi-static 0 otherwise";
CM_ SG_ 1190 DET_BI_STATIC_FLAG_156 "1 if detection is bi-static 0 otherwise";
CM_ SG_ 1190 DET_MH_SCAN_INDEX_4LSB_153_156 "Scan index of the measured detection";
CM_ SG_ 1190 DET_MH_CYCLE_COUNTER_153_156 "Detection Alive Counter";
CM_ SG_ 1191 DET_RANGE_157 " measured position  of the detection";
CM_ SG_ 1191 DET_RANGE_ERR_157 "RMSE or standard deviation of the measured angle  of the detection";
CM_ SG_ 1191 DET_RANGE_VELOCITY_157 "Radial velocity of the detection positive in direction to the sensor";
CM_ SG_ 1191 DET_RANGE_VELOCITY_ERR_157 "RMSE or standard deviation of the measure radial velocity of the detection";
CM_ SG_ 1191 DET_AZIMUTH_157 "Measured angle  of the detection";
CM_ SG_ 1191 DET_AZIMUTH_ERR_157 "RMSE or standard deviation of the measured angle  of the detection";
CM_ SG_ 1191 DET_ELEVATION_157 "measured elevation of the detection";
CM_ SG_ 1191 DET_ELEVATION_ERR_157 "RMSE or standard deviation of the measured elevation  of the detection";
CM_ SG_ 1191 DET_RCS_157 "Radar Cross Section or Amplitude, is a measure of how detectable an object is by radar. A larger RCS indicates that an object is more easily detected.";
CM_ SG_ 1191 DET_VALID_FLAG_157 "is set if the measured detection is valid";
CM_ SG_ 1191 DET_BI_STATIC_FLAG_157 "1 if detection is bi-static 0 otherwise";
CM_ SG_ 1191 DET_SUPER_RES_TARGET_157 "flasg is set if the detection is super resolution target";
CM_ SG_ 1191 DET_SNR_157 "The signal to noise ratio (SNR) of the radar detection";
CM_ SG_ 1191 DET_POINT_TARGET_PROB_157 "Describes the possibility if more than one real-world object has led to this detection. 0[%] := 100[%] Multi target probability";
CM_ SG_ 1191 DET_EXISTENCE_PROB_157 "Existence probability of the detection not based on history. Value does  not depend on any past experience with similar detections.
\note Use as confidence measure where a low value means less confidence
and a high value indicates strong confidence.";
CM_ SG_ 1191 DET_OUTSIDE_SECTOR_157 "Flag to indicate detections outside the sector, set if the wrong sector calibration matrix was used";
CM_ SG_ 1191 DET_HVC_FLAG_157 "Core2 Vehicle clutter flag";
CM_ SG_ 1191 DET_CONFD_AZIMUTH_157 "Define the Confidence of Azimuth for Detection ";
CM_ SG_ 1191 DET_CONFD_ELEVATION_157 "Define the Confidence of Elevation for the Detection ";
CM_ SG_ 1191 DET_BI_STATIC_FLAG_158 "1 if detection is bi-static 0 otherwise";
CM_ SG_ 1191 DET_BI_STATIC_FLAG_159 "1 if detection is bi-static 0 otherwise";
CM_ SG_ 1191 DET_BI_STATIC_FLAG_160 "1 if detection is bi-static 0 otherwise";
CM_ SG_ 1191 DET_MH_SCAN_INDEX_4LSB_157_160 "Scan index of the measured detection";
CM_ SG_ 1191 DET_MH_CYCLE_COUNTER_157_160 "Detection Alive Counter";
CM_ SG_ 1192 DET_RANGE_161 " measured position  of the detection";
CM_ SG_ 1192 DET_RANGE_ERR_161 "RMSE or standard deviation of the measured angle  of the detection";
CM_ SG_ 1192 DET_RANGE_VELOCITY_161 "Radial velocity of the detection positive in direction to the sensor";
CM_ SG_ 1192 DET_RANGE_VELOCITY_ERR_161 "RMSE or standard deviation of the measure radial velocity of the detection";
CM_ SG_ 1192 DET_AZIMUTH_161 "Measured angle  of the detection";
CM_ SG_ 1192 DET_AZIMUTH_ERR_161 "RMSE or standard deviation of the measured angle  of the detection";
CM_ SG_ 1192 DET_ELEVATION_161 "measured elevation of the detection";
CM_ SG_ 1192 DET_ELEVATION_ERR_161 "RMSE or standard deviation of the measured elevation  of the detection";
CM_ SG_ 1192 DET_RCS_161 "Radar Cross Section or Amplitude, is a measure of how detectable an object is by radar. A larger RCS indicates that an object is more easily detected.";
CM_ SG_ 1192 DET_VALID_FLAG_161 "is set if the measured detection is valid";
CM_ SG_ 1192 DET_BI_STATIC_FLAG_161 "1 if detection is bi-static 0 otherwise";
CM_ SG_ 1192 DET_SUPER_RES_TARGET_161 "flasg is set if the detection is super resolution target";
CM_ SG_ 1192 DET_SNR_161 "The signal to noise ratio (SNR) of the radar detection";
CM_ SG_ 1192 DET_POINT_TARGET_PROB_161 "Describes the possibility if more than one real-world object has led to this detection. 0[%] := 100[%] Multi target probability";
CM_ SG_ 1192 DET_EXISTENCE_PROB_161 "Existence probability of the detection not based on history. Value does  not depend on any past experience with similar detections.
\note Use as confidence measure where a low value means less confidence
and a high value indicates strong confidence.";
CM_ SG_ 1192 DET_OUTSIDE_SECTOR_161 "Flag to indicate detections outside the sector, set if the wrong sector calibration matrix was used";
CM_ SG_ 1192 DET_HVC_FLAG_161 "Core2 Vehicle clutter flag";
CM_ SG_ 1192 DET_CONFD_AZIMUTH_161 "Define the Confidence of Azimuth for Detection ";
CM_ SG_ 1192 DET_CONFD_ELEVATION_161 "Define the Confidence of Elevation for the Detection ";
CM_ SG_ 1192 DET_BI_STATIC_FLAG_162 "1 if detection is bi-static 0 otherwise";
CM_ SG_ 1192 DET_BI_STATIC_FLAG_163 "1 if detection is bi-static 0 otherwise";
CM_ SG_ 1192 DET_BI_STATIC_FLAG_164 "1 if detection is bi-static 0 otherwise";
CM_ SG_ 1192 DET_MH_SCAN_INDEX_4LSB_161_164 "Scan index of the measured detection";
CM_ SG_ 1192 DET_MH_CYCLE_COUNTER_161_164 "Detection Alive Counter";
CM_ SG_ 1193 DET_RANGE_165 " measured position  of the detection";
CM_ SG_ 1193 DET_RANGE_ERR_165 "RMSE or standard deviation of the measured angle  of the detection";
CM_ SG_ 1193 DET_RANGE_VELOCITY_165 "Radial velocity of the detection positive in direction to the sensor";
CM_ SG_ 1193 DET_RANGE_VELOCITY_ERR_165 "RMSE or standard deviation of the measure radial velocity of the detection";
CM_ SG_ 1193 DET_AZIMUTH_165 "Measured angle  of the detection";
CM_ SG_ 1193 DET_AZIMUTH_ERR_165 "RMSE or standard deviation of the measured angle  of the detection";
CM_ SG_ 1193 DET_ELEVATION_165 "measured elevation of the detection";
CM_ SG_ 1193 DET_ELEVATION_ERR_165 "RMSE or standard deviation of the measured elevation  of the detection";
CM_ SG_ 1193 DET_RCS_165 "Radar Cross Section or Amplitude, is a measure of how detectable an object is by radar. A larger RCS indicates that an object is more easily detected.";
CM_ SG_ 1193 DET_VALID_FLAG_165 "is set if the measured detection is valid";
CM_ SG_ 1193 DET_BI_STATIC_FLAG_165 "1 if detection is bi-static 0 otherwise";
CM_ SG_ 1193 DET_SUPER_RES_TARGET_165 "flasg is set if the detection is super resolution target";
CM_ SG_ 1193 DET_SNR_165 "The signal to noise ratio (SNR) of the radar detection";
CM_ SG_ 1193 DET_POINT_TARGET_PROB_165 "Describes the possibility if more than one real-world object has led to this detection. 0[%] := 100[%] Multi target probability";
CM_ SG_ 1193 DET_EXISTENCE_PROB_165 "Existence probability of the detection not based on history. Value does  not depend on any past experience with similar detections.
\note Use as confidence measure where a low value means less confidence
and a high value indicates strong confidence.";
CM_ SG_ 1193 DET_OUTSIDE_SECTOR_165 "Flag to indicate detections outside the sector, set if the wrong sector calibration matrix was used";
CM_ SG_ 1193 DET_HVC_FLAG_165 "Core2 Vehicle clutter flag";
CM_ SG_ 1193 DET_CONFD_AZIMUTH_165 "Define the Confidence of Azimuth for Detection ";
CM_ SG_ 1193 DET_CONFD_ELEVATION_165 "Define the Confidence of Elevation for the Detection ";
CM_ SG_ 1193 DET_BI_STATIC_FLAG_166 "1 if detection is bi-static 0 otherwise";
CM_ SG_ 1193 DET_BI_STATIC_FLAG_167 "1 if detection is bi-static 0 otherwise";
CM_ SG_ 1193 DET_BI_STATIC_FLAG_168 "1 if detection is bi-static 0 otherwise";
CM_ SG_ 1193 DET_MH_SCAN_INDEX_4LSB_165_168 "Scan index of the measured detection";
CM_ SG_ 1193 DET_MH_CYCLE_COUNTER_165_168 "Detection Alive Counter";
CM_ SG_ 1194 DET_RANGE_169 " measured position  of the detection";
CM_ SG_ 1194 DET_RANGE_ERR_169 "RMSE or standard deviation of the measured angle  of the detection";
CM_ SG_ 1194 DET_RANGE_VELOCITY_169 "Radial velocity of the detection positive in direction to the sensor";
CM_ SG_ 1194 DET_RANGE_VELOCITY_ERR_169 "RMSE or standard deviation of the measure radial velocity of the detection";
CM_ SG_ 1194 DET_AZIMUTH_169 "Measured angle  of the detection";
CM_ SG_ 1194 DET_AZIMUTH_ERR_169 "RMSE or standard deviation of the measured angle  of the detection";
CM_ SG_ 1194 DET_ELEVATION_169 "measured elevation of the detection";
CM_ SG_ 1194 DET_ELEVATION_ERR_169 "RMSE or standard deviation of the measured elevation  of the detection";
CM_ SG_ 1194 DET_RCS_169 "Radar Cross Section or Amplitude, is a measure of how detectable an object is by radar. A larger RCS indicates that an object is more easily detected.";
CM_ SG_ 1194 DET_VALID_FLAG_169 "is set if the measured detection is valid";
CM_ SG_ 1194 DET_BI_STATIC_FLAG_169 "1 if detection is bi-static 0 otherwise";
CM_ SG_ 1194 DET_SUPER_RES_TARGET_169 "flasg is set if the detection is super resolution target";
CM_ SG_ 1194 DET_SNR_169 "The signal to noise ratio (SNR) of the radar detection";
CM_ SG_ 1194 DET_POINT_TARGET_PROB_169 "Describes the possibility if more than one real-world object has led to this detection. 0[%] := 100[%] Multi target probability";
CM_ SG_ 1194 DET_EXISTENCE_PROB_169 "Existence probability of the detection not based on history. Value does  not depend on any past experience with similar detections.
\note Use as confidence measure where a low value means less confidence
and a high value indicates strong confidence.";
CM_ SG_ 1194 DET_OUTSIDE_SECTOR_169 "Flag to indicate detections outside the sector, set if the wrong sector calibration matrix was used";
CM_ SG_ 1194 DET_HVC_FLAG_169 "Core2 Vehicle clutter flag";
CM_ SG_ 1194 DET_CONFD_AZIMUTH_169 "Define the Confidence of Azimuth for Detection ";
CM_ SG_ 1194 DET_CONFD_ELEVATION_169 "Define the Confidence of Elevation for the Detection ";
CM_ SG_ 1194 DET_BI_STATIC_FLAG_170 "1 if detection is bi-static 0 otherwise";
CM_ SG_ 1194 DET_BI_STATIC_FLAG_171 "1 if detection is bi-static 0 otherwise";
CM_ SG_ 1194 DET_BI_STATIC_FLAG_172 "1 if detection is bi-static 0 otherwise";
CM_ SG_ 1194 DET_MH_SCAN_INDEX_4LSB_169_172 "Scan index of the measured detection";
CM_ SG_ 1194 DET_MH_CYCLE_COUNTER_169_172 "Detection Alive Counter";
CM_ SG_ 1195 DET_RANGE_173 " measured position  of the detection";
CM_ SG_ 1195 DET_RANGE_ERR_173 "RMSE or standard deviation of the measured angle  of the detection";
CM_ SG_ 1195 DET_RANGE_VELOCITY_173 "Radial velocity of the detection positive in direction to the sensor";
CM_ SG_ 1195 DET_RANGE_VELOCITY_ERR_173 "RMSE or standard deviation of the measure radial velocity of the detection";
CM_ SG_ 1195 DET_AZIMUTH_173 "Measured angle  of the detection";
CM_ SG_ 1195 DET_AZIMUTH_ERR_173 "RMSE or standard deviation of the measured angle  of the detection";
CM_ SG_ 1195 DET_ELEVATION_173 "measured elevation of the detection";
CM_ SG_ 1195 DET_ELEVATION_ERR_173 "RMSE or standard deviation of the measured elevation  of the detection";
CM_ SG_ 1195 DET_RCS_173 "Radar Cross Section or Amplitude, is a measure of how detectable an object is by radar. A larger RCS indicates that an object is more easily detected.";
CM_ SG_ 1195 DET_VALID_FLAG_173 "is set if the measured detection is valid";
CM_ SG_ 1195 DET_BI_STATIC_FLAG_173 "1 if detection is bi-static 0 otherwise";
CM_ SG_ 1195 DET_SUPER_RES_TARGET_173 "flasg is set if the detection is super resolution target";
CM_ SG_ 1195 DET_SNR_173 "The signal to noise ratio (SNR) of the radar detection";
CM_ SG_ 1195 DET_POINT_TARGET_PROB_173 "Describes the possibility if more than one real-world object has led to this detection. 0[%] := 100[%] Multi target probability";
CM_ SG_ 1195 DET_EXISTENCE_PROB_173 "Existence probability of the detection not based on history. Value does  not depend on any past experience with similar detections.
\note Use as confidence measure where a low value means less confidence
and a high value indicates strong confidence.";
CM_ SG_ 1195 DET_OUTSIDE_SECTOR_173 "Flag to indicate detections outside the sector, set if the wrong sector calibration matrix was used";
CM_ SG_ 1195 DET_HVC_FLAG_173 "Core2 Vehicle clutter flag";
CM_ SG_ 1195 DET_CONFD_AZIMUTH_173 "Define the Confidence of Azimuth for Detection ";
CM_ SG_ 1195 DET_CONFD_ELEVATION_173 "Define the Confidence of Elevation for the Detection ";
CM_ SG_ 1195 DET_BI_STATIC_FLAG_174 "1 if detection is bi-static 0 otherwise";
CM_ SG_ 1195 DET_BI_STATIC_FLAG_175 "1 if detection is bi-static 0 otherwise";
CM_ SG_ 1195 DET_BI_STATIC_FLAG_176 "1 if detection is bi-static 0 otherwise";
CM_ SG_ 1195 DET_MH_SCAN_INDEX_4LSB_173_176 "Scan index of the measured detection";
CM_ SG_ 1195 DET_MH_CYCLE_COUNTER_173_176 "Detection Alive Counter";
CM_ SG_ 1196 DET_RANGE_177 " measured position  of the detection";
CM_ SG_ 1196 DET_RANGE_ERR_177 "RMSE or standard deviation of the measured angle  of the detection";
CM_ SG_ 1196 DET_RANGE_VELOCITY_177 "Radial velocity of the detection positive in direction to the sensor";
CM_ SG_ 1196 DET_RANGE_VELOCITY_ERR_177 "RMSE or standard deviation of the measure radial velocity of the detection";
CM_ SG_ 1196 DET_AZIMUTH_177 "Measured angle  of the detection";
CM_ SG_ 1196 DET_AZIMUTH_ERR_177 "RMSE or standard deviation of the measured angle  of the detection";
CM_ SG_ 1196 DET_ELEVATION_177 "measured elevation of the detection";
CM_ SG_ 1196 DET_ELEVATION_ERR_177 "RMSE or standard deviation of the measured elevation  of the detection";
CM_ SG_ 1196 DET_RCS_177 "Radar Cross Section or Amplitude, is a measure of how detectable an object is by radar. A larger RCS indicates that an object is more easily detected.";
CM_ SG_ 1196 DET_VALID_FLAG_177 "is set if the measured detection is valid";
CM_ SG_ 1196 DET_BI_STATIC_FLAG_177 "1 if detection is bi-static 0 otherwise";
CM_ SG_ 1196 DET_SUPER_RES_TARGET_177 "flasg is set if the detection is super resolution target";
CM_ SG_ 1196 DET_SNR_177 "The signal to noise ratio (SNR) of the radar detection";
CM_ SG_ 1196 DET_POINT_TARGET_PROB_177 "Describes the possibility if more than one real-world object has led to this detection. 0[%] := 100[%] Multi target probability";
CM_ SG_ 1196 DET_EXISTENCE_PROB_177 "Existence probability of the detection not based on history. Value does  not depend on any past experience with similar detections.
\note Use as confidence measure where a low value means less confidence
and a high value indicates strong confidence.";
CM_ SG_ 1196 DET_OUTSIDE_SECTOR_177 "Flag to indicate detections outside the sector, set if the wrong sector calibration matrix was used";
CM_ SG_ 1196 DET_HVC_FLAG_177 "Core2 Vehicle clutter flag";
CM_ SG_ 1196 DET_CONFD_AZIMUTH_177 "Define the Confidence of Azimuth for Detection ";
CM_ SG_ 1196 DET_CONFD_ELEVATION_177 "Define the Confidence of Elevation for the Detection ";
CM_ SG_ 1196 DET_BI_STATIC_FLAG_178 "1 if detection is bi-static 0 otherwise";
CM_ SG_ 1196 DET_BI_STATIC_FLAG_179 "1 if detection is bi-static 0 otherwise";
CM_ SG_ 1196 DET_BI_STATIC_FLAG_180 "1 if detection is bi-static 0 otherwise";
CM_ SG_ 1196 DET_MH_SCAN_INDEX_4LSB_177_180 "Scan index of the measured detection";
CM_ SG_ 1196 DET_MH_CYCLE_COUNTER_177_180 "Detection Alive Counter";
CM_ SG_ 1197 DET_RANGE_181 " measured position  of the detection";
CM_ SG_ 1197 DET_RANGE_ERR_181 "RMSE or standard deviation of the measured angle  of the detection";
CM_ SG_ 1197 DET_RANGE_VELOCITY_181 "Radial velocity of the detection positive in direction to the sensor";
CM_ SG_ 1197 DET_RANGE_VELOCITY_ERR_181 "RMSE or standard deviation of the measure radial velocity of the detection";
CM_ SG_ 1197 DET_AZIMUTH_181 "Measured angle  of the detection";
CM_ SG_ 1197 DET_AZIMUTH_ERR_181 "RMSE or standard deviation of the measured angle  of the detection";
CM_ SG_ 1197 DET_ELEVATION_181 "measured elevation of the detection";
CM_ SG_ 1197 DET_ELEVATION_ERR_181 "RMSE or standard deviation of the measured elevation  of the detection";
CM_ SG_ 1197 DET_RCS_181 "Radar Cross Section or Amplitude, is a measure of how detectable an object is by radar. A larger RCS indicates that an object is more easily detected.";
CM_ SG_ 1197 DET_VALID_FLAG_181 "is set if the measured detection is valid";
CM_ SG_ 1197 DET_BI_STATIC_FLAG_181 "1 if detection is bi-static 0 otherwise";
CM_ SG_ 1197 DET_SUPER_RES_TARGET_181 "flasg is set if the detection is super resolution target";
CM_ SG_ 1197 DET_SNR_181 "The signal to noise ratio (SNR) of the radar detection";
CM_ SG_ 1197 DET_POINT_TARGET_PROB_181 "Describes the possibility if more than one real-world object has led to this detection. 0[%] := 100[%] Multi target probability";
CM_ SG_ 1197 DET_EXISTENCE_PROB_181 "Existence probability of the detection not based on history. Value does  not depend on any past experience with similar detections.
\note Use as confidence measure where a low value means less confidence
and a high value indicates strong confidence.";
CM_ SG_ 1197 DET_OUTSIDE_SECTOR_181 "Flag to indicate detections outside the sector, set if the wrong sector calibration matrix was used";
CM_ SG_ 1197 DET_HVC_FLAG_181 "Core2 Vehicle clutter flag";
CM_ SG_ 1197 DET_CONFD_AZIMUTH_181 "Define the Confidence of Azimuth for Detection ";
CM_ SG_ 1197 DET_CONFD_ELEVATION_181 "Define the Confidence of Elevation for the Detection ";
CM_ SG_ 1197 DET_BI_STATIC_FLAG_182 "1 if detection is bi-static 0 otherwise";
CM_ SG_ 1197 DET_BI_STATIC_FLAG_183 "1 if detection is bi-static 0 otherwise";
CM_ SG_ 1197 DET_BI_STATIC_FLAG_184 "1 if detection is bi-static 0 otherwise";
CM_ SG_ 1197 DET_MH_SCAN_INDEX_4LSB_181_184 "Scan index of the measured detection";
CM_ SG_ 1197 DET_MH_CYCLE_COUNTER_181_184 "Detection Alive Counter";
CM_ SG_ 1198 DET_RANGE_185 " measured position  of the detection";
CM_ SG_ 1198 DET_RANGE_ERR_185 "RMSE or standard deviation of the measured angle  of the detection";
CM_ SG_ 1198 DET_RANGE_VELOCITY_185 "Radial velocity of the detection positive in direction to the sensor";
CM_ SG_ 1198 DET_RANGE_VELOCITY_ERR_185 "RMSE or standard deviation of the measure radial velocity of the detection";
CM_ SG_ 1198 DET_AZIMUTH_185 "Measured angle  of the detection";
CM_ SG_ 1198 DET_AZIMUTH_ERR_185 "RMSE or standard deviation of the measured angle  of the detection";
CM_ SG_ 1198 DET_ELEVATION_185 "measured elevation of the detection";
CM_ SG_ 1198 DET_ELEVATION_ERR_185 "RMSE or standard deviation of the measured elevation  of the detection";
CM_ SG_ 1198 DET_RCS_185 "Radar Cross Section or Amplitude, is a measure of how detectable an object is by radar. A larger RCS indicates that an object is more easily detected.";
CM_ SG_ 1198 DET_VALID_FLAG_185 "is set if the measured detection is valid";
CM_ SG_ 1198 DET_BI_STATIC_FLAG_185 "1 if detection is bi-static 0 otherwise";
CM_ SG_ 1198 DET_SUPER_RES_TARGET_185 "flasg is set if the detection is super resolution target";
CM_ SG_ 1198 DET_SNR_185 "The signal to noise ratio (SNR) of the radar detection";
CM_ SG_ 1198 DET_POINT_TARGET_PROB_185 "Describes the possibility if more than one real-world object has led to this detection. 0[%] := 100[%] Multi target probability";
CM_ SG_ 1198 DET_EXISTENCE_PROB_185 "Existence probability of the detection not based on history. Value does  not depend on any past experience with similar detections.
\note Use as confidence measure where a low value means less confidence
and a high value indicates strong confidence.";
CM_ SG_ 1198 DET_OUTSIDE_SECTOR_185 "Flag to indicate detections outside the sector, set if the wrong sector calibration matrix was used";
CM_ SG_ 1198 DET_HVC_FLAG_185 "Core2 Vehicle clutter flag";
CM_ SG_ 1198 DET_CONFD_AZIMUTH_185 "Define the Confidence of Azimuth for Detection ";
CM_ SG_ 1198 DET_CONFD_ELEVATION_185 "Define the Confidence of Elevation for the Detection ";
CM_ SG_ 1198 DET_BI_STATIC_FLAG_186 "1 if detection is bi-static 0 otherwise";
CM_ SG_ 1198 DET_BI_STATIC_FLAG_187 "1 if detection is bi-static 0 otherwise";
CM_ SG_ 1198 DET_BI_STATIC_FLAG_188 "1 if detection is bi-static 0 otherwise";
CM_ SG_ 1198 DET_MH_SCAN_INDEX_4LSB_185_188 "Scan index of the measured detection";
CM_ SG_ 1198 DET_MH_CYCLE_COUNTER_185_188 "Detection Alive Counter";
BA_DEF_ BO_  "CanTpBs" INT 0 255;
BA_DEF_ BO_  "DiagRequest" ENUM  "No","Yes";
BA_DEF_ BO_  "DiagResponse" ENUM  "No","Yes";
BA_DEF_ BO_  "E2EDataId" INT 0 65535;
BA_DEF_ BO_  "E2EDataLength" INT 0 65535;
BA_DEF_ BO_  "E2EProfile" STRING ;
BA_DEF_ BO_  "EventRateOfChange" INT 10 10000;
BA_DEF_ BO_  "GenMsgCycleTime" INT 0 100000;
BA_DEF_ BO_  "GenMsgILSupport" ENUM  "No","Yes";
BA_DEF_ BO_  "GenMsgNrOfRepetition" INT 0 100;
BA_DEF_ BO_  "GenMsgSendType" ENUM  "FixedPeriodic","Event","EnabledPeriodic","NotUsed","NotUsed","EventPeriodic","NotUsed","NotUsed","NoMsgSendType";
BA_DEF_ BO_  "NetworkInitialization" ENUM  "No","Yes";
BA_DEF_ BO_  "NmAsrMessage" ENUM  "No","Yes";
BA_DEF_ BO_  "NmMessage" ENUM  "No","Yes";
BA_DEF_ BO_  "SCP_AuthInfoTxLength" INT 0 512;
BA_DEF_ BO_  "SCP_DataId" INT 0 65535;
BA_DEF_ BO_  "SCP_FreshnessValueId" INT 0 65535;
BA_DEF_ BO_  "SCP_FreshnessValueLength" INT 0 512;
BA_DEF_ BO_  "SCP_FreshnessValueTxLength" INT 0 512;
BA_DEF_ BO_  "SC_Message" ENUM  "No","Yes","Yes, split message";
BA_DEF_ BO_  "TpTxIndex" INT 0 255;
BA_DEF_ BO_  "VFrameFormat" ENUM  "StandardCAN","ExtendedCAN","reserved","reserved","reserved","reserved","reserved","reserved","reserved","reserved","reserved","reserved","reserved","reserved","StandardCAN_FD","ExtendedCAN_FD";
BA_DEF_ SG_  "GenSigCmt" STRING ;
BA_DEF_ SG_  "GenSigCycleTime" INT 0 0;
BA_DEF_ SG_  "GenSigSendType" ENUM  "Cyclic","OnWrite","vector_leerstring","OnChange","vector_leerstring","IfActive","vector_leerstring","NoSigSendType";
BA_DEF_ SG_  "GenSigStartValue" INT 0 1000000000;
BA_DEF_ SG_  "GenSigTimeoutTime" INT 0 0;
BA_DEF_ SG_  "GenSigVtEn" STRING ;
BA_DEF_ SG_  "GenSigVtName" STRING ;
BA_DEF_ SG_  "InvalidValue" STRING ;
BA_DEF_DEF_  "CanTpBs" 255;
BA_DEF_DEF_  "DiagRequest" "No";
BA_DEF_DEF_  "DiagResponse" "No";
BA_DEF_DEF_  "E2EDataId" 0;
BA_DEF_DEF_  "E2EDataLength" 0;
BA_DEF_DEF_  "E2EProfile" "";
BA_DEF_DEF_  "EventRateOfChange" 10000;
BA_DEF_DEF_  "GenMsgCycleTime" 0;
BA_DEF_DEF_  "GenMsgILSupport" "Yes";
BA_DEF_DEF_  "GenMsgNrOfRepetition" 0;
BA_DEF_DEF_  "GenMsgSendType" "NoMsgSendType";
BA_DEF_DEF_  "NetworkInitialization" "Yes";
BA_DEF_DEF_  "NmAsrMessage" "No";
BA_DEF_DEF_  "NmMessage" "No";
BA_DEF_DEF_  "SCP_AuthInfoTxLength" 28;
BA_DEF_DEF_  "SCP_DataId" 0;
BA_DEF_DEF_  "SCP_FreshnessValueId" 0;
BA_DEF_DEF_  "SCP_FreshnessValueLength" 48;
BA_DEF_DEF_  "SCP_FreshnessValueTxLength" 4;
BA_DEF_DEF_  "SC_Message" "No";
BA_DEF_DEF_  "TpTxIndex" 0;
BA_DEF_DEF_  "VFrameFormat" "StandardCAN_FD";
BA_DEF_DEF_  "GenSigCmt" "";
BA_DEF_DEF_  "GenSigCycleTime" 0;
BA_DEF_DEF_  "GenSigSendType" "NoSigSendType";
BA_DEF_DEF_  "GenSigStartValue" 0;
BA_DEF_DEF_  "GenSigTimeoutTime" 0;
BA_DEF_DEF_  "GenSigVtEn" "";
BA_DEF_DEF_  "GenSigVtName" "";
BA_DEF_DEF_  "InvalidValue" "";
BA_ "GenMsgSendType" BO_ 1181 1;
BA_ "GenMsgSendType" BO_ 1182 1;
BA_ "GenMsgSendType" BO_ 1183 1;
BA_ "GenMsgSendType" BO_ 1184 1;
BA_ "GenMsgSendType" BO_ 1185 1;
BA_ "GenMsgSendType" BO_ 1186 1;
BA_ "GenMsgSendType" BO_ 1187 1;
BA_ "GenMsgSendType" BO_ 1188 1;
BA_ "GenMsgSendType" BO_ 1189 1;
BA_ "GenMsgSendType" BO_ 1190 1;
BA_ "GenMsgSendType" BO_ 1191 1;
BA_ "GenMsgSendType" BO_ 1192 1;
BA_ "GenMsgSendType" BO_ 1193 1;
BA_ "GenMsgSendType" BO_ 1194 1;
BA_ "GenMsgSendType" BO_ 1195 1;
BA_ "GenMsgSendType" BO_ 1196 1;
BA_ "GenMsgSendType" BO_ 1197 1;
BA_ "GenMsgSendType" BO_ 1198 1;
BA_ "GenSigStartValue" SG_ 1181 DET_RANGE_VELOCITY_117 16384;
BA_ "GenSigStartValue" SG_ 1181 DET_RCS_117 128;
BA_ "GenSigStartValue" SG_ 1181 DET_RANGE_VELOCITY_118 16384;
BA_ "GenSigStartValue" SG_ 1181 DET_RCS_118 128;
BA_ "GenSigStartValue" SG_ 1181 DET_RANGE_VELOCITY_119 16384;
BA_ "GenSigStartValue" SG_ 1181 DET_RCS_119 128;
BA_ "GenSigStartValue" SG_ 1181 DET_RANGE_VELOCITY_120 16384;
BA_ "GenSigStartValue" SG_ 1181 DET_RCS_120 128;
BA_ "GenSigStartValue" SG_ 1182 DET_RANGE_VELOCITY_121 16384;
BA_ "GenSigStartValue" SG_ 1182 DET_RCS_121 128;
BA_ "GenSigStartValue" SG_ 1182 DET_RANGE_VELOCITY_122 16384;
BA_ "GenSigStartValue" SG_ 1182 DET_RCS_122 128;
BA_ "GenSigStartValue" SG_ 1182 DET_RANGE_VELOCITY_123 16384;
BA_ "GenSigStartValue" SG_ 1182 DET_RCS_123 128;
BA_ "GenSigStartValue" SG_ 1182 DET_RANGE_VELOCITY_124 16384;
BA_ "GenSigStartValue" SG_ 1182 DET_RCS_124 128;
BA_ "GenSigStartValue" SG_ 1183 DET_RANGE_VELOCITY_125 16384;
BA_ "GenSigStartValue" SG_ 1183 DET_RCS_125 128;
BA_ "GenSigStartValue" SG_ 1183 DET_RANGE_VELOCITY_126 16384;
BA_ "GenSigStartValue" SG_ 1183 DET_RCS_126 128;
BA_ "GenSigStartValue" SG_ 1183 DET_RANGE_VELOCITY_127 16384;
BA_ "GenSigStartValue" SG_ 1183 DET_RCS_127 128;
BA_ "GenSigStartValue" SG_ 1183 DET_RANGE_VELOCITY_128 16384;
BA_ "GenSigStartValue" SG_ 1183 DET_RCS_128 128;
BA_ "GenSigStartValue" SG_ 1184 DET_RANGE_VELOCITY_129 16384;
BA_ "GenSigStartValue" SG_ 1184 DET_RCS_129 128;
BA_ "GenSigStartValue" SG_ 1184 DET_RANGE_VELOCITY_130 16384;
BA_ "GenSigStartValue" SG_ 1184 DET_RCS_130 128;
BA_ "GenSigStartValue" SG_ 1184 DET_RANGE_VELOCITY_131 16384;
BA_ "GenSigStartValue" SG_ 1184 DET_RCS_131 128;
BA_ "GenSigStartValue" SG_ 1184 DET_RANGE_VELOCITY_132 16384;
BA_ "GenSigStartValue" SG_ 1184 DET_RCS_132 128;
BA_ "GenSigStartValue" SG_ 1185 DET_RANGE_VELOCITY_133 16384;
BA_ "GenSigStartValue" SG_ 1185 DET_RCS_133 128;
BA_ "GenSigStartValue" SG_ 1185 DET_RANGE_VELOCITY_134 16384;
BA_ "GenSigStartValue" SG_ 1185 DET_RCS_134 128;
BA_ "GenSigStartValue" SG_ 1185 DET_RANGE_VELOCITY_135 16384;
BA_ "GenSigStartValue" SG_ 1185 DET_RCS_135 128;
BA_ "GenSigStartValue" SG_ 1185 DET_RANGE_VELOCITY_136 16384;
BA_ "GenSigStartValue" SG_ 1185 DET_RCS_136 128;
BA_ "GenSigStartValue" SG_ 1186 DET_RANGE_VELOCITY_137 16384;
BA_ "GenSigStartValue" SG_ 1186 DET_RCS_137 128;
BA_ "GenSigStartValue" SG_ 1186 DET_RANGE_VELOCITY_138 16384;
BA_ "GenSigStartValue" SG_ 1186 DET_RCS_138 128;
BA_ "GenSigStartValue" SG_ 1186 DET_RANGE_VELOCITY_139 16384;
BA_ "GenSigStartValue" SG_ 1186 DET_RCS_139 128;
BA_ "GenSigStartValue" SG_ 1186 DET_RANGE_VELOCITY_140 16384;
BA_ "GenSigStartValue" SG_ 1186 DET_RCS_140 128;
BA_ "GenSigStartValue" SG_ 1187 DET_RANGE_VELOCITY_141 16384;
BA_ "GenSigStartValue" SG_ 1187 DET_RCS_141 128;
BA_ "GenSigStartValue" SG_ 1187 DET_RANGE_VELOCITY_142 16384;
BA_ "GenSigStartValue" SG_ 1187 DET_RCS_142 128;
BA_ "GenSigStartValue" SG_ 1187 DET_RANGE_VELOCITY_143 16384;
BA_ "GenSigStartValue" SG_ 1187 DET_RCS_143 128;
BA_ "GenSigStartValue" SG_ 1187 DET_RANGE_VELOCITY_144 16384;
BA_ "GenSigStartValue" SG_ 1187 DET_RCS_144 128;
BA_ "GenSigStartValue" SG_ 1188 DET_RANGE_VELOCITY_145 16384;
BA_ "GenSigStartValue" SG_ 1188 DET_RCS_145 128;
BA_ "GenSigStartValue" SG_ 1188 DET_RANGE_VELOCITY_146 16384;
BA_ "GenSigStartValue" SG_ 1188 DET_RCS_146 128;
BA_ "GenSigStartValue" SG_ 1188 DET_RANGE_VELOCITY_147 16384;
BA_ "GenSigStartValue" SG_ 1188 DET_RCS_147 128;
BA_ "GenSigStartValue" SG_ 1188 DET_RANGE_VELOCITY_148 16384;
BA_ "GenSigStartValue" SG_ 1188 DET_RCS_148 128;
BA_ "GenSigStartValue" SG_ 1189 DET_RANGE_VELOCITY_149 16384;
BA_ "GenSigStartValue" SG_ 1189 DET_RCS_149 128;
BA_ "GenSigStartValue" SG_ 1189 DET_RANGE_VELOCITY_150 16384;
BA_ "GenSigStartValue" SG_ 1189 DET_RCS_150 128;
BA_ "GenSigStartValue" SG_ 1189 DET_RANGE_VELOCITY_151 16384;
BA_ "GenSigStartValue" SG_ 1189 DET_RCS_151 128;
BA_ "GenSigStartValue" SG_ 1189 DET_RANGE_VELOCITY_152 16384;
BA_ "GenSigStartValue" SG_ 1189 DET_RCS_152 128;
BA_ "GenSigStartValue" SG_ 1190 DET_RANGE_VELOCITY_153 16384;
BA_ "GenSigStartValue" SG_ 1190 DET_RCS_153 128;
BA_ "GenSigStartValue" SG_ 1190 DET_RANGE_VELOCITY_154 16384;
BA_ "GenSigStartValue" SG_ 1190 DET_RCS_154 128;
BA_ "GenSigStartValue" SG_ 1190 DET_RANGE_VELOCITY_155 16384;
BA_ "GenSigStartValue" SG_ 1190 DET_RCS_155 128;
BA_ "GenSigStartValue" SG_ 1190 DET_RANGE_VELOCITY_156 16384;
BA_ "GenSigStartValue" SG_ 1190 DET_RCS_156 128;
BA_ "GenSigStartValue" SG_ 1191 DET_RANGE_VELOCITY_157 16384;
BA_ "GenSigStartValue" SG_ 1191 DET_RCS_157 128;
BA_ "GenSigStartValue" SG_ 1191 DET_RANGE_VELOCITY_158 16384;
BA_ "GenSigStartValue" SG_ 1191 DET_RCS_158 128;
BA_ "GenSigStartValue" SG_ 1191 DET_RANGE_VELOCITY_159 16384;
BA_ "GenSigStartValue" SG_ 1191 DET_RCS_159 128;
BA_ "GenSigStartValue" SG_ 1191 DET_RANGE_VELOCITY_160 16384;
BA_ "GenSigStartValue" SG_ 1191 DET_RCS_160 128;
BA_ "GenSigStartValue" SG_ 1192 DET_RANGE_VELOCITY_161 16384;
BA_ "GenSigStartValue" SG_ 1192 DET_RCS_161 128;
BA_ "GenSigStartValue" SG_ 1192 DET_RANGE_VELOCITY_162 16384;
BA_ "GenSigStartValue" SG_ 1192 DET_RCS_162 128;
BA_ "GenSigStartValue" SG_ 1192 DET_RANGE_VELOCITY_163 16384;
BA_ "GenSigStartValue" SG_ 1192 DET_RCS_163 128;
BA_ "GenSigStartValue" SG_ 1192 DET_RANGE_VELOCITY_164 16384;
BA_ "GenSigStartValue" SG_ 1192 DET_RCS_164 128;
BA_ "GenSigStartValue" SG_ 1193 DET_RANGE_VELOCITY_165 16384;
BA_ "GenSigStartValue" SG_ 1193 DET_RCS_165 128;
BA_ "GenSigStartValue" SG_ 1193 DET_RANGE_VELOCITY_166 16384;
BA_ "GenSigStartValue" SG_ 1193 DET_RCS_166 128;
BA_ "GenSigStartValue" SG_ 1193 DET_RANGE_VELOCITY_167 16384;
BA_ "GenSigStartValue" SG_ 1193 DET_RCS_167 128;
BA_ "GenSigStartValue" SG_ 1193 DET_RANGE_VELOCITY_168 16384;
BA_ "GenSigStartValue" SG_ 1193 DET_RCS_168 128;
BA_ "GenSigStartValue" SG_ 1194 DET_RANGE_VELOCITY_169 16384;
BA_ "GenSigStartValue" SG_ 1194 DET_RCS_169 128;
BA_ "GenSigStartValue" SG_ 1194 DET_RANGE_VELOCITY_170 16384;
BA_ "GenSigStartValue" SG_ 1194 DET_RCS_170 128;
BA_ "GenSigStartValue" SG_ 1194 DET_RANGE_VELOCITY_171 16384;
BA_ "GenSigStartValue" SG_ 1194 DET_RCS_171 128;
BA_ "GenSigStartValue" SG_ 1194 DET_RANGE_VELOCITY_172 16384;
BA_ "GenSigStartValue" SG_ 1194 DET_RCS_172 128;
BA_ "GenSigStartValue" SG_ 1195 DET_RANGE_VELOCITY_173 16384;
BA_ "GenSigStartValue" SG_ 1195 DET_RCS_173 128;
BA_ "GenSigStartValue" SG_ 1195 DET_RANGE_VELOCITY_174 16384;
BA_ "GenSigStartValue" SG_ 1195 DET_RCS_174 128;
BA_ "GenSigStartValue" SG_ 1195 DET_RANGE_VELOCITY_175 16384;
BA_ "GenSigStartValue" SG_ 1195 DET_RCS_175 128;
BA_ "GenSigStartValue" SG_ 1195 DET_RANGE_VELOCITY_176 16384;
BA_ "GenSigStartValue" SG_ 1195 DET_RCS_176 128;
BA_ "GenSigStartValue" SG_ 1196 DET_RANGE_VELOCITY_177 16384;
BA_ "GenSigStartValue" SG_ 1196 DET_RCS_177 128;
BA_ "GenSigStartValue" SG_ 1196 DET_RANGE_VELOCITY_178 16384;
BA_ "GenSigStartValue" SG_ 1196 DET_RCS_178 128;
BA_ "GenSigStartValue" SG_ 1196 DET_RANGE_VELOCITY_179 16384;
BA_ "GenSigStartValue" SG_ 1196 DET_RCS_179 128;
BA_ "GenSigStartValue" SG_ 1196 DET_RANGE_VELOCITY_180 16384;
BA_ "GenSigStartValue" SG_ 1196 DET_RCS_180 128;
BA_ "GenSigStartValue" SG_ 1197 DET_RANGE_VELOCITY_181 16384;
BA_ "GenSigStartValue" SG_ 1197 DET_RCS_181 128;
BA_ "GenSigStartValue" SG_ 1197 DET_RANGE_VELOCITY_182 16384;
BA_ "GenSigStartValue" SG_ 1197 DET_RCS_182 128;
BA_ "GenSigStartValue" SG_ 1197 DET_RANGE_VELOCITY_183 16384;
BA_ "GenSigStartValue" SG_ 1197 DET_RCS_183 128;
BA_ "GenSigStartValue" SG_ 1197 DET_RANGE_VELOCITY_184 16384;
BA_ "GenSigStartValue" SG_ 1197 DET_RCS_184 128;
BA_ "GenSigStartValue" SG_ 1198 DET_RANGE_VELOCITY_185 16384;
BA_ "GenSigStartValue" SG_ 1198 DET_RCS_185 128;
BA_ "GenSigStartValue" SG_ 1198 DET_RANGE_VELOCITY_186 16384;
BA_ "GenSigStartValue" SG_ 1198 DET_RCS_186 128;
BA_ "GenSigStartValue" SG_ 1198 DET_RANGE_VELOCITY_187 16384;
BA_ "GenSigStartValue" SG_ 1198 DET_RCS_187 128;
BA_ "GenSigStartValue" SG_ 1198 DET_RANGE_VELOCITY_188 16384;
BA_ "GenSigStartValue" SG_ 1198 DET_RCS_188 128;
VAL_ 1181 DET_CONFD_AZIMUTH_117 0 "High" 1 "MidHigh" 2 "MidLow" 3 "Low" ;
VAL_ 1181 DET_CONFD_ELEVATION_117 0 "High" 1 "MidHigh" 2 "MidLow" 3 "Low" ;
VAL_ 1181 DET_CONFD_AZIMUTH_118 0 "High" 1 "MidHigh" 2 "MidLow" 3 "Low" ;
VAL_ 1181 DET_CONFD_ELEVATION_118 0 "High" 1 "MidHigh" 2 "MidLow" 3 "Low" ;
VAL_ 1181 DET_CONFD_AZIMUTH_119 0 "High" 1 "MidHigh" 2 "MidLow" 3 "Low" ;
VAL_ 1181 DET_CONFD_ELEVATION_119 0 "High" 1 "MidHigh" 2 "MidLow" 3 "Low" ;
VAL_ 1182 DET_CONFD_AZIMUTH_121 0 "High" 1 "MidHigh" 2 "MidLow" 3 "Low" ;
VAL_ 1182 DET_CONFD_ELEVATION_121 0 "High" 1 "MidHigh" 2 "MidLow" 3 "Low" ;
VAL_ 1182 DET_CONFD_AZIMUTH_122 0 "High" 1 "MidHigh" 2 "MidLow" 3 "Low" ;
VAL_ 1182 DET_CONFD_ELEVATION_122 0 "High" 1 "MidHigh" 2 "MidLow" 3 "Low" ;
VAL_ 1182 DET_CONFD_AZIMUTH_123 0 "High" 1 "MidHigh" 2 "MidLow" 3 "Low" ;
VAL_ 1182 DET_CONFD_ELEVATION_123 0 "High" 1 "MidHigh" 2 "MidLow" 3 "Low" ;
VAL_ 1183 DET_CONFD_AZIMUTH_125 0 "High" 1 "MidHigh" 2 "MidLow" 3 "Low" ;
VAL_ 1183 DET_CONFD_ELEVATION_125 0 "High" 1 "MidHigh" 2 "MidLow" 3 "Low" ;
VAL_ 1183 DET_CONFD_AZIMUTH_126 0 "High" 1 "MidHigh" 2 "MidLow" 3 "Low" ;
VAL_ 1183 DET_CONFD_ELEVATION_126 0 "High" 1 "MidHigh" 2 "MidLow" 3 "Low" ;
VAL_ 1183 DET_CONFD_AZIMUTH_127 0 "High" 1 "MidHigh" 2 "MidLow" 3 "Low" ;
VAL_ 1183 DET_CONFD_ELEVATION_127 0 "High" 1 "MidHigh" 2 "MidLow" 3 "Low" ;
VAL_ 1184 DET_CONFD_AZIMUTH_129 0 "High" 1 "MidHigh" 2 "MidLow" 3 "Low" ;
VAL_ 1184 DET_CONFD_ELEVATION_129 0 "High" 1 "MidHigh" 2 "MidLow" 3 "Low" ;
VAL_ 1184 DET_CONFD_AZIMUTH_130 0 "High" 1 "MidHigh" 2 "MidLow" 3 "Low" ;
VAL_ 1184 DET_CONFD_ELEVATION_130 0 "High" 1 "MidHigh" 2 "MidLow" 3 "Low" ;
VAL_ 1184 DET_CONFD_AZIMUTH_131 0 "High" 1 "MidHigh" 2 "MidLow" 3 "Low" ;
VAL_ 1184 DET_CONFD_ELEVATION_131 0 "High" 1 "MidHigh" 2 "MidLow" 3 "Low" ;
VAL_ 1185 DET_CONFD_AZIMUTH_133 0 "High" 1 "MidHigh" 2 "MidLow" 3 "Low" ;
VAL_ 1185 DET_CONFD_ELEVATION_133 0 "High" 1 "MidHigh" 2 "MidLow" 3 "Low" ;
VAL_ 1185 DET_CONFD_AZIMUTH_134 0 "High" 1 "MidHigh" 2 "MidLow" 3 "Low" ;
VAL_ 1185 DET_CONFD_ELEVATION_134 0 "High" 1 "MidHigh" 2 "MidLow" 3 "Low" ;
VAL_ 1185 DET_CONFD_AZIMUTH_135 0 "High" 1 "MidHigh" 2 "MidLow" 3 "Low" ;
VAL_ 1185 DET_CONFD_ELEVATION_135 0 "High" 1 "MidHigh" 2 "MidLow" 3 "Low" ;
VAL_ 1186 DET_CONFD_AZIMUTH_137 0 "High" 1 "MidHigh" 2 "MidLow" 3 "Low" ;
VAL_ 1186 DET_CONFD_ELEVATION_137 0 "High" 1 "MidHigh" 2 "MidLow" 3 "Low" ;
VAL_ 1186 DET_CONFD_AZIMUTH_138 0 "High" 1 "MidHigh" 2 "MidLow" 3 "Low" ;
VAL_ 1186 DET_CONFD_ELEVATION_138 0 "High" 1 "MidHigh" 2 "MidLow" 3 "Low" ;
VAL_ 1186 DET_CONFD_AZIMUTH_139 0 "High" 1 "MidHigh" 2 "MidLow" 3 "Low" ;
VAL_ 1186 DET_CONFD_ELEVATION_139 0 "High" 1 "MidHigh" 2 "MidLow" 3 "Low" ;
VAL_ 1187 DET_CONFD_AZIMUTH_141 0 "High" 1 "MidHigh" 2 "MidLow" 3 "Low" ;
VAL_ 1187 DET_CONFD_ELEVATION_141 0 "High" 1 "MidHigh" 2 "MidLow" 3 "Low" ;
VAL_ 1187 DET_CONFD_AZIMUTH_142 0 "High" 1 "MidHigh" 2 "MidLow" 3 "Low" ;
VAL_ 1187 DET_CONFD_ELEVATION_142 0 "High" 1 "MidHigh" 2 "MidLow" 3 "Low" ;
VAL_ 1187 DET_CONFD_AZIMUTH_143 0 "High" 1 "MidHigh" 2 "MidLow" 3 "Low" ;
VAL_ 1187 DET_CONFD_ELEVATION_143 0 "High" 1 "MidHigh" 2 "MidLow" 3 "Low" ;
VAL_ 1188 DET_CONFD_AZIMUTH_145 0 "High" 1 "MidHigh" 2 "MidLow" 3 "Low" ;
VAL_ 1188 DET_CONFD_ELEVATION_145 0 "High" 1 "MidHigh" 2 "MidLow" 3 "Low" ;
VAL_ 1188 DET_CONFD_AZIMUTH_146 0 "High" 1 "MidHigh" 2 "MidLow" 3 "Low" ;
VAL_ 1188 DET_CONFD_ELEVATION_146 0 "High" 1 "MidHigh" 2 "MidLow" 3 "Low" ;
VAL_ 1188 DET_CONFD_AZIMUTH_147 0 "High" 1 "MidHigh" 2 "MidLow" 3 "Low" ;
VAL_ 1188 DET_CONFD_ELEVATION_147 0 "High" 1 "MidHigh" 2 "MidLow" 3 "Low" ;
VAL_ 1189 DET_CONFD_AZIMUTH_149 0 "High" 1 "MidHigh" 2 "MidLow" 3 "Low" ;
VAL_ 1189 DET_CONFD_ELEVATION_149 0 "High" 1 "MidHigh" 2 "MidLow" 3 "Low" ;
VAL_ 1189 DET_CONFD_AZIMUTH_150 0 "High" 1 "MidHigh" 2 "MidLow" 3 "Low" ;
VAL_ 1189 DET_CONFD_ELEVATION_150 0 "High" 1 "MidHigh" 2 "MidLow" 3 "Low" ;
VAL_ 1189 DET_CONFD_AZIMUTH_151 0 "High" 1 "MidHigh" 2 "MidLow" 3 "Low" ;
VAL_ 1189 DET_CONFD_ELEVATION_151 0 "High" 1 "MidHigh" 2 "MidLow" 3 "Low" ;
VAL_ 1190 DET_CONFD_AZIMUTH_153 0 "High" 1 "MidHigh" 2 "MidLow" 3 "Low" ;
VAL_ 1190 DET_CONFD_ELEVATION_153 0 "High" 1 "MidHigh" 2 "MidLow" 3 "Low" ;
VAL_ 1190 DET_CONFD_AZIMUTH_154 0 "High" 1 "MidHigh" 2 "MidLow" 3 "Low" ;
VAL_ 1190 DET_CONFD_ELEVATION_154 0 "High" 1 "MidHigh" 2 "MidLow" 3 "Low" ;
VAL_ 1190 DET_CONFD_AZIMUTH_155 0 "High" 1 "MidHigh" 2 "MidLow" 3 "Low" ;
VAL_ 1190 DET_CONFD_ELEVATION_155 0 "High" 1 "MidHigh" 2 "MidLow" 3 "Low" ;
VAL_ 1191 DET_CONFD_AZIMUTH_157 0 "High" 1 "MidHigh" 2 "MidLow" 3 "Low" ;
VAL_ 1191 DET_CONFD_ELEVATION_157 0 "High" 1 "MidHigh" 2 "MidLow" 3 "Low" ;
VAL_ 1191 DET_CONFD_AZIMUTH_158 0 "High" 1 "MidHigh" 2 "MidLow" 3 "Low" ;
VAL_ 1191 DET_CONFD_ELEVATION_158 0 "High" 1 "MidHigh" 2 "MidLow" 3 "Low" ;
VAL_ 1191 DET_CONFD_AZIMUTH_159 0 "High" 1 "MidHigh" 2 "MidLow" 3 "Low" ;
VAL_ 1191 DET_CONFD_ELEVATION_159 0 "High" 1 "MidHigh" 2 "MidLow" 3 "Low" ;
VAL_ 1192 DET_CONFD_AZIMUTH_161 0 "High" 1 "MidHigh" 2 "MidLow" 3 "Low" ;
VAL_ 1192 DET_CONFD_ELEVATION_161 0 "High" 1 "MidHigh" 2 "MidLow" 3 "Low" ;
VAL_ 1192 DET_CONFD_AZIMUTH_162 0 "High" 1 "MidHigh" 2 "MidLow" 3 "Low" ;
VAL_ 1192 DET_CONFD_ELEVATION_162 0 "High" 1 "MidHigh" 2 "MidLow" 3 "Low" ;
VAL_ 1192 DET_CONFD_AZIMUTH_163 0 "High" 1 "MidHigh" 2 "MidLow" 3 "Low" ;
VAL_ 1192 DET_CONFD_ELEVATION_163 0 "High" 1 "MidHigh" 2 "MidLow" 3 "Low" ;
VAL_ 1193 DET_CONFD_AZIMUTH_165 0 "High" 1 "MidHigh" 2 "MidLow" 3 "Low" ;
VAL_ 1193 DET_CONFD_ELEVATION_165 0 "High" 1 "MidHigh" 2 "MidLow" 3 "Low" ;
VAL_ 1193 DET_CONFD_AZIMUTH_166 0 "High" 1 "MidHigh" 2 "MidLow" 3 "Low" ;
VAL_ 1193 DET_CONFD_ELEVATION_166 0 "High" 1 "MidHigh" 2 "MidLow" 3 "Low" ;
VAL_ 1193 DET_CONFD_AZIMUTH_167 0 "High" 1 "MidHigh" 2 "MidLow" 3 "Low" ;
VAL_ 1193 DET_CONFD_ELEVATION_167 0 "High" 1 "MidHigh" 2 "MidLow" 3 "Low" ;
VAL_ 1194 DET_CONFD_AZIMUTH_169 0 "High" 1 "MidHigh" 2 "MidLow" 3 "Low" ;
VAL_ 1194 DET_CONFD_ELEVATION_169 0 "High" 1 "MidHigh" 2 "MidLow" 3 "Low" ;
VAL_ 1194 DET_CONFD_AZIMUTH_170 0 "High" 1 "MidHigh" 2 "MidLow" 3 "Low" ;
VAL_ 1194 DET_CONFD_ELEVATION_170 0 "High" 1 "MidHigh" 2 "MidLow" 3 "Low" ;
VAL_ 1194 DET_CONFD_AZIMUTH_171 0 "High" 1 "MidHigh" 2 "MidLow" 3 "Low" ;
VAL_ 1194 DET_CONFD_ELEVATION_171 0 "High" 1 "MidHigh" 2 "MidLow" 3 "Low" ;
VAL_ 1195 DET_CONFD_AZIMUTH_173 0 "High" 1 "MidHigh" 2 "MidLow" 3 "Low" ;
VAL_ 1195 DET_CONFD_ELEVATION_173 0 "High" 1 "MidHigh" 2 "MidLow" 3 "Low" ;
VAL_ 1195 DET_CONFD_AZIMUTH_174 0 "High" 1 "MidHigh" 2 "MidLow" 3 "Low" ;
VAL_ 1195 DET_CONFD_ELEVATION_174 0 "High" 1 "MidHigh" 2 "MidLow" 3 "Low" ;
VAL_ 1195 DET_CONFD_AZIMUTH_175 0 "High" 1 "MidHigh" 2 "MidLow" 3 "Low" ;
VAL_ 1195 DET_CONFD_ELEVATION_175 0 "High" 1 "MidHigh" 2 "MidLow" 3 "Low" ;
VAL_ 1196 DET_CONFD_AZIMUTH_177 0 "High" 1 "MidHigh" 2 "MidLow" 3 "Low" ;
VAL_ 1196 DET_CONFD_ELEVATION_177 0 "High" 1 "MidHigh" 2 "MidLow" 3 "Low" ;
VAL_ 1196 DET_CONFD_AZIMUTH_178 0 "High" 1 "MidHigh" 2 "MidLow" 3 "Low" ;
VAL_ 1196 DET_CONFD_ELEVATION_178 0 "High" 1 "MidHigh" 2 "MidLow" 3 "Low" ;
VAL_ 1196 DET_CONFD_AZIMUTH_179 0 "High" 1 "MidHigh" 2 "MidLow" 3 "Low" ;
VAL_ 1196 DET_CONFD_ELEVATION_179 0 "High" 1 "MidHigh" 2 "MidLow" 3 "Low" ;
VAL_ 1197 DET_CONFD_AZIMUTH_181 0 "High" 1 "MidHigh" 2 "MidLow" 3 "Low" ;
VAL_ 1197 DET_CONFD_ELEVATION_181 0 "High" 1 "MidHigh" 2 "MidLow" 3 "Low" ;
VAL_ 1197 DET_CONFD_AZIMUTH_182 0 "High" 1 "MidHigh" 2 "MidLow" 3 "Low" ;
VAL_ 1197 DET_CONFD_ELEVATION_182 0 "High" 1 "MidHigh" 2 "MidLow" 3 "Low" ;
VAL_ 1197 DET_CONFD_AZIMUTH_183 0 "High" 1 "MidHigh" 2 "MidLow" 3 "Low" ;
VAL_ 1197 DET_CONFD_ELEVATION_183 0 "High" 1 "MidHigh" 2 "MidLow" 3 "Low" ;
VAL_ 1198 DET_CONFD_AZIMUTH_185 0 "High" 1 "MidHigh" 2 "MidLow" 3 "Low" ;
VAL_ 1198 DET_CONFD_ELEVATION_185 0 "High" 1 "MidHigh" 2 "MidLow" 3 "Low" ;
VAL_ 1198 DET_CONFD_AZIMUTH_186 0 "High" 1 "MidHigh" 2 "MidLow" 3 "Low" ;
VAL_ 1198 DET_CONFD_ELEVATION_186 0 "High" 1 "MidHigh" 2 "MidLow" 3 "Low" ;
VAL_ 1198 DET_CONFD_AZIMUTH_187 0 "High" 1 "MidHigh" 2 "MidLow" 3 "Low" ;
VAL_ 1198 DET_CONFD_ELEVATION_187 0 "High" 1 "MidHigh" 2 "MidLow" 3 "Low" ;
SIG_GROUP_ 1181 Detections_117_120 1 : DET_MH_CRC16_117_120 DET_MH_CYCLE_COUNTER_117_120 DET_MH_SCAN_INDEX_4LSB_117_120 DET_CONFD_ELEVATION_117 DET_CONFD_AZIMUTH_117 DET_HVC_FLAG_117 DET_OUTSIDE_SECTOR_117 DET_EXISTENCE_PROB_117 DET_POINT_TARGET_PROB_117 DET_SNR_117 DET_SUPER_RES_TARGET_117 DET_BI_STATIC_FLAG_117 DET_VALID_FLAG_117 DET_RCS_117 DET_ELEVATION_ERR_117 DET_ELEVATION_117 DET_AZIMUTH_ERR_117 DET_AZIMUTH_117 DET_RANGE_VELOCITY_ERR_117 DET_RANGE_VELOCITY_117 DET_RANGE_ERR_117 DET_RANGE_117 DET_CONFD_ELEVATION_118 DET_CONFD_AZIMUTH_118 DET_HVC_FLAG_118 DET_OUTSIDE_SECTOR_118 DET_EXISTENCE_PROB_118 DET_POINT_TARGET_PROB_118 DET_SNR_118 DET_SUPER_RES_TARGET_118 DET_BI_STATIC_FLAG_118 DET_VALID_FLAG_118 DET_RCS_118 DET_ELEVATION_ERR_118 DET_ELEVATION_118 DET_AZIMUTH_ERR_118 DET_AZIMUTH_118 DET_RANGE_VELOCITY_ERR_118 DET_RANGE_VELOCITY_118 DET_RANGE_ERR_118 DET_RANGE_118 DET_CONFD_ELEVATION_119 DET_CONFD_AZIMUTH_119 DET_HVC_FLAG_119 DET_OUTSIDE_SECTOR_119 DET_EXISTENCE_PROB_119 DET_POINT_TARGET_PROB_119 DET_SNR_119 DET_SUPER_RES_TARGET_119 DET_BI_STATIC_FLAG_119 DET_VALID_FLAG_119 DET_RCS_119 DET_ELEVATION_ERR_119 DET_ELEVATION_119 DET_AZIMUTH_ERR_119 DET_AZIMUTH_119 DET_RANGE_VELOCITY_ERR_119 DET_RANGE_VELOCITY_119 DET_RANGE_ERR_119 DET_RANGE_119 DET_CONFD_ELEVATION_120 DET_CONFD_AZIMUTH_120 DET_HVC_FLAG_120 DET_OUTSIDE_SECTOR_120 DET_EXISTENCE_PROB_120 DET_POINT_TARGET_PROB_120 DET_SNR_120 DET_SUPER_RES_TARGET_120 DET_BI_STATIC_FLAG_120 DET_VALID_FLAG_120 DET_RCS_120 DET_ELEVATION_ERR_120 DET_ELEVATION_120 DET_AZIMUTH_ERR_120 DET_AZIMUTH_120 DET_RANGE_VELOCITY_ERR_120 DET_RANGE_VELOCITY_120 DET_RANGE_ERR_120 DET_RANGE_120;
SIG_GROUP_ 1182 Detections_121_124 1 : DET_MH_CRC16_121_124 DET_MH_CYCLE_COUNTER_121_124 DET_MH_SCAN_INDEX_4LSB_121_124 DET_CONFD_ELEVATION_121 DET_CONFD_AZIMUTH_121 DET_HVC_FLAG_121 DET_OUTSIDE_SECTOR_121 DET_EXISTENCE_PROB_121 DET_POINT_TARGET_PROB_121 DET_SNR_121 DET_SUPER_RES_TARGET_121 DET_BI_STATIC_FLAG_121 DET_VALID_FLAG_121 DET_RCS_121 DET_ELEVATION_ERR_121 DET_ELEVATION_121 DET_AZIMUTH_ERR_121 DET_AZIMUTH_121 DET_RANGE_VELOCITY_ERR_121 DET_RANGE_VELOCITY_121 DET_RANGE_ERR_121 DET_RANGE_121 DET_CONFD_ELEVATION_122 DET_CONFD_AZIMUTH_122 DET_HVC_FLAG_122 DET_OUTSIDE_SECTOR_122 DET_EXISTENCE_PROB_122 DET_POINT_TARGET_PROB_122 DET_SNR_122 DET_SUPER_RES_TARGET_122 DET_BI_STATIC_FLAG_122 DET_VALID_FLAG_122 DET_RCS_122 DET_ELEVATION_ERR_122 DET_ELEVATION_122 DET_AZIMUTH_ERR_122 DET_AZIMUTH_122 DET_RANGE_VELOCITY_ERR_122 DET_RANGE_VELOCITY_122 DET_RANGE_ERR_122 DET_RANGE_122 DET_CONFD_ELEVATION_123 DET_CONFD_AZIMUTH_123 DET_HVC_FLAG_123 DET_OUTSIDE_SECTOR_123 DET_EXISTENCE_PROB_123 DET_POINT_TARGET_PROB_123 DET_SNR_123 DET_SUPER_RES_TARGET_123 DET_BI_STATIC_FLAG_123 DET_VALID_FLAG_123 DET_RCS_123 DET_ELEVATION_ERR_123 DET_ELEVATION_123 DET_AZIMUTH_ERR_123 DET_AZIMUTH_123 DET_RANGE_VELOCITY_ERR_123 DET_RANGE_VELOCITY_123 DET_RANGE_ERR_123 DET_RANGE_123 DET_CONFD_ELEVATION_124 DET_CONFD_AZIMUTH_124 DET_HVC_FLAG_124 DET_OUTSIDE_SECTOR_124 DET_EXISTENCE_PROB_124 DET_POINT_TARGET_PROB_124 DET_SNR_124 DET_SUPER_RES_TARGET_124 DET_BI_STATIC_FLAG_124 DET_VALID_FLAG_124 DET_RCS_124 DET_ELEVATION_ERR_124 DET_ELEVATION_124 DET_AZIMUTH_ERR_124 DET_AZIMUTH_124 DET_RANGE_VELOCITY_ERR_124 DET_RANGE_VELOCITY_124 DET_RANGE_ERR_124 DET_RANGE_124;
SIG_GROUP_ 1183 Detections_125_128 1 : DET_MH_CRC16_125_128 DET_MH_CYCLE_COUNTER_125_128 DET_MH_SCAN_INDEX_4LSB_125_128 DET_CONFD_ELEVATION_125 DET_CONFD_AZIMUTH_125 DET_HVC_FLAG_125 DET_OUTSIDE_SECTOR_125 DET_EXISTENCE_PROB_125 DET_POINT_TARGET_PROB_125 DET_SNR_125 DET_SUPER_RES_TARGET_125 DET_BI_STATIC_FLAG_125 DET_VALID_FLAG_125 DET_RCS_125 DET_ELEVATION_ERR_125 DET_ELEVATION_125 DET_AZIMUTH_ERR_125 DET_AZIMUTH_125 DET_RANGE_VELOCITY_ERR_125 DET_RANGE_VELOCITY_125 DET_RANGE_ERR_125 DET_RANGE_125 DET_CONFD_ELEVATION_126 DET_CONFD_AZIMUTH_126 DET_HVC_FLAG_126 DET_OUTSIDE_SECTOR_126 DET_EXISTENCE_PROB_126 DET_POINT_TARGET_PROB_126 DET_SNR_126 DET_SUPER_RES_TARGET_126 DET_BI_STATIC_FLAG_126 DET_VALID_FLAG_126 DET_RCS_126 DET_ELEVATION_ERR_126 DET_ELEVATION_126 DET_AZIMUTH_ERR_126 DET_AZIMUTH_126 DET_RANGE_VELOCITY_ERR_126 DET_RANGE_VELOCITY_126 DET_RANGE_ERR_126 DET_RANGE_126 DET_CONFD_ELEVATION_127 DET_CONFD_AZIMUTH_127 DET_HVC_FLAG_127 DET_OUTSIDE_SECTOR_127 DET_EXISTENCE_PROB_127 DET_POINT_TARGET_PROB_127 DET_SNR_127 DET_SUPER_RES_TARGET_127 DET_BI_STATIC_FLAG_127 DET_VALID_FLAG_127 DET_RCS_127 DET_ELEVATION_ERR_127 DET_ELEVATION_127 DET_AZIMUTH_ERR_127 DET_AZIMUTH_127 DET_RANGE_VELOCITY_ERR_127 DET_RANGE_VELOCITY_127 DET_RANGE_ERR_127 DET_RANGE_127 DET_CONFD_ELEVATION_128 DET_CONFD_AZIMUTH_128 DET_HVC_FLAG_128 DET_OUTSIDE_SECTOR_128 DET_EXISTENCE_PROB_128 DET_POINT_TARGET_PROB_128 DET_SNR_128 DET_SUPER_RES_TARGET_128 DET_BI_STATIC_FLAG_128 DET_VALID_FLAG_128 DET_RCS_128 DET_ELEVATION_ERR_128 DET_ELEVATION_128 DET_AZIMUTH_ERR_128 DET_AZIMUTH_128 DET_RANGE_VELOCITY_ERR_128 DET_RANGE_VELOCITY_128 DET_RANGE_ERR_128 DET_RANGE_128;
SIG_GROUP_ 1184 Detections_129_132 1 : DET_MH_CRC16_129_132 DET_MH_CYCLE_COUNTER_129_132 DET_MH_SCAN_INDEX_4LSB_129_132 DET_CONFD_ELEVATION_129 DET_CONFD_AZIMUTH_129 DET_HVC_FLAG_129 DET_OUTSIDE_SECTOR_129 DET_EXISTENCE_PROB_129 DET_POINT_TARGET_PROB_129 DET_SNR_129 DET_SUPER_RES_TARGET_129 DET_BI_STATIC_FLAG_129 DET_VALID_FLAG_129 DET_RCS_129 DET_ELEVATION_ERR_129 DET_ELEVATION_129 DET_AZIMUTH_ERR_129 DET_AZIMUTH_129 DET_RANGE_VELOCITY_ERR_129 DET_RANGE_VELOCITY_129 DET_RANGE_ERR_129 DET_RANGE_129 DET_CONFD_ELEVATION_130 DET_CONFD_AZIMUTH_130 DET_HVC_FLAG_130 DET_OUTSIDE_SECTOR_130 DET_EXISTENCE_PROB_130 DET_POINT_TARGET_PROB_130 DET_SNR_130 DET_SUPER_RES_TARGET_130 DET_BI_STATIC_FLAG_130 DET_VALID_FLAG_130 DET_RCS_130 DET_ELEVATION_ERR_130 DET_ELEVATION_130 DET_AZIMUTH_ERR_130 DET_AZIMUTH_130 DET_RANGE_VELOCITY_ERR_130 DET_RANGE_VELOCITY_130 DET_RANGE_ERR_130 DET_RANGE_130 DET_CONFD_ELEVATION_131 DET_CONFD_AZIMUTH_131 DET_HVC_FLAG_131 DET_OUTSIDE_SECTOR_131 DET_EXISTENCE_PROB_131 DET_POINT_TARGET_PROB_131 DET_SNR_131 DET_SUPER_RES_TARGET_131 DET_BI_STATIC_FLAG_131 DET_VALID_FLAG_131 DET_RCS_131 DET_ELEVATION_ERR_131 DET_ELEVATION_131 DET_AZIMUTH_ERR_131 DET_AZIMUTH_131 DET_RANGE_VELOCITY_ERR_131 DET_RANGE_VELOCITY_131 DET_RANGE_ERR_131 DET_RANGE_131 DET_CONFD_ELEVATION_132 DET_CONFD_AZIMUTH_132 DET_HVC_FLAG_132 DET_OUTSIDE_SECTOR_132 DET_EXISTENCE_PROB_132 DET_POINT_TARGET_PROB_132 DET_SNR_132 DET_SUPER_RES_TARGET_132 DET_BI_STATIC_FLAG_132 DET_VALID_FLAG_132 DET_RCS_132 DET_ELEVATION_ERR_132 DET_ELEVATION_132 DET_AZIMUTH_ERR_132 DET_AZIMUTH_132 DET_RANGE_VELOCITY_ERR_132 DET_RANGE_VELOCITY_132 DET_RANGE_ERR_132 DET_RANGE_132;
SIG_GROUP_ 1185 Detections_133_136 1 : DET_MH_CRC16_133_136 DET_MH_CYCLE_COUNTER_133_136 DET_MH_SCAN_INDEX_4LSB_133_136 DET_CONFD_ELEVATION_133 DET_CONFD_AZIMUTH_133 DET_HVC_FLAG_133 DET_OUTSIDE_SECTOR_133 DET_EXISTENCE_PROB_133 DET_POINT_TARGET_PROB_133 DET_SNR_133 DET_SUPER_RES_TARGET_133 DET_BI_STATIC_FLAG_133 DET_VALID_FLAG_133 DET_RCS_133 DET_ELEVATION_ERR_133 DET_ELEVATION_133 DET_AZIMUTH_ERR_133 DET_AZIMUTH_133 DET_RANGE_VELOCITY_ERR_133 DET_RANGE_VELOCITY_133 DET_RANGE_ERR_133 DET_RANGE_133 DET_CONFD_ELEVATION_134 DET_CONFD_AZIMUTH_134 DET_HVC_FLAG_134 DET_OUTSIDE_SECTOR_134 DET_EXISTENCE_PROB_134 DET_POINT_TARGET_PROB_134 DET_SNR_134 DET_SUPER_RES_TARGET_134 DET_BI_STATIC_FLAG_134 DET_VALID_FLAG_134 DET_RCS_134 DET_ELEVATION_ERR_134 DET_ELEVATION_134 DET_AZIMUTH_ERR_134 DET_AZIMUTH_134 DET_RANGE_VELOCITY_ERR_134 DET_RANGE_VELOCITY_134 DET_RANGE_ERR_134 DET_RANGE_134 DET_CONFD_ELEVATION_135 DET_CONFD_AZIMUTH_135 DET_HVC_FLAG_135 DET_OUTSIDE_SECTOR_135 DET_EXISTENCE_PROB_135 DET_POINT_TARGET_PROB_135 DET_SNR_135 DET_SUPER_RES_TARGET_135 DET_BI_STATIC_FLAG_135 DET_VALID_FLAG_135 DET_RCS_135 DET_ELEVATION_ERR_135 DET_ELEVATION_135 DET_AZIMUTH_ERR_135 DET_AZIMUTH_135 DET_RANGE_VELOCITY_ERR_135 DET_RANGE_VELOCITY_135 DET_RANGE_ERR_135 DET_RANGE_135 DET_CONFD_ELEVATION_136 DET_CONFD_AZIMUTH_136 DET_HVC_FLAG_136 DET_OUTSIDE_SECTOR_136 DET_EXISTENCE_PROB_136 DET_POINT_TARGET_PROB_136 DET_SNR_136 DET_SUPER_RES_TARGET_136 DET_BI_STATIC_FLAG_136 DET_VALID_FLAG_136 DET_RCS_136 DET_ELEVATION_ERR_136 DET_ELEVATION_136 DET_AZIMUTH_ERR_136 DET_AZIMUTH_136 DET_RANGE_VELOCITY_ERR_136 DET_RANGE_VELOCITY_136 DET_RANGE_ERR_136 DET_RANGE_136;
SIG_GROUP_ 1186 Detections_137_140 1 : DET_MH_CRC16_137_140 DET_MH_CYCLE_COUNTER_137_140 DET_MH_SCAN_INDEX_4LSB_137_140 DET_CONFD_ELEVATION_137 DET_CONFD_AZIMUTH_137 DET_HVC_FLAG_137 DET_OUTSIDE_SECTOR_137 DET_EXISTENCE_PROB_137 DET_POINT_TARGET_PROB_137 DET_SNR_137 DET_SUPER_RES_TARGET_137 DET_BI_STATIC_FLAG_137 DET_VALID_FLAG_137 DET_RCS_137 DET_ELEVATION_ERR_137 DET_ELEVATION_137 DET_AZIMUTH_ERR_137 DET_AZIMUTH_137 DET_RANGE_VELOCITY_ERR_137 DET_RANGE_VELOCITY_137 DET_RANGE_ERR_137 DET_RANGE_137 DET_CONFD_ELEVATION_138 DET_CONFD_AZIMUTH_138 DET_HVC_FLAG_138 DET_OUTSIDE_SECTOR_138 DET_EXISTENCE_PROB_138 DET_POINT_TARGET_PROB_138 DET_SNR_138 DET_SUPER_RES_TARGET_138 DET_BI_STATIC_FLAG_138 DET_VALID_FLAG_138 DET_RCS_138 DET_ELEVATION_ERR_138 DET_ELEVATION_138 DET_AZIMUTH_ERR_138 DET_AZIMUTH_138 DET_RANGE_VELOCITY_ERR_138 DET_RANGE_VELOCITY_138 DET_RANGE_ERR_138 DET_RANGE_138 DET_CONFD_ELEVATION_139 DET_CONFD_AZIMUTH_139 DET_HVC_FLAG_139 DET_OUTSIDE_SECTOR_139 DET_EXISTENCE_PROB_139 DET_POINT_TARGET_PROB_139 DET_SNR_139 DET_SUPER_RES_TARGET_139 DET_BI_STATIC_FLAG_139 DET_VALID_FLAG_139 DET_RCS_139 DET_ELEVATION_ERR_139 DET_ELEVATION_139 DET_AZIMUTH_ERR_139 DET_AZIMUTH_139 DET_RANGE_VELOCITY_ERR_139 DET_RANGE_VELOCITY_139 DET_RANGE_ERR_139 DET_RANGE_139 DET_CONFD_ELEVATION_140 DET_CONFD_AZIMUTH_140 DET_HVC_FLAG_140 DET_OUTSIDE_SECTOR_140 DET_EXISTENCE_PROB_140 DET_POINT_TARGET_PROB_140 DET_SNR_140 DET_SUPER_RES_TARGET_140 DET_BI_STATIC_FLAG_140 DET_VALID_FLAG_140 DET_RCS_140 DET_ELEVATION_ERR_140 DET_ELEVATION_140 DET_AZIMUTH_ERR_140 DET_AZIMUTH_140 DET_RANGE_VELOCITY_ERR_140 DET_RANGE_VELOCITY_140 DET_RANGE_ERR_140 DET_RANGE_140;
SIG_GROUP_ 1187 Detections_141_144 1 : DET_MH_CRC16_141_144 DET_MH_CYCLE_COUNTER_141_144 DET_MH_SCAN_INDEX_4LSB_141_144 DET_CONFD_ELEVATION_141 DET_CONFD_AZIMUTH_141 DET_HVC_FLAG_141 DET_OUTSIDE_SECTOR_141 DET_EXISTENCE_PROB_141 DET_POINT_TARGET_PROB_141 DET_SNR_141 DET_SUPER_RES_TARGET_141 DET_BI_STATIC_FLAG_141 DET_VALID_FLAG_141 DET_RCS_141 DET_ELEVATION_ERR_141 DET_ELEVATION_141 DET_AZIMUTH_ERR_141 DET_AZIMUTH_141 DET_RANGE_VELOCITY_ERR_141 DET_RANGE_VELOCITY_141 DET_RANGE_ERR_141 DET_RANGE_141 DET_CONFD_ELEVATION_142 DET_CONFD_AZIMUTH_142 DET_HVC_FLAG_142 DET_OUTSIDE_SECTOR_142 DET_EXISTENCE_PROB_142 DET_POINT_TARGET_PROB_142 DET_SNR_142 DET_SUPER_RES_TARGET_142 DET_BI_STATIC_FLAG_142 DET_VALID_FLAG_142 DET_RCS_142 DET_ELEVATION_ERR_142 DET_ELEVATION_142 DET_AZIMUTH_ERR_142 DET_AZIMUTH_142 DET_RANGE_VELOCITY_ERR_142 DET_RANGE_VELOCITY_142 DET_RANGE_ERR_142 DET_RANGE_142 DET_CONFD_ELEVATION_143 DET_CONFD_AZIMUTH_143 DET_HVC_FLAG_143 DET_OUTSIDE_SECTOR_143 DET_EXISTENCE_PROB_143 DET_POINT_TARGET_PROB_143 DET_SNR_143 DET_SUPER_RES_TARGET_143 DET_BI_STATIC_FLAG_143 DET_VALID_FLAG_143 DET_RCS_143 DET_ELEVATION_ERR_143 DET_ELEVATION_143 DET_AZIMUTH_ERR_143 DET_AZIMUTH_143 DET_RANGE_VELOCITY_ERR_143 DET_RANGE_VELOCITY_143 DET_RANGE_ERR_143 DET_RANGE_143 DET_CONFD_ELEVATION_144 DET_CONFD_AZIMUTH_144 DET_HVC_FLAG_144 DET_OUTSIDE_SECTOR_144 DET_EXISTENCE_PROB_144 DET_POINT_TARGET_PROB_144 DET_SNR_144 DET_SUPER_RES_TARGET_144 DET_BI_STATIC_FLAG_144 DET_VALID_FLAG_144 DET_RCS_144 DET_ELEVATION_ERR_144 DET_ELEVATION_144 DET_AZIMUTH_ERR_144 DET_AZIMUTH_144 DET_RANGE_VELOCITY_ERR_144 DET_RANGE_VELOCITY_144 DET_RANGE_ERR_144 DET_RANGE_144;
SIG_GROUP_ 1188 Detections_145_148 1 : DET_MH_CRC16_145_148 DET_MH_CYCLE_COUNTER_145_148 DET_MH_SCAN_INDEX_4LSB_145_148 DET_CONFD_ELEVATION_145 DET_CONFD_AZIMUTH_145 DET_HVC_FLAG_145 DET_OUTSIDE_SECTOR_145 DET_EXISTENCE_PROB_145 DET_POINT_TARGET_PROB_145 DET_SNR_145 DET_SUPER_RES_TARGET_145 DET_BI_STATIC_FLAG_145 DET_VALID_FLAG_145 DET_RCS_145 DET_ELEVATION_ERR_145 DET_ELEVATION_145 DET_AZIMUTH_ERR_145 DET_AZIMUTH_145 DET_RANGE_VELOCITY_ERR_145 DET_RANGE_VELOCITY_145 DET_RANGE_ERR_145 DET_RANGE_145 DET_CONFD_ELEVATION_146 DET_CONFD_AZIMUTH_146 DET_HVC_FLAG_146 DET_OUTSIDE_SECTOR_146 DET_EXISTENCE_PROB_146 DET_POINT_TARGET_PROB_146 DET_SNR_146 DET_SUPER_RES_TARGET_146 DET_BI_STATIC_FLAG_146 DET_VALID_FLAG_146 DET_RCS_146 DET_ELEVATION_ERR_146 DET_ELEVATION_146 DET_AZIMUTH_ERR_146 DET_AZIMUTH_146 DET_RANGE_VELOCITY_ERR_146 DET_RANGE_VELOCITY_146 DET_RANGE_ERR_146 DET_RANGE_146 DET_CONFD_ELEVATION_147 DET_CONFD_AZIMUTH_147 DET_HVC_FLAG_147 DET_OUTSIDE_SECTOR_147 DET_EXISTENCE_PROB_147 DET_POINT_TARGET_PROB_147 DET_SNR_147 DET_SUPER_RES_TARGET_147 DET_BI_STATIC_FLAG_147 DET_VALID_FLAG_147 DET_RCS_147 DET_ELEVATION_ERR_147 DET_ELEVATION_147 DET_AZIMUTH_ERR_147 DET_AZIMUTH_147 DET_RANGE_VELOCITY_ERR_147 DET_RANGE_VELOCITY_147 DET_RANGE_ERR_147 DET_RANGE_147 DET_CONFD_ELEVATION_148 DET_CONFD_AZIMUTH_148 DET_HVC_FLAG_148 DET_OUTSIDE_SECTOR_148 DET_EXISTENCE_PROB_148 DET_POINT_TARGET_PROB_148 DET_SNR_148 DET_SUPER_RES_TARGET_148 DET_BI_STATIC_FLAG_148 DET_VALID_FLAG_148 DET_RCS_148 DET_ELEVATION_ERR_148 DET_ELEVATION_148 DET_AZIMUTH_ERR_148 DET_AZIMUTH_148 DET_RANGE_VELOCITY_ERR_148 DET_RANGE_VELOCITY_148 DET_RANGE_ERR_148 DET_RANGE_148;
SIG_GROUP_ 1189 Detections_149_152 1 : DET_MH_CRC16_149_152 DET_MH_CYCLE_COUNTER_149_152 DET_MH_SCAN_INDEX_4LSB_149_152 DET_CONFD_ELEVATION_149 DET_CONFD_AZIMUTH_149 DET_HVC_FLAG_149 DET_OUTSIDE_SECTOR_149 DET_EXISTENCE_PROB_149 DET_POINT_TARGET_PROB_149 DET_SNR_149 DET_SUPER_RES_TARGET_149 DET_BI_STATIC_FLAG_149 DET_VALID_FLAG_149 DET_RCS_149 DET_ELEVATION_ERR_149 DET_ELEVATION_149 DET_AZIMUTH_ERR_149 DET_AZIMUTH_149 DET_RANGE_VELOCITY_ERR_149 DET_RANGE_VELOCITY_149 DET_RANGE_ERR_149 DET_RANGE_149 DET_CONFD_ELEVATION_150 DET_CONFD_AZIMUTH_150 DET_HVC_FLAG_150 DET_OUTSIDE_SECTOR_150 DET_EXISTENCE_PROB_150 DET_POINT_TARGET_PROB_150 DET_SNR_150 DET_SUPER_RES_TARGET_150 DET_BI_STATIC_FLAG_150 DET_VALID_FLAG_150 DET_RCS_150 DET_ELEVATION_ERR_150 DET_ELEVATION_150 DET_AZIMUTH_ERR_150 DET_AZIMUTH_150 DET_RANGE_VELOCITY_ERR_150 DET_RANGE_VELOCITY_150 DET_RANGE_ERR_150 DET_RANGE_150 DET_CONFD_ELEVATION_151 DET_CONFD_AZIMUTH_151 DET_HVC_FLAG_151 DET_OUTSIDE_SECTOR_151 DET_EXISTENCE_PROB_151 DET_POINT_TARGET_PROB_151 DET_SNR_151 DET_SUPER_RES_TARGET_151 DET_BI_STATIC_FLAG_151 DET_VALID_FLAG_151 DET_RCS_151 DET_ELEVATION_ERR_151 DET_ELEVATION_151 DET_AZIMUTH_ERR_151 DET_AZIMUTH_151 DET_RANGE_VELOCITY_ERR_151 DET_RANGE_VELOCITY_151 DET_RANGE_ERR_151 DET_RANGE_151 DET_CONFD_ELEVATION_152 DET_CONFD_AZIMUTH_152 DET_HVC_FLAG_152 DET_OUTSIDE_SECTOR_152 DET_EXISTENCE_PROB_152 DET_POINT_TARGET_PROB_152 DET_SNR_152 DET_SUPER_RES_TARGET_152 DET_BI_STATIC_FLAG_152 DET_VALID_FLAG_152 DET_RCS_152 DET_ELEVATION_ERR_152 DET_ELEVATION_152 DET_AZIMUTH_ERR_152 DET_AZIMUTH_152 DET_RANGE_VELOCITY_ERR_152 DET_RANGE_VELOCITY_152 DET_RANGE_ERR_152 DET_RANGE_152;
SIG_GROUP_ 1190 Detections_153_156 1 : DET_MH_CRC16_153_156 DET_MH_CYCLE_COUNTER_153_156 DET_MH_SCAN_INDEX_4LSB_153_156 DET_CONFD_ELEVATION_153 DET_CONFD_AZIMUTH_153 DET_HVC_FLAG_153 DET_OUTSIDE_SECTOR_153 DET_EXISTENCE_PROB_153 DET_POINT_TARGET_PROB_153 DET_SNR_153 DET_SUPER_RES_TARGET_153 DET_BI_STATIC_FLAG_153 DET_VALID_FLAG_153 DET_RCS_153 DET_ELEVATION_ERR_153 DET_ELEVATION_153 DET_AZIMUTH_ERR_153 DET_AZIMUTH_153 DET_RANGE_VELOCITY_ERR_153 DET_RANGE_VELOCITY_153 DET_RANGE_ERR_153 DET_RANGE_153 DET_CONFD_ELEVATION_154 DET_CONFD_AZIMUTH_154 DET_HVC_FLAG_154 DET_OUTSIDE_SECTOR_154 DET_EXISTENCE_PROB_154 DET_POINT_TARGET_PROB_154 DET_SNR_154 DET_SUPER_RES_TARGET_154 DET_BI_STATIC_FLAG_154 DET_VALID_FLAG_154 DET_RCS_154 DET_ELEVATION_ERR_154 DET_ELEVATION_154 DET_AZIMUTH_ERR_154 DET_AZIMUTH_154 DET_RANGE_VELOCITY_ERR_154 DET_RANGE_VELOCITY_154 DET_RANGE_ERR_154 DET_RANGE_154 DET_CONFD_ELEVATION_155 DET_CONFD_AZIMUTH_155 DET_HVC_FLAG_155 DET_OUTSIDE_SECTOR_155 DET_EXISTENCE_PROB_155 DET_POINT_TARGET_PROB_155 DET_SNR_155 DET_SUPER_RES_TARGET_155 DET_BI_STATIC_FLAG_155 DET_VALID_FLAG_155 DET_RCS_155 DET_ELEVATION_ERR_155 DET_ELEVATION_155 DET_AZIMUTH_ERR_155 DET_AZIMUTH_155 DET_RANGE_VELOCITY_ERR_155 DET_RANGE_VELOCITY_155 DET_RANGE_ERR_155 DET_RANGE_155 DET_CONFD_ELEVATION_156 DET_CONFD_AZIMUTH_156 DET_HVC_FLAG_156 DET_OUTSIDE_SECTOR_156 DET_EXISTENCE_PROB_156 DET_POINT_TARGET_PROB_156 DET_SNR_156 DET_SUPER_RES_TARGET_156 DET_BI_STATIC_FLAG_156 DET_VALID_FLAG_156 DET_RCS_156 DET_ELEVATION_ERR_156 DET_ELEVATION_156 DET_AZIMUTH_ERR_156 DET_AZIMUTH_156 DET_RANGE_VELOCITY_ERR_156 DET_RANGE_VELOCITY_156 DET_RANGE_ERR_156 DET_RANGE_156;
SIG_GROUP_ 1191 Detections_157_160 1 : DET_MH_CRC16_157_160 DET_MH_CYCLE_COUNTER_157_160 DET_MH_SCAN_INDEX_4LSB_157_160 DET_CONFD_ELEVATION_157 DET_CONFD_AZIMUTH_157 DET_HVC_FLAG_157 DET_OUTSIDE_SECTOR_157 DET_EXISTENCE_PROB_157 DET_POINT_TARGET_PROB_157 DET_SNR_157 DET_SUPER_RES_TARGET_157 DET_BI_STATIC_FLAG_157 DET_VALID_FLAG_157 DET_RCS_157 DET_ELEVATION_ERR_157 DET_ELEVATION_157 DET_AZIMUTH_ERR_157 DET_AZIMUTH_157 DET_RANGE_VELOCITY_ERR_157 DET_RANGE_VELOCITY_157 DET_RANGE_ERR_157 DET_RANGE_157 DET_CONFD_ELEVATION_158 DET_CONFD_AZIMUTH_158 DET_HVC_FLAG_158 DET_OUTSIDE_SECTOR_158 DET_EXISTENCE_PROB_158 DET_POINT_TARGET_PROB_158 DET_SNR_158 DET_SUPER_RES_TARGET_158 DET_BI_STATIC_FLAG_158 DET_VALID_FLAG_158 DET_RCS_158 DET_ELEVATION_ERR_158 DET_ELEVATION_158 DET_AZIMUTH_ERR_158 DET_AZIMUTH_158 DET_RANGE_VELOCITY_ERR_158 DET_RANGE_VELOCITY_158 DET_RANGE_ERR_158 DET_RANGE_158 DET_CONFD_ELEVATION_159 DET_CONFD_AZIMUTH_159 DET_HVC_FLAG_159 DET_OUTSIDE_SECTOR_159 DET_EXISTENCE_PROB_159 DET_POINT_TARGET_PROB_159 DET_SNR_159 DET_SUPER_RES_TARGET_159 DET_BI_STATIC_FLAG_159 DET_VALID_FLAG_159 DET_RCS_159 DET_ELEVATION_ERR_159 DET_ELEVATION_159 DET_AZIMUTH_ERR_159 DET_AZIMUTH_159 DET_RANGE_VELOCITY_ERR_159 DET_RANGE_VELOCITY_159 DET_RANGE_ERR_159 DET_RANGE_159 DET_CONFD_ELEVATION_160 DET_CONFD_AZIMUTH_160 DET_HVC_FLAG_160 DET_OUTSIDE_SECTOR_160 DET_EXISTENCE_PROB_160 DET_POINT_TARGET_PROB_160 DET_SNR_160 DET_SUPER_RES_TARGET_160 DET_BI_STATIC_FLAG_160 DET_VALID_FLAG_160 DET_RCS_160 DET_ELEVATION_ERR_160 DET_ELEVATION_160 DET_AZIMUTH_ERR_160 DET_AZIMUTH_160 DET_RANGE_VELOCITY_ERR_160 DET_RANGE_VELOCITY_160 DET_RANGE_ERR_160 DET_RANGE_160;
SIG_GROUP_ 1192 Detections_161_164 1 : DET_MH_CRC16_161_164 DET_MH_CYCLE_COUNTER_161_164 DET_MH_SCAN_INDEX_4LSB_161_164 DET_CONFD_ELEVATION_161 DET_CONFD_AZIMUTH_161 DET_HVC_FLAG_161 DET_OUTSIDE_SECTOR_161 DET_EXISTENCE_PROB_161 DET_POINT_TARGET_PROB_161 DET_SNR_161 DET_SUPER_RES_TARGET_161 DET_BI_STATIC_FLAG_161 DET_VALID_FLAG_161 DET_RCS_161 DET_ELEVATION_ERR_161 DET_ELEVATION_161 DET_AZIMUTH_ERR_161 DET_AZIMUTH_161 DET_RANGE_VELOCITY_ERR_161 DET_RANGE_VELOCITY_161 DET_RANGE_ERR_161 DET_RANGE_161 DET_CONFD_ELEVATION_162 DET_CONFD_AZIMUTH_162 DET_HVC_FLAG_162 DET_OUTSIDE_SECTOR_162 DET_EXISTENCE_PROB_162 DET_POINT_TARGET_PROB_162 DET_SNR_162 DET_SUPER_RES_TARGET_162 DET_BI_STATIC_FLAG_162 DET_VALID_FLAG_162 DET_RCS_162 DET_ELEVATION_ERR_162 DET_ELEVATION_162 DET_AZIMUTH_ERR_162 DET_AZIMUTH_162 DET_RANGE_VELOCITY_ERR_162 DET_RANGE_VELOCITY_162 DET_RANGE_ERR_162 DET_RANGE_162 DET_CONFD_ELEVATION_163 DET_CONFD_AZIMUTH_163 DET_HVC_FLAG_163 DET_OUTSIDE_SECTOR_163 DET_EXISTENCE_PROB_163 DET_POINT_TARGET_PROB_163 DET_SNR_163 DET_SUPER_RES_TARGET_163 DET_BI_STATIC_FLAG_163 DET_VALID_FLAG_163 DET_RCS_163 DET_ELEVATION_ERR_163 DET_ELEVATION_163 DET_AZIMUTH_ERR_163 DET_AZIMUTH_163 DET_RANGE_VELOCITY_ERR_163 DET_RANGE_VELOCITY_163 DET_RANGE_ERR_163 DET_RANGE_163 DET_CONFD_ELEVATION_164 DET_CONFD_AZIMUTH_164 DET_HVC_FLAG_164 DET_OUTSIDE_SECTOR_164 DET_EXISTENCE_PROB_164 DET_POINT_TARGET_PROB_164 DET_SNR_164 DET_SUPER_RES_TARGET_164 DET_BI_STATIC_FLAG_164 DET_VALID_FLAG_164 DET_RCS_164 DET_ELEVATION_ERR_164 DET_ELEVATION_164 DET_AZIMUTH_ERR_164 DET_AZIMUTH_164 DET_RANGE_VELOCITY_ERR_164 DET_RANGE_VELOCITY_164 DET_RANGE_ERR_164 DET_RANGE_164;
SIG_GROUP_ 1193 Detections_165_168 1 : DET_MH_CRC16_165_168 DET_MH_CYCLE_COUNTER_165_168 DET_MH_SCAN_INDEX_4LSB_165_168 DET_CONFD_ELEVATION_165 DET_CONFD_AZIMUTH_165 DET_HVC_FLAG_165 DET_OUTSIDE_SECTOR_165 DET_EXISTENCE_PROB_165 DET_POINT_TARGET_PROB_165 DET_SNR_165 DET_SUPER_RES_TARGET_165 DET_BI_STATIC_FLAG_165 DET_VALID_FLAG_165 DET_RCS_165 DET_ELEVATION_ERR_165 DET_ELEVATION_165 DET_AZIMUTH_ERR_165 DET_AZIMUTH_165 DET_RANGE_VELOCITY_ERR_165 DET_RANGE_VELOCITY_165 DET_RANGE_ERR_165 DET_RANGE_165 DET_CONFD_ELEVATION_166 DET_CONFD_AZIMUTH_166 DET_HVC_FLAG_166 DET_OUTSIDE_SECTOR_166 DET_EXISTENCE_PROB_166 DET_POINT_TARGET_PROB_166 DET_SNR_166 DET_SUPER_RES_TARGET_166 DET_BI_STATIC_FLAG_166 DET_VALID_FLAG_166 DET_RCS_166 DET_ELEVATION_ERR_166 DET_ELEVATION_166 DET_AZIMUTH_ERR_166 DET_AZIMUTH_166 DET_RANGE_VELOCITY_ERR_166 DET_RANGE_VELOCITY_166 DET_RANGE_ERR_166 DET_RANGE_166 DET_CONFD_ELEVATION_167 DET_CONFD_AZIMUTH_167 DET_HVC_FLAG_167 DET_OUTSIDE_SECTOR_167 DET_EXISTENCE_PROB_167 DET_POINT_TARGET_PROB_167 DET_SNR_167 DET_SUPER_RES_TARGET_167 DET_BI_STATIC_FLAG_167 DET_VALID_FLAG_167 DET_RCS_167 DET_ELEVATION_ERR_167 DET_ELEVATION_167 DET_AZIMUTH_ERR_167 DET_AZIMUTH_167 DET_RANGE_VELOCITY_ERR_167 DET_RANGE_VELOCITY_167 DET_RANGE_ERR_167 DET_RANGE_167 DET_CONFD_ELEVATION_168 DET_CONFD_AZIMUTH_168 DET_HVC_FLAG_168 DET_OUTSIDE_SECTOR_168 DET_EXISTENCE_PROB_168 DET_POINT_TARGET_PROB_168 DET_SNR_168 DET_SUPER_RES_TARGET_168 DET_BI_STATIC_FLAG_168 DET_VALID_FLAG_168 DET_RCS_168 DET_ELEVATION_ERR_168 DET_ELEVATION_168 DET_AZIMUTH_ERR_168 DET_AZIMUTH_168 DET_RANGE_VELOCITY_ERR_168 DET_RANGE_VELOCITY_168 DET_RANGE_ERR_168 DET_RANGE_168;
SIG_GROUP_ 1194 Detections_169_172 1 : DET_MH_CRC16_169_172 DET_MH_CYCLE_COUNTER_169_172 DET_MH_SCAN_INDEX_4LSB_169_172 DET_CONFD_ELEVATION_169 DET_CONFD_AZIMUTH_169 DET_HVC_FLAG_169 DET_OUTSIDE_SECTOR_169 DET_EXISTENCE_PROB_169 DET_POINT_TARGET_PROB_169 DET_SNR_169 DET_SUPER_RES_TARGET_169 DET_BI_STATIC_FLAG_169 DET_VALID_FLAG_169 DET_RCS_169 DET_ELEVATION_ERR_169 DET_ELEVATION_169 DET_AZIMUTH_ERR_169 DET_AZIMUTH_169 DET_RANGE_VELOCITY_ERR_169 DET_RANGE_VELOCITY_169 DET_RANGE_ERR_169 DET_RANGE_169 DET_CONFD_ELEVATION_170 DET_CONFD_AZIMUTH_170 DET_HVC_FLAG_170 DET_OUTSIDE_SECTOR_170 DET_EXISTENCE_PROB_170 DET_POINT_TARGET_PROB_170 DET_SNR_170 DET_SUPER_RES_TARGET_170 DET_BI_STATIC_FLAG_170 DET_VALID_FLAG_170 DET_RCS_170 DET_ELEVATION_ERR_170 DET_ELEVATION_170 DET_AZIMUTH_ERR_170 DET_AZIMUTH_170 DET_RANGE_VELOCITY_ERR_170 DET_RANGE_VELOCITY_170 DET_RANGE_ERR_170 DET_RANGE_170 DET_CONFD_ELEVATION_171 DET_CONFD_AZIMUTH_171 DET_HVC_FLAG_171 DET_OUTSIDE_SECTOR_171 DET_EXISTENCE_PROB_171 DET_POINT_TARGET_PROB_171 DET_SNR_171 DET_SUPER_RES_TARGET_171 DET_BI_STATIC_FLAG_171 DET_VALID_FLAG_171 DET_RCS_171 DET_ELEVATION_ERR_171 DET_ELEVATION_171 DET_AZIMUTH_ERR_171 DET_AZIMUTH_171 DET_RANGE_VELOCITY_ERR_171 DET_RANGE_VELOCITY_171 DET_RANGE_ERR_171 DET_RANGE_171 DET_CONFD_ELEVATION_172 DET_CONFD_AZIMUTH_172 DET_HVC_FLAG_172 DET_OUTSIDE_SECTOR_172 DET_EXISTENCE_PROB_172 DET_POINT_TARGET_PROB_172 DET_SNR_172 DET_SUPER_RES_TARGET_172 DET_BI_STATIC_FLAG_172 DET_VALID_FLAG_172 DET_RCS_172 DET_ELEVATION_ERR_172 DET_ELEVATION_172 DET_AZIMUTH_ERR_172 DET_AZIMUTH_172 DET_RANGE_VELOCITY_ERR_172 DET_RANGE_VELOCITY_172 DET_RANGE_ERR_172 DET_RANGE_172;
SIG_GROUP_ 1195 Detections_173_176 1 : DET_MH_CRC16_173_176 DET_MH_CYCLE_COUNTER_173_176 DET_MH_SCAN_INDEX_4LSB_173_176 DET_CONFD_ELEVATION_173 DET_CONFD_AZIMUTH_173 DET_HVC_FLAG_173 DET_OUTSIDE_SECTOR_173 DET_EXISTENCE_PROB_173 DET_POINT_TARGET_PROB_173 DET_SNR_173 DET_SUPER_RES_TARGET_173 DET_BI_STATIC_FLAG_173 DET_VALID_FLAG_173 DET_RCS_173 DET_ELEVATION_ERR_173 DET_ELEVATION_173 DET_AZIMUTH_ERR_173 DET_AZIMUTH_173 DET_RANGE_VELOCITY_ERR_173 DET_RANGE_VELOCITY_173 DET_RANGE_ERR_173 DET_RANGE_173 DET_CONFD_ELEVATION_174 DET_CONFD_AZIMUTH_174 DET_HVC_FLAG_174 DET_OUTSIDE_SECTOR_174 DET_EXISTENCE_PROB_174 DET_POINT_TARGET_PROB_174 DET_SNR_174 DET_SUPER_RES_TARGET_174 DET_BI_STATIC_FLAG_174 DET_VALID_FLAG_174 DET_RCS_174 DET_ELEVATION_ERR_174 DET_ELEVATION_174 DET_AZIMUTH_ERR_174 DET_AZIMUTH_174 DET_RANGE_VELOCITY_ERR_174 DET_RANGE_VELOCITY_174 DET_RANGE_ERR_174 DET_RANGE_174 DET_CONFD_ELEVATION_175 DET_CONFD_AZIMUTH_175 DET_HVC_FLAG_175 DET_OUTSIDE_SECTOR_175 DET_EXISTENCE_PROB_175 DET_POINT_TARGET_PROB_175 DET_SNR_175 DET_SUPER_RES_TARGET_175 DET_BI_STATIC_FLAG_175 DET_VALID_FLAG_175 DET_RCS_175 DET_ELEVATION_ERR_175 DET_ELEVATION_175 DET_AZIMUTH_ERR_175 DET_AZIMUTH_175 DET_RANGE_VELOCITY_ERR_175 DET_RANGE_VELOCITY_175 DET_RANGE_ERR_175 DET_RANGE_175 DET_CONFD_ELEVATION_176 DET_CONFD_AZIMUTH_176 DET_HVC_FLAG_176 DET_OUTSIDE_SECTOR_176 DET_EXISTENCE_PROB_176 DET_POINT_TARGET_PROB_176 DET_SNR_176 DET_SUPER_RES_TARGET_176 DET_BI_STATIC_FLAG_176 DET_VALID_FLAG_176 DET_RCS_176 DET_ELEVATION_ERR_176 DET_ELEVATION_176 DET_AZIMUTH_ERR_176 DET_AZIMUTH_176 DET_RANGE_VELOCITY_ERR_176 DET_RANGE_VELOCITY_176 DET_RANGE_ERR_176 DET_RANGE_176;
SIG_GROUP_ 1196 Detections_177_180 1 : DET_MH_CRC16_177_180 DET_MH_CYCLE_COUNTER_177_180 DET_MH_SCAN_INDEX_4LSB_177_180 DET_CONFD_ELEVATION_177 DET_CONFD_AZIMUTH_177 DET_HVC_FLAG_177 DET_OUTSIDE_SECTOR_177 DET_EXISTENCE_PROB_177 DET_POINT_TARGET_PROB_177 DET_SNR_177 DET_SUPER_RES_TARGET_177 DET_BI_STATIC_FLAG_177 DET_VALID_FLAG_177 DET_RCS_177 DET_ELEVATION_ERR_177 DET_ELEVATION_177 DET_AZIMUTH_ERR_177 DET_AZIMUTH_177 DET_RANGE_VELOCITY_ERR_177 DET_RANGE_VELOCITY_177 DET_RANGE_ERR_177 DET_RANGE_177 DET_CONFD_ELEVATION_178 DET_CONFD_AZIMUTH_178 DET_HVC_FLAG_178 DET_OUTSIDE_SECTOR_178 DET_EXISTENCE_PROB_178 DET_POINT_TARGET_PROB_178 DET_SNR_178 DET_SUPER_RES_TARGET_178 DET_BI_STATIC_FLAG_178 DET_VALID_FLAG_178 DET_RCS_178 DET_ELEVATION_ERR_178 DET_ELEVATION_178 DET_AZIMUTH_ERR_178 DET_AZIMUTH_178 DET_RANGE_VELOCITY_ERR_178 DET_RANGE_VELOCITY_178 DET_RANGE_ERR_178 DET_RANGE_178 DET_CONFD_ELEVATION_179 DET_CONFD_AZIMUTH_179 DET_HVC_FLAG_179 DET_OUTSIDE_SECTOR_179 DET_EXISTENCE_PROB_179 DET_POINT_TARGET_PROB_179 DET_SNR_179 DET_SUPER_RES_TARGET_179 DET_BI_STATIC_FLAG_179 DET_VALID_FLAG_179 DET_RCS_179 DET_ELEVATION_ERR_179 DET_ELEVATION_179 DET_AZIMUTH_ERR_179 DET_AZIMUTH_179 DET_RANGE_VELOCITY_ERR_179 DET_RANGE_VELOCITY_179 DET_RANGE_ERR_179 DET_RANGE_179 DET_CONFD_ELEVATION_180 DET_CONFD_AZIMUTH_180 DET_HVC_FLAG_180 DET_OUTSIDE_SECTOR_180 DET_EXISTENCE_PROB_180 DET_POINT_TARGET_PROB_180 DET_SNR_180 DET_SUPER_RES_TARGET_180 DET_BI_STATIC_FLAG_180 DET_VALID_FLAG_180 DET_RCS_180 DET_ELEVATION_ERR_180 DET_ELEVATION_180 DET_AZIMUTH_ERR_180 DET_AZIMUTH_180 DET_RANGE_VELOCITY_ERR_180 DET_RANGE_VELOCITY_180 DET_RANGE_ERR_180 DET_RANGE_180;
SIG_GROUP_ 1197 Detections_181_184 1 : DET_MH_CRC16_181_184 DET_MH_CYCLE_COUNTER_181_184 DET_MH_SCAN_INDEX_4LSB_181_184 DET_CONFD_ELEVATION_181 DET_CONFD_AZIMUTH_181 DET_HVC_FLAG_181 DET_OUTSIDE_SECTOR_181 DET_EXISTENCE_PROB_181 DET_POINT_TARGET_PROB_181 DET_SNR_181 DET_SUPER_RES_TARGET_181 DET_BI_STATIC_FLAG_181 DET_VALID_FLAG_181 DET_RCS_181 DET_ELEVATION_ERR_181 DET_ELEVATION_181 DET_AZIMUTH_ERR_181 DET_AZIMUTH_181 DET_RANGE_VELOCITY_ERR_181 DET_RANGE_VELOCITY_181 DET_RANGE_ERR_181 DET_RANGE_181 DET_CONFD_ELEVATION_182 DET_CONFD_AZIMUTH_182 DET_HVC_FLAG_182 DET_OUTSIDE_SECTOR_182 DET_EXISTENCE_PROB_182 DET_POINT_TARGET_PROB_182 DET_SNR_182 DET_SUPER_RES_TARGET_182 DET_BI_STATIC_FLAG_182 DET_VALID_FLAG_182 DET_RCS_182 DET_ELEVATION_ERR_182 DET_ELEVATION_182 DET_AZIMUTH_ERR_182 DET_AZIMUTH_182 DET_RANGE_VELOCITY_ERR_182 DET_RANGE_VELOCITY_182 DET_RANGE_ERR_182 DET_RANGE_182 DET_CONFD_ELEVATION_183 DET_CONFD_AZIMUTH_183 DET_HVC_FLAG_183 DET_OUTSIDE_SECTOR_183 DET_EXISTENCE_PROB_183 DET_POINT_TARGET_PROB_183 DET_SNR_183 DET_SUPER_RES_TARGET_183 DET_BI_STATIC_FLAG_183 DET_VALID_FLAG_183 DET_RCS_183 DET_ELEVATION_ERR_183 DET_ELEVATION_183 DET_AZIMUTH_ERR_183 DET_AZIMUTH_183 DET_RANGE_VELOCITY_ERR_183 DET_RANGE_VELOCITY_183 DET_RANGE_ERR_183 DET_RANGE_183 DET_CONFD_ELEVATION_184 DET_CONFD_AZIMUTH_184 DET_HVC_FLAG_184 DET_OUTSIDE_SECTOR_184 DET_EXISTENCE_PROB_184 DET_POINT_TARGET_PROB_184 DET_SNR_184 DET_SUPER_RES_TARGET_184 DET_BI_STATIC_FLAG_184 DET_VALID_FLAG_184 DET_RCS_184 DET_ELEVATION_ERR_184 DET_ELEVATION_184 DET_AZIMUTH_ERR_184 DET_AZIMUTH_184 DET_RANGE_VELOCITY_ERR_184 DET_RANGE_VELOCITY_184 DET_RANGE_ERR_184 DET_RANGE_184;
SIG_GROUP_ 1198 Detections_185_188 1 : DET_MH_CRC16_185_188 DET_MH_CYCLE_COUNTER_185_188 DET_MH_SCAN_INDEX_4LSB_185_188 DET_CONFD_ELEVATION_185 DET_CONFD_AZIMUTH_185 DET_HVC_FLAG_185 DET_OUTSIDE_SECTOR_185 DET_EXISTENCE_PROB_185 DET_POINT_TARGET_PROB_185 DET_SNR_185 DET_SUPER_RES_TARGET_185 DET_BI_STATIC_FLAG_185 DET_VALID_FLAG_185 DET_RCS_185 DET_ELEVATION_ERR_185 DET_ELEVATION_185 DET_AZIMUTH_ERR_185 DET_AZIMUTH_185 DET_RANGE_VELOCITY_ERR_185 DET_RANGE_VELOCITY_185 DET_RANGE_ERR_185 DET_RANGE_185 DET_CONFD_ELEVATION_186 DET_CONFD_AZIMUTH_186 DET_HVC_FLAG_186 DET_OUTSIDE_SECTOR_186 DET_EXISTENCE_PROB_186 DET_POINT_TARGET_PROB_186 DET_SNR_186 DET_SUPER_RES_TARGET_186 DET_BI_STATIC_FLAG_186 DET_VALID_FLAG_186 DET_RCS_186 DET_ELEVATION_ERR_186 DET_ELEVATION_186 DET_AZIMUTH_ERR_186 DET_AZIMUTH_186 DET_RANGE_VELOCITY_ERR_186 DET_RANGE_VELOCITY_186 DET_RANGE_ERR_186 DET_RANGE_186 DET_CONFD_ELEVATION_187 DET_CONFD_AZIMUTH_187 DET_HVC_FLAG_187 DET_OUTSIDE_SECTOR_187 DET_EXISTENCE_PROB_187 DET_POINT_TARGET_PROB_187 DET_SNR_187 DET_SUPER_RES_TARGET_187 DET_BI_STATIC_FLAG_187 DET_VALID_FLAG_187 DET_RCS_187 DET_ELEVATION_ERR_187 DET_ELEVATION_187 DET_AZIMUTH_ERR_187 DET_AZIMUTH_187 DET_RANGE_VELOCITY_ERR_187 DET_RANGE_VELOCITY_187 DET_RANGE_ERR_187 DET_RANGE_187 DET_CONFD_ELEVATION_188 DET_CONFD_AZIMUTH_188 DET_HVC_FLAG_188 DET_OUTSIDE_SECTOR_188 DET_EXISTENCE_PROB_188 DET_POINT_TARGET_PROB_188 DET_SNR_188 DET_SUPER_RES_TARGET_188 DET_BI_STATIC_FLAG_188 DET_VALID_FLAG_188 DET_RCS_188 DET_ELEVATION_ERR_188 DET_ELEVATION_188 DET_AZIMUTH_ERR_188 DET_AZIMUTH_188 DET_RANGE_VELOCITY_ERR_188 DET_RANGE_VELOCITY_188 DET_RANGE_ERR_188 DET_RANGE_188;

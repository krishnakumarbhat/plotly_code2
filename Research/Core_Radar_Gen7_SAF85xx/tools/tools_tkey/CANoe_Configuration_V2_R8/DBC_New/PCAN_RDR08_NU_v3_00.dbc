VERSION "created by canmatrix"

NS_ :

BS_:

BU_: External_Tool ADAS RDR08

BO_ 1235 RDR_DETECTION_333_336: 64 RDR08
 SG_ DET_RANGE_333 : 24|15@1+ (0.015625,0) [0|500] "m"  ADAS
 SG_ DET_RANGE_ERR_333 : 40|7@1+ (0.0075,0) [0|0.9525] "m"  ADAS
 SG_ DET_RANGE_VELOCITY_333 : 48|15@1+ (0.0078125,-128) [-128|127.9921875] "m/s"  ADAS
 SG_ DET_RANGE_VELOCITY_ERR_333 : 64|8@1+ (0.003,0) [0|0.765] "m/s"  ADAS
 SG_ DET_AZIMUTH_333 : 88|13@1+ (0.0004,-1.5708) [-1.5708|1.5708] "rad"  ADAS
 SG_ DET_AZIMUTH_ERR_333 : 105|7@1+ (0.00087267,0) [0|0.11082909] "rad"  ADAS
 SG_ DET_ELEVATION_333 : 72|8@1+ (0.00275,-0.34925) [-0.34925|0.34925] "rad"  ADAS
 SG_ DET_ELEVATION_ERR_333 : 80|6@1+ (0.00174533,0) [0|0.10995579] "rad"  ADAS
 SG_ DET_RCS_333 : 136|8@1+ (0.5,-64) [-64|63.5] "dBsm"  ADAS
 SG_ DET_VALID_FLAG_333 : 119|1@1+ (1,0) [0|1] ""  ADAS
 SG_ DET_BI_STATIC_FLAG_333 : 504|1@1+ (1,0) [0|1] ""  ADAS
 SG_ DET_SUPER_RES_TARGET_333 : 104|1@1+ (1,0) [0|1] ""  ADAS
 SG_ DET_SNR_333 : 128|8@1+ (0.35156,0) [0|89.6478] "dB"  ADAS
 SG_ DET_POINT_TARGET_PROB_333 : 114|4@1+ (6.67,0) [0|100] "%"  ADAS
 SG_ DET_EXISTENCE_PROB_333 : 120|6@1+ (1.588,0) [0|100] "%"  ADAS
 SG_ DET_OUTSIDE_SECTOR_333 : 159|1@1+ (1,0) [0|1] ""  ADAS
 SG_ DET_HVC_FLAG_333 : 118|1@1+ (1,0) [0|1] ""  ADAS
 SG_ DET_CONFD_AZIMUTH_333 : 126|2@1+ (1,0) [0|3] ""  ADAS
 SG_ DET_CONFD_ELEVATION_333 : 112|2@1+ (1,0) [0|3] ""  ADAS
 SG_ DET_RANGE_334 : 144|15@1+ (0.015625,0) [0|500] "m"  ADAS
 SG_ DET_RANGE_ERR_334 : 160|7@1+ (0.0075,0) [0|0.9525] "m"  ADAS
 SG_ DET_RANGE_VELOCITY_334 : 168|15@1+ (0.0078125,-128) [-128|127.9921875] "m/s"  ADAS
 SG_ DET_RANGE_VELOCITY_ERR_334 : 184|8@1+ (0.003,0) [0|0.765] "m/s"  ADAS
 SG_ DET_AZIMUTH_334 : 208|13@1+ (0.0004,-1.5708) [-1.5708|1.5708] "rad"  ADAS
 SG_ DET_AZIMUTH_ERR_334 : 224|7@1+ (0.00087267,0) [0|0.11082909] "rad"  ADAS
 SG_ DET_ELEVATION_334 : 192|8@1+ (0.00275,-0.34925) [-0.34925|0.34925] "rad"  ADAS
 SG_ DET_ELEVATION_ERR_334 : 200|6@1+ (0.00174533,0) [0|0.10995579] "rad"  ADAS
 SG_ DET_RCS_334 : 256|8@1+ (0.5,-64) [-64|63.5] "dBsm"  ADAS
 SG_ DET_VALID_FLAG_334 : 167|1@1+ (1,0) [0|1] ""  ADAS
 SG_ DET_BI_STATIC_FLAG_334 : 505|1@1+ (1,0) [0|1] ""  ADAS
 SG_ DET_SUPER_RES_TARGET_334 : 247|1@1+ (1,0) [0|1] ""  ADAS
 SG_ DET_SNR_334 : 248|8@1+ (0.35156,0) [0|89.6478] "dB"  ADAS
 SG_ DET_POINT_TARGET_PROB_334 : 240|4@1+ (6.67,0) [0|100] "%"  ADAS
 SG_ DET_EXISTENCE_PROB_334 : 232|6@1+ (1.588,0) [0|100] "%"  ADAS
 SG_ DET_OUTSIDE_SECTOR_334 : 183|1@1+ (1,0) [0|1] ""  ADAS
 SG_ DET_HVC_FLAG_334 : 246|1@1+ (1,0) [0|1] ""  ADAS
 SG_ DET_CONFD_AZIMUTH_334 : 206|2@1+ (1,0) [0|3] ""  ADAS
 SG_ DET_CONFD_ELEVATION_334 : 244|2@1+ (1,0) [0|3] ""  ADAS
 SG_ DET_RANGE_335 : 264|15@1+ (0.015625,0) [0|500] "m"  ADAS
 SG_ DET_RANGE_ERR_335 : 280|7@1+ (0.0075,0) [0|0.9525] "m"  ADAS
 SG_ DET_RANGE_VELOCITY_335 : 288|15@1+ (0.0078125,-128) [-128|127.9921875] "m/s"  ADAS
 SG_ DET_RANGE_VELOCITY_ERR_335 : 304|8@1+ (0.003,0) [0|0.765] "m/s"  ADAS
 SG_ DET_AZIMUTH_335 : 328|13@1+ (0.0004,-1.5708) [-1.5708|1.5708] "rad"  ADAS
 SG_ DET_AZIMUTH_ERR_335 : 345|7@1+ (0.00087267,0) [0|0.11082909] "rad"  ADAS
 SG_ DET_ELEVATION_335 : 312|8@1+ (0.00275,-0.34925) [-0.34925|0.34925] "rad"  ADAS
 SG_ DET_ELEVATION_ERR_335 : 320|6@1+ (0.00174533,0) [0|0.10995579] "rad"  ADAS
 SG_ DET_RCS_335 : 376|8@1+ (0.5,-64) [-64|63.5] "dBsm"  ADAS
 SG_ DET_VALID_FLAG_335 : 399|1@1+ (1,0) [0|1] ""  ADAS
 SG_ DET_BI_STATIC_FLAG_335 : 482|1@1+ (1,0) [0|1] ""  ADAS
 SG_ DET_SUPER_RES_TARGET_335 : 344|1@1+ (1,0) [0|1] ""  ADAS
 SG_ DET_SNR_335 : 368|8@1+ (0.35156,0) [0|89.6478] "dB"  ADAS
 SG_ DET_POINT_TARGET_PROB_335 : 360|4@1+ (6.67,0) [0|100] "%"  ADAS
 SG_ DET_EXISTENCE_PROB_335 : 352|6@1+ (1.588,0) [0|100] "%"  ADAS
 SG_ DET_OUTSIDE_SECTOR_335 : 407|1@1+ (1,0) [0|1] ""  ADAS
 SG_ DET_HVC_FLAG_335 : 364|1@1+ (1,0) [0|1] ""  ADAS
 SG_ DET_CONFD_AZIMUTH_335 : 365|2@1+ (1,0) [0|3] ""  ADAS
 SG_ DET_CONFD_ELEVATION_335 : 358|2@1+ (1,0) [0|3] ""  ADAS
 SG_ DET_RANGE_336 : 384|15@1+ (0.015625,0) [0|500] "m"  ADAS
 SG_ DET_RANGE_ERR_336 : 400|7@1+ (0.0075,0) [0|0.9525] "m"  ADAS
 SG_ DET_RANGE_VELOCITY_336 : 408|15@1+ (0.0078125,-128) [-128|127.9921875] "m/s"  ADAS
 SG_ DET_RANGE_VELOCITY_ERR_336 : 424|8@1+ (0.003,0) [0|0.765] "m/s"  ADAS
 SG_ DET_AZIMUTH_336 : 448|13@1+ (0.0004,-1.5708) [-1.5708|1.5708] "rad"  ADAS
 SG_ DET_AZIMUTH_ERR_336 : 465|7@1+ (0.00087267,0) [0|0.11082909] "rad"  ADAS
 SG_ DET_ELEVATION_336 : 432|8@1+ (0.00275,-0.34925) [-0.34925|0.34925] "rad"  ADAS
 SG_ DET_ELEVATION_ERR_336 : 440|6@1+ (0.00174533,0) [0|0.10995579] "rad"  ADAS
 SG_ DET_RCS_336 : 496|8@1+ (0.5,-64) [-64|63.5] "dBsm"  ADAS
 SG_ DET_VALID_FLAG_336 : 485|1@1+ (1,0) [0|1] ""  ADAS
 SG_ DET_BI_STATIC_FLAG_336 : 483|1@1+ (1,0) [0|1] ""  ADAS
 SG_ DET_SUPER_RES_TARGET_336 : 446|1@1+ (1,0) [0|1] ""  ADAS
 SG_ DET_SNR_336 : 488|8@1+ (0.35156,0) [0|89.6478] "dB"  ADAS
 SG_ DET_POINT_TARGET_PROB_336 : 472|4@1+ (6.67,0) [0|100] "%"  ADAS
 SG_ DET_EXISTENCE_PROB_336 : 506|6@1+ (1.588,0) [0|100] "%"  ADAS
 SG_ DET_OUTSIDE_SECTOR_336 : 481|1@1+ (1,0) [0|1] ""  ADAS
 SG_ DET_HVC_FLAG_336 : 464|1@1+ (1,0) [0|1] ""  ADAS
 SG_ DET_CONFD_AZIMUTH_336 : 486|2@1+ (1,0) [0|3] ""  ADAS
 SG_ DET_CONFD_ELEVATION_336 : 461|2@1+ (1,0) [0|3] ""  ADAS
 SG_ DET_MH_SCAN_INDEX_4LSB_333_336 : 476|4@1+ (1,0) [0|15] ""  ADAS
 SG_ DET_MH_CYCLE_COUNTER_333_336 : 16|8@1+ (1,0) [0|255] ""  ADAS
 SG_ DET_MH_CRC16_333_336 : 0|16@1+ (1,0) [0|65535] ""  ADAS

BO_ 1236 RDR_DETECTION_337_340: 64 RDR08
 SG_ DET_RANGE_337 : 24|15@1+ (0.015625,0) [0|500] "m"  ADAS
 SG_ DET_RANGE_ERR_337 : 40|7@1+ (0.0075,0) [0|0.9525] "m"  ADAS
 SG_ DET_RANGE_VELOCITY_337 : 48|15@1+ (0.0078125,-128) [-128|127.9921875] "m/s"  ADAS
 SG_ DET_RANGE_VELOCITY_ERR_337 : 64|8@1+ (0.003,0) [0|0.765] "m/s"  ADAS
 SG_ DET_AZIMUTH_337 : 88|13@1+ (0.0004,-1.5708) [-1.5708|1.5708] "rad"  ADAS
 SG_ DET_AZIMUTH_ERR_337 : 105|7@1+ (0.00087267,0) [0|0.11082909] "rad"  ADAS
 SG_ DET_ELEVATION_337 : 72|8@1+ (0.00275,-0.34925) [-0.34925|0.34925] "rad"  ADAS
 SG_ DET_ELEVATION_ERR_337 : 80|6@1+ (0.00174533,0) [0|0.10995579] "rad"  ADAS
 SG_ DET_RCS_337 : 136|8@1+ (0.5,-64) [-64|63.5] "dBsm"  ADAS
 SG_ DET_VALID_FLAG_337 : 119|1@1+ (1,0) [0|1] ""  ADAS
 SG_ DET_BI_STATIC_FLAG_337 : 504|1@1+ (1,0) [0|1] ""  ADAS
 SG_ DET_SUPER_RES_TARGET_337 : 104|1@1+ (1,0) [0|1] ""  ADAS
 SG_ DET_SNR_337 : 128|8@1+ (0.35156,0) [0|89.6478] "dB"  ADAS
 SG_ DET_POINT_TARGET_PROB_337 : 114|4@1+ (6.67,0) [0|100] "%"  ADAS
 SG_ DET_EXISTENCE_PROB_337 : 120|6@1+ (1.588,0) [0|100] "%"  ADAS
 SG_ DET_OUTSIDE_SECTOR_337 : 159|1@1+ (1,0) [0|1] ""  ADAS
 SG_ DET_HVC_FLAG_337 : 118|1@1+ (1,0) [0|1] ""  ADAS
 SG_ DET_CONFD_AZIMUTH_337 : 126|2@1+ (1,0) [0|3] ""  ADAS
 SG_ DET_CONFD_ELEVATION_337 : 112|2@1+ (1,0) [0|3] ""  ADAS
 SG_ DET_RANGE_338 : 144|15@1+ (0.015625,0) [0|500] "m"  ADAS
 SG_ DET_RANGE_ERR_338 : 160|7@1+ (0.0075,0) [0|0.9525] "m"  ADAS
 SG_ DET_RANGE_VELOCITY_338 : 168|15@1+ (0.0078125,-128) [-128|127.9921875] "m/s"  ADAS
 SG_ DET_RANGE_VELOCITY_ERR_338 : 184|8@1+ (0.003,0) [0|0.765] "m/s"  ADAS
 SG_ DET_AZIMUTH_338 : 208|13@1+ (0.0004,-1.5708) [-1.5708|1.5708] "rad"  ADAS
 SG_ DET_AZIMUTH_ERR_338 : 224|7@1+ (0.00087267,0) [0|0.11082909] "rad"  ADAS
 SG_ DET_ELEVATION_338 : 192|8@1+ (0.00275,-0.34925) [-0.34925|0.34925] "rad"  ADAS
 SG_ DET_ELEVATION_ERR_338 : 200|6@1+ (0.00174533,0) [0|0.10995579] "rad"  ADAS
 SG_ DET_RCS_338 : 256|8@1+ (0.5,-64) [-64|63.5] "dBsm"  ADAS
 SG_ DET_VALID_FLAG_338 : 167|1@1+ (1,0) [0|1] ""  ADAS
 SG_ DET_BI_STATIC_FLAG_338 : 505|1@1+ (1,0) [0|1] ""  ADAS
 SG_ DET_SUPER_RES_TARGET_338 : 247|1@1+ (1,0) [0|1] ""  ADAS
 SG_ DET_SNR_338 : 248|8@1+ (0.35156,0) [0|89.6478] "dB"  ADAS
 SG_ DET_POINT_TARGET_PROB_338 : 240|4@1+ (6.67,0) [0|100] "%"  ADAS
 SG_ DET_EXISTENCE_PROB_338 : 232|6@1+ (1.588,0) [0|100] "%"  ADAS
 SG_ DET_OUTSIDE_SECTOR_338 : 183|1@1+ (1,0) [0|1] ""  ADAS
 SG_ DET_HVC_FLAG_338 : 246|1@1+ (1,0) [0|1] ""  ADAS
 SG_ DET_CONFD_AZIMUTH_338 : 206|2@1+ (1,0) [0|3] ""  ADAS
 SG_ DET_CONFD_ELEVATION_338 : 244|2@1+ (1,0) [0|3] ""  ADAS
 SG_ DET_RANGE_339 : 264|15@1+ (0.015625,0) [0|500] "m"  ADAS
 SG_ DET_RANGE_ERR_339 : 280|7@1+ (0.0075,0) [0|0.9525] "m"  ADAS
 SG_ DET_RANGE_VELOCITY_339 : 288|15@1+ (0.0078125,-128) [-128|127.9921875] "m/s"  ADAS
 SG_ DET_RANGE_VELOCITY_ERR_339 : 304|8@1+ (0.003,0) [0|0.765] "m/s"  ADAS
 SG_ DET_AZIMUTH_339 : 328|13@1+ (0.0004,-1.5708) [-1.5708|1.5708] "rad"  ADAS
 SG_ DET_AZIMUTH_ERR_339 : 345|7@1+ (0.00087267,0) [0|0.11082909] "rad"  ADAS
 SG_ DET_ELEVATION_339 : 312|8@1+ (0.00275,-0.34925) [-0.34925|0.34925] "rad"  ADAS
 SG_ DET_ELEVATION_ERR_339 : 320|6@1+ (0.00174533,0) [0|0.10995579] "rad"  ADAS
 SG_ DET_RCS_339 : 376|8@1+ (0.5,-64) [-64|63.5] "dBsm"  ADAS
 SG_ DET_VALID_FLAG_339 : 399|1@1+ (1,0) [0|1] ""  ADAS
 SG_ DET_BI_STATIC_FLAG_339 : 482|1@1+ (1,0) [0|1] ""  ADAS
 SG_ DET_SUPER_RES_TARGET_339 : 344|1@1+ (1,0) [0|1] ""  ADAS
 SG_ DET_SNR_339 : 368|8@1+ (0.35156,0) [0|89.6478] "dB"  ADAS
 SG_ DET_POINT_TARGET_PROB_339 : 360|4@1+ (6.67,0) [0|100] "%"  ADAS
 SG_ DET_EXISTENCE_PROB_339 : 352|6@1+ (1.588,0) [0|100] "%"  ADAS
 SG_ DET_OUTSIDE_SECTOR_339 : 407|1@1+ (1,0) [0|1] ""  ADAS
 SG_ DET_HVC_FLAG_339 : 364|1@1+ (1,0) [0|1] ""  ADAS
 SG_ DET_CONFD_AZIMUTH_339 : 365|2@1+ (1,0) [0|3] ""  ADAS
 SG_ DET_CONFD_ELEVATION_339 : 358|2@1+ (1,0) [0|3] ""  ADAS
 SG_ DET_RANGE_340 : 384|15@1+ (0.015625,0) [0|500] "m"  ADAS
 SG_ DET_RANGE_ERR_340 : 400|7@1+ (0.0075,0) [0|0.9525] "m"  ADAS
 SG_ DET_RANGE_VELOCITY_340 : 408|15@1+ (0.0078125,-128) [-128|127.9921875] "m/s"  ADAS
 SG_ DET_RANGE_VELOCITY_ERR_340 : 424|8@1+ (0.003,0) [0|0.765] "m/s"  ADAS
 SG_ DET_AZIMUTH_340 : 448|13@1+ (0.0004,-1.5708) [-1.5708|1.5708] "rad"  ADAS
 SG_ DET_AZIMUTH_ERR_340 : 465|7@1+ (0.00087267,0) [0|0.11082909] "rad"  ADAS
 SG_ DET_ELEVATION_340 : 432|8@1+ (0.00275,-0.34925) [-0.34925|0.34925] "rad"  ADAS
 SG_ DET_ELEVATION_ERR_340 : 440|6@1+ (0.00174533,0) [0|0.10995579] "rad"  ADAS
 SG_ DET_RCS_340 : 496|8@1+ (0.5,-64) [-64|63.5] "dBsm"  ADAS
 SG_ DET_VALID_FLAG_340 : 485|1@1+ (1,0) [0|1] ""  ADAS
 SG_ DET_BI_STATIC_FLAG_340 : 483|1@1+ (1,0) [0|1] ""  ADAS
 SG_ DET_SUPER_RES_TARGET_340 : 446|1@1+ (1,0) [0|1] ""  ADAS
 SG_ DET_SNR_340 : 488|8@1+ (0.35156,0) [0|89.6478] "dB"  ADAS
 SG_ DET_POINT_TARGET_PROB_340 : 472|4@1+ (6.67,0) [0|100] "%"  ADAS
 SG_ DET_EXISTENCE_PROB_340 : 506|6@1+ (1.588,0) [0|100] "%"  ADAS
 SG_ DET_OUTSIDE_SECTOR_340 : 481|1@1+ (1,0) [0|1] ""  ADAS
 SG_ DET_HVC_FLAG_340 : 464|1@1+ (1,0) [0|1] ""  ADAS
 SG_ DET_CONFD_AZIMUTH_340 : 486|2@1+ (1,0) [0|3] ""  ADAS
 SG_ DET_CONFD_ELEVATION_340 : 461|2@1+ (1,0) [0|3] ""  ADAS
 SG_ DET_MH_SCAN_INDEX_4LSB_337_340 : 476|4@1+ (1,0) [0|15] ""  ADAS
 SG_ DET_MH_CYCLE_COUNTER_337_340 : 16|8@1+ (1,0) [0|255] ""  ADAS
 SG_ DET_MH_CRC16_337_340 : 0|16@1+ (1,0) [0|65535] ""  ADAS

BO_ 1237 RDR_DETECTION_341_344: 64 RDR08
 SG_ DET_RANGE_341 : 24|15@1+ (0.015625,0) [0|500] "m"  ADAS
 SG_ DET_RANGE_ERR_341 : 40|7@1+ (0.0075,0) [0|0.9525] "m"  ADAS
 SG_ DET_RANGE_VELOCITY_341 : 48|15@1+ (0.0078125,-128) [-128|127.9921875] "m/s"  ADAS
 SG_ DET_RANGE_VELOCITY_ERR_341 : 64|8@1+ (0.003,0) [0|0.765] "m/s"  ADAS
 SG_ DET_AZIMUTH_341 : 88|13@1+ (0.0004,-1.5708) [-1.5708|1.5708] "rad"  ADAS
 SG_ DET_AZIMUTH_ERR_341 : 105|7@1+ (0.00087267,0) [0|0.11082909] "rad"  ADAS
 SG_ DET_ELEVATION_341 : 72|8@1+ (0.00275,-0.34925) [-0.34925|0.34925] "rad"  ADAS
 SG_ DET_ELEVATION_ERR_341 : 80|6@1+ (0.00174533,0) [0|0.10995579] "rad"  ADAS
 SG_ DET_RCS_341 : 136|8@1+ (0.5,-64) [-64|63.5] "dBsm"  ADAS
 SG_ DET_VALID_FLAG_341 : 119|1@1+ (1,0) [0|1] ""  ADAS
 SG_ DET_BI_STATIC_FLAG_341 : 504|1@1+ (1,0) [0|1] ""  ADAS
 SG_ DET_SUPER_RES_TARGET_341 : 104|1@1+ (1,0) [0|1] ""  ADAS
 SG_ DET_SNR_341 : 128|8@1+ (0.35156,0) [0|89.6478] "dB"  ADAS
 SG_ DET_POINT_TARGET_PROB_341 : 114|4@1+ (6.67,0) [0|100] "%"  ADAS
 SG_ DET_EXISTENCE_PROB_341 : 120|6@1+ (1.588,0) [0|100] "%"  ADAS
 SG_ DET_OUTSIDE_SECTOR_341 : 159|1@1+ (1,0) [0|1] ""  ADAS
 SG_ DET_HVC_FLAG_341 : 118|1@1+ (1,0) [0|1] ""  ADAS
 SG_ DET_CONFD_AZIMUTH_341 : 126|2@1+ (1,0) [0|3] ""  ADAS
 SG_ DET_CONFD_ELEVATION_341 : 112|2@1+ (1,0) [0|3] ""  ADAS
 SG_ DET_RANGE_342 : 144|15@1+ (0.015625,0) [0|500] "m"  ADAS
 SG_ DET_RANGE_ERR_342 : 160|7@1+ (0.0075,0) [0|0.9525] "m"  ADAS
 SG_ DET_RANGE_VELOCITY_342 : 168|15@1+ (0.0078125,-128) [-128|127.9921875] "m/s"  ADAS
 SG_ DET_RANGE_VELOCITY_ERR_342 : 184|8@1+ (0.003,0) [0|0.765] "m/s"  ADAS
 SG_ DET_AZIMUTH_342 : 208|13@1+ (0.0004,-1.5708) [-1.5708|1.5708] "rad"  ADAS
 SG_ DET_AZIMUTH_ERR_342 : 224|7@1+ (0.00087267,0) [0|0.11082909] "rad"  ADAS
 SG_ DET_ELEVATION_342 : 192|8@1+ (0.00275,-0.34925) [-0.34925|0.34925] "rad"  ADAS
 SG_ DET_ELEVATION_ERR_342 : 200|6@1+ (0.00174533,0) [0|0.10995579] "rad"  ADAS
 SG_ DET_RCS_342 : 256|8@1+ (0.5,-64) [-64|63.5] "dBsm"  ADAS
 SG_ DET_VALID_FLAG_342 : 167|1@1+ (1,0) [0|1] ""  ADAS
 SG_ DET_BI_STATIC_FLAG_342 : 505|1@1+ (1,0) [0|1] ""  ADAS
 SG_ DET_SUPER_RES_TARGET_342 : 247|1@1+ (1,0) [0|1] ""  ADAS
 SG_ DET_SNR_342 : 248|8@1+ (0.35156,0) [0|89.6478] "dB"  ADAS
 SG_ DET_POINT_TARGET_PROB_342 : 240|4@1+ (6.67,0) [0|100] "%"  ADAS
 SG_ DET_EXISTENCE_PROB_342 : 232|6@1+ (1.588,0) [0|100] "%"  ADAS
 SG_ DET_OUTSIDE_SECTOR_342 : 183|1@1+ (1,0) [0|1] ""  ADAS
 SG_ DET_HVC_FLAG_342 : 246|1@1+ (1,0) [0|1] ""  ADAS
 SG_ DET_CONFD_AZIMUTH_342 : 206|2@1+ (1,0) [0|3] ""  ADAS
 SG_ DET_CONFD_ELEVATION_342 : 244|2@1+ (1,0) [0|3] ""  ADAS
 SG_ DET_RANGE_343 : 264|15@1+ (0.015625,0) [0|500] "m"  ADAS
 SG_ DET_RANGE_ERR_343 : 280|7@1+ (0.0075,0) [0|0.9525] "m"  ADAS
 SG_ DET_RANGE_VELOCITY_343 : 288|15@1+ (0.0078125,-128) [-128|127.9921875] "m/s"  ADAS
 SG_ DET_RANGE_VELOCITY_ERR_343 : 304|8@1+ (0.003,0) [0|0.765] "m/s"  ADAS
 SG_ DET_AZIMUTH_343 : 328|13@1+ (0.0004,-1.5708) [-1.5708|1.5708] "rad"  ADAS
 SG_ DET_AZIMUTH_ERR_343 : 345|7@1+ (0.00087267,0) [0|0.11082909] "rad"  ADAS
 SG_ DET_ELEVATION_343 : 312|8@1+ (0.00275,-0.34925) [-0.34925|0.34925] "rad"  ADAS
 SG_ DET_ELEVATION_ERR_343 : 320|6@1+ (0.00174533,0) [0|0.10995579] "rad"  ADAS
 SG_ DET_RCS_343 : 376|8@1+ (0.5,-64) [-64|63.5] "dBsm"  ADAS
 SG_ DET_VALID_FLAG_343 : 399|1@1+ (1,0) [0|1] ""  ADAS
 SG_ DET_BI_STATIC_FLAG_343 : 482|1@1+ (1,0) [0|1] ""  ADAS
 SG_ DET_SUPER_RES_TARGET_343 : 344|1@1+ (1,0) [0|1] ""  ADAS
 SG_ DET_SNR_343 : 368|8@1+ (0.35156,0) [0|89.6478] "dB"  ADAS
 SG_ DET_POINT_TARGET_PROB_343 : 360|4@1+ (6.67,0) [0|100] "%"  ADAS
 SG_ DET_EXISTENCE_PROB_343 : 352|6@1+ (1.588,0) [0|100] "%"  ADAS
 SG_ DET_OUTSIDE_SECTOR_343 : 407|1@1+ (1,0) [0|1] ""  ADAS
 SG_ DET_HVC_FLAG_343 : 364|1@1+ (1,0) [0|1] ""  ADAS
 SG_ DET_CONFD_AZIMUTH_343 : 365|2@1+ (1,0) [0|3] ""  ADAS
 SG_ DET_CONFD_ELEVATION_343 : 358|2@1+ (1,0) [0|3] ""  ADAS
 SG_ DET_RANGE_344 : 384|15@1+ (0.015625,0) [0|500] "m"  ADAS
 SG_ DET_RANGE_ERR_344 : 400|7@1+ (0.0075,0) [0|0.9525] "m"  ADAS
 SG_ DET_RANGE_VELOCITY_344 : 408|15@1+ (0.0078125,-128) [-128|127.9921875] "m/s"  ADAS
 SG_ DET_RANGE_VELOCITY_ERR_344 : 424|8@1+ (0.003,0) [0|0.765] "m/s"  ADAS
 SG_ DET_AZIMUTH_344 : 448|13@1+ (0.0004,-1.5708) [-1.5708|1.5708] "rad"  ADAS
 SG_ DET_AZIMUTH_ERR_344 : 465|7@1+ (0.00087267,0) [0|0.11082909] "rad"  ADAS
 SG_ DET_ELEVATION_344 : 432|8@1+ (0.00275,-0.34925) [-0.34925|0.34925] "rad"  ADAS
 SG_ DET_ELEVATION_ERR_344 : 440|6@1+ (0.00174533,0) [0|0.10995579] "rad"  ADAS
 SG_ DET_RCS_344 : 496|8@1+ (0.5,-64) [-64|63.5] "dBsm"  ADAS
 SG_ DET_VALID_FLAG_344 : 485|1@1+ (1,0) [0|1] ""  ADAS
 SG_ DET_BI_STATIC_FLAG_344 : 483|1@1+ (1,0) [0|1] ""  ADAS
 SG_ DET_SUPER_RES_TARGET_344 : 446|1@1+ (1,0) [0|1] ""  ADAS
 SG_ DET_SNR_344 : 488|8@1+ (0.35156,0) [0|89.6478] "dB"  ADAS
 SG_ DET_POINT_TARGET_PROB_344 : 472|4@1+ (6.67,0) [0|100] "%"  ADAS
 SG_ DET_EXISTENCE_PROB_344 : 506|6@1+ (1.588,0) [0|100] "%"  ADAS
 SG_ DET_OUTSIDE_SECTOR_344 : 481|1@1+ (1,0) [0|1] ""  ADAS
 SG_ DET_HVC_FLAG_344 : 464|1@1+ (1,0) [0|1] ""  ADAS
 SG_ DET_CONFD_AZIMUTH_344 : 486|2@1+ (1,0) [0|3] ""  ADAS
 SG_ DET_CONFD_ELEVATION_344 : 461|2@1+ (1,0) [0|3] ""  ADAS
 SG_ DET_MH_SCAN_INDEX_4LSB_341_344 : 476|4@1+ (1,0) [0|15] ""  ADAS
 SG_ DET_MH_CYCLE_COUNTER_341_344 : 16|8@1+ (1,0) [0|255] ""  ADAS
 SG_ DET_MH_CRC16_341_344 : 0|16@1+ (1,0) [0|65535] ""  ADAS

BO_ 1238 RDR_DETECTION_345_348: 64 RDR08
 SG_ DET_RANGE_345 : 24|15@1+ (0.015625,0) [0|500] "m"  ADAS
 SG_ DET_RANGE_ERR_345 : 40|7@1+ (0.0075,0) [0|0.9525] "m"  ADAS
 SG_ DET_RANGE_VELOCITY_345 : 48|15@1+ (0.0078125,-128) [-128|127.9921875] "m/s"  ADAS
 SG_ DET_RANGE_VELOCITY_ERR_345 : 64|8@1+ (0.003,0) [0|0.765] "m/s"  ADAS
 SG_ DET_AZIMUTH_345 : 88|13@1+ (0.0004,-1.5708) [-1.5708|1.5708] "rad"  ADAS
 SG_ DET_AZIMUTH_ERR_345 : 105|7@1+ (0.00087267,0) [0|0.11082909] "rad"  ADAS
 SG_ DET_ELEVATION_345 : 72|8@1+ (0.00275,-0.34925) [-0.34925|0.34925] "rad"  ADAS
 SG_ DET_ELEVATION_ERR_345 : 80|6@1+ (0.00174533,0) [0|0.10995579] "rad"  ADAS
 SG_ DET_RCS_345 : 136|8@1+ (0.5,-64) [-64|63.5] "dBsm"  ADAS
 SG_ DET_VALID_FLAG_345 : 119|1@1+ (1,0) [0|1] ""  ADAS
 SG_ DET_BI_STATIC_FLAG_345 : 504|1@1+ (1,0) [0|1] ""  ADAS
 SG_ DET_SUPER_RES_TARGET_345 : 104|1@1+ (1,0) [0|1] ""  ADAS
 SG_ DET_SNR_345 : 128|8@1+ (0.35156,0) [0|89.6478] "dB"  ADAS
 SG_ DET_POINT_TARGET_PROB_345 : 114|4@1+ (6.67,0) [0|100] "%"  ADAS
 SG_ DET_EXISTENCE_PROB_345 : 120|6@1+ (1.588,0) [0|100] "%"  ADAS
 SG_ DET_OUTSIDE_SECTOR_345 : 159|1@1+ (1,0) [0|1] ""  ADAS
 SG_ DET_HVC_FLAG_345 : 118|1@1+ (1,0) [0|1] ""  ADAS
 SG_ DET_CONFD_AZIMUTH_345 : 126|2@1+ (1,0) [0|3] ""  ADAS
 SG_ DET_CONFD_ELEVATION_345 : 112|2@1+ (1,0) [0|3] ""  ADAS
 SG_ DET_RANGE_346 : 144|15@1+ (0.015625,0) [0|500] "m"  ADAS
 SG_ DET_RANGE_ERR_346 : 160|7@1+ (0.0075,0) [0|0.9525] "m"  ADAS
 SG_ DET_RANGE_VELOCITY_346 : 168|15@1+ (0.0078125,-128) [-128|127.9921875] "m/s"  ADAS
 SG_ DET_RANGE_VELOCITY_ERR_346 : 184|8@1+ (0.003,0) [0|0.765] "m/s"  ADAS
 SG_ DET_AZIMUTH_346 : 208|13@1+ (0.0004,-1.5708) [-1.5708|1.5708] "rad"  ADAS
 SG_ DET_AZIMUTH_ERR_346 : 224|7@1+ (0.00087267,0) [0|0.11082909] "rad"  ADAS
 SG_ DET_ELEVATION_346 : 192|8@1+ (0.00275,-0.34925) [-0.34925|0.34925] "rad"  ADAS
 SG_ DET_ELEVATION_ERR_346 : 200|6@1+ (0.00174533,0) [0|0.10995579] "rad"  ADAS
 SG_ DET_RCS_346 : 256|8@1+ (0.5,-64) [-64|63.5] "dBsm"  ADAS
 SG_ DET_VALID_FLAG_346 : 167|1@1+ (1,0) [0|1] ""  ADAS
 SG_ DET_BI_STATIC_FLAG_346 : 505|1@1+ (1,0) [0|1] ""  ADAS
 SG_ DET_SUPER_RES_TARGET_346 : 247|1@1+ (1,0) [0|1] ""  ADAS
 SG_ DET_SNR_346 : 248|8@1+ (0.35156,0) [0|89.6478] "dB"  ADAS
 SG_ DET_POINT_TARGET_PROB_346 : 240|4@1+ (6.67,0) [0|100] "%"  ADAS
 SG_ DET_EXISTENCE_PROB_346 : 232|6@1+ (1.588,0) [0|100] "%"  ADAS
 SG_ DET_OUTSIDE_SECTOR_346 : 183|1@1+ (1,0) [0|1] ""  ADAS
 SG_ DET_HVC_FLAG_346 : 246|1@1+ (1,0) [0|1] ""  ADAS
 SG_ DET_CONFD_AZIMUTH_346 : 206|2@1+ (1,0) [0|3] ""  ADAS
 SG_ DET_CONFD_ELEVATION_346 : 244|2@1+ (1,0) [0|3] ""  ADAS
 SG_ DET_RANGE_347 : 264|15@1+ (0.015625,0) [0|500] "m"  ADAS
 SG_ DET_RANGE_ERR_347 : 280|7@1+ (0.0075,0) [0|0.9525] "m"  ADAS
 SG_ DET_RANGE_VELOCITY_347 : 288|15@1+ (0.0078125,-128) [-128|127.9921875] "m/s"  ADAS
 SG_ DET_RANGE_VELOCITY_ERR_347 : 304|8@1+ (0.003,0) [0|0.765] "m/s"  ADAS
 SG_ DET_AZIMUTH_347 : 328|13@1+ (0.0004,-1.5708) [-1.5708|1.5708] "rad"  ADAS
 SG_ DET_AZIMUTH_ERR_347 : 345|7@1+ (0.00087267,0) [0|0.11082909] "rad"  ADAS
 SG_ DET_ELEVATION_347 : 312|8@1+ (0.00275,-0.34925) [-0.34925|0.34925] "rad"  ADAS
 SG_ DET_ELEVATION_ERR_347 : 320|6@1+ (0.00174533,0) [0|0.10995579] "rad"  ADAS
 SG_ DET_RCS_347 : 376|8@1+ (0.5,-64) [-64|63.5] "dBsm"  ADAS
 SG_ DET_VALID_FLAG_347 : 399|1@1+ (1,0) [0|1] ""  ADAS
 SG_ DET_BI_STATIC_FLAG_347 : 482|1@1+ (1,0) [0|1] ""  ADAS
 SG_ DET_SUPER_RES_TARGET_347 : 344|1@1+ (1,0) [0|1] ""  ADAS
 SG_ DET_SNR_347 : 368|8@1+ (0.35156,0) [0|89.6478] "dB"  ADAS
 SG_ DET_POINT_TARGET_PROB_347 : 360|4@1+ (6.67,0) [0|100] "%"  ADAS
 SG_ DET_EXISTENCE_PROB_347 : 352|6@1+ (1.588,0) [0|100] "%"  ADAS
 SG_ DET_OUTSIDE_SECTOR_347 : 407|1@1+ (1,0) [0|1] ""  ADAS
 SG_ DET_HVC_FLAG_347 : 364|1@1+ (1,0) [0|1] ""  ADAS
 SG_ DET_CONFD_AZIMUTH_347 : 365|2@1+ (1,0) [0|3] ""  ADAS
 SG_ DET_CONFD_ELEVATION_347 : 358|2@1+ (1,0) [0|3] ""  ADAS
 SG_ DET_RANGE_348 : 384|15@1+ (0.015625,0) [0|500] "m"  ADAS
 SG_ DET_RANGE_ERR_348 : 400|7@1+ (0.0075,0) [0|0.9525] "m"  ADAS
 SG_ DET_RANGE_VELOCITY_348 : 408|15@1+ (0.0078125,-128) [-128|127.9921875] "m/s"  ADAS
 SG_ DET_RANGE_VELOCITY_ERR_348 : 424|8@1+ (0.003,0) [0|0.765] "m/s"  ADAS
 SG_ DET_AZIMUTH_348 : 448|13@1+ (0.0004,-1.5708) [-1.5708|1.5708] "rad"  ADAS
 SG_ DET_AZIMUTH_ERR_348 : 465|7@1+ (0.00087267,0) [0|0.11082909] "rad"  ADAS
 SG_ DET_ELEVATION_348 : 432|8@1+ (0.00275,-0.34925) [-0.34925|0.34925] "rad"  ADAS
 SG_ DET_ELEVATION_ERR_348 : 440|6@1+ (0.00174533,0) [0|0.10995579] "rad"  ADAS
 SG_ DET_RCS_348 : 496|8@1+ (0.5,-64) [-64|63.5] "dBsm"  ADAS
 SG_ DET_VALID_FLAG_348 : 485|1@1+ (1,0) [0|1] ""  ADAS
 SG_ DET_BI_STATIC_FLAG_348 : 483|1@1+ (1,0) [0|1] ""  ADAS
 SG_ DET_SUPER_RES_TARGET_348 : 446|1@1+ (1,0) [0|1] ""  ADAS
 SG_ DET_SNR_348 : 488|8@1+ (0.35156,0) [0|89.6478] "dB"  ADAS
 SG_ DET_POINT_TARGET_PROB_348 : 472|4@1+ (6.67,0) [0|100] "%"  ADAS
 SG_ DET_EXISTENCE_PROB_348 : 506|6@1+ (1.588,0) [0|100] "%"  ADAS
 SG_ DET_OUTSIDE_SECTOR_348 : 481|1@1+ (1,0) [0|1] ""  ADAS
 SG_ DET_HVC_FLAG_348 : 464|1@1+ (1,0) [0|1] ""  ADAS
 SG_ DET_CONFD_AZIMUTH_348 : 486|2@1+ (1,0) [0|3] ""  ADAS
 SG_ DET_CONFD_ELEVATION_348 : 461|2@1+ (1,0) [0|3] ""  ADAS
 SG_ DET_MH_SCAN_INDEX_4LSB_345_348 : 476|4@1+ (1,0) [0|15] ""  ADAS
 SG_ DET_MH_CYCLE_COUNTER_345_348 : 16|8@1+ (1,0) [0|255] ""  ADAS
 SG_ DET_MH_CRC16_345_348 : 0|16@1+ (1,0) [0|65535] ""  ADAS

BO_ 1239 RDR_DETECTION_349_352: 64 RDR08
 SG_ DET_RANGE_349 : 24|15@1+ (0.015625,0) [0|500] "m"  ADAS
 SG_ DET_RANGE_ERR_349 : 40|7@1+ (0.0075,0) [0|0.9525] "m"  ADAS
 SG_ DET_RANGE_VELOCITY_349 : 48|15@1+ (0.0078125,-128) [-128|127.9921875] "m/s"  ADAS
 SG_ DET_RANGE_VELOCITY_ERR_349 : 64|8@1+ (0.003,0) [0|0.765] "m/s"  ADAS
 SG_ DET_AZIMUTH_349 : 88|13@1+ (0.0004,-1.5708) [-1.5708|1.5708] "rad"  ADAS
 SG_ DET_AZIMUTH_ERR_349 : 105|7@1+ (0.00087267,0) [0|0.11082909] "rad"  ADAS
 SG_ DET_ELEVATION_349 : 72|8@1+ (0.00275,-0.34925) [-0.34925|0.34925] "rad"  ADAS
 SG_ DET_ELEVATION_ERR_349 : 80|6@1+ (0.00174533,0) [0|0.10995579] "rad"  ADAS
 SG_ DET_RCS_349 : 136|8@1+ (0.5,-64) [-64|63.5] "dBsm"  ADAS
 SG_ DET_VALID_FLAG_349 : 119|1@1+ (1,0) [0|1] ""  ADAS
 SG_ DET_BI_STATIC_FLAG_349 : 504|1@1+ (1,0) [0|1] ""  ADAS
 SG_ DET_SUPER_RES_TARGET_349 : 104|1@1+ (1,0) [0|1] ""  ADAS
 SG_ DET_SNR_349 : 128|8@1+ (0.35156,0) [0|89.6478] "dB"  ADAS
 SG_ DET_POINT_TARGET_PROB_349 : 114|4@1+ (6.67,0) [0|100] "%"  ADAS
 SG_ DET_EXISTENCE_PROB_349 : 120|6@1+ (1.588,0) [0|100] "%"  ADAS
 SG_ DET_OUTSIDE_SECTOR_349 : 159|1@1+ (1,0) [0|1] ""  ADAS
 SG_ DET_HVC_FLAG_349 : 118|1@1+ (1,0) [0|1] ""  ADAS
 SG_ DET_CONFD_AZIMUTH_349 : 126|2@1+ (1,0) [0|3] ""  ADAS
 SG_ DET_CONFD_ELEVATION_349 : 112|2@1+ (1,0) [0|3] ""  ADAS
 SG_ DET_RANGE_350 : 144|15@1+ (0.015625,0) [0|500] "m"  ADAS
 SG_ DET_RANGE_ERR_350 : 160|7@1+ (0.0075,0) [0|0.9525] "m"  ADAS
 SG_ DET_RANGE_VELOCITY_350 : 168|15@1+ (0.0078125,-128) [-128|127.9921875] "m/s"  ADAS
 SG_ DET_RANGE_VELOCITY_ERR_350 : 184|8@1+ (0.003,0) [0|0.765] "m/s"  ADAS
 SG_ DET_AZIMUTH_350 : 208|13@1+ (0.0004,-1.5708) [-1.5708|1.5708] "rad"  ADAS
 SG_ DET_AZIMUTH_ERR_350 : 224|7@1+ (0.00087267,0) [0|0.11082909] "rad"  ADAS
 SG_ DET_ELEVATION_350 : 192|8@1+ (0.00275,-0.34925) [-0.34925|0.34925] "rad"  ADAS
 SG_ DET_ELEVATION_ERR_350 : 200|6@1+ (0.00174533,0) [0|0.10995579] "rad"  ADAS
 SG_ DET_RCS_350 : 256|8@1+ (0.5,-64) [-64|63.5] "dBsm"  ADAS
 SG_ DET_VALID_FLAG_350 : 167|1@1+ (1,0) [0|1] ""  ADAS
 SG_ DET_BI_STATIC_FLAG_350 : 505|1@1+ (1,0) [0|1] ""  ADAS
 SG_ DET_SUPER_RES_TARGET_350 : 247|1@1+ (1,0) [0|1] ""  ADAS
 SG_ DET_SNR_350 : 248|8@1+ (0.35156,0) [0|89.6478] "dB"  ADAS
 SG_ DET_POINT_TARGET_PROB_350 : 240|4@1+ (6.67,0) [0|100] "%"  ADAS
 SG_ DET_EXISTENCE_PROB_350 : 232|6@1+ (1.588,0) [0|100] "%"  ADAS
 SG_ DET_OUTSIDE_SECTOR_350 : 183|1@1+ (1,0) [0|1] ""  ADAS
 SG_ DET_HVC_FLAG_350 : 246|1@1+ (1,0) [0|1] ""  ADAS
 SG_ DET_CONFD_AZIMUTH_350 : 206|2@1+ (1,0) [0|3] ""  ADAS
 SG_ DET_CONFD_ELEVATION_350 : 244|2@1+ (1,0) [0|3] ""  ADAS
 SG_ DET_RANGE_351 : 264|15@1+ (0.015625,0) [0|500] "m"  ADAS
 SG_ DET_RANGE_ERR_351 : 280|7@1+ (0.0075,0) [0|0.9525] "m"  ADAS
 SG_ DET_RANGE_VELOCITY_351 : 288|15@1+ (0.0078125,-128) [-128|127.9921875] "m/s"  ADAS
 SG_ DET_RANGE_VELOCITY_ERR_351 : 304|8@1+ (0.003,0) [0|0.765] "m/s"  ADAS
 SG_ DET_AZIMUTH_351 : 328|13@1+ (0.0004,-1.5708) [-1.5708|1.5708] "rad"  ADAS
 SG_ DET_AZIMUTH_ERR_351 : 345|7@1+ (0.00087267,0) [0|0.11082909] "rad"  ADAS
 SG_ DET_ELEVATION_351 : 312|8@1+ (0.00275,-0.34925) [-0.34925|0.34925] "rad"  ADAS
 SG_ DET_ELEVATION_ERR_351 : 320|6@1+ (0.00174533,0) [0|0.10995579] "rad"  ADAS
 SG_ DET_RCS_351 : 376|8@1+ (0.5,-64) [-64|63.5] "dBsm"  ADAS
 SG_ DET_VALID_FLAG_351 : 399|1@1+ (1,0) [0|1] ""  ADAS
 SG_ DET_BI_STATIC_FLAG_351 : 482|1@1+ (1,0) [0|1] ""  ADAS
 SG_ DET_SUPER_RES_TARGET_351 : 344|1@1+ (1,0) [0|1] ""  ADAS
 SG_ DET_SNR_351 : 368|8@1+ (0.35156,0) [0|89.6478] "dB"  ADAS
 SG_ DET_POINT_TARGET_PROB_351 : 360|4@1+ (6.67,0) [0|100] "%"  ADAS
 SG_ DET_EXISTENCE_PROB_351 : 352|6@1+ (1.588,0) [0|100] "%"  ADAS
 SG_ DET_OUTSIDE_SECTOR_351 : 407|1@1+ (1,0) [0|1] ""  ADAS
 SG_ DET_HVC_FLAG_351 : 364|1@1+ (1,0) [0|1] ""  ADAS
 SG_ DET_CONFD_AZIMUTH_351 : 365|2@1+ (1,0) [0|3] ""  ADAS
 SG_ DET_CONFD_ELEVATION_351 : 358|2@1+ (1,0) [0|3] ""  ADAS
 SG_ DET_RANGE_352 : 384|15@1+ (0.015625,0) [0|500] "m"  ADAS
 SG_ DET_RANGE_ERR_352 : 400|7@1+ (0.0075,0) [0|0.9525] "m"  ADAS
 SG_ DET_RANGE_VELOCITY_352 : 408|15@1+ (0.0078125,-128) [-128|127.9921875] "m/s"  ADAS
 SG_ DET_RANGE_VELOCITY_ERR_352 : 424|8@1+ (0.003,0) [0|0.765] "m/s"  ADAS
 SG_ DET_AZIMUTH_352 : 448|13@1+ (0.0004,-1.5708) [-1.5708|1.5708] "rad"  ADAS
 SG_ DET_AZIMUTH_ERR_352 : 465|7@1+ (0.00087267,0) [0|0.11082909] "rad"  ADAS
 SG_ DET_ELEVATION_352 : 432|8@1+ (0.00275,-0.34925) [-0.34925|0.34925] "rad"  ADAS
 SG_ DET_ELEVATION_ERR_352 : 440|6@1+ (0.00174533,0) [0|0.10995579] "rad"  ADAS
 SG_ DET_RCS_352 : 496|8@1+ (0.5,-64) [-64|63.5] "dBsm"  ADAS
 SG_ DET_VALID_FLAG_352 : 485|1@1+ (1,0) [0|1] ""  ADAS
 SG_ DET_BI_STATIC_FLAG_352 : 483|1@1+ (1,0) [0|1] ""  ADAS
 SG_ DET_SUPER_RES_TARGET_352 : 446|1@1+ (1,0) [0|1] ""  ADAS
 SG_ DET_SNR_352 : 488|8@1+ (0.35156,0) [0|89.6478] "dB"  ADAS
 SG_ DET_POINT_TARGET_PROB_352 : 472|4@1+ (6.67,0) [0|100] "%"  ADAS
 SG_ DET_EXISTENCE_PROB_352 : 506|6@1+ (1.588,0) [0|100] "%"  ADAS
 SG_ DET_OUTSIDE_SECTOR_352 : 481|1@1+ (1,0) [0|1] ""  ADAS
 SG_ DET_HVC_FLAG_352 : 464|1@1+ (1,0) [0|1] ""  ADAS
 SG_ DET_CONFD_AZIMUTH_352 : 486|2@1+ (1,0) [0|3] ""  ADAS
 SG_ DET_CONFD_ELEVATION_352 : 461|2@1+ (1,0) [0|3] ""  ADAS
 SG_ DET_MH_SCAN_INDEX_4LSB_349_352 : 476|4@1+ (1,0) [0|15] ""  ADAS
 SG_ DET_MH_CYCLE_COUNTER_349_352 : 16|8@1+ (1,0) [0|255] ""  ADAS
 SG_ DET_MH_CRC16_349_352 : 0|16@1+ (1,0) [0|65535] ""  ADAS

BO_ 1240 RDR_DETECTION_353_356: 64 RDR08
 SG_ DET_RANGE_353 : 24|15@1+ (0.015625,0) [0|500] "m"  ADAS
 SG_ DET_RANGE_ERR_353 : 40|7@1+ (0.0075,0) [0|0.9525] "m"  ADAS
 SG_ DET_RANGE_VELOCITY_353 : 48|15@1+ (0.0078125,-128) [-128|127.9921875] "m/s"  ADAS
 SG_ DET_RANGE_VELOCITY_ERR_353 : 64|8@1+ (0.003,0) [0|0.765] "m/s"  ADAS
 SG_ DET_AZIMUTH_353 : 88|13@1+ (0.0004,-1.5708) [-1.5708|1.5708] "rad"  ADAS
 SG_ DET_AZIMUTH_ERR_353 : 105|7@1+ (0.00087267,0) [0|0.11082909] "rad"  ADAS
 SG_ DET_ELEVATION_353 : 72|8@1+ (0.00275,-0.34925) [-0.34925|0.34925] "rad"  ADAS
 SG_ DET_ELEVATION_ERR_353 : 80|6@1+ (0.00174533,0) [0|0.10995579] "rad"  ADAS
 SG_ DET_RCS_353 : 136|8@1+ (0.5,-64) [-64|63.5] "dBsm"  ADAS
 SG_ DET_VALID_FLAG_353 : 119|1@1+ (1,0) [0|1] ""  ADAS
 SG_ DET_BI_STATIC_FLAG_353 : 504|1@1+ (1,0) [0|1] ""  ADAS
 SG_ DET_SUPER_RES_TARGET_353 : 104|1@1+ (1,0) [0|1] ""  ADAS
 SG_ DET_SNR_353 : 128|8@1+ (0.35156,0) [0|89.6478] "dB"  ADAS
 SG_ DET_POINT_TARGET_PROB_353 : 114|4@1+ (6.67,0) [0|100] "%"  ADAS
 SG_ DET_EXISTENCE_PROB_353 : 120|6@1+ (1.588,0) [0|100] "%"  ADAS
 SG_ DET_OUTSIDE_SECTOR_353 : 159|1@1+ (1,0) [0|1] ""  ADAS
 SG_ DET_HVC_FLAG_353 : 118|1@1+ (1,0) [0|1] ""  ADAS
 SG_ DET_CONFD_AZIMUTH_353 : 126|2@1+ (1,0) [0|3] ""  ADAS
 SG_ DET_CONFD_ELEVATION_353 : 112|2@1+ (1,0) [0|3] ""  ADAS
 SG_ DET_RANGE_354 : 144|15@1+ (0.015625,0) [0|500] "m"  ADAS
 SG_ DET_RANGE_ERR_354 : 160|7@1+ (0.0075,0) [0|0.9525] "m"  ADAS
 SG_ DET_RANGE_VELOCITY_354 : 168|15@1+ (0.0078125,-128) [-128|127.9921875] "m/s"  ADAS
 SG_ DET_RANGE_VELOCITY_ERR_354 : 184|8@1+ (0.003,0) [0|0.765] "m/s"  ADAS
 SG_ DET_AZIMUTH_354 : 208|13@1+ (0.0004,-1.5708) [-1.5708|1.5708] "rad"  ADAS
 SG_ DET_AZIMUTH_ERR_354 : 224|7@1+ (0.00087267,0) [0|0.11082909] "rad"  ADAS
 SG_ DET_ELEVATION_354 : 192|8@1+ (0.00275,-0.34925) [-0.34925|0.34925] "rad"  ADAS
 SG_ DET_ELEVATION_ERR_354 : 200|6@1+ (0.00174533,0) [0|0.10995579] "rad"  ADAS
 SG_ DET_RCS_354 : 256|8@1+ (0.5,-64) [-64|63.5] "dBsm"  ADAS
 SG_ DET_VALID_FLAG_354 : 167|1@1+ (1,0) [0|1] ""  ADAS
 SG_ DET_BI_STATIC_FLAG_354 : 505|1@1+ (1,0) [0|1] ""  ADAS
 SG_ DET_SUPER_RES_TARGET_354 : 247|1@1+ (1,0) [0|1] ""  ADAS
 SG_ DET_SNR_354 : 248|8@1+ (0.35156,0) [0|89.6478] "dB"  ADAS
 SG_ DET_POINT_TARGET_PROB_354 : 240|4@1+ (6.67,0) [0|100] "%"  ADAS
 SG_ DET_EXISTENCE_PROB_354 : 232|6@1+ (1.588,0) [0|100] "%"  ADAS
 SG_ DET_OUTSIDE_SECTOR_354 : 183|1@1+ (1,0) [0|1] ""  ADAS
 SG_ DET_HVC_FLAG_354 : 246|1@1+ (1,0) [0|1] ""  ADAS
 SG_ DET_CONFD_AZIMUTH_354 : 206|2@1+ (1,0) [0|3] ""  ADAS
 SG_ DET_CONFD_ELEVATION_354 : 244|2@1+ (1,0) [0|3] ""  ADAS
 SG_ DET_RANGE_355 : 264|15@1+ (0.015625,0) [0|500] "m"  ADAS
 SG_ DET_RANGE_ERR_355 : 280|7@1+ (0.0075,0) [0|0.9525] "m"  ADAS
 SG_ DET_RANGE_VELOCITY_355 : 288|15@1+ (0.0078125,-128) [-128|127.9921875] "m/s"  ADAS
 SG_ DET_RANGE_VELOCITY_ERR_355 : 304|8@1+ (0.003,0) [0|0.765] "m/s"  ADAS
 SG_ DET_AZIMUTH_355 : 328|13@1+ (0.0004,-1.5708) [-1.5708|1.5708] "rad"  ADAS
 SG_ DET_AZIMUTH_ERR_355 : 345|7@1+ (0.00087267,0) [0|0.11082909] "rad"  ADAS
 SG_ DET_ELEVATION_355 : 312|8@1+ (0.00275,-0.34925) [-0.34925|0.34925] "rad"  ADAS
 SG_ DET_ELEVATION_ERR_355 : 320|6@1+ (0.00174533,0) [0|0.10995579] "rad"  ADAS
 SG_ DET_RCS_355 : 376|8@1+ (0.5,-64) [-64|63.5] "dBsm"  ADAS
 SG_ DET_VALID_FLAG_355 : 399|1@1+ (1,0) [0|1] ""  ADAS
 SG_ DET_BI_STATIC_FLAG_355 : 482|1@1+ (1,0) [0|1] ""  ADAS
 SG_ DET_SUPER_RES_TARGET_355 : 344|1@1+ (1,0) [0|1] ""  ADAS
 SG_ DET_SNR_355 : 368|8@1+ (0.35156,0) [0|89.6478] "dB"  ADAS
 SG_ DET_POINT_TARGET_PROB_355 : 360|4@1+ (6.67,0) [0|100] "%"  ADAS
 SG_ DET_EXISTENCE_PROB_355 : 352|6@1+ (1.588,0) [0|100] "%"  ADAS
 SG_ DET_OUTSIDE_SECTOR_355 : 407|1@1+ (1,0) [0|1] ""  ADAS
 SG_ DET_HVC_FLAG_355 : 364|1@1+ (1,0) [0|1] ""  ADAS
 SG_ DET_CONFD_AZIMUTH_355 : 365|2@1+ (1,0) [0|3] ""  ADAS
 SG_ DET_CONFD_ELEVATION_355 : 358|2@1+ (1,0) [0|3] ""  ADAS
 SG_ DET_RANGE_356 : 384|15@1+ (0.015625,0) [0|500] "m"  ADAS
 SG_ DET_RANGE_ERR_356 : 400|7@1+ (0.0075,0) [0|0.9525] "m"  ADAS
 SG_ DET_RANGE_VELOCITY_356 : 408|15@1+ (0.0078125,-128) [-128|127.9921875] "m/s"  ADAS
 SG_ DET_RANGE_VELOCITY_ERR_356 : 424|8@1+ (0.003,0) [0|0.765] "m/s"  ADAS
 SG_ DET_AZIMUTH_356 : 448|13@1+ (0.0004,-1.5708) [-1.5708|1.5708] "rad"  ADAS
 SG_ DET_AZIMUTH_ERR_356 : 465|7@1+ (0.00087267,0) [0|0.11082909] "rad"  ADAS
 SG_ DET_ELEVATION_356 : 432|8@1+ (0.00275,-0.34925) [-0.34925|0.34925] "rad"  ADAS
 SG_ DET_ELEVATION_ERR_356 : 440|6@1+ (0.00174533,0) [0|0.10995579] "rad"  ADAS
 SG_ DET_RCS_356 : 496|8@1+ (0.5,-64) [-64|63.5] "dBsm"  ADAS
 SG_ DET_VALID_FLAG_356 : 485|1@1+ (1,0) [0|1] ""  ADAS
 SG_ DET_BI_STATIC_FLAG_356 : 483|1@1+ (1,0) [0|1] ""  ADAS
 SG_ DET_SUPER_RES_TARGET_356 : 446|1@1+ (1,0) [0|1] ""  ADAS
 SG_ DET_SNR_356 : 488|8@1+ (0.35156,0) [0|89.6478] "dB"  ADAS
 SG_ DET_POINT_TARGET_PROB_356 : 472|4@1+ (6.67,0) [0|100] "%"  ADAS
 SG_ DET_EXISTENCE_PROB_356 : 506|6@1+ (1.588,0) [0|100] "%"  ADAS
 SG_ DET_OUTSIDE_SECTOR_356 : 481|1@1+ (1,0) [0|1] ""  ADAS
 SG_ DET_HVC_FLAG_356 : 464|1@1+ (1,0) [0|1] ""  ADAS
 SG_ DET_CONFD_AZIMUTH_356 : 486|2@1+ (1,0) [0|3] ""  ADAS
 SG_ DET_CONFD_ELEVATION_356 : 461|2@1+ (1,0) [0|3] ""  ADAS
 SG_ DET_MH_SCAN_INDEX_4LSB_353_356 : 476|4@1+ (1,0) [0|15] ""  ADAS
 SG_ DET_MH_CYCLE_COUNTER_353_356 : 16|8@1+ (1,0) [0|255] ""  ADAS
 SG_ DET_MH_CRC16_353_356 : 0|16@1+ (1,0) [0|65535] ""  ADAS

BO_ 1241 RDR_DETECTION_357_360: 64 RDR08
 SG_ DET_RANGE_357 : 24|15@1+ (0.015625,0) [0|500] "m"  ADAS
 SG_ DET_RANGE_ERR_357 : 40|7@1+ (0.0075,0) [0|0.9525] "m"  ADAS
 SG_ DET_RANGE_VELOCITY_357 : 48|15@1+ (0.0078125,-128) [-128|127.9921875] "m/s"  ADAS
 SG_ DET_RANGE_VELOCITY_ERR_357 : 64|8@1+ (0.003,0) [0|0.765] "m/s"  ADAS
 SG_ DET_AZIMUTH_357 : 88|13@1+ (0.0004,-1.5708) [-1.5708|1.5708] "rad"  ADAS
 SG_ DET_AZIMUTH_ERR_357 : 105|7@1+ (0.00087267,0) [0|0.11082909] "rad"  ADAS
 SG_ DET_ELEVATION_357 : 72|8@1+ (0.00275,-0.34925) [-0.34925|0.34925] "rad"  ADAS
 SG_ DET_ELEVATION_ERR_357 : 80|6@1+ (0.00174533,0) [0|0.10995579] "rad"  ADAS
 SG_ DET_RCS_357 : 136|8@1+ (0.5,-64) [-64|63.5] "dBsm"  ADAS
 SG_ DET_VALID_FLAG_357 : 119|1@1+ (1,0) [0|1] ""  ADAS
 SG_ DET_BI_STATIC_FLAG_357 : 504|1@1+ (1,0) [0|1] ""  ADAS
 SG_ DET_SUPER_RES_TARGET_357 : 104|1@1+ (1,0) [0|1] ""  ADAS
 SG_ DET_SNR_357 : 128|8@1+ (0.35156,0) [0|89.6478] "dB"  ADAS
 SG_ DET_POINT_TARGET_PROB_357 : 114|4@1+ (6.67,0) [0|100] "%"  ADAS
 SG_ DET_EXISTENCE_PROB_357 : 120|6@1+ (1.588,0) [0|100] "%"  ADAS
 SG_ DET_OUTSIDE_SECTOR_357 : 159|1@1+ (1,0) [0|1] ""  ADAS
 SG_ DET_HVC_FLAG_357 : 118|1@1+ (1,0) [0|1] ""  ADAS
 SG_ DET_CONFD_AZIMUTH_357 : 126|2@1+ (1,0) [0|3] ""  ADAS
 SG_ DET_CONFD_ELEVATION_357 : 112|2@1+ (1,0) [0|3] ""  ADAS
 SG_ DET_RANGE_358 : 144|15@1+ (0.015625,0) [0|500] "m"  ADAS
 SG_ DET_RANGE_ERR_358 : 160|7@1+ (0.0075,0) [0|0.9525] "m"  ADAS
 SG_ DET_RANGE_VELOCITY_358 : 168|15@1+ (0.0078125,-128) [-128|127.9921875] "m/s"  ADAS
 SG_ DET_RANGE_VELOCITY_ERR_358 : 184|8@1+ (0.003,0) [0|0.765] "m/s"  ADAS
 SG_ DET_AZIMUTH_358 : 208|13@1+ (0.0004,-1.5708) [-1.5708|1.5708] "rad"  ADAS
 SG_ DET_AZIMUTH_ERR_358 : 224|7@1+ (0.00087267,0) [0|0.11082909] "rad"  ADAS
 SG_ DET_ELEVATION_358 : 192|8@1+ (0.00275,-0.34925) [-0.34925|0.34925] "rad"  ADAS
 SG_ DET_ELEVATION_ERR_358 : 200|6@1+ (0.00174533,0) [0|0.10995579] "rad"  ADAS
 SG_ DET_RCS_358 : 256|8@1+ (0.5,-64) [-64|63.5] "dBsm"  ADAS
 SG_ DET_VALID_FLAG_358 : 167|1@1+ (1,0) [0|1] ""  ADAS
 SG_ DET_BI_STATIC_FLAG_358 : 505|1@1+ (1,0) [0|1] ""  ADAS
 SG_ DET_SUPER_RES_TARGET_358 : 247|1@1+ (1,0) [0|1] ""  ADAS
 SG_ DET_SNR_358 : 248|8@1+ (0.35156,0) [0|89.6478] "dB"  ADAS
 SG_ DET_POINT_TARGET_PROB_358 : 240|4@1+ (6.67,0) [0|100] "%"  ADAS
 SG_ DET_EXISTENCE_PROB_358 : 232|6@1+ (1.588,0) [0|100] "%"  ADAS
 SG_ DET_OUTSIDE_SECTOR_358 : 183|1@1+ (1,0) [0|1] ""  ADAS
 SG_ DET_HVC_FLAG_358 : 246|1@1+ (1,0) [0|1] ""  ADAS
 SG_ DET_CONFD_AZIMUTH_358 : 206|2@1+ (1,0) [0|3] ""  ADAS
 SG_ DET_CONFD_ELEVATION_358 : 244|2@1+ (1,0) [0|3] ""  ADAS
 SG_ DET_RANGE_359 : 264|15@1+ (0.015625,0) [0|500] "m"  ADAS
 SG_ DET_RANGE_ERR_359 : 280|7@1+ (0.0075,0) [0|0.9525] "m"  ADAS
 SG_ DET_RANGE_VELOCITY_359 : 288|15@1+ (0.0078125,-128) [-128|127.9921875] "m/s"  ADAS
 SG_ DET_RANGE_VELOCITY_ERR_359 : 304|8@1+ (0.003,0) [0|0.765] "m/s"  ADAS
 SG_ DET_AZIMUTH_359 : 328|13@1+ (0.0004,-1.5708) [-1.5708|1.5708] "rad"  ADAS
 SG_ DET_AZIMUTH_ERR_359 : 345|7@1+ (0.00087267,0) [0|0.11082909] "rad"  ADAS
 SG_ DET_ELEVATION_359 : 312|8@1+ (0.00275,-0.34925) [-0.34925|0.34925] "rad"  ADAS
 SG_ DET_ELEVATION_ERR_359 : 320|6@1+ (0.00174533,0) [0|0.10995579] "rad"  ADAS
 SG_ DET_RCS_359 : 376|8@1+ (0.5,-64) [-64|63.5] "dBsm"  ADAS
 SG_ DET_VALID_FLAG_359 : 399|1@1+ (1,0) [0|1] ""  ADAS
 SG_ DET_BI_STATIC_FLAG_359 : 482|1@1+ (1,0) [0|1] ""  ADAS
 SG_ DET_SUPER_RES_TARGET_359 : 344|1@1+ (1,0) [0|1] ""  ADAS
 SG_ DET_SNR_359 : 368|8@1+ (0.35156,0) [0|89.6478] "dB"  ADAS
 SG_ DET_POINT_TARGET_PROB_359 : 360|4@1+ (6.67,0) [0|100] "%"  ADAS
 SG_ DET_EXISTENCE_PROB_359 : 352|6@1+ (1.588,0) [0|100] "%"  ADAS
 SG_ DET_OUTSIDE_SECTOR_359 : 407|1@1+ (1,0) [0|1] ""  ADAS
 SG_ DET_HVC_FLAG_359 : 364|1@1+ (1,0) [0|1] ""  ADAS
 SG_ DET_CONFD_AZIMUTH_359 : 365|2@1+ (1,0) [0|3] ""  ADAS
 SG_ DET_CONFD_ELEVATION_359 : 358|2@1+ (1,0) [0|3] ""  ADAS
 SG_ DET_RANGE_360 : 384|15@1+ (0.015625,0) [0|500] "m"  ADAS
 SG_ DET_RANGE_ERR_360 : 400|7@1+ (0.0075,0) [0|0.9525] "m"  ADAS
 SG_ DET_RANGE_VELOCITY_360 : 408|15@1+ (0.0078125,-128) [-128|127.9921875] "m/s"  ADAS
 SG_ DET_RANGE_VELOCITY_ERR_360 : 424|8@1+ (0.003,0) [0|0.765] "m/s"  ADAS
 SG_ DET_AZIMUTH_360 : 448|13@1+ (0.0004,-1.5708) [-1.5708|1.5708] "rad"  ADAS
 SG_ DET_AZIMUTH_ERR_360 : 465|7@1+ (0.00087267,0) [0|0.11082909] "rad"  ADAS
 SG_ DET_ELEVATION_360 : 432|8@1+ (0.00275,-0.34925) [-0.34925|0.34925] "rad"  ADAS
 SG_ DET_ELEVATION_ERR_360 : 440|6@1+ (0.00174533,0) [0|0.10995579] "rad"  ADAS
 SG_ DET_RCS_360 : 496|8@1+ (0.5,-64) [-64|63.5] "dBsm"  ADAS
 SG_ DET_VALID_FLAG_360 : 485|1@1+ (1,0) [0|1] ""  ADAS
 SG_ DET_BI_STATIC_FLAG_360 : 483|1@1+ (1,0) [0|1] ""  ADAS
 SG_ DET_SUPER_RES_TARGET_360 : 446|1@1+ (1,0) [0|1] ""  ADAS
 SG_ DET_SNR_360 : 488|8@1+ (0.35156,0) [0|89.6478] "dB"  ADAS
 SG_ DET_POINT_TARGET_PROB_360 : 472|4@1+ (6.67,0) [0|100] "%"  ADAS
 SG_ DET_EXISTENCE_PROB_360 : 506|6@1+ (1.588,0) [0|100] "%"  ADAS
 SG_ DET_OUTSIDE_SECTOR_360 : 481|1@1+ (1,0) [0|1] ""  ADAS
 SG_ DET_HVC_FLAG_360 : 464|1@1+ (1,0) [0|1] ""  ADAS
 SG_ DET_CONFD_AZIMUTH_360 : 486|2@1+ (1,0) [0|3] ""  ADAS
 SG_ DET_CONFD_ELEVATION_360 : 461|2@1+ (1,0) [0|3] ""  ADAS
 SG_ DET_MH_SCAN_INDEX_4LSB_357_360 : 476|4@1+ (1,0) [0|15] ""  ADAS
 SG_ DET_MH_CYCLE_COUNTER_357_360 : 16|8@1+ (1,0) [0|255] ""  ADAS
 SG_ DET_MH_CRC16_357_360 : 0|16@1+ (1,0) [0|65535] ""  ADAS

BO_ 1242 RDR_DETECTION_361_364: 64 RDR08
 SG_ DET_RANGE_361 : 24|15@1+ (0.015625,0) [0|500] "m"  ADAS
 SG_ DET_RANGE_ERR_361 : 40|7@1+ (0.0075,0) [0|0.9525] "m"  ADAS
 SG_ DET_RANGE_VELOCITY_361 : 48|15@1+ (0.0078125,-128) [-128|127.9921875] "m/s"  ADAS
 SG_ DET_RANGE_VELOCITY_ERR_361 : 64|8@1+ (0.003,0) [0|0.765] "m/s"  ADAS
 SG_ DET_AZIMUTH_361 : 88|13@1+ (0.0004,-1.5708) [-1.5708|1.5708] "rad"  ADAS
 SG_ DET_AZIMUTH_ERR_361 : 105|7@1+ (0.00087267,0) [0|0.11082909] "rad"  ADAS
 SG_ DET_ELEVATION_361 : 72|8@1+ (0.00275,-0.34925) [-0.34925|0.34925] "rad"  ADAS
 SG_ DET_ELEVATION_ERR_361 : 80|6@1+ (0.00174533,0) [0|0.10995579] "rad"  ADAS
 SG_ DET_RCS_361 : 136|8@1+ (0.5,-64) [-64|63.5] "dBsm"  ADAS
 SG_ DET_VALID_FLAG_361 : 119|1@1+ (1,0) [0|1] ""  ADAS
 SG_ DET_BI_STATIC_FLAG_361 : 504|1@1+ (1,0) [0|1] ""  ADAS
 SG_ DET_SUPER_RES_TARGET_361 : 104|1@1+ (1,0) [0|1] ""  ADAS
 SG_ DET_SNR_361 : 128|8@1+ (0.35156,0) [0|89.6478] "dB"  ADAS
 SG_ DET_POINT_TARGET_PROB_361 : 114|4@1+ (6.67,0) [0|100] "%"  ADAS
 SG_ DET_EXISTENCE_PROB_361 : 120|6@1+ (1.588,0) [0|100] "%"  ADAS
 SG_ DET_OUTSIDE_SECTOR_361 : 159|1@1+ (1,0) [0|1] ""  ADAS
 SG_ DET_HVC_FLAG_361 : 118|1@1+ (1,0) [0|1] ""  ADAS
 SG_ DET_CONFD_AZIMUTH_361 : 126|2@1+ (1,0) [0|3] ""  ADAS
 SG_ DET_CONFD_ELEVATION_361 : 112|2@1+ (1,0) [0|3] ""  ADAS
 SG_ DET_RANGE_362 : 144|15@1+ (0.015625,0) [0|500] "m"  ADAS
 SG_ DET_RANGE_ERR_362 : 160|7@1+ (0.0075,0) [0|0.9525] "m"  ADAS
 SG_ DET_RANGE_VELOCITY_362 : 168|15@1+ (0.0078125,-128) [-128|127.9921875] "m/s"  ADAS
 SG_ DET_RANGE_VELOCITY_ERR_362 : 184|8@1+ (0.003,0) [0|0.765] "m/s"  ADAS
 SG_ DET_AZIMUTH_362 : 208|13@1+ (0.0004,-1.5708) [-1.5708|1.5708] "rad"  ADAS
 SG_ DET_AZIMUTH_ERR_362 : 224|7@1+ (0.00087267,0) [0|0.11082909] "rad"  ADAS
 SG_ DET_ELEVATION_362 : 192|8@1+ (0.00275,-0.34925) [-0.34925|0.34925] "rad"  ADAS
 SG_ DET_ELEVATION_ERR_362 : 200|6@1+ (0.00174533,0) [0|0.10995579] "rad"  ADAS
 SG_ DET_RCS_362 : 256|8@1+ (0.5,-64) [-64|63.5] "dBsm"  ADAS
 SG_ DET_VALID_FLAG_362 : 167|1@1+ (1,0) [0|1] ""  ADAS
 SG_ DET_BI_STATIC_FLAG_362 : 505|1@1+ (1,0) [0|1] ""  ADAS
 SG_ DET_SUPER_RES_TARGET_362 : 247|1@1+ (1,0) [0|1] ""  ADAS
 SG_ DET_SNR_362 : 248|8@1+ (0.35156,0) [0|89.6478] "dB"  ADAS
 SG_ DET_POINT_TARGET_PROB_362 : 240|4@1+ (6.67,0) [0|100] "%"  ADAS
 SG_ DET_EXISTENCE_PROB_362 : 232|6@1+ (1.588,0) [0|100] "%"  ADAS
 SG_ DET_OUTSIDE_SECTOR_362 : 183|1@1+ (1,0) [0|1] ""  ADAS
 SG_ DET_HVC_FLAG_362 : 246|1@1+ (1,0) [0|1] ""  ADAS
 SG_ DET_CONFD_AZIMUTH_362 : 206|2@1+ (1,0) [0|3] ""  ADAS
 SG_ DET_CONFD_ELEVATION_362 : 244|2@1+ (1,0) [0|3] ""  ADAS
 SG_ DET_RANGE_363 : 264|15@1+ (0.015625,0) [0|500] "m"  ADAS
 SG_ DET_RANGE_ERR_363 : 280|7@1+ (0.0075,0) [0|0.9525] "m"  ADAS
 SG_ DET_RANGE_VELOCITY_363 : 288|15@1+ (0.0078125,-128) [-128|127.9921875] "m/s"  ADAS
 SG_ DET_RANGE_VELOCITY_ERR_363 : 304|8@1+ (0.003,0) [0|0.765] "m/s"  ADAS
 SG_ DET_AZIMUTH_363 : 328|13@1+ (0.0004,-1.5708) [-1.5708|1.5708] "rad"  ADAS
 SG_ DET_AZIMUTH_ERR_363 : 345|7@1+ (0.00087267,0) [0|0.11082909] "rad"  ADAS
 SG_ DET_ELEVATION_363 : 312|8@1+ (0.00275,-0.34925) [-0.34925|0.34925] "rad"  ADAS
 SG_ DET_ELEVATION_ERR_363 : 320|6@1+ (0.00174533,0) [0|0.10995579] "rad"  ADAS
 SG_ DET_RCS_363 : 376|8@1+ (0.5,-64) [-64|63.5] "dBsm"  ADAS
 SG_ DET_VALID_FLAG_363 : 399|1@1+ (1,0) [0|1] ""  ADAS
 SG_ DET_BI_STATIC_FLAG_363 : 482|1@1+ (1,0) [0|1] ""  ADAS
 SG_ DET_SUPER_RES_TARGET_363 : 344|1@1+ (1,0) [0|1] ""  ADAS
 SG_ DET_SNR_363 : 368|8@1+ (0.35156,0) [0|89.6478] "dB"  ADAS
 SG_ DET_POINT_TARGET_PROB_363 : 360|4@1+ (6.67,0) [0|100] "%"  ADAS
 SG_ DET_EXISTENCE_PROB_363 : 352|6@1+ (1.588,0) [0|100] "%"  ADAS
 SG_ DET_OUTSIDE_SECTOR_363 : 407|1@1+ (1,0) [0|1] ""  ADAS
 SG_ DET_HVC_FLAG_363 : 364|1@1+ (1,0) [0|1] ""  ADAS
 SG_ DET_CONFD_AZIMUTH_363 : 365|2@1+ (1,0) [0|3] ""  ADAS
 SG_ DET_CONFD_ELEVATION_363 : 358|2@1+ (1,0) [0|3] ""  ADAS
 SG_ DET_RANGE_364 : 384|15@1+ (0.015625,0) [0|500] "m"  ADAS
 SG_ DET_RANGE_ERR_364 : 400|7@1+ (0.0075,0) [0|0.9525] "m"  ADAS
 SG_ DET_RANGE_VELOCITY_364 : 408|15@1+ (0.0078125,-128) [-128|127.9921875] "m/s"  ADAS
 SG_ DET_RANGE_VELOCITY_ERR_364 : 424|8@1+ (0.003,0) [0|0.765] "m/s"  ADAS
 SG_ DET_AZIMUTH_364 : 448|13@1+ (0.0004,-1.5708) [-1.5708|1.5708] "rad"  ADAS
 SG_ DET_AZIMUTH_ERR_364 : 465|7@1+ (0.00087267,0) [0|0.11082909] "rad"  ADAS
 SG_ DET_ELEVATION_364 : 432|8@1+ (0.00275,-0.34925) [-0.34925|0.34925] "rad"  ADAS
 SG_ DET_ELEVATION_ERR_364 : 440|6@1+ (0.00174533,0) [0|0.10995579] "rad"  ADAS
 SG_ DET_RCS_364 : 496|8@1+ (0.5,-64) [-64|63.5] "dBsm"  ADAS
 SG_ DET_VALID_FLAG_364 : 485|1@1+ (1,0) [0|1] ""  ADAS
 SG_ DET_BI_STATIC_FLAG_364 : 483|1@1+ (1,0) [0|1] ""  ADAS
 SG_ DET_SUPER_RES_TARGET_364 : 446|1@1+ (1,0) [0|1] ""  ADAS
 SG_ DET_SNR_364 : 488|8@1+ (0.35156,0) [0|89.6478] "dB"  ADAS
 SG_ DET_POINT_TARGET_PROB_364 : 472|4@1+ (6.67,0) [0|100] "%"  ADAS
 SG_ DET_EXISTENCE_PROB_364 : 506|6@1+ (1.588,0) [0|100] "%"  ADAS
 SG_ DET_OUTSIDE_SECTOR_364 : 481|1@1+ (1,0) [0|1] ""  ADAS
 SG_ DET_HVC_FLAG_364 : 464|1@1+ (1,0) [0|1] ""  ADAS
 SG_ DET_CONFD_AZIMUTH_364 : 486|2@1+ (1,0) [0|3] ""  ADAS
 SG_ DET_CONFD_ELEVATION_364 : 461|2@1+ (1,0) [0|3] ""  ADAS
 SG_ DET_MH_SCAN_INDEX_4LSB_361_364 : 476|4@1+ (1,0) [0|15] ""  ADAS
 SG_ DET_MH_CYCLE_COUNTER_361_364 : 16|8@1+ (1,0) [0|255] ""  ADAS
 SG_ DET_MH_CRC16_361_364 : 0|16@1+ (1,0) [0|65535] ""  ADAS

BO_ 1243 RDR_DETECTION_365_368: 64 RDR08
 SG_ DET_RANGE_365 : 24|15@1+ (0.015625,0) [0|500] "m"  ADAS
 SG_ DET_RANGE_ERR_365 : 40|7@1+ (0.0075,0) [0|0.9525] "m"  ADAS
 SG_ DET_RANGE_VELOCITY_365 : 48|15@1+ (0.0078125,-128) [-128|127.9921875] "m/s"  ADAS
 SG_ DET_RANGE_VELOCITY_ERR_365 : 64|8@1+ (0.003,0) [0|0.765] "m/s"  ADAS
 SG_ DET_AZIMUTH_365 : 88|13@1+ (0.0004,-1.5708) [-1.5708|1.5708] "rad"  ADAS
 SG_ DET_AZIMUTH_ERR_365 : 105|7@1+ (0.00087267,0) [0|0.11082909] "rad"  ADAS
 SG_ DET_ELEVATION_365 : 72|8@1+ (0.00275,-0.34925) [-0.34925|0.34925] "rad"  ADAS
 SG_ DET_ELEVATION_ERR_365 : 80|6@1+ (0.00174533,0) [0|0.10995579] "rad"  ADAS
 SG_ DET_RCS_365 : 136|8@1+ (0.5,-64) [-64|63.5] "dBsm"  ADAS
 SG_ DET_VALID_FLAG_365 : 119|1@1+ (1,0) [0|1] ""  ADAS
 SG_ DET_BI_STATIC_FLAG_365 : 504|1@1+ (1,0) [0|1] ""  ADAS
 SG_ DET_SUPER_RES_TARGET_365 : 104|1@1+ (1,0) [0|1] ""  ADAS
 SG_ DET_SNR_365 : 128|8@1+ (0.35156,0) [0|89.6478] "dB"  ADAS
 SG_ DET_POINT_TARGET_PROB_365 : 114|4@1+ (6.67,0) [0|100] "%"  ADAS
 SG_ DET_EXISTENCE_PROB_365 : 120|6@1+ (1.588,0) [0|100] "%"  ADAS
 SG_ DET_OUTSIDE_SECTOR_365 : 159|1@1+ (1,0) [0|1] ""  ADAS
 SG_ DET_HVC_FLAG_365 : 118|1@1+ (1,0) [0|1] ""  ADAS
 SG_ DET_CONFD_AZIMUTH_365 : 126|2@1+ (1,0) [0|3] ""  ADAS
 SG_ DET_CONFD_ELEVATION_365 : 112|2@1+ (1,0) [0|3] ""  ADAS
 SG_ DET_RANGE_366 : 144|15@1+ (0.015625,0) [0|500] "m"  ADAS
 SG_ DET_RANGE_ERR_366 : 160|7@1+ (0.0075,0) [0|0.9525] "m"  ADAS
 SG_ DET_RANGE_VELOCITY_366 : 168|15@1+ (0.0078125,-128) [-128|127.9921875] "m/s"  ADAS
 SG_ DET_RANGE_VELOCITY_ERR_366 : 184|8@1+ (0.003,0) [0|0.765] "m/s"  ADAS
 SG_ DET_AZIMUTH_366 : 208|13@1+ (0.0004,-1.5708) [-1.5708|1.5708] "rad"  ADAS
 SG_ DET_AZIMUTH_ERR_366 : 224|7@1+ (0.00087267,0) [0|0.11082909] "rad"  ADAS
 SG_ DET_ELEVATION_366 : 192|8@1+ (0.00275,-0.34925) [-0.34925|0.34925] "rad"  ADAS
 SG_ DET_ELEVATION_ERR_366 : 200|6@1+ (0.00174533,0) [0|0.10995579] "rad"  ADAS
 SG_ DET_RCS_366 : 256|8@1+ (0.5,-64) [-64|63.5] "dBsm"  ADAS
 SG_ DET_VALID_FLAG_366 : 167|1@1+ (1,0) [0|1] ""  ADAS
 SG_ DET_BI_STATIC_FLAG_366 : 505|1@1+ (1,0) [0|1] ""  ADAS
 SG_ DET_SUPER_RES_TARGET_366 : 247|1@1+ (1,0) [0|1] ""  ADAS
 SG_ DET_SNR_366 : 248|8@1+ (0.35156,0) [0|89.6478] "dB"  ADAS
 SG_ DET_POINT_TARGET_PROB_366 : 240|4@1+ (6.67,0) [0|100] "%"  ADAS
 SG_ DET_EXISTENCE_PROB_366 : 232|6@1+ (1.588,0) [0|100] "%"  ADAS
 SG_ DET_OUTSIDE_SECTOR_366 : 183|1@1+ (1,0) [0|1] ""  ADAS
 SG_ DET_HVC_FLAG_366 : 246|1@1+ (1,0) [0|1] ""  ADAS
 SG_ DET_CONFD_AZIMUTH_366 : 206|2@1+ (1,0) [0|3] ""  ADAS
 SG_ DET_CONFD_ELEVATION_366 : 244|2@1+ (1,0) [0|3] ""  ADAS
 SG_ DET_RANGE_367 : 264|15@1+ (0.015625,0) [0|500] "m"  ADAS
 SG_ DET_RANGE_ERR_367 : 280|7@1+ (0.0075,0) [0|0.9525] "m"  ADAS
 SG_ DET_RANGE_VELOCITY_367 : 288|15@1+ (0.0078125,-128) [-128|127.9921875] "m/s"  ADAS
 SG_ DET_RANGE_VELOCITY_ERR_367 : 304|8@1+ (0.003,0) [0|0.765] "m/s"  ADAS
 SG_ DET_AZIMUTH_367 : 328|13@1+ (0.0004,-1.5708) [-1.5708|1.5708] "rad"  ADAS
 SG_ DET_AZIMUTH_ERR_367 : 345|7@1+ (0.00087267,0) [0|0.11082909] "rad"  ADAS
 SG_ DET_ELEVATION_367 : 312|8@1+ (0.00275,-0.34925) [-0.34925|0.34925] "rad"  ADAS
 SG_ DET_ELEVATION_ERR_367 : 320|6@1+ (0.00174533,0) [0|0.10995579] "rad"  ADAS
 SG_ DET_RCS_367 : 376|8@1+ (0.5,-64) [-64|63.5] "dBsm"  ADAS
 SG_ DET_VALID_FLAG_367 : 399|1@1+ (1,0) [0|1] ""  ADAS
 SG_ DET_BI_STATIC_FLAG_367 : 482|1@1+ (1,0) [0|1] ""  ADAS
 SG_ DET_SUPER_RES_TARGET_367 : 344|1@1+ (1,0) [0|1] ""  ADAS
 SG_ DET_SNR_367 : 368|8@1+ (0.35156,0) [0|89.6478] "dB"  ADAS
 SG_ DET_POINT_TARGET_PROB_367 : 360|4@1+ (6.67,0) [0|100] "%"  ADAS
 SG_ DET_EXISTENCE_PROB_367 : 352|6@1+ (1.588,0) [0|100] "%"  ADAS
 SG_ DET_OUTSIDE_SECTOR_367 : 407|1@1+ (1,0) [0|1] ""  ADAS
 SG_ DET_HVC_FLAG_367 : 364|1@1+ (1,0) [0|1] ""  ADAS
 SG_ DET_CONFD_AZIMUTH_367 : 365|2@1+ (1,0) [0|3] ""  ADAS
 SG_ DET_CONFD_ELEVATION_367 : 358|2@1+ (1,0) [0|3] ""  ADAS
 SG_ DET_RANGE_368 : 384|15@1+ (0.015625,0) [0|500] "m"  ADAS
 SG_ DET_RANGE_ERR_368 : 400|7@1+ (0.0075,0) [0|0.9525] "m"  ADAS
 SG_ DET_RANGE_VELOCITY_368 : 408|15@1+ (0.0078125,-128) [-128|127.9921875] "m/s"  ADAS
 SG_ DET_RANGE_VELOCITY_ERR_368 : 424|8@1+ (0.003,0) [0|0.765] "m/s"  ADAS
 SG_ DET_AZIMUTH_368 : 448|13@1+ (0.0004,-1.5708) [-1.5708|1.5708] "rad"  ADAS
 SG_ DET_AZIMUTH_ERR_368 : 465|7@1+ (0.00087267,0) [0|0.11082909] "rad"  ADAS
 SG_ DET_ELEVATION_368 : 432|8@1+ (0.00275,-0.34925) [-0.34925|0.34925] "rad"  ADAS
 SG_ DET_ELEVATION_ERR_368 : 440|6@1+ (0.00174533,0) [0|0.10995579] "rad"  ADAS
 SG_ DET_RCS_368 : 496|8@1+ (0.5,-64) [-64|63.5] "dBsm"  ADAS
 SG_ DET_VALID_FLAG_368 : 485|1@1+ (1,0) [0|1] ""  ADAS
 SG_ DET_BI_STATIC_FLAG_368 : 483|1@1+ (1,0) [0|1] ""  ADAS
 SG_ DET_SUPER_RES_TARGET_368 : 446|1@1+ (1,0) [0|1] ""  ADAS
 SG_ DET_SNR_368 : 488|8@1+ (0.35156,0) [0|89.6478] "dB"  ADAS
 SG_ DET_POINT_TARGET_PROB_368 : 472|4@1+ (6.67,0) [0|100] "%"  ADAS
 SG_ DET_EXISTENCE_PROB_368 : 506|6@1+ (1.588,0) [0|100] "%"  ADAS
 SG_ DET_OUTSIDE_SECTOR_368 : 481|1@1+ (1,0) [0|1] ""  ADAS
 SG_ DET_HVC_FLAG_368 : 464|1@1+ (1,0) [0|1] ""  ADAS
 SG_ DET_CONFD_AZIMUTH_368 : 486|2@1+ (1,0) [0|3] ""  ADAS
 SG_ DET_CONFD_ELEVATION_368 : 461|2@1+ (1,0) [0|3] ""  ADAS
 SG_ DET_MH_SCAN_INDEX_4LSB_365_368 : 476|4@1+ (1,0) [0|15] ""  ADAS
 SG_ DET_MH_CYCLE_COUNTER_365_368 : 16|8@1+ (1,0) [0|255] ""  ADAS
 SG_ DET_MH_CRC16_365_368 : 0|16@1+ (1,0) [0|65535] ""  ADAS

BO_ 1244 RDR_DETECTION_369_372: 64 RDR08
 SG_ DET_RANGE_369 : 24|15@1+ (0.015625,0) [0|500] "m"  ADAS
 SG_ DET_RANGE_ERR_369 : 40|7@1+ (0.0075,0) [0|0.9525] "m"  ADAS
 SG_ DET_RANGE_VELOCITY_369 : 48|15@1+ (0.0078125,-128) [-128|127.9921875] "m/s"  ADAS
 SG_ DET_RANGE_VELOCITY_ERR_369 : 64|8@1+ (0.003,0) [0|0.765] "m/s"  ADAS
 SG_ DET_AZIMUTH_369 : 88|13@1+ (0.0004,-1.5708) [-1.5708|1.5708] "rad"  ADAS
 SG_ DET_AZIMUTH_ERR_369 : 105|7@1+ (0.00087267,0) [0|0.11082909] "rad"  ADAS
 SG_ DET_ELEVATION_369 : 72|8@1+ (0.00275,-0.34925) [-0.34925|0.34925] "rad"  ADAS
 SG_ DET_ELEVATION_ERR_369 : 80|6@1+ (0.00174533,0) [0|0.10995579] "rad"  ADAS
 SG_ DET_RCS_369 : 136|8@1+ (0.5,-64) [-64|63.5] "dBsm"  ADAS
 SG_ DET_VALID_FLAG_369 : 119|1@1+ (1,0) [0|1] ""  ADAS
 SG_ DET_BI_STATIC_FLAG_369 : 504|1@1+ (1,0) [0|1] ""  ADAS
 SG_ DET_SUPER_RES_TARGET_369 : 104|1@1+ (1,0) [0|1] ""  ADAS
 SG_ DET_SNR_369 : 128|8@1+ (0.35156,0) [0|89.6478] "dB"  ADAS
 SG_ DET_POINT_TARGET_PROB_369 : 114|4@1+ (6.67,0) [0|100] "%"  ADAS
 SG_ DET_EXISTENCE_PROB_369 : 120|6@1+ (1.588,0) [0|100] "%"  ADAS
 SG_ DET_OUTSIDE_SECTOR_369 : 159|1@1+ (1,0) [0|1] ""  ADAS
 SG_ DET_HVC_FLAG_369 : 118|1@1+ (1,0) [0|1] ""  ADAS
 SG_ DET_CONFD_AZIMUTH_369 : 126|2@1+ (1,0) [0|3] ""  ADAS
 SG_ DET_CONFD_ELEVATION_369 : 112|2@1+ (1,0) [0|3] ""  ADAS
 SG_ DET_RANGE_370 : 144|15@1+ (0.015625,0) [0|500] "m"  ADAS
 SG_ DET_RANGE_ERR_370 : 160|7@1+ (0.0075,0) [0|0.9525] "m"  ADAS
 SG_ DET_RANGE_VELOCITY_370 : 168|15@1+ (0.0078125,-128) [-128|127.9921875] "m/s"  ADAS
 SG_ DET_RANGE_VELOCITY_ERR_370 : 184|8@1+ (0.003,0) [0|0.765] "m/s"  ADAS
 SG_ DET_AZIMUTH_370 : 208|13@1+ (0.0004,-1.5708) [-1.5708|1.5708] "rad"  ADAS
 SG_ DET_AZIMUTH_ERR_370 : 224|7@1+ (0.00087267,0) [0|0.11082909] "rad"  ADAS
 SG_ DET_ELEVATION_370 : 192|8@1+ (0.00275,-0.34925) [-0.34925|0.34925] "rad"  ADAS
 SG_ DET_ELEVATION_ERR_370 : 200|6@1+ (0.00174533,0) [0|0.10995579] "rad"  ADAS
 SG_ DET_RCS_370 : 256|8@1+ (0.5,-64) [-64|63.5] "dBsm"  ADAS
 SG_ DET_VALID_FLAG_370 : 167|1@1+ (1,0) [0|1] ""  ADAS
 SG_ DET_BI_STATIC_FLAG_370 : 505|1@1+ (1,0) [0|1] ""  ADAS
 SG_ DET_SUPER_RES_TARGET_370 : 247|1@1+ (1,0) [0|1] ""  ADAS
 SG_ DET_SNR_370 : 248|8@1+ (0.35156,0) [0|89.6478] "dB"  ADAS
 SG_ DET_POINT_TARGET_PROB_370 : 240|4@1+ (6.67,0) [0|100] "%"  ADAS
 SG_ DET_EXISTENCE_PROB_370 : 232|6@1+ (1.588,0) [0|100] "%"  ADAS
 SG_ DET_OUTSIDE_SECTOR_370 : 183|1@1+ (1,0) [0|1] ""  ADAS
 SG_ DET_HVC_FLAG_370 : 246|1@1+ (1,0) [0|1] ""  ADAS
 SG_ DET_CONFD_AZIMUTH_370 : 206|2@1+ (1,0) [0|3] ""  ADAS
 SG_ DET_CONFD_ELEVATION_370 : 244|2@1+ (1,0) [0|3] ""  ADAS
 SG_ DET_RANGE_371 : 264|15@1+ (0.015625,0) [0|500] "m"  ADAS
 SG_ DET_RANGE_ERR_371 : 280|7@1+ (0.0075,0) [0|0.9525] "m"  ADAS
 SG_ DET_RANGE_VELOCITY_371 : 288|15@1+ (0.0078125,-128) [-128|127.9921875] "m/s"  ADAS
 SG_ DET_RANGE_VELOCITY_ERR_371 : 304|8@1+ (0.003,0) [0|0.765] "m/s"  ADAS
 SG_ DET_AZIMUTH_371 : 328|13@1+ (0.0004,-1.5708) [-1.5708|1.5708] "rad"  ADAS
 SG_ DET_AZIMUTH_ERR_371 : 345|7@1+ (0.00087267,0) [0|0.11082909] "rad"  ADAS
 SG_ DET_ELEVATION_371 : 312|8@1+ (0.00275,-0.34925) [-0.34925|0.34925] "rad"  ADAS
 SG_ DET_ELEVATION_ERR_371 : 320|6@1+ (0.00174533,0) [0|0.10995579] "rad"  ADAS
 SG_ DET_RCS_371 : 376|8@1+ (0.5,-64) [-64|63.5] "dBsm"  ADAS
 SG_ DET_VALID_FLAG_371 : 399|1@1+ (1,0) [0|1] ""  ADAS
 SG_ DET_BI_STATIC_FLAG_371 : 482|1@1+ (1,0) [0|1] ""  ADAS
 SG_ DET_SUPER_RES_TARGET_371 : 344|1@1+ (1,0) [0|1] ""  ADAS
 SG_ DET_SNR_371 : 368|8@1+ (0.35156,0) [0|89.6478] "dB"  ADAS
 SG_ DET_POINT_TARGET_PROB_371 : 360|4@1+ (6.67,0) [0|100] "%"  ADAS
 SG_ DET_EXISTENCE_PROB_371 : 352|6@1+ (1.588,0) [0|100] "%"  ADAS
 SG_ DET_OUTSIDE_SECTOR_371 : 407|1@1+ (1,0) [0|1] ""  ADAS
 SG_ DET_HVC_FLAG_371 : 364|1@1+ (1,0) [0|1] ""  ADAS
 SG_ DET_CONFD_AZIMUTH_371 : 365|2@1+ (1,0) [0|3] ""  ADAS
 SG_ DET_CONFD_ELEVATION_371 : 358|2@1+ (1,0) [0|3] ""  ADAS
 SG_ DET_RANGE_372 : 384|15@1+ (0.015625,0) [0|500] "m"  ADAS
 SG_ DET_RANGE_ERR_372 : 400|7@1+ (0.0075,0) [0|0.9525] "m"  ADAS
 SG_ DET_RANGE_VELOCITY_372 : 408|15@1+ (0.0078125,-128) [-128|127.9921875] "m/s"  ADAS
 SG_ DET_RANGE_VELOCITY_ERR_372 : 424|8@1+ (0.003,0) [0|0.765] "m/s"  ADAS
 SG_ DET_AZIMUTH_372 : 448|13@1+ (0.0004,-1.5708) [-1.5708|1.5708] "rad"  ADAS
 SG_ DET_AZIMUTH_ERR_372 : 465|7@1+ (0.00087267,0) [0|0.11082909] "rad"  ADAS
 SG_ DET_ELEVATION_372 : 432|8@1+ (0.00275,-0.34925) [-0.34925|0.34925] "rad"  ADAS
 SG_ DET_ELEVATION_ERR_372 : 440|6@1+ (0.00174533,0) [0|0.10995579] "rad"  ADAS
 SG_ DET_RCS_372 : 496|8@1+ (0.5,-64) [-64|63.5] "dBsm"  ADAS
 SG_ DET_VALID_FLAG_372 : 485|1@1+ (1,0) [0|1] ""  ADAS
 SG_ DET_BI_STATIC_FLAG_372 : 483|1@1+ (1,0) [0|1] ""  ADAS
 SG_ DET_SUPER_RES_TARGET_372 : 446|1@1+ (1,0) [0|1] ""  ADAS
 SG_ DET_SNR_372 : 488|8@1+ (0.35156,0) [0|89.6478] "dB"  ADAS
 SG_ DET_POINT_TARGET_PROB_372 : 472|4@1+ (6.67,0) [0|100] "%"  ADAS
 SG_ DET_EXISTENCE_PROB_372 : 506|6@1+ (1.588,0) [0|100] "%"  ADAS
 SG_ DET_OUTSIDE_SECTOR_372 : 481|1@1+ (1,0) [0|1] ""  ADAS
 SG_ DET_HVC_FLAG_372 : 464|1@1+ (1,0) [0|1] ""  ADAS
 SG_ DET_CONFD_AZIMUTH_372 : 486|2@1+ (1,0) [0|3] ""  ADAS
 SG_ DET_CONFD_ELEVATION_372 : 461|2@1+ (1,0) [0|3] ""  ADAS
 SG_ DET_MH_SCAN_INDEX_4LSB_369_372 : 476|4@1+ (1,0) [0|15] ""  ADAS
 SG_ DET_MH_CYCLE_COUNTER_369_372 : 16|8@1+ (1,0) [0|255] ""  ADAS
 SG_ DET_MH_CRC16_369_372 : 0|16@1+ (1,0) [0|65535] ""  ADAS

BO_ 1245 RDR_DETECTION_373_376: 64 RDR08
 SG_ DET_RANGE_373 : 24|15@1+ (0.015625,0) [0|500] "m"  ADAS
 SG_ DET_RANGE_ERR_373 : 40|7@1+ (0.0075,0) [0|0.9525] "m"  ADAS
 SG_ DET_RANGE_VELOCITY_373 : 48|15@1+ (0.0078125,-128) [-128|127.9921875] "m/s"  ADAS
 SG_ DET_RANGE_VELOCITY_ERR_373 : 64|8@1+ (0.003,0) [0|0.765] "m/s"  ADAS
 SG_ DET_AZIMUTH_373 : 88|13@1+ (0.0004,-1.5708) [-1.5708|1.5708] "rad"  ADAS
 SG_ DET_AZIMUTH_ERR_373 : 105|7@1+ (0.00087267,0) [0|0.11082909] "rad"  ADAS
 SG_ DET_ELEVATION_373 : 72|8@1+ (0.00275,-0.34925) [-0.34925|0.34925] "rad"  ADAS
 SG_ DET_ELEVATION_ERR_373 : 80|6@1+ (0.00174533,0) [0|0.10995579] "rad"  ADAS
 SG_ DET_RCS_373 : 136|8@1+ (0.5,-64) [-64|63.5] "dBsm"  ADAS
 SG_ DET_VALID_FLAG_373 : 119|1@1+ (1,0) [0|1] ""  ADAS
 SG_ DET_BI_STATIC_FLAG_373 : 504|1@1+ (1,0) [0|1] ""  ADAS
 SG_ DET_SUPER_RES_TARGET_373 : 104|1@1+ (1,0) [0|1] ""  ADAS
 SG_ DET_SNR_373 : 128|8@1+ (0.35156,0) [0|89.6478] "dB"  ADAS
 SG_ DET_POINT_TARGET_PROB_373 : 114|4@1+ (6.67,0) [0|100] "%"  ADAS
 SG_ DET_EXISTENCE_PROB_373 : 120|6@1+ (1.588,0) [0|100] "%"  ADAS
 SG_ DET_OUTSIDE_SECTOR_373 : 159|1@1+ (1,0) [0|1] ""  ADAS
 SG_ DET_HVC_FLAG_373 : 118|1@1+ (1,0) [0|1] ""  ADAS
 SG_ DET_CONFD_AZIMUTH_373 : 126|2@1+ (1,0) [0|3] ""  ADAS
 SG_ DET_CONFD_ELEVATION_373 : 112|2@1+ (1,0) [0|3] ""  ADAS
 SG_ DET_RANGE_374 : 144|15@1+ (0.015625,0) [0|500] "m"  ADAS
 SG_ DET_RANGE_ERR_374 : 160|7@1+ (0.0075,0) [0|0.9525] "m"  ADAS
 SG_ DET_RANGE_VELOCITY_374 : 168|15@1+ (0.0078125,-128) [-128|127.9921875] "m/s"  ADAS
 SG_ DET_RANGE_VELOCITY_ERR_374 : 184|8@1+ (0.003,0) [0|0.765] "m/s"  ADAS
 SG_ DET_AZIMUTH_374 : 208|13@1+ (0.0004,-1.5708) [-1.5708|1.5708] "rad"  ADAS
 SG_ DET_AZIMUTH_ERR_374 : 224|7@1+ (0.00087267,0) [0|0.11082909] "rad"  ADAS
 SG_ DET_ELEVATION_374 : 192|8@1+ (0.00275,-0.34925) [-0.34925|0.34925] "rad"  ADAS
 SG_ DET_ELEVATION_ERR_374 : 200|6@1+ (0.00174533,0) [0|0.10995579] "rad"  ADAS
 SG_ DET_RCS_374 : 256|8@1+ (0.5,-64) [-64|63.5] "dBsm"  ADAS
 SG_ DET_VALID_FLAG_374 : 167|1@1+ (1,0) [0|1] ""  ADAS
 SG_ DET_BI_STATIC_FLAG_374 : 505|1@1+ (1,0) [0|1] ""  ADAS
 SG_ DET_SUPER_RES_TARGET_374 : 247|1@1+ (1,0) [0|1] ""  ADAS
 SG_ DET_SNR_374 : 248|8@1+ (0.35156,0) [0|89.6478] "dB"  ADAS
 SG_ DET_POINT_TARGET_PROB_374 : 240|4@1+ (6.67,0) [0|100] "%"  ADAS
 SG_ DET_EXISTENCE_PROB_374 : 232|6@1+ (1.588,0) [0|100] "%"  ADAS
 SG_ DET_OUTSIDE_SECTOR_374 : 183|1@1+ (1,0) [0|1] ""  ADAS
 SG_ DET_HVC_FLAG_374 : 246|1@1+ (1,0) [0|1] ""  ADAS
 SG_ DET_CONFD_AZIMUTH_374 : 206|2@1+ (1,0) [0|3] ""  ADAS
 SG_ DET_CONFD_ELEVATION_374 : 244|2@1+ (1,0) [0|3] ""  ADAS
 SG_ DET_RANGE_375 : 264|15@1+ (0.015625,0) [0|500] "m"  ADAS
 SG_ DET_RANGE_ERR_375 : 280|7@1+ (0.0075,0) [0|0.9525] "m"  ADAS
 SG_ DET_RANGE_VELOCITY_375 : 288|15@1+ (0.0078125,-128) [-128|127.9921875] "m/s"  ADAS
 SG_ DET_RANGE_VELOCITY_ERR_375 : 304|8@1+ (0.003,0) [0|0.765] "m/s"  ADAS
 SG_ DET_AZIMUTH_375 : 328|13@1+ (0.0004,-1.5708) [-1.5708|1.5708] "rad"  ADAS
 SG_ DET_AZIMUTH_ERR_375 : 345|7@1+ (0.00087267,0) [0|0.11082909] "rad"  ADAS
 SG_ DET_ELEVATION_375 : 312|8@1+ (0.00275,-0.34925) [-0.34925|0.34925] "rad"  ADAS
 SG_ DET_ELEVATION_ERR_375 : 320|6@1+ (0.00174533,0) [0|0.10995579] "rad"  ADAS
 SG_ DET_RCS_375 : 376|8@1+ (0.5,-64) [-64|63.5] "dBsm"  ADAS
 SG_ DET_VALID_FLAG_375 : 399|1@1+ (1,0) [0|1] ""  ADAS
 SG_ DET_BI_STATIC_FLAG_375 : 482|1@1+ (1,0) [0|1] ""  ADAS
 SG_ DET_SUPER_RES_TARGET_375 : 344|1@1+ (1,0) [0|1] ""  ADAS
 SG_ DET_SNR_375 : 368|8@1+ (0.35156,0) [0|89.6478] "dB"  ADAS
 SG_ DET_POINT_TARGET_PROB_375 : 360|4@1+ (6.67,0) [0|100] "%"  ADAS
 SG_ DET_EXISTENCE_PROB_375 : 352|6@1+ (1.588,0) [0|100] "%"  ADAS
 SG_ DET_OUTSIDE_SECTOR_375 : 407|1@1+ (1,0) [0|1] ""  ADAS
 SG_ DET_HVC_FLAG_375 : 364|1@1+ (1,0) [0|1] ""  ADAS
 SG_ DET_CONFD_AZIMUTH_375 : 365|2@1+ (1,0) [0|3] ""  ADAS
 SG_ DET_CONFD_ELEVATION_375 : 358|2@1+ (1,0) [0|3] ""  ADAS
 SG_ DET_RANGE_376 : 384|15@1+ (0.015625,0) [0|500] "m"  ADAS
 SG_ DET_RANGE_ERR_376 : 400|7@1+ (0.0075,0) [0|0.9525] "m"  ADAS
 SG_ DET_RANGE_VELOCITY_376 : 408|15@1+ (0.0078125,-128) [-128|127.9921875] "m/s"  ADAS
 SG_ DET_RANGE_VELOCITY_ERR_376 : 424|8@1+ (0.003,0) [0|0.765] "m/s"  ADAS
 SG_ DET_AZIMUTH_376 : 448|13@1+ (0.0004,-1.5708) [-1.5708|1.5708] "rad"  ADAS
 SG_ DET_AZIMUTH_ERR_376 : 465|7@1+ (0.00087267,0) [0|0.11082909] "rad"  ADAS
 SG_ DET_ELEVATION_376 : 432|8@1+ (0.00275,-0.34925) [-0.34925|0.34925] "rad"  ADAS
 SG_ DET_ELEVATION_ERR_376 : 440|6@1+ (0.00174533,0) [0|0.10995579] "rad"  ADAS
 SG_ DET_RCS_376 : 496|8@1+ (0.5,-64) [-64|63.5] "dBsm"  ADAS
 SG_ DET_VALID_FLAG_376 : 485|1@1+ (1,0) [0|1] ""  ADAS
 SG_ DET_BI_STATIC_FLAG_376 : 483|1@1+ (1,0) [0|1] ""  ADAS
 SG_ DET_SUPER_RES_TARGET_376 : 446|1@1+ (1,0) [0|1] ""  ADAS
 SG_ DET_SNR_376 : 488|8@1+ (0.35156,0) [0|89.6478] "dB"  ADAS
 SG_ DET_POINT_TARGET_PROB_376 : 472|4@1+ (6.67,0) [0|100] "%"  ADAS
 SG_ DET_EXISTENCE_PROB_376 : 506|6@1+ (1.588,0) [0|100] "%"  ADAS
 SG_ DET_OUTSIDE_SECTOR_376 : 481|1@1+ (1,0) [0|1] ""  ADAS
 SG_ DET_HVC_FLAG_376 : 464|1@1+ (1,0) [0|1] ""  ADAS
 SG_ DET_CONFD_AZIMUTH_376 : 486|2@1+ (1,0) [0|3] ""  ADAS
 SG_ DET_CONFD_ELEVATION_376 : 461|2@1+ (1,0) [0|3] ""  ADAS
 SG_ DET_MH_SCAN_INDEX_4LSB_373_376 : 476|4@1+ (1,0) [0|15] ""  ADAS
 SG_ DET_MH_CYCLE_COUNTER_373_376 : 16|8@1+ (1,0) [0|255] ""  ADAS
 SG_ DET_MH_CRC16_373_376 : 0|16@1+ (1,0) [0|65535] ""  ADAS

BO_ 1246 RDR_DETECTION_377_380: 64 RDR08
 SG_ DET_RANGE_377 : 24|15@1+ (0.015625,0) [0|500] "m"  ADAS
 SG_ DET_RANGE_ERR_377 : 40|7@1+ (0.0075,0) [0|0.9525] "m"  ADAS
 SG_ DET_RANGE_VELOCITY_377 : 48|15@1+ (0.0078125,-128) [-128|127.9921875] "m/s"  ADAS
 SG_ DET_RANGE_VELOCITY_ERR_377 : 64|8@1+ (0.003,0) [0|0.765] "m/s"  ADAS
 SG_ DET_AZIMUTH_377 : 88|13@1+ (0.0004,-1.5708) [-1.5708|1.5708] "rad"  ADAS
 SG_ DET_AZIMUTH_ERR_377 : 105|7@1+ (0.00087267,0) [0|0.11082909] "rad"  ADAS
 SG_ DET_ELEVATION_377 : 72|8@1+ (0.00275,-0.34925) [-0.34925|0.34925] "rad"  ADAS
 SG_ DET_ELEVATION_ERR_377 : 80|6@1+ (0.00174533,0) [0|0.10995579] "rad"  ADAS
 SG_ DET_RCS_377 : 136|8@1+ (0.5,-64) [-64|63.5] "dBsm"  ADAS
 SG_ DET_VALID_FLAG_377 : 119|1@1+ (1,0) [0|1] ""  ADAS
 SG_ DET_BI_STATIC_FLAG_377 : 504|1@1+ (1,0) [0|1] ""  ADAS
 SG_ DET_SUPER_RES_TARGET_377 : 104|1@1+ (1,0) [0|1] ""  ADAS
 SG_ DET_SNR_377 : 128|8@1+ (0.35156,0) [0|89.6478] "dB"  ADAS
 SG_ DET_POINT_TARGET_PROB_377 : 114|4@1+ (6.67,0) [0|100] "%"  ADAS
 SG_ DET_EXISTENCE_PROB_377 : 120|6@1+ (1.588,0) [0|100] "%"  ADAS
 SG_ DET_OUTSIDE_SECTOR_377 : 159|1@1+ (1,0) [0|1] ""  ADAS
 SG_ DET_HVC_FLAG_377 : 118|1@1+ (1,0) [0|1] ""  ADAS
 SG_ DET_CONFD_AZIMUTH_377 : 126|2@1+ (1,0) [0|3] ""  ADAS
 SG_ DET_CONFD_ELEVATION_377 : 112|2@1+ (1,0) [0|3] ""  ADAS
 SG_ DET_RANGE_378 : 144|15@1+ (0.015625,0) [0|500] "m"  ADAS
 SG_ DET_RANGE_ERR_378 : 160|7@1+ (0.0075,0) [0|0.9525] "m"  ADAS
 SG_ DET_RANGE_VELOCITY_378 : 168|15@1+ (0.0078125,-128) [-128|127.9921875] "m/s"  ADAS
 SG_ DET_RANGE_VELOCITY_ERR_378 : 184|8@1+ (0.003,0) [0|0.765] "m/s"  ADAS
 SG_ DET_AZIMUTH_378 : 208|13@1+ (0.0004,-1.5708) [-1.5708|1.5708] "rad"  ADAS
 SG_ DET_AZIMUTH_ERR_378 : 224|7@1+ (0.00087267,0) [0|0.11082909] "rad"  ADAS
 SG_ DET_ELEVATION_378 : 192|8@1+ (0.00275,-0.34925) [-0.34925|0.34925] "rad"  ADAS
 SG_ DET_ELEVATION_ERR_378 : 200|6@1+ (0.00174533,0) [0|0.10995579] "rad"  ADAS
 SG_ DET_RCS_378 : 256|8@1+ (0.5,-64) [-64|63.5] "dBsm"  ADAS
 SG_ DET_VALID_FLAG_378 : 167|1@1+ (1,0) [0|1] ""  ADAS
 SG_ DET_BI_STATIC_FLAG_378 : 505|1@1+ (1,0) [0|1] ""  ADAS
 SG_ DET_SUPER_RES_TARGET_378 : 247|1@1+ (1,0) [0|1] ""  ADAS
 SG_ DET_SNR_378 : 248|8@1+ (0.35156,0) [0|89.6478] "dB"  ADAS
 SG_ DET_POINT_TARGET_PROB_378 : 240|4@1+ (6.67,0) [0|100] "%"  ADAS
 SG_ DET_EXISTENCE_PROB_378 : 232|6@1+ (1.588,0) [0|100] "%"  ADAS
 SG_ DET_OUTSIDE_SECTOR_378 : 183|1@1+ (1,0) [0|1] ""  ADAS
 SG_ DET_HVC_FLAG_378 : 246|1@1+ (1,0) [0|1] ""  ADAS
 SG_ DET_CONFD_AZIMUTH_378 : 206|2@1+ (1,0) [0|3] ""  ADAS
 SG_ DET_CONFD_ELEVATION_378 : 244|2@1+ (1,0) [0|3] ""  ADAS
 SG_ DET_RANGE_379 : 264|15@1+ (0.015625,0) [0|500] "m"  ADAS
 SG_ DET_RANGE_ERR_379 : 280|7@1+ (0.0075,0) [0|0.9525] "m"  ADAS
 SG_ DET_RANGE_VELOCITY_379 : 288|15@1+ (0.0078125,-128) [-128|127.9921875] "m/s"  ADAS
 SG_ DET_RANGE_VELOCITY_ERR_379 : 304|8@1+ (0.003,0) [0|0.765] "m/s"  ADAS
 SG_ DET_AZIMUTH_379 : 328|13@1+ (0.0004,-1.5708) [-1.5708|1.5708] "rad"  ADAS
 SG_ DET_AZIMUTH_ERR_379 : 345|7@1+ (0.00087267,0) [0|0.11082909] "rad"  ADAS
 SG_ DET_ELEVATION_379 : 312|8@1+ (0.00275,-0.34925) [-0.34925|0.34925] "rad"  ADAS
 SG_ DET_ELEVATION_ERR_379 : 320|6@1+ (0.00174533,0) [0|0.10995579] "rad"  ADAS
 SG_ DET_RCS_379 : 376|8@1+ (0.5,-64) [-64|63.5] "dBsm"  ADAS
 SG_ DET_VALID_FLAG_379 : 399|1@1+ (1,0) [0|1] ""  ADAS
 SG_ DET_BI_STATIC_FLAG_379 : 482|1@1+ (1,0) [0|1] ""  ADAS
 SG_ DET_SUPER_RES_TARGET_379 : 344|1@1+ (1,0) [0|1] ""  ADAS
 SG_ DET_SNR_379 : 368|8@1+ (0.35156,0) [0|89.6478] "dB"  ADAS
 SG_ DET_POINT_TARGET_PROB_379 : 360|4@1+ (6.67,0) [0|100] "%"  ADAS
 SG_ DET_EXISTENCE_PROB_379 : 352|6@1+ (1.588,0) [0|100] "%"  ADAS
 SG_ DET_OUTSIDE_SECTOR_379 : 407|1@1+ (1,0) [0|1] ""  ADAS
 SG_ DET_HVC_FLAG_379 : 364|1@1+ (1,0) [0|1] ""  ADAS
 SG_ DET_CONFD_AZIMUTH_379 : 365|2@1+ (1,0) [0|3] ""  ADAS
 SG_ DET_CONFD_ELEVATION_379 : 358|2@1+ (1,0) [0|3] ""  ADAS
 SG_ DET_RANGE_380 : 384|15@1+ (0.015625,0) [0|500] "m"  ADAS
 SG_ DET_RANGE_ERR_380 : 400|7@1+ (0.0075,0) [0|0.9525] "m"  ADAS
 SG_ DET_RANGE_VELOCITY_380 : 408|15@1+ (0.0078125,-128) [-128|127.9921875] "m/s"  ADAS
 SG_ DET_RANGE_VELOCITY_ERR_380 : 424|8@1+ (0.003,0) [0|0.765] "m/s"  ADAS
 SG_ DET_AZIMUTH_380 : 448|13@1+ (0.0004,-1.5708) [-1.5708|1.5708] "rad"  ADAS
 SG_ DET_AZIMUTH_ERR_380 : 465|7@1+ (0.00087267,0) [0|0.11082909] "rad"  ADAS
 SG_ DET_ELEVATION_380 : 432|8@1+ (0.00275,-0.34925) [-0.34925|0.34925] "rad"  ADAS
 SG_ DET_ELEVATION_ERR_380 : 440|6@1+ (0.00174533,0) [0|0.10995579] "rad"  ADAS
 SG_ DET_RCS_380 : 496|8@1+ (0.5,-64) [-64|63.5] "dBsm"  ADAS
 SG_ DET_VALID_FLAG_380 : 485|1@1+ (1,0) [0|1] ""  ADAS
 SG_ DET_BI_STATIC_FLAG_380 : 483|1@1+ (1,0) [0|1] ""  ADAS
 SG_ DET_SUPER_RES_TARGET_380 : 446|1@1+ (1,0) [0|1] ""  ADAS
 SG_ DET_SNR_380 : 488|8@1+ (0.35156,0) [0|89.6478] "dB"  ADAS
 SG_ DET_POINT_TARGET_PROB_380 : 472|4@1+ (6.67,0) [0|100] "%"  ADAS
 SG_ DET_EXISTENCE_PROB_380 : 506|6@1+ (1.588,0) [0|100] "%"  ADAS
 SG_ DET_OUTSIDE_SECTOR_380 : 481|1@1+ (1,0) [0|1] ""  ADAS
 SG_ DET_HVC_FLAG_380 : 464|1@1+ (1,0) [0|1] ""  ADAS
 SG_ DET_CONFD_AZIMUTH_380 : 486|2@1+ (1,0) [0|3] ""  ADAS
 SG_ DET_CONFD_ELEVATION_380 : 461|2@1+ (1,0) [0|3] ""  ADAS
 SG_ DET_MH_SCAN_INDEX_4LSB_377_380 : 476|4@1+ (1,0) [0|15] ""  ADAS
 SG_ DET_MH_CYCLE_COUNTER_377_380 : 16|8@1+ (1,0) [0|255] ""  ADAS
 SG_ DET_MH_CRC16_377_380 : 0|16@1+ (1,0) [0|65535] ""  ADAS

BO_ 1247 RDR_DETECTION_381_384: 64 RDR08
 SG_ DET_RANGE_381 : 24|15@1+ (0.015625,0) [0|500] "m"  ADAS
 SG_ DET_RANGE_ERR_381 : 40|7@1+ (0.0075,0) [0|0.9525] "m"  ADAS
 SG_ DET_RANGE_VELOCITY_381 : 48|15@1+ (0.0078125,-128) [-128|127.9921875] "m/s"  ADAS
 SG_ DET_RANGE_VELOCITY_ERR_381 : 64|8@1+ (0.003,0) [0|0.765] "m/s"  ADAS
 SG_ DET_AZIMUTH_381 : 88|13@1+ (0.0004,-1.5708) [-1.5708|1.5708] "rad"  ADAS
 SG_ DET_AZIMUTH_ERR_381 : 105|7@1+ (0.00087267,0) [0|0.11082909] "rad"  ADAS
 SG_ DET_ELEVATION_381 : 72|8@1+ (0.00275,-0.34925) [-0.34925|0.34925] "rad"  ADAS
 SG_ DET_ELEVATION_ERR_381 : 80|6@1+ (0.00174533,0) [0|0.10995579] "rad"  ADAS
 SG_ DET_RCS_381 : 136|8@1+ (0.5,-64) [-64|63.5] "dBsm"  ADAS
 SG_ DET_VALID_FLAG_381 : 119|1@1+ (1,0) [0|1] ""  ADAS
 SG_ DET_BI_STATIC_FLAG_381 : 504|1@1+ (1,0) [0|1] ""  ADAS
 SG_ DET_SUPER_RES_TARGET_381 : 104|1@1+ (1,0) [0|1] ""  ADAS
 SG_ DET_SNR_381 : 128|8@1+ (0.35156,0) [0|89.6478] "dB"  ADAS
 SG_ DET_POINT_TARGET_PROB_381 : 114|4@1+ (6.67,0) [0|100] "%"  ADAS
 SG_ DET_EXISTENCE_PROB_381 : 120|6@1+ (1.588,0) [0|100] "%"  ADAS
 SG_ DET_OUTSIDE_SECTOR_381 : 159|1@1+ (1,0) [0|1] ""  ADAS
 SG_ DET_HVC_FLAG_381 : 118|1@1+ (1,0) [0|1] ""  ADAS
 SG_ DET_CONFD_AZIMUTH_381 : 126|2@1+ (1,0) [0|3] ""  ADAS
 SG_ DET_CONFD_ELEVATION_381 : 112|2@1+ (1,0) [0|3] ""  ADAS
 SG_ DET_RANGE_382 : 144|15@1+ (0.015625,0) [0|500] "m"  ADAS
 SG_ DET_RANGE_ERR_382 : 160|7@1+ (0.0075,0) [0|0.9525] "m"  ADAS
 SG_ DET_RANGE_VELOCITY_382 : 168|15@1+ (0.0078125,-128) [-128|127.9921875] "m/s"  ADAS
 SG_ DET_RANGE_VELOCITY_ERR_382 : 184|8@1+ (0.003,0) [0|0.765] "m/s"  ADAS
 SG_ DET_AZIMUTH_382 : 208|13@1+ (0.0004,-1.5708) [-1.5708|1.5708] "rad"  ADAS
 SG_ DET_AZIMUTH_ERR_382 : 224|7@1+ (0.00087267,0) [0|0.11082909] "rad"  ADAS
 SG_ DET_ELEVATION_382 : 192|8@1+ (0.00275,-0.34925) [-0.34925|0.34925] "rad"  ADAS
 SG_ DET_ELEVATION_ERR_382 : 200|6@1+ (0.00174533,0) [0|0.10995579] "rad"  ADAS
 SG_ DET_RCS_382 : 256|8@1+ (0.5,-64) [-64|63.5] "dBsm"  ADAS
 SG_ DET_VALID_FLAG_382 : 167|1@1+ (1,0) [0|1] ""  ADAS
 SG_ DET_BI_STATIC_FLAG_382 : 505|1@1+ (1,0) [0|1] ""  ADAS
 SG_ DET_SUPER_RES_TARGET_382 : 247|1@1+ (1,0) [0|1] ""  ADAS
 SG_ DET_SNR_382 : 248|8@1+ (0.35156,0) [0|89.6478] "dB"  ADAS
 SG_ DET_POINT_TARGET_PROB_382 : 240|4@1+ (6.67,0) [0|100] "%"  ADAS
 SG_ DET_EXISTENCE_PROB_382 : 232|6@1+ (1.588,0) [0|100] "%"  ADAS
 SG_ DET_OUTSIDE_SECTOR_382 : 183|1@1+ (1,0) [0|1] ""  ADAS
 SG_ DET_HVC_FLAG_382 : 246|1@1+ (1,0) [0|1] ""  ADAS
 SG_ DET_CONFD_AZIMUTH_382 : 206|2@1+ (1,0) [0|3] ""  ADAS
 SG_ DET_CONFD_ELEVATION_382 : 244|2@1+ (1,0) [0|3] ""  ADAS
 SG_ DET_RANGE_383 : 264|15@1+ (0.015625,0) [0|500] "m"  ADAS
 SG_ DET_RANGE_ERR_383 : 280|7@1+ (0.0075,0) [0|0.9525] "m"  ADAS
 SG_ DET_RANGE_VELOCITY_383 : 288|15@1+ (0.0078125,-128) [-128|127.9921875] "m/s"  ADAS
 SG_ DET_RANGE_VELOCITY_ERR_383 : 304|8@1+ (0.003,0) [0|0.765] "m/s"  ADAS
 SG_ DET_AZIMUTH_383 : 328|13@1+ (0.0004,-1.5708) [-1.5708|1.5708] "rad"  ADAS
 SG_ DET_AZIMUTH_ERR_383 : 345|7@1+ (0.00087267,0) [0|0.11082909] "rad"  ADAS
 SG_ DET_ELEVATION_383 : 312|8@1+ (0.00275,-0.34925) [-0.34925|0.34925] "rad"  ADAS
 SG_ DET_ELEVATION_ERR_383 : 320|6@1+ (0.00174533,0) [0|0.10995579] "rad"  ADAS
 SG_ DET_RCS_383 : 376|8@1+ (0.5,-64) [-64|63.5] "dBsm"  ADAS
 SG_ DET_VALID_FLAG_383 : 399|1@1+ (1,0) [0|1] ""  ADAS
 SG_ DET_BI_STATIC_FLAG_383 : 482|1@1+ (1,0) [0|1] ""  ADAS
 SG_ DET_SUPER_RES_TARGET_383 : 344|1@1+ (1,0) [0|1] ""  ADAS
 SG_ DET_SNR_383 : 368|8@1+ (0.35156,0) [0|89.6478] "dB"  ADAS
 SG_ DET_POINT_TARGET_PROB_383 : 360|4@1+ (6.67,0) [0|100] "%"  ADAS
 SG_ DET_EXISTENCE_PROB_383 : 352|6@1+ (1.588,0) [0|100] "%"  ADAS
 SG_ DET_OUTSIDE_SECTOR_383 : 407|1@1+ (1,0) [0|1] ""  ADAS
 SG_ DET_HVC_FLAG_383 : 364|1@1+ (1,0) [0|1] ""  ADAS
 SG_ DET_CONFD_AZIMUTH_383 : 365|2@1+ (1,0) [0|3] ""  ADAS
 SG_ DET_CONFD_ELEVATION_383 : 358|2@1+ (1,0) [0|3] ""  ADAS
 SG_ DET_RANGE_384 : 384|15@1+ (0.015625,0) [0|500] "m"  ADAS
 SG_ DET_RANGE_ERR_384 : 400|7@1+ (0.0075,0) [0|0.9525] "m"  ADAS
 SG_ DET_RANGE_VELOCITY_384 : 408|15@1+ (0.0078125,-128) [-128|127.9921875] "m/s"  ADAS
 SG_ DET_RANGE_VELOCITY_ERR_384 : 424|8@1+ (0.003,0) [0|0.765] "m/s"  ADAS
 SG_ DET_AZIMUTH_384 : 448|13@1+ (0.0004,-1.5708) [-1.5708|1.5708] "rad"  ADAS
 SG_ DET_AZIMUTH_ERR_384 : 465|7@1+ (0.00087267,0) [0|0.11082909] "rad"  ADAS
 SG_ DET_ELEVATION_384 : 432|8@1+ (0.00275,-0.34925) [-0.34925|0.34925] "rad"  ADAS
 SG_ DET_ELEVATION_ERR_384 : 440|6@1+ (0.00174533,0) [0|0.10995579] "rad"  ADAS
 SG_ DET_RCS_384 : 496|8@1+ (0.5,-64) [-64|63.5] "dBsm"  ADAS
 SG_ DET_VALID_FLAG_384 : 485|1@1+ (1,0) [0|1] ""  ADAS
 SG_ DET_BI_STATIC_FLAG_384 : 483|1@1+ (1,0) [0|1] ""  ADAS
 SG_ DET_SUPER_RES_TARGET_384 : 446|1@1+ (1,0) [0|1] ""  ADAS
 SG_ DET_SNR_384 : 488|8@1+ (0.35156,0) [0|89.6478] "dB"  ADAS
 SG_ DET_POINT_TARGET_PROB_384 : 472|4@1+ (6.67,0) [0|100] "%"  ADAS
 SG_ DET_EXISTENCE_PROB_384 : 506|6@1+ (1.588,0) [0|100] "%"  ADAS
 SG_ DET_OUTSIDE_SECTOR_384 : 481|1@1+ (1,0) [0|1] ""  ADAS
 SG_ DET_HVC_FLAG_384 : 464|1@1+ (1,0) [0|1] ""  ADAS
 SG_ DET_CONFD_AZIMUTH_384 : 486|2@1+ (1,0) [0|3] ""  ADAS
 SG_ DET_CONFD_ELEVATION_384 : 461|2@1+ (1,0) [0|3] ""  ADAS
 SG_ DET_MH_SCAN_INDEX_4LSB_381_384 : 476|4@1+ (1,0) [0|15] ""  ADAS
 SG_ DET_MH_CYCLE_COUNTER_381_384 : 16|8@1+ (1,0) [0|255] ""  ADAS
 SG_ DET_MH_CRC16_381_384 : 0|16@1+ (1,0) [0|65535] ""  ADAS

BO_ 1248 RDR_DETECTION_385_388: 64 RDR08
 SG_ DET_RANGE_385 : 24|15@1+ (0.015625,0) [0|500] "m"  ADAS
 SG_ DET_RANGE_ERR_385 : 40|7@1+ (0.0075,0) [0|0.9525] "m"  ADAS
 SG_ DET_RANGE_VELOCITY_385 : 48|15@1+ (0.0078125,-128) [-128|127.9921875] "m/s"  ADAS
 SG_ DET_RANGE_VELOCITY_ERR_385 : 64|8@1+ (0.003,0) [0|0.765] "m/s"  ADAS
 SG_ DET_AZIMUTH_385 : 88|13@1+ (0.0004,-1.5708) [-1.5708|1.5708] "rad"  ADAS
 SG_ DET_AZIMUTH_ERR_385 : 105|7@1+ (0.00087267,0) [0|0.11082909] "rad"  ADAS
 SG_ DET_ELEVATION_385 : 72|8@1+ (0.00275,-0.34925) [-0.34925|0.34925] "rad"  ADAS
 SG_ DET_ELEVATION_ERR_385 : 80|6@1+ (0.00174533,0) [0|0.10995579] "rad"  ADAS
 SG_ DET_RCS_385 : 136|8@1+ (0.5,-64) [-64|63.5] "dBsm"  ADAS
 SG_ DET_VALID_FLAG_385 : 119|1@1+ (1,0) [0|1] ""  ADAS
 SG_ DET_BI_STATIC_FLAG_385 : 504|1@1+ (1,0) [0|1] ""  ADAS
 SG_ DET_SUPER_RES_TARGET_385 : 104|1@1+ (1,0) [0|1] ""  ADAS
 SG_ DET_SNR_385 : 128|8@1+ (0.35156,0) [0|89.6478] "dB"  ADAS
 SG_ DET_POINT_TARGET_PROB_385 : 114|4@1+ (6.67,0) [0|100] "%"  ADAS
 SG_ DET_EXISTENCE_PROB_385 : 120|6@1+ (1.588,0) [0|100] "%"  ADAS
 SG_ DET_OUTSIDE_SECTOR_385 : 159|1@1+ (1,0) [0|1] ""  ADAS
 SG_ DET_HVC_FLAG_385 : 118|1@1+ (1,0) [0|1] ""  ADAS
 SG_ DET_CONFD_AZIMUTH_385 : 126|2@1+ (1,0) [0|3] ""  ADAS
 SG_ DET_CONFD_ELEVATION_385 : 112|2@1+ (1,0) [0|3] ""  ADAS
 SG_ DET_RANGE_386 : 144|15@1+ (0.015625,0) [0|500] "m"  ADAS
 SG_ DET_RANGE_ERR_386 : 160|7@1+ (0.0075,0) [0|0.9525] "m"  ADAS
 SG_ DET_RANGE_VELOCITY_386 : 168|15@1+ (0.0078125,-128) [-128|127.9921875] "m/s"  ADAS
 SG_ DET_RANGE_VELOCITY_ERR_386 : 184|8@1+ (0.003,0) [0|0.765] "m/s"  ADAS
 SG_ DET_AZIMUTH_386 : 208|13@1+ (0.0004,-1.5708) [-1.5708|1.5708] "rad"  ADAS
 SG_ DET_AZIMUTH_ERR_386 : 224|7@1+ (0.00087267,0) [0|0.11082909] "rad"  ADAS
 SG_ DET_ELEVATION_386 : 192|8@1+ (0.00275,-0.34925) [-0.34925|0.34925] "rad"  ADAS
 SG_ DET_ELEVATION_ERR_386 : 200|6@1+ (0.00174533,0) [0|0.10995579] "rad"  ADAS
 SG_ DET_RCS_386 : 256|8@1+ (0.5,-64) [-64|63.5] "dBsm"  ADAS
 SG_ DET_VALID_FLAG_386 : 167|1@1+ (1,0) [0|1] ""  ADAS
 SG_ DET_BI_STATIC_FLAG_386 : 505|1@1+ (1,0) [0|1] ""  ADAS
 SG_ DET_SUPER_RES_TARGET_386 : 247|1@1+ (1,0) [0|1] ""  ADAS
 SG_ DET_SNR_386 : 248|8@1+ (0.35156,0) [0|89.6478] "dB"  ADAS
 SG_ DET_POINT_TARGET_PROB_386 : 240|4@1+ (6.67,0) [0|100] "%"  ADAS
 SG_ DET_EXISTENCE_PROB_386 : 232|6@1+ (1.588,0) [0|100] "%"  ADAS
 SG_ DET_OUTSIDE_SECTOR_386 : 183|1@1+ (1,0) [0|1] ""  ADAS
 SG_ DET_HVC_FLAG_386 : 246|1@1+ (1,0) [0|1] ""  ADAS
 SG_ DET_CONFD_AZIMUTH_386 : 206|2@1+ (1,0) [0|3] ""  ADAS
 SG_ DET_CONFD_ELEVATION_386 : 244|2@1+ (1,0) [0|3] ""  ADAS
 SG_ DET_RANGE_387 : 264|15@1+ (0.015625,0) [0|500] "m"  ADAS
 SG_ DET_RANGE_ERR_387 : 280|7@1+ (0.0075,0) [0|0.9525] "m"  ADAS
 SG_ DET_RANGE_VELOCITY_387 : 288|15@1+ (0.0078125,-128) [-128|127.9921875] "m/s"  ADAS
 SG_ DET_RANGE_VELOCITY_ERR_387 : 304|8@1+ (0.003,0) [0|0.765] "m/s"  ADAS
 SG_ DET_AZIMUTH_387 : 328|13@1+ (0.0004,-1.5708) [-1.5708|1.5708] "rad"  ADAS
 SG_ DET_AZIMUTH_ERR_387 : 345|7@1+ (0.00087267,0) [0|0.11082909] "rad"  ADAS
 SG_ DET_ELEVATION_387 : 312|8@1+ (0.00275,-0.34925) [-0.34925|0.34925] "rad"  ADAS
 SG_ DET_ELEVATION_ERR_387 : 320|6@1+ (0.00174533,0) [0|0.10995579] "rad"  ADAS
 SG_ DET_RCS_387 : 376|8@1+ (0.5,-64) [-64|63.5] "dBsm"  ADAS
 SG_ DET_VALID_FLAG_387 : 399|1@1+ (1,0) [0|1] ""  ADAS
 SG_ DET_BI_STATIC_FLAG_387 : 482|1@1+ (1,0) [0|1] ""  ADAS
 SG_ DET_SUPER_RES_TARGET_387 : 344|1@1+ (1,0) [0|1] ""  ADAS
 SG_ DET_SNR_387 : 368|8@1+ (0.35156,0) [0|89.6478] "dB"  ADAS
 SG_ DET_POINT_TARGET_PROB_387 : 360|4@1+ (6.67,0) [0|100] "%"  ADAS
 SG_ DET_EXISTENCE_PROB_387 : 352|6@1+ (1.588,0) [0|100] "%"  ADAS
 SG_ DET_OUTSIDE_SECTOR_387 : 407|1@1+ (1,0) [0|1] ""  ADAS
 SG_ DET_HVC_FLAG_387 : 364|1@1+ (1,0) [0|1] ""  ADAS
 SG_ DET_CONFD_AZIMUTH_387 : 365|2@1+ (1,0) [0|3] ""  ADAS
 SG_ DET_CONFD_ELEVATION_387 : 358|2@1+ (1,0) [0|3] ""  ADAS
 SG_ DET_RANGE_388 : 384|15@1+ (0.015625,0) [0|500] "m"  ADAS
 SG_ DET_RANGE_ERR_388 : 400|7@1+ (0.0075,0) [0|0.9525] "m"  ADAS
 SG_ DET_RANGE_VELOCITY_388 : 408|15@1+ (0.0078125,-128) [-128|127.9921875] "m/s"  ADAS
 SG_ DET_RANGE_VELOCITY_ERR_388 : 424|8@1+ (0.003,0) [0|0.765] "m/s"  ADAS
 SG_ DET_AZIMUTH_388 : 448|13@1+ (0.0004,-1.5708) [-1.5708|1.5708] "rad"  ADAS
 SG_ DET_AZIMUTH_ERR_388 : 465|7@1+ (0.00087267,0) [0|0.11082909] "rad"  ADAS
 SG_ DET_ELEVATION_388 : 432|8@1+ (0.00275,-0.34925) [-0.34925|0.34925] "rad"  ADAS
 SG_ DET_ELEVATION_ERR_388 : 440|6@1+ (0.00174533,0) [0|0.10995579] "rad"  ADAS
 SG_ DET_RCS_388 : 496|8@1+ (0.5,-64) [-64|63.5] "dBsm"  ADAS
 SG_ DET_VALID_FLAG_388 : 485|1@1+ (1,0) [0|1] ""  ADAS
 SG_ DET_BI_STATIC_FLAG_388 : 483|1@1+ (1,0) [0|1] ""  ADAS
 SG_ DET_SUPER_RES_TARGET_388 : 446|1@1+ (1,0) [0|1] ""  ADAS
 SG_ DET_SNR_388 : 488|8@1+ (0.35156,0) [0|89.6478] "dB"  ADAS
 SG_ DET_POINT_TARGET_PROB_388 : 472|4@1+ (6.67,0) [0|100] "%"  ADAS
 SG_ DET_EXISTENCE_PROB_388 : 506|6@1+ (1.588,0) [0|100] "%"  ADAS
 SG_ DET_OUTSIDE_SECTOR_388 : 481|1@1+ (1,0) [0|1] ""  ADAS
 SG_ DET_HVC_FLAG_388 : 464|1@1+ (1,0) [0|1] ""  ADAS
 SG_ DET_CONFD_AZIMUTH_388 : 486|2@1+ (1,0) [0|3] ""  ADAS
 SG_ DET_CONFD_ELEVATION_388 : 461|2@1+ (1,0) [0|3] ""  ADAS
 SG_ DET_MH_SCAN_INDEX_4LSB_385_388 : 476|4@1+ (1,0) [0|15] ""  ADAS
 SG_ DET_MH_CYCLE_COUNTER_385_388 : 16|8@1+ (1,0) [0|255] ""  ADAS
 SG_ DET_MH_CRC16_385_388 : 0|16@1+ (1,0) [0|65535] ""  ADAS

BO_ 1249 RDR_DETECTION_389_392: 64 RDR08
 SG_ DET_RANGE_389 : 24|15@1+ (0.015625,0) [0|500] "m"  ADAS
 SG_ DET_RANGE_ERR_389 : 40|7@1+ (0.0075,0) [0|0.9525] "m"  ADAS
 SG_ DET_RANGE_VELOCITY_389 : 48|15@1+ (0.0078125,-128) [-128|127.9921875] "m/s"  ADAS
 SG_ DET_RANGE_VELOCITY_ERR_389 : 64|8@1+ (0.003,0) [0|0.765] "m/s"  ADAS
 SG_ DET_AZIMUTH_389 : 88|13@1+ (0.0004,-1.5708) [-1.5708|1.5708] "rad"  ADAS
 SG_ DET_AZIMUTH_ERR_389 : 105|7@1+ (0.00087267,0) [0|0.11082909] "rad"  ADAS
 SG_ DET_ELEVATION_389 : 72|8@1+ (0.00275,-0.34925) [-0.34925|0.34925] "rad"  ADAS
 SG_ DET_ELEVATION_ERR_389 : 80|6@1+ (0.00174533,0) [0|0.10995579] "rad"  ADAS
 SG_ DET_RCS_389 : 136|8@1+ (0.5,-64) [-64|63.5] "dBsm"  ADAS
 SG_ DET_VALID_FLAG_389 : 119|1@1+ (1,0) [0|1] ""  ADAS
 SG_ DET_BI_STATIC_FLAG_389 : 504|1@1+ (1,0) [0|1] ""  ADAS
 SG_ DET_SUPER_RES_TARGET_389 : 104|1@1+ (1,0) [0|1] ""  ADAS
 SG_ DET_SNR_389 : 128|8@1+ (0.35156,0) [0|89.6478] "dB"  ADAS
 SG_ DET_POINT_TARGET_PROB_389 : 114|4@1+ (6.67,0) [0|100] "%"  ADAS
 SG_ DET_EXISTENCE_PROB_389 : 120|6@1+ (1.588,0) [0|100] "%"  ADAS
 SG_ DET_OUTSIDE_SECTOR_389 : 159|1@1+ (1,0) [0|1] ""  ADAS
 SG_ DET_HVC_FLAG_389 : 118|1@1+ (1,0) [0|1] ""  ADAS
 SG_ DET_CONFD_AZIMUTH_389 : 126|2@1+ (1,0) [0|3] ""  ADAS
 SG_ DET_CONFD_ELEVATION_389 : 112|2@1+ (1,0) [0|3] ""  ADAS
 SG_ DET_RANGE_390 : 144|15@1+ (0.015625,0) [0|500] "m"  ADAS
 SG_ DET_RANGE_ERR_390 : 160|7@1+ (0.0075,0) [0|0.9525] "m"  ADAS
 SG_ DET_RANGE_VELOCITY_390 : 168|15@1+ (0.0078125,-128) [-128|127.9921875] "m/s"  ADAS
 SG_ DET_RANGE_VELOCITY_ERR_390 : 184|8@1+ (0.003,0) [0|0.765] "m/s"  ADAS
 SG_ DET_AZIMUTH_390 : 208|13@1+ (0.0004,-1.5708) [-1.5708|1.5708] "rad"  ADAS
 SG_ DET_AZIMUTH_ERR_390 : 224|7@1+ (0.00087267,0) [0|0.11082909] "rad"  ADAS
 SG_ DET_ELEVATION_390 : 192|8@1+ (0.00275,-0.34925) [-0.34925|0.34925] "rad"  ADAS
 SG_ DET_ELEVATION_ERR_390 : 200|6@1+ (0.00174533,0) [0|0.10995579] "rad"  ADAS
 SG_ DET_RCS_390 : 256|8@1+ (0.5,-64) [-64|63.5] "dBsm"  ADAS
 SG_ DET_VALID_FLAG_390 : 167|1@1+ (1,0) [0|1] ""  ADAS
 SG_ DET_BI_STATIC_FLAG_390 : 505|1@1+ (1,0) [0|1] ""  ADAS
 SG_ DET_SUPER_RES_TARGET_390 : 247|1@1+ (1,0) [0|1] ""  ADAS
 SG_ DET_SNR_390 : 248|8@1+ (0.35156,0) [0|89.6478] "dB"  ADAS
 SG_ DET_POINT_TARGET_PROB_390 : 240|4@1+ (6.67,0) [0|100] "%"  ADAS
 SG_ DET_EXISTENCE_PROB_390 : 232|6@1+ (1.588,0) [0|100] "%"  ADAS
 SG_ DET_OUTSIDE_SECTOR_390 : 183|1@1+ (1,0) [0|1] ""  ADAS
 SG_ DET_HVC_FLAG_390 : 246|1@1+ (1,0) [0|1] ""  ADAS
 SG_ DET_CONFD_AZIMUTH_390 : 206|2@1+ (1,0) [0|3] ""  ADAS
 SG_ DET_CONFD_ELEVATION_390 : 244|2@1+ (1,0) [0|3] ""  ADAS
 SG_ DET_RANGE_391 : 264|15@1+ (0.015625,0) [0|500] "m"  ADAS
 SG_ DET_RANGE_ERR_391 : 280|7@1+ (0.0075,0) [0|0.9525] "m"  ADAS
 SG_ DET_RANGE_VELOCITY_391 : 288|15@1+ (0.0078125,-128) [-128|127.9921875] "m/s"  ADAS
 SG_ DET_RANGE_VELOCITY_ERR_391 : 304|8@1+ (0.003,0) [0|0.765] "m/s"  ADAS
 SG_ DET_AZIMUTH_391 : 328|13@1+ (0.0004,-1.5708) [-1.5708|1.5708] "rad"  ADAS
 SG_ DET_AZIMUTH_ERR_391 : 345|7@1+ (0.00087267,0) [0|0.11082909] "rad"  ADAS
 SG_ DET_ELEVATION_391 : 312|8@1+ (0.00275,-0.34925) [-0.34925|0.34925] "rad"  ADAS
 SG_ DET_ELEVATION_ERR_391 : 320|6@1+ (0.00174533,0) [0|0.10995579] "rad"  ADAS
 SG_ DET_RCS_391 : 376|8@1+ (0.5,-64) [-64|63.5] "dBsm"  ADAS
 SG_ DET_VALID_FLAG_391 : 399|1@1+ (1,0) [0|1] ""  ADAS
 SG_ DET_BI_STATIC_FLAG_391 : 482|1@1+ (1,0) [0|1] ""  ADAS
 SG_ DET_SUPER_RES_TARGET_391 : 344|1@1+ (1,0) [0|1] ""  ADAS
 SG_ DET_SNR_391 : 368|8@1+ (0.35156,0) [0|89.6478] "dB"  ADAS
 SG_ DET_POINT_TARGET_PROB_391 : 360|4@1+ (6.67,0) [0|100] "%"  ADAS
 SG_ DET_EXISTENCE_PROB_391 : 352|6@1+ (1.588,0) [0|100] "%"  ADAS
 SG_ DET_OUTSIDE_SECTOR_391 : 407|1@1+ (1,0) [0|1] ""  ADAS
 SG_ DET_HVC_FLAG_391 : 364|1@1+ (1,0) [0|1] ""  ADAS
 SG_ DET_CONFD_AZIMUTH_391 : 365|2@1+ (1,0) [0|3] ""  ADAS
 SG_ DET_CONFD_ELEVATION_391 : 358|2@1+ (1,0) [0|3] ""  ADAS
 SG_ DET_RANGE_392 : 384|15@1+ (0.015625,0) [0|500] "m"  ADAS
 SG_ DET_RANGE_ERR_392 : 400|7@1+ (0.0075,0) [0|0.9525] "m"  ADAS
 SG_ DET_RANGE_VELOCITY_392 : 408|15@1+ (0.0078125,-128) [-128|127.9921875] "m/s"  ADAS
 SG_ DET_RANGE_VELOCITY_ERR_392 : 424|8@1+ (0.003,0) [0|0.765] "m/s"  ADAS
 SG_ DET_AZIMUTH_392 : 448|13@1+ (0.0004,-1.5708) [-1.5708|1.5708] "rad"  ADAS
 SG_ DET_AZIMUTH_ERR_392 : 465|7@1+ (0.00087267,0) [0|0.11082909] "rad"  ADAS
 SG_ DET_ELEVATION_392 : 432|8@1+ (0.00275,-0.34925) [-0.34925|0.34925] "rad"  ADAS
 SG_ DET_ELEVATION_ERR_392 : 440|6@1+ (0.00174533,0) [0|0.10995579] "rad"  ADAS
 SG_ DET_RCS_392 : 496|8@1+ (0.5,-64) [-64|63.5] "dBsm"  ADAS
 SG_ DET_VALID_FLAG_392 : 485|1@1+ (1,0) [0|1] ""  ADAS
 SG_ DET_BI_STATIC_FLAG_392 : 483|1@1+ (1,0) [0|1] ""  ADAS
 SG_ DET_SUPER_RES_TARGET_392 : 446|1@1+ (1,0) [0|1] ""  ADAS
 SG_ DET_SNR_392 : 488|8@1+ (0.35156,0) [0|89.6478] "dB"  ADAS
 SG_ DET_POINT_TARGET_PROB_392 : 472|4@1+ (6.67,0) [0|100] "%"  ADAS
 SG_ DET_EXISTENCE_PROB_392 : 506|6@1+ (1.588,0) [0|100] "%"  ADAS
 SG_ DET_OUTSIDE_SECTOR_392 : 481|1@1+ (1,0) [0|1] ""  ADAS
 SG_ DET_HVC_FLAG_392 : 464|1@1+ (1,0) [0|1] ""  ADAS
 SG_ DET_CONFD_AZIMUTH_392 : 486|2@1+ (1,0) [0|3] ""  ADAS
 SG_ DET_CONFD_ELEVATION_392 : 461|2@1+ (1,0) [0|3] ""  ADAS
 SG_ DET_MH_SCAN_INDEX_4LSB_389_392 : 476|4@1+ (1,0) [0|15] ""  ADAS
 SG_ DET_MH_CYCLE_COUNTER_389_392 : 16|8@1+ (1,0) [0|255] ""  ADAS
 SG_ DET_MH_CRC16_389_392 : 0|16@1+ (1,0) [0|65535] ""  ADAS

BO_ 1250 RDR_DETECTION_393_396: 64 RDR08
 SG_ DET_RANGE_393 : 24|15@1+ (0.015625,0) [0|500] "m"  ADAS
 SG_ DET_RANGE_ERR_393 : 40|7@1+ (0.0075,0) [0|0.9525] "m"  ADAS
 SG_ DET_RANGE_VELOCITY_393 : 48|15@1+ (0.0078125,-128) [-128|127.9921875] "m/s"  ADAS
 SG_ DET_RANGE_VELOCITY_ERR_393 : 64|8@1+ (0.003,0) [0|0.765] "m/s"  ADAS
 SG_ DET_AZIMUTH_393 : 88|13@1+ (0.0004,-1.5708) [-1.5708|1.5708] "rad"  ADAS
 SG_ DET_AZIMUTH_ERR_393 : 105|7@1+ (0.00087267,0) [0|0.11082909] "rad"  ADAS
 SG_ DET_ELEVATION_393 : 72|8@1+ (0.00275,-0.34925) [-0.34925|0.34925] "rad"  ADAS
 SG_ DET_ELEVATION_ERR_393 : 80|6@1+ (0.00174533,0) [0|0.10995579] "rad"  ADAS
 SG_ DET_RCS_393 : 136|8@1+ (0.5,-64) [-64|63.5] "dBsm"  ADAS
 SG_ DET_VALID_FLAG_393 : 119|1@1+ (1,0) [0|1] ""  ADAS
 SG_ DET_BI_STATIC_FLAG_393 : 504|1@1+ (1,0) [0|1] ""  ADAS
 SG_ DET_SUPER_RES_TARGET_393 : 104|1@1+ (1,0) [0|1] ""  ADAS
 SG_ DET_SNR_393 : 128|8@1+ (0.35156,0) [0|89.6478] "dB"  ADAS
 SG_ DET_POINT_TARGET_PROB_393 : 114|4@1+ (6.67,0) [0|100] "%"  ADAS
 SG_ DET_EXISTENCE_PROB_393 : 120|6@1+ (1.588,0) [0|100] "%"  ADAS
 SG_ DET_OUTSIDE_SECTOR_393 : 159|1@1+ (1,0) [0|1] ""  ADAS
 SG_ DET_HVC_FLAG_393 : 118|1@1+ (1,0) [0|1] ""  ADAS
 SG_ DET_CONFD_AZIMUTH_393 : 126|2@1+ (1,0) [0|3] ""  ADAS
 SG_ DET_CONFD_ELEVATION_393 : 112|2@1+ (1,0) [0|3] ""  ADAS
 SG_ DET_RANGE_394 : 144|15@1+ (0.015625,0) [0|500] "m"  ADAS
 SG_ DET_RANGE_ERR_394 : 160|7@1+ (0.0075,0) [0|0.9525] "m"  ADAS
 SG_ DET_RANGE_VELOCITY_394 : 168|15@1+ (0.0078125,-128) [-128|127.9921875] "m/s"  ADAS
 SG_ DET_RANGE_VELOCITY_ERR_394 : 184|8@1+ (0.003,0) [0|0.765] "m/s"  ADAS
 SG_ DET_AZIMUTH_394 : 208|13@1+ (0.0004,-1.5708) [-1.5708|1.5708] "rad"  ADAS
 SG_ DET_AZIMUTH_ERR_394 : 224|7@1+ (0.00087267,0) [0|0.11082909] "rad"  ADAS
 SG_ DET_ELEVATION_394 : 192|8@1+ (0.00275,-0.34925) [-0.34925|0.34925] "rad"  ADAS
 SG_ DET_ELEVATION_ERR_394 : 200|6@1+ (0.00174533,0) [0|0.10995579] "rad"  ADAS
 SG_ DET_RCS_394 : 256|8@1+ (0.5,-64) [-64|63.5] "dBsm"  ADAS
 SG_ DET_VALID_FLAG_394 : 167|1@1+ (1,0) [0|1] ""  ADAS
 SG_ DET_BI_STATIC_FLAG_394 : 505|1@1+ (1,0) [0|1] ""  ADAS
 SG_ DET_SUPER_RES_TARGET_394 : 247|1@1+ (1,0) [0|1] ""  ADAS
 SG_ DET_SNR_394 : 248|8@1+ (0.35156,0) [0|89.6478] "dB"  ADAS
 SG_ DET_POINT_TARGET_PROB_394 : 240|4@1+ (6.67,0) [0|100] "%"  ADAS
 SG_ DET_EXISTENCE_PROB_394 : 232|6@1+ (1.588,0) [0|100] "%"  ADAS
 SG_ DET_OUTSIDE_SECTOR_394 : 183|1@1+ (1,0) [0|1] ""  ADAS
 SG_ DET_HVC_FLAG_394 : 246|1@1+ (1,0) [0|1] ""  ADAS
 SG_ DET_CONFD_AZIMUTH_394 : 206|2@1+ (1,0) [0|3] ""  ADAS
 SG_ DET_CONFD_ELEVATION_394 : 244|2@1+ (1,0) [0|3] ""  ADAS
 SG_ DET_RANGE_395 : 264|15@1+ (0.015625,0) [0|500] "m"  ADAS
 SG_ DET_RANGE_ERR_395 : 280|7@1+ (0.0075,0) [0|0.9525] "m"  ADAS
 SG_ DET_RANGE_VELOCITY_395 : 288|15@1+ (0.0078125,-128) [-128|127.9921875] "m/s"  ADAS
 SG_ DET_RANGE_VELOCITY_ERR_395 : 304|8@1+ (0.003,0) [0|0.765] "m/s"  ADAS
 SG_ DET_AZIMUTH_395 : 328|13@1+ (0.0004,-1.5708) [-1.5708|1.5708] "rad"  ADAS
 SG_ DET_AZIMUTH_ERR_395 : 345|7@1+ (0.00087267,0) [0|0.11082909] "rad"  ADAS
 SG_ DET_ELEVATION_395 : 312|8@1+ (0.00275,-0.34925) [-0.34925|0.34925] "rad"  ADAS
 SG_ DET_ELEVATION_ERR_395 : 320|6@1+ (0.00174533,0) [0|0.10995579] "rad"  ADAS
 SG_ DET_RCS_395 : 376|8@1+ (0.5,-64) [-64|63.5] "dBsm"  ADAS
 SG_ DET_VALID_FLAG_395 : 399|1@1+ (1,0) [0|1] ""  ADAS
 SG_ DET_BI_STATIC_FLAG_395 : 482|1@1+ (1,0) [0|1] ""  ADAS
 SG_ DET_SUPER_RES_TARGET_395 : 344|1@1+ (1,0) [0|1] ""  ADAS
 SG_ DET_SNR_395 : 368|8@1+ (0.35156,0) [0|89.6478] "dB"  ADAS
 SG_ DET_POINT_TARGET_PROB_395 : 360|4@1+ (6.67,0) [0|100] "%"  ADAS
 SG_ DET_EXISTENCE_PROB_395 : 352|6@1+ (1.588,0) [0|100] "%"  ADAS
 SG_ DET_OUTSIDE_SECTOR_395 : 407|1@1+ (1,0) [0|1] ""  ADAS
 SG_ DET_HVC_FLAG_395 : 364|1@1+ (1,0) [0|1] ""  ADAS
 SG_ DET_CONFD_AZIMUTH_395 : 365|2@1+ (1,0) [0|3] ""  ADAS
 SG_ DET_CONFD_ELEVATION_395 : 358|2@1+ (1,0) [0|3] ""  ADAS
 SG_ DET_RANGE_396 : 384|15@1+ (0.015625,0) [0|500] "m"  ADAS
 SG_ DET_RANGE_ERR_396 : 400|7@1+ (0.0075,0) [0|0.9525] "m"  ADAS
 SG_ DET_RANGE_VELOCITY_396 : 408|15@1+ (0.0078125,-128) [-128|127.9921875] "m/s"  ADAS
 SG_ DET_RANGE_VELOCITY_ERR_396 : 424|8@1+ (0.003,0) [0|0.765] "m/s"  ADAS
 SG_ DET_AZIMUTH_396 : 448|13@1+ (0.0004,-1.5708) [-1.5708|1.5708] "rad"  ADAS
 SG_ DET_AZIMUTH_ERR_396 : 465|7@1+ (0.00087267,0) [0|0.11082909] "rad"  ADAS
 SG_ DET_ELEVATION_396 : 432|8@1+ (0.00275,-0.34925) [-0.34925|0.34925] "rad"  ADAS
 SG_ DET_ELEVATION_ERR_396 : 440|6@1+ (0.00174533,0) [0|0.10995579] "rad"  ADAS
 SG_ DET_RCS_396 : 496|8@1+ (0.5,-64) [-64|63.5] "dBsm"  ADAS
 SG_ DET_VALID_FLAG_396 : 485|1@1+ (1,0) [0|1] ""  ADAS
 SG_ DET_BI_STATIC_FLAG_396 : 483|1@1+ (1,0) [0|1] ""  ADAS
 SG_ DET_SUPER_RES_TARGET_396 : 446|1@1+ (1,0) [0|1] ""  ADAS
 SG_ DET_SNR_396 : 488|8@1+ (0.35156,0) [0|89.6478] "dB"  ADAS
 SG_ DET_POINT_TARGET_PROB_396 : 472|4@1+ (6.67,0) [0|100] "%"  ADAS
 SG_ DET_EXISTENCE_PROB_396 : 506|6@1+ (1.588,0) [0|100] "%"  ADAS
 SG_ DET_OUTSIDE_SECTOR_396 : 481|1@1+ (1,0) [0|1] ""  ADAS
 SG_ DET_HVC_FLAG_396 : 464|1@1+ (1,0) [0|1] ""  ADAS
 SG_ DET_CONFD_AZIMUTH_396 : 486|2@1+ (1,0) [0|3] ""  ADAS
 SG_ DET_CONFD_ELEVATION_396 : 461|2@1+ (1,0) [0|3] ""  ADAS
 SG_ DET_MH_SCAN_INDEX_4LSB_393_396 : 476|4@1+ (1,0) [0|15] ""  ADAS
 SG_ DET_MH_CYCLE_COUNTER_393_396 : 16|8@1+ (1,0) [0|255] ""  ADAS
 SG_ DET_MH_CRC16_393_396 : 0|16@1+ (1,0) [0|65535] ""  ADAS

BO_ 1251 RDR_DETECTION_397_400: 64 RDR08
 SG_ DET_RANGE_397 : 24|15@1+ (0.015625,0) [0|500] "m"  ADAS
 SG_ DET_RANGE_ERR_397 : 40|7@1+ (0.0075,0) [0|0.9525] "m"  ADAS
 SG_ DET_RANGE_VELOCITY_397 : 48|15@1+ (0.0078125,-128) [-128|127.9921875] "m/s"  ADAS
 SG_ DET_RANGE_VELOCITY_ERR_397 : 64|8@1+ (0.003,0) [0|0.765] "m/s"  ADAS
 SG_ DET_AZIMUTH_397 : 88|13@1+ (0.0004,-1.5708) [-1.5708|1.5708] "rad"  ADAS
 SG_ DET_AZIMUTH_ERR_397 : 105|7@1+ (0.00087267,0) [0|0.11082909] "rad"  ADAS
 SG_ DET_ELEVATION_397 : 72|8@1+ (0.00275,-0.34925) [-0.34925|0.34925] "rad"  ADAS
 SG_ DET_ELEVATION_ERR_397 : 80|6@1+ (0.00174533,0) [0|0.10995579] "rad"  ADAS
 SG_ DET_RCS_397 : 136|8@1+ (0.5,-64) [-64|63.5] "dBsm"  ADAS
 SG_ DET_VALID_FLAG_397 : 119|1@1+ (1,0) [0|1] ""  ADAS
 SG_ DET_BI_STATIC_FLAG_397 : 504|1@1+ (1,0) [0|1] ""  ADAS
 SG_ DET_SUPER_RES_TARGET_397 : 104|1@1+ (1,0) [0|1] ""  ADAS
 SG_ DET_SNR_397 : 128|8@1+ (0.35156,0) [0|89.6478] "dB"  ADAS
 SG_ DET_POINT_TARGET_PROB_397 : 114|4@1+ (6.67,0) [0|100] "%"  ADAS
 SG_ DET_EXISTENCE_PROB_397 : 120|6@1+ (1.588,0) [0|100] "%"  ADAS
 SG_ DET_OUTSIDE_SECTOR_397 : 159|1@1+ (1,0) [0|1] ""  ADAS
 SG_ DET_HVC_FLAG_397 : 118|1@1+ (1,0) [0|1] ""  ADAS
 SG_ DET_CONFD_AZIMUTH_397 : 126|2@1+ (1,0) [0|3] ""  ADAS
 SG_ DET_CONFD_ELEVATION_397 : 112|2@1+ (1,0) [0|3] ""  ADAS
 SG_ DET_RANGE_398 : 144|15@1+ (0.015625,0) [0|500] "m"  ADAS
 SG_ DET_RANGE_ERR_398 : 160|7@1+ (0.0075,0) [0|0.9525] "m"  ADAS
 SG_ DET_RANGE_VELOCITY_398 : 168|15@1+ (0.0078125,-128) [-128|127.9921875] "m/s"  ADAS
 SG_ DET_RANGE_VELOCITY_ERR_398 : 184|8@1+ (0.003,0) [0|0.765] "m/s"  ADAS
 SG_ DET_AZIMUTH_398 : 208|13@1+ (0.0004,-1.5708) [-1.5708|1.5708] "rad"  ADAS
 SG_ DET_AZIMUTH_ERR_398 : 224|7@1+ (0.00087267,0) [0|0.11082909] "rad"  ADAS
 SG_ DET_ELEVATION_398 : 192|8@1+ (0.00275,-0.34925) [-0.34925|0.34925] "rad"  ADAS
 SG_ DET_ELEVATION_ERR_398 : 200|6@1+ (0.00174533,0) [0|0.10995579] "rad"  ADAS
 SG_ DET_RCS_398 : 256|8@1+ (0.5,-64) [-64|63.5] "dBsm"  ADAS
 SG_ DET_VALID_FLAG_398 : 167|1@1+ (1,0) [0|1] ""  ADAS
 SG_ DET_BI_STATIC_FLAG_398 : 505|1@1+ (1,0) [0|1] ""  ADAS
 SG_ DET_SUPER_RES_TARGET_398 : 247|1@1+ (1,0) [0|1] ""  ADAS
 SG_ DET_SNR_398 : 248|8@1+ (0.35156,0) [0|89.6478] "dB"  ADAS
 SG_ DET_POINT_TARGET_PROB_398 : 240|4@1+ (6.67,0) [0|100] "%"  ADAS
 SG_ DET_EXISTENCE_PROB_398 : 232|6@1+ (1.588,0) [0|100] "%"  ADAS
 SG_ DET_OUTSIDE_SECTOR_398 : 183|1@1+ (1,0) [0|1] ""  ADAS
 SG_ DET_HVC_FLAG_398 : 246|1@1+ (1,0) [0|1] ""  ADAS
 SG_ DET_CONFD_AZIMUTH_398 : 206|2@1+ (1,0) [0|3] ""  ADAS
 SG_ DET_CONFD_ELEVATION_398 : 244|2@1+ (1,0) [0|3] ""  ADAS
 SG_ DET_RANGE_399 : 264|15@1+ (0.015625,0) [0|500] "m"  ADAS
 SG_ DET_RANGE_ERR_399 : 280|7@1+ (0.0075,0) [0|0.9525] "m"  ADAS
 SG_ DET_RANGE_VELOCITY_399 : 288|15@1+ (0.0078125,-128) [-128|127.9921875] "m/s"  ADAS
 SG_ DET_RANGE_VELOCITY_ERR_399 : 304|8@1+ (0.003,0) [0|0.765] "m/s"  ADAS
 SG_ DET_AZIMUTH_399 : 328|13@1+ (0.0004,-1.5708) [-1.5708|1.5708] "rad"  ADAS
 SG_ DET_AZIMUTH_ERR_399 : 345|7@1+ (0.00087267,0) [0|0.11082909] "rad"  ADAS
 SG_ DET_ELEVATION_399 : 312|8@1+ (0.00275,-0.34925) [-0.34925|0.34925] "rad"  ADAS
 SG_ DET_ELEVATION_ERR_399 : 320|6@1+ (0.00174533,0) [0|0.10995579] "rad"  ADAS
 SG_ DET_RCS_399 : 376|8@1+ (0.5,-64) [-64|63.5] "dBsm"  ADAS
 SG_ DET_VALID_FLAG_399 : 399|1@1+ (1,0) [0|1] ""  ADAS
 SG_ DET_BI_STATIC_FLAG_399 : 482|1@1+ (1,0) [0|1] ""  ADAS
 SG_ DET_SUPER_RES_TARGET_399 : 344|1@1+ (1,0) [0|1] ""  ADAS
 SG_ DET_SNR_399 : 368|8@1+ (0.35156,0) [0|89.6478] "dB"  ADAS
 SG_ DET_POINT_TARGET_PROB_399 : 360|4@1+ (6.67,0) [0|100] "%"  ADAS
 SG_ DET_EXISTENCE_PROB_399 : 352|6@1+ (1.588,0) [0|100] "%"  ADAS
 SG_ DET_OUTSIDE_SECTOR_399 : 407|1@1+ (1,0) [0|1] ""  ADAS
 SG_ DET_HVC_FLAG_399 : 364|1@1+ (1,0) [0|1] ""  ADAS
 SG_ DET_CONFD_AZIMUTH_399 : 365|2@1+ (1,0) [0|3] ""  ADAS
 SG_ DET_CONFD_ELEVATION_399 : 358|2@1+ (1,0) [0|3] ""  ADAS
 SG_ DET_RANGE_400 : 384|15@1+ (0.015625,0) [0|500] "m"  ADAS
 SG_ DET_RANGE_ERR_400 : 400|7@1+ (0.0075,0) [0|0.9525] "m"  ADAS
 SG_ DET_RANGE_VELOCITY_400 : 408|15@1+ (0.0078125,-128) [-128|127.9921875] "m/s"  ADAS
 SG_ DET_RANGE_VELOCITY_ERR_400 : 424|8@1+ (0.003,0) [0|0.765] "m/s"  ADAS
 SG_ DET_AZIMUTH_400 : 448|13@1+ (0.0004,-1.5708) [-1.5708|1.5708] "rad"  ADAS
 SG_ DET_AZIMUTH_ERR_400 : 465|7@1+ (0.00087267,0) [0|0.11082909] "rad"  ADAS
 SG_ DET_ELEVATION_400 : 432|8@1+ (0.00275,-0.34925) [-0.34925|0.34925] "rad"  ADAS
 SG_ DET_ELEVATION_ERR_400 : 440|6@1+ (0.00174533,0) [0|0.10995579] "rad"  ADAS
 SG_ DET_RCS_400 : 496|8@1+ (0.5,-64) [-64|63.5] "dBsm"  ADAS
 SG_ DET_VALID_FLAG_400 : 485|1@1+ (1,0) [0|1] ""  ADAS
 SG_ DET_BI_STATIC_FLAG_400 : 483|1@1+ (1,0) [0|1] ""  ADAS
 SG_ DET_SUPER_RES_TARGET_400 : 446|1@1+ (1,0) [0|1] ""  ADAS
 SG_ DET_SNR_400 : 488|8@1+ (0.35156,0) [0|89.6478] "dB"  ADAS
 SG_ DET_POINT_TARGET_PROB_400 : 472|4@1+ (6.67,0) [0|100] "%"  ADAS
 SG_ DET_EXISTENCE_PROB_400 : 506|6@1+ (1.588,0) [0|100] "%"  ADAS
 SG_ DET_OUTSIDE_SECTOR_400 : 481|1@1+ (1,0) [0|1] ""  ADAS
 SG_ DET_HVC_FLAG_400 : 464|1@1+ (1,0) [0|1] ""  ADAS
 SG_ DET_CONFD_AZIMUTH_400 : 486|2@1+ (1,0) [0|3] ""  ADAS
 SG_ DET_CONFD_ELEVATION_400 : 461|2@1+ (1,0) [0|3] ""  ADAS
 SG_ DET_MH_SCAN_INDEX_4LSB_397_400 : 476|4@1+ (1,0) [0|15] ""  ADAS
 SG_ DET_MH_CYCLE_COUNTER_397_400 : 16|8@1+ (1,0) [0|255] ""  ADAS
 SG_ DET_MH_CRC16_397_400 : 0|16@1+ (1,0) [0|65535] ""  ADAS

CM_ SG_ 1235 DET_RANGE_333 " measured position  of the detection";
CM_ SG_ 1235 DET_RANGE_ERR_333 "RMSE or standard deviation of the measured angle  of the detection";
CM_ SG_ 1235 DET_RANGE_VELOCITY_333 "Radial velocity of the detection positive in direction to the sensor";
CM_ SG_ 1235 DET_RANGE_VELOCITY_ERR_333 "RMSE or standard deviation of the measure radial velocity of the detection";
CM_ SG_ 1235 DET_AZIMUTH_333 "Measured angle  of the detection";
CM_ SG_ 1235 DET_AZIMUTH_ERR_333 "RMSE or standard deviation of the measured angle  of the detection";
CM_ SG_ 1235 DET_ELEVATION_333 "measured elevation of the detection";
CM_ SG_ 1235 DET_ELEVATION_ERR_333 "RMSE or standard deviation of the measured elevation  of the detection";
CM_ SG_ 1235 DET_RCS_333 "Radar Cross Section or Amplitude, is a measure of how detectable an object is by radar. A larger RCS indicates that an object is more easily detected.";
CM_ SG_ 1235 DET_VALID_FLAG_333 "is set if the measured detection is valid";
CM_ SG_ 1235 DET_BI_STATIC_FLAG_333 "1 if detection is bi-static 0 otherwise";
CM_ SG_ 1235 DET_SUPER_RES_TARGET_333 "flasg is set if the detection is super resolution target";
CM_ SG_ 1235 DET_SNR_333 "The signal to noise ratio (SNR) of the radar detection";
CM_ SG_ 1235 DET_POINT_TARGET_PROB_333 "Describes the possibility if more than one real-world object has led to this detection. 0[%] := 100[%] Multi target probability";
CM_ SG_ 1235 DET_EXISTENCE_PROB_333 "Existence probability of the detection not based on history. Value does  not depend on any past experience with similar detections.
\note Use as confidence measure where a low value means less confidence
and a high value indicates strong confidence.";
CM_ SG_ 1235 DET_OUTSIDE_SECTOR_333 "Flag to indicate detections outside the sector, set if the wrong sector calibration matrix was used";
CM_ SG_ 1235 DET_HVC_FLAG_333 "Core2 Vehicle clutter flag";
CM_ SG_ 1235 DET_CONFD_AZIMUTH_333 "Define the Confidence of Azimuth for Detection ";
CM_ SG_ 1235 DET_CONFD_ELEVATION_333 "Define the Confidence of Elevation for the Detection ";
CM_ SG_ 1235 DET_BI_STATIC_FLAG_334 "1 if detection is bi-static 0 otherwise";
CM_ SG_ 1235 DET_BI_STATIC_FLAG_335 "1 if detection is bi-static 0 otherwise";
CM_ SG_ 1235 DET_BI_STATIC_FLAG_336 "1 if detection is bi-static 0 otherwise";
CM_ SG_ 1235 DET_MH_SCAN_INDEX_4LSB_333_336 "Scan index of the measured detection";
CM_ SG_ 1235 DET_MH_CYCLE_COUNTER_333_336 "Detection Alive Counter";
CM_ SG_ 1236 DET_RANGE_337 " measured position  of the detection";
CM_ SG_ 1236 DET_RANGE_ERR_337 "RMSE or standard deviation of the measured angle  of the detection";
CM_ SG_ 1236 DET_RANGE_VELOCITY_337 "Radial velocity of the detection positive in direction to the sensor";
CM_ SG_ 1236 DET_RANGE_VELOCITY_ERR_337 "RMSE or standard deviation of the measure radial velocity of the detection";
CM_ SG_ 1236 DET_AZIMUTH_337 "Measured angle  of the detection";
CM_ SG_ 1236 DET_AZIMUTH_ERR_337 "RMSE or standard deviation of the measured angle  of the detection";
CM_ SG_ 1236 DET_ELEVATION_337 "measured elevation of the detection";
CM_ SG_ 1236 DET_ELEVATION_ERR_337 "RMSE or standard deviation of the measured elevation  of the detection";
CM_ SG_ 1236 DET_RCS_337 "Radar Cross Section or Amplitude, is a measure of how detectable an object is by radar. A larger RCS indicates that an object is more easily detected.";
CM_ SG_ 1236 DET_VALID_FLAG_337 "is set if the measured detection is valid";
CM_ SG_ 1236 DET_BI_STATIC_FLAG_337 "1 if detection is bi-static 0 otherwise";
CM_ SG_ 1236 DET_SUPER_RES_TARGET_337 "flasg is set if the detection is super resolution target";
CM_ SG_ 1236 DET_SNR_337 "The signal to noise ratio (SNR) of the radar detection";
CM_ SG_ 1236 DET_POINT_TARGET_PROB_337 "Describes the possibility if more than one real-world object has led to this detection. 0[%] := 100[%] Multi target probability";
CM_ SG_ 1236 DET_EXISTENCE_PROB_337 "Existence probability of the detection not based on history. Value does  not depend on any past experience with similar detections.
\note Use as confidence measure where a low value means less confidence
and a high value indicates strong confidence.";
CM_ SG_ 1236 DET_OUTSIDE_SECTOR_337 "Flag to indicate detections outside the sector, set if the wrong sector calibration matrix was used";
CM_ SG_ 1236 DET_HVC_FLAG_337 "Core2 Vehicle clutter flag";
CM_ SG_ 1236 DET_CONFD_AZIMUTH_337 "Define the Confidence of Azimuth for Detection ";
CM_ SG_ 1236 DET_CONFD_ELEVATION_337 "Define the Confidence of Elevation for the Detection ";
CM_ SG_ 1236 DET_BI_STATIC_FLAG_338 "1 if detection is bi-static 0 otherwise";
CM_ SG_ 1236 DET_BI_STATIC_FLAG_339 "1 if detection is bi-static 0 otherwise";
CM_ SG_ 1236 DET_BI_STATIC_FLAG_340 "1 if detection is bi-static 0 otherwise";
CM_ SG_ 1236 DET_MH_SCAN_INDEX_4LSB_337_340 "Scan index of the measured detection";
CM_ SG_ 1236 DET_MH_CYCLE_COUNTER_337_340 "Detection Alive Counter";
CM_ SG_ 1237 DET_RANGE_341 " measured position  of the detection";
CM_ SG_ 1237 DET_RANGE_ERR_341 "RMSE or standard deviation of the measured angle  of the detection";
CM_ SG_ 1237 DET_RANGE_VELOCITY_341 "Radial velocity of the detection positive in direction to the sensor";
CM_ SG_ 1237 DET_RANGE_VELOCITY_ERR_341 "RMSE or standard deviation of the measure radial velocity of the detection";
CM_ SG_ 1237 DET_AZIMUTH_341 "Measured angle  of the detection";
CM_ SG_ 1237 DET_AZIMUTH_ERR_341 "RMSE or standard deviation of the measured angle  of the detection";
CM_ SG_ 1237 DET_ELEVATION_341 "measured elevation of the detection";
CM_ SG_ 1237 DET_ELEVATION_ERR_341 "RMSE or standard deviation of the measured elevation  of the detection";
CM_ SG_ 1237 DET_RCS_341 "Radar Cross Section or Amplitude, is a measure of how detectable an object is by radar. A larger RCS indicates that an object is more easily detected.";
CM_ SG_ 1237 DET_VALID_FLAG_341 "is set if the measured detection is valid";
CM_ SG_ 1237 DET_BI_STATIC_FLAG_341 "1 if detection is bi-static 0 otherwise";
CM_ SG_ 1237 DET_SUPER_RES_TARGET_341 "flasg is set if the detection is super resolution target";
CM_ SG_ 1237 DET_SNR_341 "The signal to noise ratio (SNR) of the radar detection";
CM_ SG_ 1237 DET_POINT_TARGET_PROB_341 "Describes the possibility if more than one real-world object has led to this detection. 0[%] := 100[%] Multi target probability";
CM_ SG_ 1237 DET_EXISTENCE_PROB_341 "Existence probability of the detection not based on history. Value does  not depend on any past experience with similar detections.
\note Use as confidence measure where a low value means less confidence
and a high value indicates strong confidence.";
CM_ SG_ 1237 DET_OUTSIDE_SECTOR_341 "Flag to indicate detections outside the sector, set if the wrong sector calibration matrix was used";
CM_ SG_ 1237 DET_HVC_FLAG_341 "Core2 Vehicle clutter flag";
CM_ SG_ 1237 DET_CONFD_AZIMUTH_341 "Define the Confidence of Azimuth for Detection ";
CM_ SG_ 1237 DET_CONFD_ELEVATION_341 "Define the Confidence of Elevation for the Detection ";
CM_ SG_ 1237 DET_BI_STATIC_FLAG_342 "1 if detection is bi-static 0 otherwise";
CM_ SG_ 1237 DET_BI_STATIC_FLAG_343 "1 if detection is bi-static 0 otherwise";
CM_ SG_ 1237 DET_BI_STATIC_FLAG_344 "1 if detection is bi-static 0 otherwise";
CM_ SG_ 1237 DET_MH_SCAN_INDEX_4LSB_341_344 "Scan index of the measured detection";
CM_ SG_ 1237 DET_MH_CYCLE_COUNTER_341_344 "Detection Alive Counter";
CM_ SG_ 1238 DET_RANGE_345 " measured position  of the detection";
CM_ SG_ 1238 DET_RANGE_ERR_345 "RMSE or standard deviation of the measured angle  of the detection";
CM_ SG_ 1238 DET_RANGE_VELOCITY_345 "Radial velocity of the detection positive in direction to the sensor";
CM_ SG_ 1238 DET_RANGE_VELOCITY_ERR_345 "RMSE or standard deviation of the measure radial velocity of the detection";
CM_ SG_ 1238 DET_AZIMUTH_345 "Measured angle  of the detection";
CM_ SG_ 1238 DET_AZIMUTH_ERR_345 "RMSE or standard deviation of the measured angle  of the detection";
CM_ SG_ 1238 DET_ELEVATION_345 "measured elevation of the detection";
CM_ SG_ 1238 DET_ELEVATION_ERR_345 "RMSE or standard deviation of the measured elevation  of the detection";
CM_ SG_ 1238 DET_RCS_345 "Radar Cross Section or Amplitude, is a measure of how detectable an object is by radar. A larger RCS indicates that an object is more easily detected.";
CM_ SG_ 1238 DET_VALID_FLAG_345 "is set if the measured detection is valid";
CM_ SG_ 1238 DET_BI_STATIC_FLAG_345 "1 if detection is bi-static 0 otherwise";
CM_ SG_ 1238 DET_SUPER_RES_TARGET_345 "flasg is set if the detection is super resolution target";
CM_ SG_ 1238 DET_SNR_345 "The signal to noise ratio (SNR) of the radar detection";
CM_ SG_ 1238 DET_POINT_TARGET_PROB_345 "Describes the possibility if more than one real-world object has led to this detection. 0[%] := 100[%] Multi target probability";
CM_ SG_ 1238 DET_EXISTENCE_PROB_345 "Existence probability of the detection not based on history. Value does  not depend on any past experience with similar detections.
\note Use as confidence measure where a low value means less confidence
and a high value indicates strong confidence.";
CM_ SG_ 1238 DET_OUTSIDE_SECTOR_345 "Flag to indicate detections outside the sector, set if the wrong sector calibration matrix was used";
CM_ SG_ 1238 DET_HVC_FLAG_345 "Core2 Vehicle clutter flag";
CM_ SG_ 1238 DET_CONFD_AZIMUTH_345 "Define the Confidence of Azimuth for Detection ";
CM_ SG_ 1238 DET_CONFD_ELEVATION_345 "Define the Confidence of Elevation for the Detection ";
CM_ SG_ 1238 DET_BI_STATIC_FLAG_346 "1 if detection is bi-static 0 otherwise";
CM_ SG_ 1238 DET_BI_STATIC_FLAG_347 "1 if detection is bi-static 0 otherwise";
CM_ SG_ 1238 DET_BI_STATIC_FLAG_348 "1 if detection is bi-static 0 otherwise";
CM_ SG_ 1238 DET_MH_SCAN_INDEX_4LSB_345_348 "Scan index of the measured detection";
CM_ SG_ 1238 DET_MH_CYCLE_COUNTER_345_348 "Detection Alive Counter";
CM_ SG_ 1239 DET_RANGE_349 " measured position  of the detection";
CM_ SG_ 1239 DET_RANGE_ERR_349 "RMSE or standard deviation of the measured angle  of the detection";
CM_ SG_ 1239 DET_RANGE_VELOCITY_349 "Radial velocity of the detection positive in direction to the sensor";
CM_ SG_ 1239 DET_RANGE_VELOCITY_ERR_349 "RMSE or standard deviation of the measure radial velocity of the detection";
CM_ SG_ 1239 DET_AZIMUTH_349 "Measured angle  of the detection";
CM_ SG_ 1239 DET_AZIMUTH_ERR_349 "RMSE or standard deviation of the measured angle  of the detection";
CM_ SG_ 1239 DET_ELEVATION_349 "measured elevation of the detection";
CM_ SG_ 1239 DET_ELEVATION_ERR_349 "RMSE or standard deviation of the measured elevation  of the detection";
CM_ SG_ 1239 DET_RCS_349 "Radar Cross Section or Amplitude, is a measure of how detectable an object is by radar. A larger RCS indicates that an object is more easily detected.";
CM_ SG_ 1239 DET_VALID_FLAG_349 "is set if the measured detection is valid";
CM_ SG_ 1239 DET_BI_STATIC_FLAG_349 "1 if detection is bi-static 0 otherwise";
CM_ SG_ 1239 DET_SUPER_RES_TARGET_349 "flasg is set if the detection is super resolution target";
CM_ SG_ 1239 DET_SNR_349 "The signal to noise ratio (SNR) of the radar detection";
CM_ SG_ 1239 DET_POINT_TARGET_PROB_349 "Describes the possibility if more than one real-world object has led to this detection. 0[%] := 100[%] Multi target probability";
CM_ SG_ 1239 DET_EXISTENCE_PROB_349 "Existence probability of the detection not based on history. Value does  not depend on any past experience with similar detections.
\note Use as confidence measure where a low value means less confidence
and a high value indicates strong confidence.";
CM_ SG_ 1239 DET_OUTSIDE_SECTOR_349 "Flag to indicate detections outside the sector, set if the wrong sector calibration matrix was used";
CM_ SG_ 1239 DET_HVC_FLAG_349 "Core2 Vehicle clutter flag";
CM_ SG_ 1239 DET_CONFD_AZIMUTH_349 "Define the Confidence of Azimuth for Detection ";
CM_ SG_ 1239 DET_CONFD_ELEVATION_349 "Define the Confidence of Elevation for the Detection ";
CM_ SG_ 1239 DET_BI_STATIC_FLAG_350 "1 if detection is bi-static 0 otherwise";
CM_ SG_ 1239 DET_BI_STATIC_FLAG_351 "1 if detection is bi-static 0 otherwise";
CM_ SG_ 1239 DET_BI_STATIC_FLAG_352 "1 if detection is bi-static 0 otherwise";
CM_ SG_ 1239 DET_MH_SCAN_INDEX_4LSB_349_352 "Scan index of the measured detection";
CM_ SG_ 1239 DET_MH_CYCLE_COUNTER_349_352 "Detection Alive Counter";
CM_ SG_ 1240 DET_RANGE_353 " measured position  of the detection";
CM_ SG_ 1240 DET_RANGE_ERR_353 "RMSE or standard deviation of the measured angle  of the detection";
CM_ SG_ 1240 DET_RANGE_VELOCITY_353 "Radial velocity of the detection positive in direction to the sensor";
CM_ SG_ 1240 DET_RANGE_VELOCITY_ERR_353 "RMSE or standard deviation of the measure radial velocity of the detection";
CM_ SG_ 1240 DET_AZIMUTH_353 "Measured angle  of the detection";
CM_ SG_ 1240 DET_AZIMUTH_ERR_353 "RMSE or standard deviation of the measured angle  of the detection";
CM_ SG_ 1240 DET_ELEVATION_353 "measured elevation of the detection";
CM_ SG_ 1240 DET_ELEVATION_ERR_353 "RMSE or standard deviation of the measured elevation  of the detection";
CM_ SG_ 1240 DET_RCS_353 "Radar Cross Section or Amplitude, is a measure of how detectable an object is by radar. A larger RCS indicates that an object is more easily detected.";
CM_ SG_ 1240 DET_VALID_FLAG_353 "is set if the measured detection is valid";
CM_ SG_ 1240 DET_BI_STATIC_FLAG_353 "1 if detection is bi-static 0 otherwise";
CM_ SG_ 1240 DET_SUPER_RES_TARGET_353 "flasg is set if the detection is super resolution target";
CM_ SG_ 1240 DET_SNR_353 "The signal to noise ratio (SNR) of the radar detection";
CM_ SG_ 1240 DET_POINT_TARGET_PROB_353 "Describes the possibility if more than one real-world object has led to this detection. 0[%] := 100[%] Multi target probability";
CM_ SG_ 1240 DET_EXISTENCE_PROB_353 "Existence probability of the detection not based on history. Value does  not depend on any past experience with similar detections.
\note Use as confidence measure where a low value means less confidence
and a high value indicates strong confidence.";
CM_ SG_ 1240 DET_OUTSIDE_SECTOR_353 "Flag to indicate detections outside the sector, set if the wrong sector calibration matrix was used";
CM_ SG_ 1240 DET_HVC_FLAG_353 "Core2 Vehicle clutter flag";
CM_ SG_ 1240 DET_CONFD_AZIMUTH_353 "Define the Confidence of Azimuth for Detection ";
CM_ SG_ 1240 DET_CONFD_ELEVATION_353 "Define the Confidence of Elevation for the Detection ";
CM_ SG_ 1240 DET_BI_STATIC_FLAG_354 "1 if detection is bi-static 0 otherwise";
CM_ SG_ 1240 DET_BI_STATIC_FLAG_355 "1 if detection is bi-static 0 otherwise";
CM_ SG_ 1240 DET_BI_STATIC_FLAG_356 "1 if detection is bi-static 0 otherwise";
CM_ SG_ 1240 DET_MH_SCAN_INDEX_4LSB_353_356 "Scan index of the measured detection";
CM_ SG_ 1240 DET_MH_CYCLE_COUNTER_353_356 "Detection Alive Counter";
CM_ SG_ 1241 DET_RANGE_357 " measured position  of the detection";
CM_ SG_ 1241 DET_RANGE_ERR_357 "RMSE or standard deviation of the measured angle  of the detection";
CM_ SG_ 1241 DET_RANGE_VELOCITY_357 "Radial velocity of the detection positive in direction to the sensor";
CM_ SG_ 1241 DET_RANGE_VELOCITY_ERR_357 "RMSE or standard deviation of the measure radial velocity of the detection";
CM_ SG_ 1241 DET_AZIMUTH_357 "Measured angle  of the detection";
CM_ SG_ 1241 DET_AZIMUTH_ERR_357 "RMSE or standard deviation of the measured angle  of the detection";
CM_ SG_ 1241 DET_ELEVATION_357 "measured elevation of the detection";
CM_ SG_ 1241 DET_ELEVATION_ERR_357 "RMSE or standard deviation of the measured elevation  of the detection";
CM_ SG_ 1241 DET_RCS_357 "Radar Cross Section or Amplitude, is a measure of how detectable an object is by radar. A larger RCS indicates that an object is more easily detected.";
CM_ SG_ 1241 DET_VALID_FLAG_357 "is set if the measured detection is valid";
CM_ SG_ 1241 DET_BI_STATIC_FLAG_357 "1 if detection is bi-static 0 otherwise";
CM_ SG_ 1241 DET_SUPER_RES_TARGET_357 "flasg is set if the detection is super resolution target";
CM_ SG_ 1241 DET_SNR_357 "The signal to noise ratio (SNR) of the radar detection";
CM_ SG_ 1241 DET_POINT_TARGET_PROB_357 "Describes the possibility if more than one real-world object has led to this detection. 0[%] := 100[%] Multi target probability";
CM_ SG_ 1241 DET_EXISTENCE_PROB_357 "Existence probability of the detection not based on history. Value does  not depend on any past experience with similar detections.
\note Use as confidence measure where a low value means less confidence
and a high value indicates strong confidence.";
CM_ SG_ 1241 DET_OUTSIDE_SECTOR_357 "Flag to indicate detections outside the sector, set if the wrong sector calibration matrix was used";
CM_ SG_ 1241 DET_HVC_FLAG_357 "Core2 Vehicle clutter flag";
CM_ SG_ 1241 DET_CONFD_AZIMUTH_357 "Define the Confidence of Azimuth for Detection ";
CM_ SG_ 1241 DET_CONFD_ELEVATION_357 "Define the Confidence of Elevation for the Detection ";
CM_ SG_ 1241 DET_BI_STATIC_FLAG_358 "1 if detection is bi-static 0 otherwise";
CM_ SG_ 1241 DET_BI_STATIC_FLAG_359 "1 if detection is bi-static 0 otherwise";
CM_ SG_ 1241 DET_BI_STATIC_FLAG_360 "1 if detection is bi-static 0 otherwise";
CM_ SG_ 1241 DET_MH_SCAN_INDEX_4LSB_357_360 "Scan index of the measured detection";
CM_ SG_ 1241 DET_MH_CYCLE_COUNTER_357_360 "Detection Alive Counter";
CM_ SG_ 1242 DET_RANGE_361 " measured position  of the detection";
CM_ SG_ 1242 DET_RANGE_ERR_361 "RMSE or standard deviation of the measured angle  of the detection";
CM_ SG_ 1242 DET_RANGE_VELOCITY_361 "Radial velocity of the detection positive in direction to the sensor";
CM_ SG_ 1242 DET_RANGE_VELOCITY_ERR_361 "RMSE or standard deviation of the measure radial velocity of the detection";
CM_ SG_ 1242 DET_AZIMUTH_361 "Measured angle  of the detection";
CM_ SG_ 1242 DET_AZIMUTH_ERR_361 "RMSE or standard deviation of the measured angle  of the detection";
CM_ SG_ 1242 DET_ELEVATION_361 "measured elevation of the detection";
CM_ SG_ 1242 DET_ELEVATION_ERR_361 "RMSE or standard deviation of the measured elevation  of the detection";
CM_ SG_ 1242 DET_RCS_361 "Radar Cross Section or Amplitude, is a measure of how detectable an object is by radar. A larger RCS indicates that an object is more easily detected.";
CM_ SG_ 1242 DET_VALID_FLAG_361 "is set if the measured detection is valid";
CM_ SG_ 1242 DET_BI_STATIC_FLAG_361 "1 if detection is bi-static 0 otherwise";
CM_ SG_ 1242 DET_SUPER_RES_TARGET_361 "flasg is set if the detection is super resolution target";
CM_ SG_ 1242 DET_SNR_361 "The signal to noise ratio (SNR) of the radar detection";
CM_ SG_ 1242 DET_POINT_TARGET_PROB_361 "Describes the possibility if more than one real-world object has led to this detection. 0[%] := 100[%] Multi target probability";
CM_ SG_ 1242 DET_EXISTENCE_PROB_361 "Existence probability of the detection not based on history. Value does  not depend on any past experience with similar detections.
\note Use as confidence measure where a low value means less confidence
and a high value indicates strong confidence.";
CM_ SG_ 1242 DET_OUTSIDE_SECTOR_361 "Flag to indicate detections outside the sector, set if the wrong sector calibration matrix was used";
CM_ SG_ 1242 DET_HVC_FLAG_361 "Core2 Vehicle clutter flag";
CM_ SG_ 1242 DET_CONFD_AZIMUTH_361 "Define the Confidence of Azimuth for Detection ";
CM_ SG_ 1242 DET_CONFD_ELEVATION_361 "Define the Confidence of Elevation for the Detection ";
CM_ SG_ 1242 DET_BI_STATIC_FLAG_362 "1 if detection is bi-static 0 otherwise";
CM_ SG_ 1242 DET_BI_STATIC_FLAG_363 "1 if detection is bi-static 0 otherwise";
CM_ SG_ 1242 DET_BI_STATIC_FLAG_364 "1 if detection is bi-static 0 otherwise";
CM_ SG_ 1242 DET_MH_SCAN_INDEX_4LSB_361_364 "Scan index of the measured detection";
CM_ SG_ 1242 DET_MH_CYCLE_COUNTER_361_364 "Detection Alive Counter";
CM_ SG_ 1243 DET_RANGE_365 " measured position  of the detection";
CM_ SG_ 1243 DET_RANGE_ERR_365 "RMSE or standard deviation of the measured angle  of the detection";
CM_ SG_ 1243 DET_RANGE_VELOCITY_365 "Radial velocity of the detection positive in direction to the sensor";
CM_ SG_ 1243 DET_RANGE_VELOCITY_ERR_365 "RMSE or standard deviation of the measure radial velocity of the detection";
CM_ SG_ 1243 DET_AZIMUTH_365 "Measured angle  of the detection";
CM_ SG_ 1243 DET_AZIMUTH_ERR_365 "RMSE or standard deviation of the measured angle  of the detection";
CM_ SG_ 1243 DET_ELEVATION_365 "measured elevation of the detection";
CM_ SG_ 1243 DET_ELEVATION_ERR_365 "RMSE or standard deviation of the measured elevation  of the detection";
CM_ SG_ 1243 DET_RCS_365 "Radar Cross Section or Amplitude, is a measure of how detectable an object is by radar. A larger RCS indicates that an object is more easily detected.";
CM_ SG_ 1243 DET_VALID_FLAG_365 "is set if the measured detection is valid";
CM_ SG_ 1243 DET_BI_STATIC_FLAG_365 "1 if detection is bi-static 0 otherwise";
CM_ SG_ 1243 DET_SUPER_RES_TARGET_365 "flasg is set if the detection is super resolution target";
CM_ SG_ 1243 DET_SNR_365 "The signal to noise ratio (SNR) of the radar detection";
CM_ SG_ 1243 DET_POINT_TARGET_PROB_365 "Describes the possibility if more than one real-world object has led to this detection. 0[%] := 100[%] Multi target probability";
CM_ SG_ 1243 DET_EXISTENCE_PROB_365 "Existence probability of the detection not based on history. Value does  not depend on any past experience with similar detections.
\note Use as confidence measure where a low value means less confidence
and a high value indicates strong confidence.";
CM_ SG_ 1243 DET_OUTSIDE_SECTOR_365 "Flag to indicate detections outside the sector, set if the wrong sector calibration matrix was used";
CM_ SG_ 1243 DET_HVC_FLAG_365 "Core2 Vehicle clutter flag";
CM_ SG_ 1243 DET_CONFD_AZIMUTH_365 "Define the Confidence of Azimuth for Detection ";
CM_ SG_ 1243 DET_CONFD_ELEVATION_365 "Define the Confidence of Elevation for the Detection ";
CM_ SG_ 1243 DET_BI_STATIC_FLAG_366 "1 if detection is bi-static 0 otherwise";
CM_ SG_ 1243 DET_BI_STATIC_FLAG_367 "1 if detection is bi-static 0 otherwise";
CM_ SG_ 1243 DET_BI_STATIC_FLAG_368 "1 if detection is bi-static 0 otherwise";
CM_ SG_ 1243 DET_MH_SCAN_INDEX_4LSB_365_368 "Scan index of the measured detection";
CM_ SG_ 1243 DET_MH_CYCLE_COUNTER_365_368 "Detection Alive Counter";
CM_ SG_ 1244 DET_RANGE_369 " measured position  of the detection";
CM_ SG_ 1244 DET_RANGE_ERR_369 "RMSE or standard deviation of the measured angle  of the detection";
CM_ SG_ 1244 DET_RANGE_VELOCITY_369 "Radial velocity of the detection positive in direction to the sensor";
CM_ SG_ 1244 DET_RANGE_VELOCITY_ERR_369 "RMSE or standard deviation of the measure radial velocity of the detection";
CM_ SG_ 1244 DET_AZIMUTH_369 "Measured angle  of the detection";
CM_ SG_ 1244 DET_AZIMUTH_ERR_369 "RMSE or standard deviation of the measured angle  of the detection";
CM_ SG_ 1244 DET_ELEVATION_369 "measured elevation of the detection";
CM_ SG_ 1244 DET_ELEVATION_ERR_369 "RMSE or standard deviation of the measured elevation  of the detection";
CM_ SG_ 1244 DET_RCS_369 "Radar Cross Section or Amplitude, is a measure of how detectable an object is by radar. A larger RCS indicates that an object is more easily detected.";
CM_ SG_ 1244 DET_VALID_FLAG_369 "is set if the measured detection is valid";
CM_ SG_ 1244 DET_BI_STATIC_FLAG_369 "1 if detection is bi-static 0 otherwise";
CM_ SG_ 1244 DET_SUPER_RES_TARGET_369 "flasg is set if the detection is super resolution target";
CM_ SG_ 1244 DET_SNR_369 "The signal to noise ratio (SNR) of the radar detection";
CM_ SG_ 1244 DET_POINT_TARGET_PROB_369 "Describes the possibility if more than one real-world object has led to this detection. 0[%] := 100[%] Multi target probability";
CM_ SG_ 1244 DET_EXISTENCE_PROB_369 "Existence probability of the detection not based on history. Value does  not depend on any past experience with similar detections.
\note Use as confidence measure where a low value means less confidence
and a high value indicates strong confidence.";
CM_ SG_ 1244 DET_OUTSIDE_SECTOR_369 "Flag to indicate detections outside the sector, set if the wrong sector calibration matrix was used";
CM_ SG_ 1244 DET_HVC_FLAG_369 "Core2 Vehicle clutter flag";
CM_ SG_ 1244 DET_CONFD_AZIMUTH_369 "Define the Confidence of Azimuth for Detection ";
CM_ SG_ 1244 DET_CONFD_ELEVATION_369 "Define the Confidence of Elevation for the Detection ";
CM_ SG_ 1244 DET_BI_STATIC_FLAG_370 "1 if detection is bi-static 0 otherwise";
CM_ SG_ 1244 DET_BI_STATIC_FLAG_371 "1 if detection is bi-static 0 otherwise";
CM_ SG_ 1244 DET_BI_STATIC_FLAG_372 "1 if detection is bi-static 0 otherwise";
CM_ SG_ 1244 DET_MH_SCAN_INDEX_4LSB_369_372 "Scan index of the measured detection";
CM_ SG_ 1244 DET_MH_CYCLE_COUNTER_369_372 "Detection Alive Counter";
CM_ SG_ 1245 DET_RANGE_373 " measured position  of the detection";
CM_ SG_ 1245 DET_RANGE_ERR_373 "RMSE or standard deviation of the measured angle  of the detection";
CM_ SG_ 1245 DET_RANGE_VELOCITY_373 "Radial velocity of the detection positive in direction to the sensor";
CM_ SG_ 1245 DET_RANGE_VELOCITY_ERR_373 "RMSE or standard deviation of the measure radial velocity of the detection";
CM_ SG_ 1245 DET_AZIMUTH_373 "Measured angle  of the detection";
CM_ SG_ 1245 DET_AZIMUTH_ERR_373 "RMSE or standard deviation of the measured angle  of the detection";
CM_ SG_ 1245 DET_ELEVATION_373 "measured elevation of the detection";
CM_ SG_ 1245 DET_ELEVATION_ERR_373 "RMSE or standard deviation of the measured elevation  of the detection";
CM_ SG_ 1245 DET_RCS_373 "Radar Cross Section or Amplitude, is a measure of how detectable an object is by radar. A larger RCS indicates that an object is more easily detected.";
CM_ SG_ 1245 DET_VALID_FLAG_373 "is set if the measured detection is valid";
CM_ SG_ 1245 DET_BI_STATIC_FLAG_373 "1 if detection is bi-static 0 otherwise";
CM_ SG_ 1245 DET_SUPER_RES_TARGET_373 "flasg is set if the detection is super resolution target";
CM_ SG_ 1245 DET_SNR_373 "The signal to noise ratio (SNR) of the radar detection";
CM_ SG_ 1245 DET_POINT_TARGET_PROB_373 "Describes the possibility if more than one real-world object has led to this detection. 0[%] := 100[%] Multi target probability";
CM_ SG_ 1245 DET_EXISTENCE_PROB_373 "Existence probability of the detection not based on history. Value does  not depend on any past experience with similar detections.
\note Use as confidence measure where a low value means less confidence
and a high value indicates strong confidence.";
CM_ SG_ 1245 DET_OUTSIDE_SECTOR_373 "Flag to indicate detections outside the sector, set if the wrong sector calibration matrix was used";
CM_ SG_ 1245 DET_HVC_FLAG_373 "Core2 Vehicle clutter flag";
CM_ SG_ 1245 DET_CONFD_AZIMUTH_373 "Define the Confidence of Azimuth for Detection ";
CM_ SG_ 1245 DET_CONFD_ELEVATION_373 "Define the Confidence of Elevation for the Detection ";
CM_ SG_ 1245 DET_BI_STATIC_FLAG_374 "1 if detection is bi-static 0 otherwise";
CM_ SG_ 1245 DET_BI_STATIC_FLAG_375 "1 if detection is bi-static 0 otherwise";
CM_ SG_ 1245 DET_BI_STATIC_FLAG_376 "1 if detection is bi-static 0 otherwise";
CM_ SG_ 1245 DET_MH_SCAN_INDEX_4LSB_373_376 "Scan index of the measured detection";
CM_ SG_ 1245 DET_MH_CYCLE_COUNTER_373_376 "Detection Alive Counter";
CM_ SG_ 1246 DET_RANGE_377 " measured position  of the detection";
CM_ SG_ 1246 DET_RANGE_ERR_377 "RMSE or standard deviation of the measured angle  of the detection";
CM_ SG_ 1246 DET_RANGE_VELOCITY_377 "Radial velocity of the detection positive in direction to the sensor";
CM_ SG_ 1246 DET_RANGE_VELOCITY_ERR_377 "RMSE or standard deviation of the measure radial velocity of the detection";
CM_ SG_ 1246 DET_AZIMUTH_377 "Measured angle  of the detection";
CM_ SG_ 1246 DET_AZIMUTH_ERR_377 "RMSE or standard deviation of the measured angle  of the detection";
CM_ SG_ 1246 DET_ELEVATION_377 "measured elevation of the detection";
CM_ SG_ 1246 DET_ELEVATION_ERR_377 "RMSE or standard deviation of the measured elevation  of the detection";
CM_ SG_ 1246 DET_RCS_377 "Radar Cross Section or Amplitude, is a measure of how detectable an object is by radar. A larger RCS indicates that an object is more easily detected.";
CM_ SG_ 1246 DET_VALID_FLAG_377 "is set if the measured detection is valid";
CM_ SG_ 1246 DET_BI_STATIC_FLAG_377 "1 if detection is bi-static 0 otherwise";
CM_ SG_ 1246 DET_SUPER_RES_TARGET_377 "flasg is set if the detection is super resolution target";
CM_ SG_ 1246 DET_SNR_377 "The signal to noise ratio (SNR) of the radar detection";
CM_ SG_ 1246 DET_POINT_TARGET_PROB_377 "Describes the possibility if more than one real-world object has led to this detection. 0[%] := 100[%] Multi target probability";
CM_ SG_ 1246 DET_EXISTENCE_PROB_377 "Existence probability of the detection not based on history. Value does  not depend on any past experience with similar detections.
\note Use as confidence measure where a low value means less confidence
and a high value indicates strong confidence.";
CM_ SG_ 1246 DET_OUTSIDE_SECTOR_377 "Flag to indicate detections outside the sector, set if the wrong sector calibration matrix was used";
CM_ SG_ 1246 DET_HVC_FLAG_377 "Core2 Vehicle clutter flag";
CM_ SG_ 1246 DET_CONFD_AZIMUTH_377 "Define the Confidence of Azimuth for Detection ";
CM_ SG_ 1246 DET_CONFD_ELEVATION_377 "Define the Confidence of Elevation for the Detection ";
CM_ SG_ 1246 DET_BI_STATIC_FLAG_378 "1 if detection is bi-static 0 otherwise";
CM_ SG_ 1246 DET_BI_STATIC_FLAG_379 "1 if detection is bi-static 0 otherwise";
CM_ SG_ 1246 DET_BI_STATIC_FLAG_380 "1 if detection is bi-static 0 otherwise";
CM_ SG_ 1246 DET_MH_SCAN_INDEX_4LSB_377_380 "Scan index of the measured detection";
CM_ SG_ 1246 DET_MH_CYCLE_COUNTER_377_380 "Detection Alive Counter";
CM_ SG_ 1247 DET_RANGE_381 " measured position  of the detection";
CM_ SG_ 1247 DET_RANGE_ERR_381 "RMSE or standard deviation of the measured angle  of the detection";
CM_ SG_ 1247 DET_RANGE_VELOCITY_381 "Radial velocity of the detection positive in direction to the sensor";
CM_ SG_ 1247 DET_RANGE_VELOCITY_ERR_381 "RMSE or standard deviation of the measure radial velocity of the detection";
CM_ SG_ 1247 DET_AZIMUTH_381 "Measured angle  of the detection";
CM_ SG_ 1247 DET_AZIMUTH_ERR_381 "RMSE or standard deviation of the measured angle  of the detection";
CM_ SG_ 1247 DET_ELEVATION_381 "measured elevation of the detection";
CM_ SG_ 1247 DET_ELEVATION_ERR_381 "RMSE or standard deviation of the measured elevation  of the detection";
CM_ SG_ 1247 DET_RCS_381 "Radar Cross Section or Amplitude, is a measure of how detectable an object is by radar. A larger RCS indicates that an object is more easily detected.";
CM_ SG_ 1247 DET_VALID_FLAG_381 "is set if the measured detection is valid";
CM_ SG_ 1247 DET_BI_STATIC_FLAG_381 "1 if detection is bi-static 0 otherwise";
CM_ SG_ 1247 DET_SUPER_RES_TARGET_381 "flasg is set if the detection is super resolution target";
CM_ SG_ 1247 DET_SNR_381 "The signal to noise ratio (SNR) of the radar detection";
CM_ SG_ 1247 DET_POINT_TARGET_PROB_381 "Describes the possibility if more than one real-world object has led to this detection. 0[%] := 100[%] Multi target probability";
CM_ SG_ 1247 DET_EXISTENCE_PROB_381 "Existence probability of the detection not based on history. Value does  not depend on any past experience with similar detections.
\note Use as confidence measure where a low value means less confidence
and a high value indicates strong confidence.";
CM_ SG_ 1247 DET_OUTSIDE_SECTOR_381 "Flag to indicate detections outside the sector, set if the wrong sector calibration matrix was used";
CM_ SG_ 1247 DET_HVC_FLAG_381 "Core2 Vehicle clutter flag";
CM_ SG_ 1247 DET_CONFD_AZIMUTH_381 "Define the Confidence of Azimuth for Detection ";
CM_ SG_ 1247 DET_CONFD_ELEVATION_381 "Define the Confidence of Elevation for the Detection ";
CM_ SG_ 1247 DET_BI_STATIC_FLAG_382 "1 if detection is bi-static 0 otherwise";
CM_ SG_ 1247 DET_BI_STATIC_FLAG_383 "1 if detection is bi-static 0 otherwise";
CM_ SG_ 1247 DET_BI_STATIC_FLAG_384 "1 if detection is bi-static 0 otherwise";
CM_ SG_ 1247 DET_MH_SCAN_INDEX_4LSB_381_384 "Scan index of the measured detection";
CM_ SG_ 1247 DET_MH_CYCLE_COUNTER_381_384 "Detection Alive Counter";
CM_ SG_ 1248 DET_RANGE_385 " measured position  of the detection";
CM_ SG_ 1248 DET_RANGE_ERR_385 "RMSE or standard deviation of the measured angle  of the detection";
CM_ SG_ 1248 DET_RANGE_VELOCITY_385 "Radial velocity of the detection positive in direction to the sensor";
CM_ SG_ 1248 DET_RANGE_VELOCITY_ERR_385 "RMSE or standard deviation of the measure radial velocity of the detection";
CM_ SG_ 1248 DET_AZIMUTH_385 "Measured angle  of the detection";
CM_ SG_ 1248 DET_AZIMUTH_ERR_385 "RMSE or standard deviation of the measured angle  of the detection";
CM_ SG_ 1248 DET_ELEVATION_385 "measured elevation of the detection";
CM_ SG_ 1248 DET_ELEVATION_ERR_385 "RMSE or standard deviation of the measured elevation  of the detection";
CM_ SG_ 1248 DET_RCS_385 "Radar Cross Section or Amplitude, is a measure of how detectable an object is by radar. A larger RCS indicates that an object is more easily detected.";
CM_ SG_ 1248 DET_VALID_FLAG_385 "is set if the measured detection is valid";
CM_ SG_ 1248 DET_BI_STATIC_FLAG_385 "1 if detection is bi-static 0 otherwise";
CM_ SG_ 1248 DET_SUPER_RES_TARGET_385 "flasg is set if the detection is super resolution target";
CM_ SG_ 1248 DET_SNR_385 "The signal to noise ratio (SNR) of the radar detection";
CM_ SG_ 1248 DET_POINT_TARGET_PROB_385 "Describes the possibility if more than one real-world object has led to this detection. 0[%] := 100[%] Multi target probability";
CM_ SG_ 1248 DET_EXISTENCE_PROB_385 "Existence probability of the detection not based on history. Value does  not depend on any past experience with similar detections.
\note Use as confidence measure where a low value means less confidence
and a high value indicates strong confidence.";
CM_ SG_ 1248 DET_OUTSIDE_SECTOR_385 "Flag to indicate detections outside the sector, set if the wrong sector calibration matrix was used";
CM_ SG_ 1248 DET_HVC_FLAG_385 "Core2 Vehicle clutter flag";
CM_ SG_ 1248 DET_CONFD_AZIMUTH_385 "Define the Confidence of Azimuth for Detection ";
CM_ SG_ 1248 DET_CONFD_ELEVATION_385 "Define the Confidence of Elevation for the Detection ";
CM_ SG_ 1248 DET_BI_STATIC_FLAG_386 "1 if detection is bi-static 0 otherwise";
CM_ SG_ 1248 DET_BI_STATIC_FLAG_387 "1 if detection is bi-static 0 otherwise";
CM_ SG_ 1248 DET_BI_STATIC_FLAG_388 "1 if detection is bi-static 0 otherwise";
CM_ SG_ 1248 DET_MH_SCAN_INDEX_4LSB_385_388 "Scan index of the measured detection";
CM_ SG_ 1248 DET_MH_CYCLE_COUNTER_385_388 "Detection Alive Counter";
CM_ SG_ 1249 DET_RANGE_389 " measured position  of the detection";
CM_ SG_ 1249 DET_RANGE_ERR_389 "RMSE or standard deviation of the measured angle  of the detection";
CM_ SG_ 1249 DET_RANGE_VELOCITY_389 "Radial velocity of the detection positive in direction to the sensor";
CM_ SG_ 1249 DET_RANGE_VELOCITY_ERR_389 "RMSE or standard deviation of the measure radial velocity of the detection";
CM_ SG_ 1249 DET_AZIMUTH_389 "Measured angle  of the detection";
CM_ SG_ 1249 DET_AZIMUTH_ERR_389 "RMSE or standard deviation of the measured angle  of the detection";
CM_ SG_ 1249 DET_ELEVATION_389 "measured elevation of the detection";
CM_ SG_ 1249 DET_ELEVATION_ERR_389 "RMSE or standard deviation of the measured elevation  of the detection";
CM_ SG_ 1249 DET_RCS_389 "Radar Cross Section or Amplitude, is a measure of how detectable an object is by radar. A larger RCS indicates that an object is more easily detected.";
CM_ SG_ 1249 DET_VALID_FLAG_389 "is set if the measured detection is valid";
CM_ SG_ 1249 DET_BI_STATIC_FLAG_389 "1 if detection is bi-static 0 otherwise";
CM_ SG_ 1249 DET_SUPER_RES_TARGET_389 "flasg is set if the detection is super resolution target";
CM_ SG_ 1249 DET_SNR_389 "The signal to noise ratio (SNR) of the radar detection";
CM_ SG_ 1249 DET_POINT_TARGET_PROB_389 "Describes the possibility if more than one real-world object has led to this detection. 0[%] := 100[%] Multi target probability";
CM_ SG_ 1249 DET_EXISTENCE_PROB_389 "Existence probability of the detection not based on history. Value does  not depend on any past experience with similar detections.
\note Use as confidence measure where a low value means less confidence
and a high value indicates strong confidence.";
CM_ SG_ 1249 DET_OUTSIDE_SECTOR_389 "Flag to indicate detections outside the sector, set if the wrong sector calibration matrix was used";
CM_ SG_ 1249 DET_HVC_FLAG_389 "Core2 Vehicle clutter flag";
CM_ SG_ 1249 DET_CONFD_AZIMUTH_389 "Define the Confidence of Azimuth for Detection ";
CM_ SG_ 1249 DET_CONFD_ELEVATION_389 "Define the Confidence of Elevation for the Detection ";
CM_ SG_ 1249 DET_BI_STATIC_FLAG_390 "1 if detection is bi-static 0 otherwise";
CM_ SG_ 1249 DET_BI_STATIC_FLAG_391 "1 if detection is bi-static 0 otherwise";
CM_ SG_ 1249 DET_BI_STATIC_FLAG_392 "1 if detection is bi-static 0 otherwise";
CM_ SG_ 1249 DET_MH_SCAN_INDEX_4LSB_389_392 "Scan index of the measured detection";
CM_ SG_ 1249 DET_MH_CYCLE_COUNTER_389_392 "Detection Alive Counter";
CM_ SG_ 1250 DET_RANGE_393 " measured position  of the detection";
CM_ SG_ 1250 DET_RANGE_ERR_393 "RMSE or standard deviation of the measured angle  of the detection";
CM_ SG_ 1250 DET_RANGE_VELOCITY_393 "Radial velocity of the detection positive in direction to the sensor";
CM_ SG_ 1250 DET_RANGE_VELOCITY_ERR_393 "RMSE or standard deviation of the measure radial velocity of the detection";
CM_ SG_ 1250 DET_AZIMUTH_393 "Measured angle  of the detection";
CM_ SG_ 1250 DET_AZIMUTH_ERR_393 "RMSE or standard deviation of the measured angle  of the detection";
CM_ SG_ 1250 DET_ELEVATION_393 "measured elevation of the detection";
CM_ SG_ 1250 DET_ELEVATION_ERR_393 "RMSE or standard deviation of the measured elevation  of the detection";
CM_ SG_ 1250 DET_RCS_393 "Radar Cross Section or Amplitude, is a measure of how detectable an object is by radar. A larger RCS indicates that an object is more easily detected.";
CM_ SG_ 1250 DET_VALID_FLAG_393 "is set if the measured detection is valid";
CM_ SG_ 1250 DET_BI_STATIC_FLAG_393 "1 if detection is bi-static 0 otherwise";
CM_ SG_ 1250 DET_SUPER_RES_TARGET_393 "flasg is set if the detection is super resolution target";
CM_ SG_ 1250 DET_SNR_393 "The signal to noise ratio (SNR) of the radar detection";
CM_ SG_ 1250 DET_POINT_TARGET_PROB_393 "Describes the possibility if more than one real-world object has led to this detection. 0[%] := 100[%] Multi target probability";
CM_ SG_ 1250 DET_EXISTENCE_PROB_393 "Existence probability of the detection not based on history. Value does  not depend on any past experience with similar detections.
\note Use as confidence measure where a low value means less confidence
and a high value indicates strong confidence.";
CM_ SG_ 1250 DET_OUTSIDE_SECTOR_393 "Flag to indicate detections outside the sector, set if the wrong sector calibration matrix was used";
CM_ SG_ 1250 DET_HVC_FLAG_393 "Core2 Vehicle clutter flag";
CM_ SG_ 1250 DET_CONFD_AZIMUTH_393 "Define the Confidence of Azimuth for Detection ";
CM_ SG_ 1250 DET_CONFD_ELEVATION_393 "Define the Confidence of Elevation for the Detection ";
CM_ SG_ 1250 DET_BI_STATIC_FLAG_394 "1 if detection is bi-static 0 otherwise";
CM_ SG_ 1250 DET_BI_STATIC_FLAG_395 "1 if detection is bi-static 0 otherwise";
CM_ SG_ 1250 DET_BI_STATIC_FLAG_396 "1 if detection is bi-static 0 otherwise";
CM_ SG_ 1250 DET_MH_SCAN_INDEX_4LSB_393_396 "Scan index of the measured detection";
CM_ SG_ 1250 DET_MH_CYCLE_COUNTER_393_396 "Detection Alive Counter";
CM_ SG_ 1251 DET_RANGE_397 " measured position  of the detection";
CM_ SG_ 1251 DET_RANGE_ERR_397 "RMSE or standard deviation of the measured angle  of the detection";
CM_ SG_ 1251 DET_RANGE_VELOCITY_397 "Radial velocity of the detection positive in direction to the sensor";
CM_ SG_ 1251 DET_RANGE_VELOCITY_ERR_397 "RMSE or standard deviation of the measure radial velocity of the detection";
CM_ SG_ 1251 DET_AZIMUTH_397 "Measured angle  of the detection";
CM_ SG_ 1251 DET_AZIMUTH_ERR_397 "RMSE or standard deviation of the measured angle  of the detection";
CM_ SG_ 1251 DET_ELEVATION_397 "measured elevation of the detection";
CM_ SG_ 1251 DET_ELEVATION_ERR_397 "RMSE or standard deviation of the measured elevation  of the detection";
CM_ SG_ 1251 DET_RCS_397 "Radar Cross Section or Amplitude, is a measure of how detectable an object is by radar. A larger RCS indicates that an object is more easily detected.";
CM_ SG_ 1251 DET_VALID_FLAG_397 "is set if the measured detection is valid";
CM_ SG_ 1251 DET_BI_STATIC_FLAG_397 "1 if detection is bi-static 0 otherwise";
CM_ SG_ 1251 DET_SUPER_RES_TARGET_397 "flasg is set if the detection is super resolution target";
CM_ SG_ 1251 DET_SNR_397 "The signal to noise ratio (SNR) of the radar detection";
CM_ SG_ 1251 DET_POINT_TARGET_PROB_397 "Describes the possibility if more than one real-world object has led to this detection. 0[%] := 100[%] Multi target probability";
CM_ SG_ 1251 DET_EXISTENCE_PROB_397 "Existence probability of the detection not based on history. Value does  not depend on any past experience with similar detections.
\note Use as confidence measure where a low value means less confidence
and a high value indicates strong confidence.";
CM_ SG_ 1251 DET_OUTSIDE_SECTOR_397 "Flag to indicate detections outside the sector, set if the wrong sector calibration matrix was used";
CM_ SG_ 1251 DET_HVC_FLAG_397 "Core2 Vehicle clutter flag";
CM_ SG_ 1251 DET_CONFD_AZIMUTH_397 "Define the Confidence of Azimuth for Detection ";
CM_ SG_ 1251 DET_CONFD_ELEVATION_397 "Define the Confidence of Elevation for the Detection ";
CM_ SG_ 1251 DET_BI_STATIC_FLAG_398 "1 if detection is bi-static 0 otherwise";
CM_ SG_ 1251 DET_BI_STATIC_FLAG_399 "1 if detection is bi-static 0 otherwise";
CM_ SG_ 1251 DET_BI_STATIC_FLAG_400 "1 if detection is bi-static 0 otherwise";
CM_ SG_ 1251 DET_MH_SCAN_INDEX_4LSB_397_400 "Scan index of the measured detection";
CM_ SG_ 1251 DET_MH_CYCLE_COUNTER_397_400 "Detection Alive Counter";
BA_DEF_ BO_  "CanTpBs" INT 0 255;
BA_DEF_ BO_  "DiagRequest" ENUM  "No","Yes";
BA_DEF_ BO_  "DiagResponse" ENUM  "No","Yes";
BA_DEF_ BO_  "E2EDataId" INT 0 65535;
BA_DEF_ BO_  "E2EDataLength" INT 0 65535;
BA_DEF_ BO_  "E2EProfile" STRING ;
BA_DEF_ BO_  "EventRateOfChange" INT 10 10000;
BA_DEF_ BO_  "GenMsgCycleTime" INT 0 100000;
BA_DEF_ BO_  "GenMsgILSupport" ENUM  "No","Yes";
BA_DEF_ BO_  "GenMsgNrOfRepetition" INT 0 100;
BA_DEF_ BO_  "GenMsgSendType" ENUM  "FixedPeriodic","Event","EnabledPeriodic","NotUsed","NotUsed","EventPeriodic","NotUsed","NotUsed","NoMsgSendType";
BA_DEF_ BO_  "NetworkInitialization" ENUM  "No","Yes";
BA_DEF_ BO_  "NmAsrMessage" ENUM  "No","Yes";
BA_DEF_ BO_  "NmMessage" ENUM  "No","Yes";
BA_DEF_ BO_  "SCP_AuthInfoTxLength" INT 0 512;
BA_DEF_ BO_  "SCP_DataId" INT 0 65535;
BA_DEF_ BO_  "SCP_FreshnessValueId" INT 0 65535;
BA_DEF_ BO_  "SCP_FreshnessValueLength" INT 0 512;
BA_DEF_ BO_  "SCP_FreshnessValueTxLength" INT 0 512;
BA_DEF_ BO_  "SC_Message" ENUM  "No","Yes","Yes, split message";
BA_DEF_ BO_  "TpTxIndex" INT 0 255;
BA_DEF_ BO_  "VFrameFormat" ENUM  "StandardCAN","ExtendedCAN","reserved","reserved","reserved","reserved","reserved","reserved","reserved","reserved","reserved","reserved","reserved","reserved","StandardCAN_FD","ExtendedCAN_FD";
BA_DEF_ SG_  "GenSigCmt" STRING ;
BA_DEF_ SG_  "GenSigCycleTime" INT 0 0;
BA_DEF_ SG_  "GenSigSendType" ENUM  "Cyclic","OnWrite","vector_leerstring","OnChange","vector_leerstring","IfActive","vector_leerstring","NoSigSendType";
BA_DEF_ SG_  "GenSigStartValue" INT 0 1000000000;
BA_DEF_ SG_  "GenSigTimeoutTime" INT 0 0;
BA_DEF_ SG_  "GenSigVtEn" STRING ;
BA_DEF_ SG_  "GenSigVtName" STRING ;
BA_DEF_ SG_  "InvalidValue" STRING ;
BA_DEF_DEF_  "CanTpBs" 255;
BA_DEF_DEF_  "DiagRequest" "No";
BA_DEF_DEF_  "DiagResponse" "No";
BA_DEF_DEF_  "E2EDataId" 0;
BA_DEF_DEF_  "E2EDataLength" 0;
BA_DEF_DEF_  "E2EProfile" "";
BA_DEF_DEF_  "EventRateOfChange" 10000;
BA_DEF_DEF_  "GenMsgCycleTime" 0;
BA_DEF_DEF_  "GenMsgILSupport" "Yes";
BA_DEF_DEF_  "GenMsgNrOfRepetition" 0;
BA_DEF_DEF_  "GenMsgSendType" "NoMsgSendType";
BA_DEF_DEF_  "NetworkInitialization" "Yes";
BA_DEF_DEF_  "NmAsrMessage" "No";
BA_DEF_DEF_  "NmMessage" "No";
BA_DEF_DEF_  "SCP_AuthInfoTxLength" 28;
BA_DEF_DEF_  "SCP_DataId" 0;
BA_DEF_DEF_  "SCP_FreshnessValueId" 0;
BA_DEF_DEF_  "SCP_FreshnessValueLength" 48;
BA_DEF_DEF_  "SCP_FreshnessValueTxLength" 4;
BA_DEF_DEF_  "SC_Message" "No";
BA_DEF_DEF_  "TpTxIndex" 0;
BA_DEF_DEF_  "VFrameFormat" "StandardCAN_FD";
BA_DEF_DEF_  "GenSigCmt" "";
BA_DEF_DEF_  "GenSigCycleTime" 0;
BA_DEF_DEF_  "GenSigSendType" "NoSigSendType";
BA_DEF_DEF_  "GenSigStartValue" 0;
BA_DEF_DEF_  "GenSigTimeoutTime" 0;
BA_DEF_DEF_  "GenSigVtEn" "";
BA_DEF_DEF_  "GenSigVtName" "";
BA_DEF_DEF_  "InvalidValue" "";
BA_ "GenMsgSendType" BO_ 1235 1;
BA_ "GenMsgSendType" BO_ 1236 1;
BA_ "GenMsgSendType" BO_ 1237 1;
BA_ "GenMsgSendType" BO_ 1238 1;
BA_ "GenMsgSendType" BO_ 1239 1;
BA_ "GenMsgSendType" BO_ 1240 1;
BA_ "GenMsgSendType" BO_ 1241 1;
BA_ "GenMsgSendType" BO_ 1242 1;
BA_ "GenMsgSendType" BO_ 1243 1;
BA_ "GenMsgSendType" BO_ 1244 1;
BA_ "GenMsgSendType" BO_ 1245 1;
BA_ "GenMsgSendType" BO_ 1246 1;
BA_ "GenMsgSendType" BO_ 1247 1;
BA_ "GenMsgSendType" BO_ 1248 1;
BA_ "GenMsgSendType" BO_ 1249 1;
BA_ "GenMsgSendType" BO_ 1250 1;
BA_ "GenMsgSendType" BO_ 1251 1;
BA_ "GenSigStartValue" SG_ 1235 DET_RANGE_VELOCITY_333 16384;
BA_ "GenSigStartValue" SG_ 1235 DET_RCS_333 128;
BA_ "GenSigStartValue" SG_ 1235 DET_RANGE_VELOCITY_334 16384;
BA_ "GenSigStartValue" SG_ 1235 DET_RCS_334 128;
BA_ "GenSigStartValue" SG_ 1235 DET_RANGE_VELOCITY_335 16384;
BA_ "GenSigStartValue" SG_ 1235 DET_RCS_335 128;
BA_ "GenSigStartValue" SG_ 1235 DET_RANGE_VELOCITY_336 16384;
BA_ "GenSigStartValue" SG_ 1235 DET_RCS_336 128;
BA_ "GenSigStartValue" SG_ 1236 DET_RANGE_VELOCITY_337 16384;
BA_ "GenSigStartValue" SG_ 1236 DET_RCS_337 128;
BA_ "GenSigStartValue" SG_ 1236 DET_RANGE_VELOCITY_338 16384;
BA_ "GenSigStartValue" SG_ 1236 DET_RCS_338 128;
BA_ "GenSigStartValue" SG_ 1236 DET_RANGE_VELOCITY_339 16384;
BA_ "GenSigStartValue" SG_ 1236 DET_RCS_339 128;
BA_ "GenSigStartValue" SG_ 1236 DET_RANGE_VELOCITY_340 16384;
BA_ "GenSigStartValue" SG_ 1236 DET_RCS_340 128;
BA_ "GenSigStartValue" SG_ 1237 DET_RANGE_VELOCITY_341 16384;
BA_ "GenSigStartValue" SG_ 1237 DET_RCS_341 128;
BA_ "GenSigStartValue" SG_ 1237 DET_RANGE_VELOCITY_342 16384;
BA_ "GenSigStartValue" SG_ 1237 DET_RCS_342 128;
BA_ "GenSigStartValue" SG_ 1237 DET_RANGE_VELOCITY_343 16384;
BA_ "GenSigStartValue" SG_ 1237 DET_RCS_343 128;
BA_ "GenSigStartValue" SG_ 1237 DET_RANGE_VELOCITY_344 16384;
BA_ "GenSigStartValue" SG_ 1237 DET_RCS_344 128;
BA_ "GenSigStartValue" SG_ 1238 DET_RANGE_VELOCITY_345 16384;
BA_ "GenSigStartValue" SG_ 1238 DET_RCS_345 128;
BA_ "GenSigStartValue" SG_ 1238 DET_RANGE_VELOCITY_346 16384;
BA_ "GenSigStartValue" SG_ 1238 DET_RCS_346 128;
BA_ "GenSigStartValue" SG_ 1238 DET_RANGE_VELOCITY_347 16384;
BA_ "GenSigStartValue" SG_ 1238 DET_RCS_347 128;
BA_ "GenSigStartValue" SG_ 1238 DET_RANGE_VELOCITY_348 16384;
BA_ "GenSigStartValue" SG_ 1238 DET_RCS_348 128;
BA_ "GenSigStartValue" SG_ 1239 DET_RANGE_VELOCITY_349 16384;
BA_ "GenSigStartValue" SG_ 1239 DET_RCS_349 128;
BA_ "GenSigStartValue" SG_ 1239 DET_RANGE_VELOCITY_350 16384;
BA_ "GenSigStartValue" SG_ 1239 DET_RCS_350 128;
BA_ "GenSigStartValue" SG_ 1239 DET_RANGE_VELOCITY_351 16384;
BA_ "GenSigStartValue" SG_ 1239 DET_RCS_351 128;
BA_ "GenSigStartValue" SG_ 1239 DET_RANGE_VELOCITY_352 16384;
BA_ "GenSigStartValue" SG_ 1239 DET_RCS_352 128;
BA_ "GenSigStartValue" SG_ 1240 DET_RANGE_VELOCITY_353 16384;
BA_ "GenSigStartValue" SG_ 1240 DET_RCS_353 128;
BA_ "GenSigStartValue" SG_ 1240 DET_RANGE_VELOCITY_354 16384;
BA_ "GenSigStartValue" SG_ 1240 DET_RCS_354 128;
BA_ "GenSigStartValue" SG_ 1240 DET_RANGE_VELOCITY_355 16384;
BA_ "GenSigStartValue" SG_ 1240 DET_RCS_355 128;
BA_ "GenSigStartValue" SG_ 1240 DET_RANGE_VELOCITY_356 16384;
BA_ "GenSigStartValue" SG_ 1240 DET_RCS_356 128;
BA_ "GenSigStartValue" SG_ 1241 DET_RANGE_VELOCITY_357 16384;
BA_ "GenSigStartValue" SG_ 1241 DET_RCS_357 128;
BA_ "GenSigStartValue" SG_ 1241 DET_RANGE_VELOCITY_358 16384;
BA_ "GenSigStartValue" SG_ 1241 DET_RCS_358 128;
BA_ "GenSigStartValue" SG_ 1241 DET_RANGE_VELOCITY_359 16384;
BA_ "GenSigStartValue" SG_ 1241 DET_RCS_359 128;
BA_ "GenSigStartValue" SG_ 1241 DET_RANGE_VELOCITY_360 16384;
BA_ "GenSigStartValue" SG_ 1241 DET_RCS_360 128;
BA_ "GenSigStartValue" SG_ 1242 DET_RANGE_VELOCITY_361 16384;
BA_ "GenSigStartValue" SG_ 1242 DET_RCS_361 128;
BA_ "GenSigStartValue" SG_ 1242 DET_RANGE_VELOCITY_362 16384;
BA_ "GenSigStartValue" SG_ 1242 DET_RCS_362 128;
BA_ "GenSigStartValue" SG_ 1242 DET_RANGE_VELOCITY_363 16384;
BA_ "GenSigStartValue" SG_ 1242 DET_RCS_363 128;
BA_ "GenSigStartValue" SG_ 1242 DET_RANGE_VELOCITY_364 16384;
BA_ "GenSigStartValue" SG_ 1242 DET_RCS_364 128;
BA_ "GenSigStartValue" SG_ 1243 DET_RANGE_VELOCITY_365 16384;
BA_ "GenSigStartValue" SG_ 1243 DET_RCS_365 128;
BA_ "GenSigStartValue" SG_ 1243 DET_RANGE_VELOCITY_366 16384;
BA_ "GenSigStartValue" SG_ 1243 DET_RCS_366 128;
BA_ "GenSigStartValue" SG_ 1243 DET_RANGE_VELOCITY_367 16384;
BA_ "GenSigStartValue" SG_ 1243 DET_RCS_367 128;
BA_ "GenSigStartValue" SG_ 1243 DET_RANGE_VELOCITY_368 16384;
BA_ "GenSigStartValue" SG_ 1243 DET_RCS_368 128;
BA_ "GenSigStartValue" SG_ 1244 DET_RANGE_VELOCITY_369 16384;
BA_ "GenSigStartValue" SG_ 1244 DET_RCS_369 128;
BA_ "GenSigStartValue" SG_ 1244 DET_RANGE_VELOCITY_370 16384;
BA_ "GenSigStartValue" SG_ 1244 DET_RCS_370 128;
BA_ "GenSigStartValue" SG_ 1244 DET_RANGE_VELOCITY_371 16384;
BA_ "GenSigStartValue" SG_ 1244 DET_RCS_371 128;
BA_ "GenSigStartValue" SG_ 1244 DET_RANGE_VELOCITY_372 16384;
BA_ "GenSigStartValue" SG_ 1244 DET_RCS_372 128;
BA_ "GenSigStartValue" SG_ 1245 DET_RANGE_VELOCITY_373 16384;
BA_ "GenSigStartValue" SG_ 1245 DET_RCS_373 128;
BA_ "GenSigStartValue" SG_ 1245 DET_RANGE_VELOCITY_374 16384;
BA_ "GenSigStartValue" SG_ 1245 DET_RCS_374 128;
BA_ "GenSigStartValue" SG_ 1245 DET_RANGE_VELOCITY_375 16384;
BA_ "GenSigStartValue" SG_ 1245 DET_RCS_375 128;
BA_ "GenSigStartValue" SG_ 1245 DET_RANGE_VELOCITY_376 16384;
BA_ "GenSigStartValue" SG_ 1245 DET_RCS_376 128;
BA_ "GenSigStartValue" SG_ 1246 DET_RANGE_VELOCITY_377 16384;
BA_ "GenSigStartValue" SG_ 1246 DET_RCS_377 128;
BA_ "GenSigStartValue" SG_ 1246 DET_RANGE_VELOCITY_378 16384;
BA_ "GenSigStartValue" SG_ 1246 DET_RCS_378 128;
BA_ "GenSigStartValue" SG_ 1246 DET_RANGE_VELOCITY_379 16384;
BA_ "GenSigStartValue" SG_ 1246 DET_RCS_379 128;
BA_ "GenSigStartValue" SG_ 1246 DET_RANGE_VELOCITY_380 16384;
BA_ "GenSigStartValue" SG_ 1246 DET_RCS_380 128;
BA_ "GenSigStartValue" SG_ 1247 DET_RANGE_VELOCITY_381 16384;
BA_ "GenSigStartValue" SG_ 1247 DET_RCS_381 128;
BA_ "GenSigStartValue" SG_ 1247 DET_RANGE_VELOCITY_382 16384;
BA_ "GenSigStartValue" SG_ 1247 DET_RCS_382 128;
BA_ "GenSigStartValue" SG_ 1247 DET_RANGE_VELOCITY_383 16384;
BA_ "GenSigStartValue" SG_ 1247 DET_RCS_383 128;
BA_ "GenSigStartValue" SG_ 1247 DET_RANGE_VELOCITY_384 16384;
BA_ "GenSigStartValue" SG_ 1247 DET_RCS_384 128;
BA_ "GenSigStartValue" SG_ 1248 DET_RANGE_VELOCITY_385 16384;
BA_ "GenSigStartValue" SG_ 1248 DET_RCS_385 128;
BA_ "GenSigStartValue" SG_ 1248 DET_RANGE_VELOCITY_386 16384;
BA_ "GenSigStartValue" SG_ 1248 DET_RCS_386 128;
BA_ "GenSigStartValue" SG_ 1248 DET_RANGE_VELOCITY_387 16384;
BA_ "GenSigStartValue" SG_ 1248 DET_RCS_387 128;
BA_ "GenSigStartValue" SG_ 1248 DET_RANGE_VELOCITY_388 16384;
BA_ "GenSigStartValue" SG_ 1248 DET_RCS_388 128;
BA_ "GenSigStartValue" SG_ 1249 DET_RANGE_VELOCITY_389 16384;
BA_ "GenSigStartValue" SG_ 1249 DET_RCS_389 128;
BA_ "GenSigStartValue" SG_ 1249 DET_RANGE_VELOCITY_390 16384;
BA_ "GenSigStartValue" SG_ 1249 DET_RCS_390 128;
BA_ "GenSigStartValue" SG_ 1249 DET_RANGE_VELOCITY_391 16384;
BA_ "GenSigStartValue" SG_ 1249 DET_RCS_391 128;
BA_ "GenSigStartValue" SG_ 1249 DET_RANGE_VELOCITY_392 16384;
BA_ "GenSigStartValue" SG_ 1249 DET_RCS_392 128;
BA_ "GenSigStartValue" SG_ 1250 DET_RANGE_VELOCITY_393 16384;
BA_ "GenSigStartValue" SG_ 1250 DET_RCS_393 128;
BA_ "GenSigStartValue" SG_ 1250 DET_RANGE_VELOCITY_394 16384;
BA_ "GenSigStartValue" SG_ 1250 DET_RCS_394 128;
BA_ "GenSigStartValue" SG_ 1250 DET_RANGE_VELOCITY_395 16384;
BA_ "GenSigStartValue" SG_ 1250 DET_RCS_395 128;
BA_ "GenSigStartValue" SG_ 1250 DET_RANGE_VELOCITY_396 16384;
BA_ "GenSigStartValue" SG_ 1250 DET_RCS_396 128;
BA_ "GenSigStartValue" SG_ 1251 DET_RANGE_VELOCITY_397 16384;
BA_ "GenSigStartValue" SG_ 1251 DET_RCS_397 128;
BA_ "GenSigStartValue" SG_ 1251 DET_RANGE_VELOCITY_398 16384;
BA_ "GenSigStartValue" SG_ 1251 DET_RCS_398 128;
BA_ "GenSigStartValue" SG_ 1251 DET_RANGE_VELOCITY_399 16384;
BA_ "GenSigStartValue" SG_ 1251 DET_RCS_399 128;
BA_ "GenSigStartValue" SG_ 1251 DET_RANGE_VELOCITY_400 16384;
BA_ "GenSigStartValue" SG_ 1251 DET_RCS_400 128;
VAL_ 1235 DET_CONFD_AZIMUTH_333 0 "High" 1 "MidHigh" 2 "MidLow" 3 "Low" ;
VAL_ 1235 DET_CONFD_ELEVATION_333 0 "High" 1 "MidHigh" 2 "MidLow" 3 "Low" ;
VAL_ 1235 DET_CONFD_AZIMUTH_334 0 "High" 1 "MidHigh" 2 "MidLow" 3 "Low" ;
VAL_ 1235 DET_CONFD_ELEVATION_334 0 "High" 1 "MidHigh" 2 "MidLow" 3 "Low" ;
VAL_ 1235 DET_CONFD_AZIMUTH_335 0 "High" 1 "MidHigh" 2 "MidLow" 3 "Low" ;
VAL_ 1235 DET_CONFD_ELEVATION_335 0 "High" 1 "MidHigh" 2 "MidLow" 3 "Low" ;
VAL_ 1236 DET_CONFD_AZIMUTH_337 0 "High" 1 "MidHigh" 2 "MidLow" 3 "Low" ;
VAL_ 1236 DET_CONFD_ELEVATION_337 0 "High" 1 "MidHigh" 2 "MidLow" 3 "Low" ;
VAL_ 1236 DET_CONFD_AZIMUTH_338 0 "High" 1 "MidHigh" 2 "MidLow" 3 "Low" ;
VAL_ 1236 DET_CONFD_ELEVATION_338 0 "High" 1 "MidHigh" 2 "MidLow" 3 "Low" ;
VAL_ 1236 DET_CONFD_AZIMUTH_339 0 "High" 1 "MidHigh" 2 "MidLow" 3 "Low" ;
VAL_ 1236 DET_CONFD_ELEVATION_339 0 "High" 1 "MidHigh" 2 "MidLow" 3 "Low" ;
VAL_ 1237 DET_CONFD_AZIMUTH_341 0 "High" 1 "MidHigh" 2 "MidLow" 3 "Low" ;
VAL_ 1237 DET_CONFD_ELEVATION_341 0 "High" 1 "MidHigh" 2 "MidLow" 3 "Low" ;
VAL_ 1237 DET_CONFD_AZIMUTH_342 0 "High" 1 "MidHigh" 2 "MidLow" 3 "Low" ;
VAL_ 1237 DET_CONFD_ELEVATION_342 0 "High" 1 "MidHigh" 2 "MidLow" 3 "Low" ;
VAL_ 1237 DET_CONFD_AZIMUTH_343 0 "High" 1 "MidHigh" 2 "MidLow" 3 "Low" ;
VAL_ 1237 DET_CONFD_ELEVATION_343 0 "High" 1 "MidHigh" 2 "MidLow" 3 "Low" ;
VAL_ 1238 DET_CONFD_AZIMUTH_345 0 "High" 1 "MidHigh" 2 "MidLow" 3 "Low" ;
VAL_ 1238 DET_CONFD_ELEVATION_345 0 "High" 1 "MidHigh" 2 "MidLow" 3 "Low" ;
VAL_ 1238 DET_CONFD_AZIMUTH_346 0 "High" 1 "MidHigh" 2 "MidLow" 3 "Low" ;
VAL_ 1238 DET_CONFD_ELEVATION_346 0 "High" 1 "MidHigh" 2 "MidLow" 3 "Low" ;
VAL_ 1238 DET_CONFD_AZIMUTH_347 0 "High" 1 "MidHigh" 2 "MidLow" 3 "Low" ;
VAL_ 1238 DET_CONFD_ELEVATION_347 0 "High" 1 "MidHigh" 2 "MidLow" 3 "Low" ;
VAL_ 1239 DET_CONFD_AZIMUTH_349 0 "High" 1 "MidHigh" 2 "MidLow" 3 "Low" ;
VAL_ 1239 DET_CONFD_ELEVATION_349 0 "High" 1 "MidHigh" 2 "MidLow" 3 "Low" ;
VAL_ 1239 DET_CONFD_AZIMUTH_350 0 "High" 1 "MidHigh" 2 "MidLow" 3 "Low" ;
VAL_ 1239 DET_CONFD_ELEVATION_350 0 "High" 1 "MidHigh" 2 "MidLow" 3 "Low" ;
VAL_ 1239 DET_CONFD_AZIMUTH_351 0 "High" 1 "MidHigh" 2 "MidLow" 3 "Low" ;
VAL_ 1239 DET_CONFD_ELEVATION_351 0 "High" 1 "MidHigh" 2 "MidLow" 3 "Low" ;
VAL_ 1240 DET_CONFD_AZIMUTH_353 0 "High" 1 "MidHigh" 2 "MidLow" 3 "Low" ;
VAL_ 1240 DET_CONFD_ELEVATION_353 0 "High" 1 "MidHigh" 2 "MidLow" 3 "Low" ;
VAL_ 1240 DET_CONFD_AZIMUTH_354 0 "High" 1 "MidHigh" 2 "MidLow" 3 "Low" ;
VAL_ 1240 DET_CONFD_ELEVATION_354 0 "High" 1 "MidHigh" 2 "MidLow" 3 "Low" ;
VAL_ 1240 DET_CONFD_AZIMUTH_355 0 "High" 1 "MidHigh" 2 "MidLow" 3 "Low" ;
VAL_ 1240 DET_CONFD_ELEVATION_355 0 "High" 1 "MidHigh" 2 "MidLow" 3 "Low" ;
VAL_ 1241 DET_CONFD_AZIMUTH_357 0 "High" 1 "MidHigh" 2 "MidLow" 3 "Low" ;
VAL_ 1241 DET_CONFD_ELEVATION_357 0 "High" 1 "MidHigh" 2 "MidLow" 3 "Low" ;
VAL_ 1241 DET_CONFD_AZIMUTH_358 0 "High" 1 "MidHigh" 2 "MidLow" 3 "Low" ;
VAL_ 1241 DET_CONFD_ELEVATION_358 0 "High" 1 "MidHigh" 2 "MidLow" 3 "Low" ;
VAL_ 1241 DET_CONFD_AZIMUTH_359 0 "High" 1 "MidHigh" 2 "MidLow" 3 "Low" ;
VAL_ 1241 DET_CONFD_ELEVATION_359 0 "High" 1 "MidHigh" 2 "MidLow" 3 "Low" ;
VAL_ 1242 DET_CONFD_AZIMUTH_361 0 "High" 1 "MidHigh" 2 "MidLow" 3 "Low" ;
VAL_ 1242 DET_CONFD_ELEVATION_361 0 "High" 1 "MidHigh" 2 "MidLow" 3 "Low" ;
VAL_ 1242 DET_CONFD_AZIMUTH_362 0 "High" 1 "MidHigh" 2 "MidLow" 3 "Low" ;
VAL_ 1242 DET_CONFD_ELEVATION_362 0 "High" 1 "MidHigh" 2 "MidLow" 3 "Low" ;
VAL_ 1242 DET_CONFD_AZIMUTH_363 0 "High" 1 "MidHigh" 2 "MidLow" 3 "Low" ;
VAL_ 1242 DET_CONFD_ELEVATION_363 0 "High" 1 "MidHigh" 2 "MidLow" 3 "Low" ;
VAL_ 1243 DET_CONFD_AZIMUTH_365 0 "High" 1 "MidHigh" 2 "MidLow" 3 "Low" ;
VAL_ 1243 DET_CONFD_ELEVATION_365 0 "High" 1 "MidHigh" 2 "MidLow" 3 "Low" ;
VAL_ 1243 DET_CONFD_AZIMUTH_366 0 "High" 1 "MidHigh" 2 "MidLow" 3 "Low" ;
VAL_ 1243 DET_CONFD_ELEVATION_366 0 "High" 1 "MidHigh" 2 "MidLow" 3 "Low" ;
VAL_ 1243 DET_CONFD_AZIMUTH_367 0 "High" 1 "MidHigh" 2 "MidLow" 3 "Low" ;
VAL_ 1243 DET_CONFD_ELEVATION_367 0 "High" 1 "MidHigh" 2 "MidLow" 3 "Low" ;
VAL_ 1244 DET_CONFD_AZIMUTH_369 0 "High" 1 "MidHigh" 2 "MidLow" 3 "Low" ;
VAL_ 1244 DET_CONFD_ELEVATION_369 0 "High" 1 "MidHigh" 2 "MidLow" 3 "Low" ;
VAL_ 1244 DET_CONFD_AZIMUTH_370 0 "High" 1 "MidHigh" 2 "MidLow" 3 "Low" ;
VAL_ 1244 DET_CONFD_ELEVATION_370 0 "High" 1 "MidHigh" 2 "MidLow" 3 "Low" ;
VAL_ 1244 DET_CONFD_AZIMUTH_371 0 "High" 1 "MidHigh" 2 "MidLow" 3 "Low" ;
VAL_ 1244 DET_CONFD_ELEVATION_371 0 "High" 1 "MidHigh" 2 "MidLow" 3 "Low" ;
VAL_ 1245 DET_CONFD_AZIMUTH_373 0 "High" 1 "MidHigh" 2 "MidLow" 3 "Low" ;
VAL_ 1245 DET_CONFD_ELEVATION_373 0 "High" 1 "MidHigh" 2 "MidLow" 3 "Low" ;
VAL_ 1245 DET_CONFD_AZIMUTH_374 0 "High" 1 "MidHigh" 2 "MidLow" 3 "Low" ;
VAL_ 1245 DET_CONFD_ELEVATION_374 0 "High" 1 "MidHigh" 2 "MidLow" 3 "Low" ;
VAL_ 1245 DET_CONFD_AZIMUTH_375 0 "High" 1 "MidHigh" 2 "MidLow" 3 "Low" ;
VAL_ 1245 DET_CONFD_ELEVATION_375 0 "High" 1 "MidHigh" 2 "MidLow" 3 "Low" ;
VAL_ 1246 DET_CONFD_AZIMUTH_377 0 "High" 1 "MidHigh" 2 "MidLow" 3 "Low" ;
VAL_ 1246 DET_CONFD_ELEVATION_377 0 "High" 1 "MidHigh" 2 "MidLow" 3 "Low" ;
VAL_ 1246 DET_CONFD_AZIMUTH_378 0 "High" 1 "MidHigh" 2 "MidLow" 3 "Low" ;
VAL_ 1246 DET_CONFD_ELEVATION_378 0 "High" 1 "MidHigh" 2 "MidLow" 3 "Low" ;
VAL_ 1246 DET_CONFD_AZIMUTH_379 0 "High" 1 "MidHigh" 2 "MidLow" 3 "Low" ;
VAL_ 1246 DET_CONFD_ELEVATION_379 0 "High" 1 "MidHigh" 2 "MidLow" 3 "Low" ;
VAL_ 1247 DET_CONFD_AZIMUTH_381 0 "High" 1 "MidHigh" 2 "MidLow" 3 "Low" ;
VAL_ 1247 DET_CONFD_ELEVATION_381 0 "High" 1 "MidHigh" 2 "MidLow" 3 "Low" ;
VAL_ 1247 DET_CONFD_AZIMUTH_382 0 "High" 1 "MidHigh" 2 "MidLow" 3 "Low" ;
VAL_ 1247 DET_CONFD_ELEVATION_382 0 "High" 1 "MidHigh" 2 "MidLow" 3 "Low" ;
VAL_ 1247 DET_CONFD_AZIMUTH_383 0 "High" 1 "MidHigh" 2 "MidLow" 3 "Low" ;
VAL_ 1247 DET_CONFD_ELEVATION_383 0 "High" 1 "MidHigh" 2 "MidLow" 3 "Low" ;
VAL_ 1248 DET_CONFD_AZIMUTH_385 0 "High" 1 "MidHigh" 2 "MidLow" 3 "Low" ;
VAL_ 1248 DET_CONFD_ELEVATION_385 0 "High" 1 "MidHigh" 2 "MidLow" 3 "Low" ;
VAL_ 1248 DET_CONFD_AZIMUTH_386 0 "High" 1 "MidHigh" 2 "MidLow" 3 "Low" ;
VAL_ 1248 DET_CONFD_ELEVATION_386 0 "High" 1 "MidHigh" 2 "MidLow" 3 "Low" ;
VAL_ 1248 DET_CONFD_AZIMUTH_387 0 "High" 1 "MidHigh" 2 "MidLow" 3 "Low" ;
VAL_ 1248 DET_CONFD_ELEVATION_387 0 "High" 1 "MidHigh" 2 "MidLow" 3 "Low" ;
VAL_ 1249 DET_CONFD_AZIMUTH_389 0 "High" 1 "MidHigh" 2 "MidLow" 3 "Low" ;
VAL_ 1249 DET_CONFD_ELEVATION_389 0 "High" 1 "MidHigh" 2 "MidLow" 3 "Low" ;
VAL_ 1249 DET_CONFD_AZIMUTH_390 0 "High" 1 "MidHigh" 2 "MidLow" 3 "Low" ;
VAL_ 1249 DET_CONFD_ELEVATION_390 0 "High" 1 "MidHigh" 2 "MidLow" 3 "Low" ;
VAL_ 1249 DET_CONFD_AZIMUTH_391 0 "High" 1 "MidHigh" 2 "MidLow" 3 "Low" ;
VAL_ 1249 DET_CONFD_ELEVATION_391 0 "High" 1 "MidHigh" 2 "MidLow" 3 "Low" ;
VAL_ 1250 DET_CONFD_AZIMUTH_393 0 "High" 1 "MidHigh" 2 "MidLow" 3 "Low" ;
VAL_ 1250 DET_CONFD_ELEVATION_393 0 "High" 1 "MidHigh" 2 "MidLow" 3 "Low" ;
VAL_ 1250 DET_CONFD_AZIMUTH_394 0 "High" 1 "MidHigh" 2 "MidLow" 3 "Low" ;
VAL_ 1250 DET_CONFD_ELEVATION_394 0 "High" 1 "MidHigh" 2 "MidLow" 3 "Low" ;
VAL_ 1250 DET_CONFD_AZIMUTH_395 0 "High" 1 "MidHigh" 2 "MidLow" 3 "Low" ;
VAL_ 1250 DET_CONFD_ELEVATION_395 0 "High" 1 "MidHigh" 2 "MidLow" 3 "Low" ;
VAL_ 1251 DET_CONFD_AZIMUTH_397 0 "High" 1 "MidHigh" 2 "MidLow" 3 "Low" ;
VAL_ 1251 DET_CONFD_ELEVATION_397 0 "High" 1 "MidHigh" 2 "MidLow" 3 "Low" ;
VAL_ 1251 DET_CONFD_AZIMUTH_398 0 "High" 1 "MidHigh" 2 "MidLow" 3 "Low" ;
VAL_ 1251 DET_CONFD_ELEVATION_398 0 "High" 1 "MidHigh" 2 "MidLow" 3 "Low" ;
VAL_ 1251 DET_CONFD_AZIMUTH_399 0 "High" 1 "MidHigh" 2 "MidLow" 3 "Low" ;
VAL_ 1251 DET_CONFD_ELEVATION_399 0 "High" 1 "MidHigh" 2 "MidLow" 3 "Low" ;
SIG_GROUP_ 1235 Detections_333_336 1 : DET_MH_CRC16_333_336 DET_MH_CYCLE_COUNTER_333_336 DET_MH_SCAN_INDEX_4LSB_333_336 DET_CONFD_ELEVATION_333 DET_CONFD_AZIMUTH_333 DET_HVC_FLAG_333 DET_OUTSIDE_SECTOR_333 DET_EXISTENCE_PROB_333 DET_POINT_TARGET_PROB_333 DET_SNR_333 DET_SUPER_RES_TARGET_333 DET_BI_STATIC_FLAG_333 DET_VALID_FLAG_333 DET_RCS_333 DET_ELEVATION_ERR_333 DET_ELEVATION_333 DET_AZIMUTH_ERR_333 DET_AZIMUTH_333 DET_RANGE_VELOCITY_ERR_333 DET_RANGE_VELOCITY_333 DET_RANGE_ERR_333 DET_RANGE_333 DET_CONFD_ELEVATION_334 DET_CONFD_AZIMUTH_334 DET_HVC_FLAG_334 DET_OUTSIDE_SECTOR_334 DET_EXISTENCE_PROB_334 DET_POINT_TARGET_PROB_334 DET_SNR_334 DET_SUPER_RES_TARGET_334 DET_BI_STATIC_FLAG_334 DET_VALID_FLAG_334 DET_RCS_334 DET_ELEVATION_ERR_334 DET_ELEVATION_334 DET_AZIMUTH_ERR_334 DET_AZIMUTH_334 DET_RANGE_VELOCITY_ERR_334 DET_RANGE_VELOCITY_334 DET_RANGE_ERR_334 DET_RANGE_334 DET_CONFD_ELEVATION_335 DET_CONFD_AZIMUTH_335 DET_HVC_FLAG_335 DET_OUTSIDE_SECTOR_335 DET_EXISTENCE_PROB_335 DET_POINT_TARGET_PROB_335 DET_SNR_335 DET_SUPER_RES_TARGET_335 DET_BI_STATIC_FLAG_335 DET_VALID_FLAG_335 DET_RCS_335 DET_ELEVATION_ERR_335 DET_ELEVATION_335 DET_AZIMUTH_ERR_335 DET_AZIMUTH_335 DET_RANGE_VELOCITY_ERR_335 DET_RANGE_VELOCITY_335 DET_RANGE_ERR_335 DET_RANGE_335 DET_CONFD_ELEVATION_336 DET_CONFD_AZIMUTH_336 DET_HVC_FLAG_336 DET_OUTSIDE_SECTOR_336 DET_EXISTENCE_PROB_336 DET_POINT_TARGET_PROB_336 DET_SNR_336 DET_SUPER_RES_TARGET_336 DET_BI_STATIC_FLAG_336 DET_VALID_FLAG_336 DET_RCS_336 DET_ELEVATION_ERR_336 DET_ELEVATION_336 DET_AZIMUTH_ERR_336 DET_AZIMUTH_336 DET_RANGE_VELOCITY_ERR_336 DET_RANGE_VELOCITY_336 DET_RANGE_ERR_336 DET_RANGE_336;
SIG_GROUP_ 1236 Detections_337_340 1 : DET_MH_CRC16_337_340 DET_MH_CYCLE_COUNTER_337_340 DET_MH_SCAN_INDEX_4LSB_337_340 DET_CONFD_ELEVATION_337 DET_CONFD_AZIMUTH_337 DET_HVC_FLAG_337 DET_OUTSIDE_SECTOR_337 DET_EXISTENCE_PROB_337 DET_POINT_TARGET_PROB_337 DET_SNR_337 DET_SUPER_RES_TARGET_337 DET_BI_STATIC_FLAG_337 DET_VALID_FLAG_337 DET_RCS_337 DET_ELEVATION_ERR_337 DET_ELEVATION_337 DET_AZIMUTH_ERR_337 DET_AZIMUTH_337 DET_RANGE_VELOCITY_ERR_337 DET_RANGE_VELOCITY_337 DET_RANGE_ERR_337 DET_RANGE_337 DET_CONFD_ELEVATION_338 DET_CONFD_AZIMUTH_338 DET_HVC_FLAG_338 DET_OUTSIDE_SECTOR_338 DET_EXISTENCE_PROB_338 DET_POINT_TARGET_PROB_338 DET_SNR_338 DET_SUPER_RES_TARGET_338 DET_BI_STATIC_FLAG_338 DET_VALID_FLAG_338 DET_RCS_338 DET_ELEVATION_ERR_338 DET_ELEVATION_338 DET_AZIMUTH_ERR_338 DET_AZIMUTH_338 DET_RANGE_VELOCITY_ERR_338 DET_RANGE_VELOCITY_338 DET_RANGE_ERR_338 DET_RANGE_338 DET_CONFD_ELEVATION_339 DET_CONFD_AZIMUTH_339 DET_HVC_FLAG_339 DET_OUTSIDE_SECTOR_339 DET_EXISTENCE_PROB_339 DET_POINT_TARGET_PROB_339 DET_SNR_339 DET_SUPER_RES_TARGET_339 DET_BI_STATIC_FLAG_339 DET_VALID_FLAG_339 DET_RCS_339 DET_ELEVATION_ERR_339 DET_ELEVATION_339 DET_AZIMUTH_ERR_339 DET_AZIMUTH_339 DET_RANGE_VELOCITY_ERR_339 DET_RANGE_VELOCITY_339 DET_RANGE_ERR_339 DET_RANGE_339 DET_CONFD_ELEVATION_340 DET_CONFD_AZIMUTH_340 DET_HVC_FLAG_340 DET_OUTSIDE_SECTOR_340 DET_EXISTENCE_PROB_340 DET_POINT_TARGET_PROB_340 DET_SNR_340 DET_SUPER_RES_TARGET_340 DET_BI_STATIC_FLAG_340 DET_VALID_FLAG_340 DET_RCS_340 DET_ELEVATION_ERR_340 DET_ELEVATION_340 DET_AZIMUTH_ERR_340 DET_AZIMUTH_340 DET_RANGE_VELOCITY_ERR_340 DET_RANGE_VELOCITY_340 DET_RANGE_ERR_340 DET_RANGE_340;
SIG_GROUP_ 1237 Detections_341_344 1 : DET_MH_CRC16_341_344 DET_MH_CYCLE_COUNTER_341_344 DET_MH_SCAN_INDEX_4LSB_341_344 DET_CONFD_ELEVATION_341 DET_CONFD_AZIMUTH_341 DET_HVC_FLAG_341 DET_OUTSIDE_SECTOR_341 DET_EXISTENCE_PROB_341 DET_POINT_TARGET_PROB_341 DET_SNR_341 DET_SUPER_RES_TARGET_341 DET_BI_STATIC_FLAG_341 DET_VALID_FLAG_341 DET_RCS_341 DET_ELEVATION_ERR_341 DET_ELEVATION_341 DET_AZIMUTH_ERR_341 DET_AZIMUTH_341 DET_RANGE_VELOCITY_ERR_341 DET_RANGE_VELOCITY_341 DET_RANGE_ERR_341 DET_RANGE_341 DET_CONFD_ELEVATION_342 DET_CONFD_AZIMUTH_342 DET_HVC_FLAG_342 DET_OUTSIDE_SECTOR_342 DET_EXISTENCE_PROB_342 DET_POINT_TARGET_PROB_342 DET_SNR_342 DET_SUPER_RES_TARGET_342 DET_BI_STATIC_FLAG_342 DET_VALID_FLAG_342 DET_RCS_342 DET_ELEVATION_ERR_342 DET_ELEVATION_342 DET_AZIMUTH_ERR_342 DET_AZIMUTH_342 DET_RANGE_VELOCITY_ERR_342 DET_RANGE_VELOCITY_342 DET_RANGE_ERR_342 DET_RANGE_342 DET_CONFD_ELEVATION_343 DET_CONFD_AZIMUTH_343 DET_HVC_FLAG_343 DET_OUTSIDE_SECTOR_343 DET_EXISTENCE_PROB_343 DET_POINT_TARGET_PROB_343 DET_SNR_343 DET_SUPER_RES_TARGET_343 DET_BI_STATIC_FLAG_343 DET_VALID_FLAG_343 DET_RCS_343 DET_ELEVATION_ERR_343 DET_ELEVATION_343 DET_AZIMUTH_ERR_343 DET_AZIMUTH_343 DET_RANGE_VELOCITY_ERR_343 DET_RANGE_VELOCITY_343 DET_RANGE_ERR_343 DET_RANGE_343 DET_CONFD_ELEVATION_344 DET_CONFD_AZIMUTH_344 DET_HVC_FLAG_344 DET_OUTSIDE_SECTOR_344 DET_EXISTENCE_PROB_344 DET_POINT_TARGET_PROB_344 DET_SNR_344 DET_SUPER_RES_TARGET_344 DET_BI_STATIC_FLAG_344 DET_VALID_FLAG_344 DET_RCS_344 DET_ELEVATION_ERR_344 DET_ELEVATION_344 DET_AZIMUTH_ERR_344 DET_AZIMUTH_344 DET_RANGE_VELOCITY_ERR_344 DET_RANGE_VELOCITY_344 DET_RANGE_ERR_344 DET_RANGE_344;
SIG_GROUP_ 1238 Detections_345_348 1 : DET_MH_CRC16_345_348 DET_MH_CYCLE_COUNTER_345_348 DET_MH_SCAN_INDEX_4LSB_345_348 DET_CONFD_ELEVATION_345 DET_CONFD_AZIMUTH_345 DET_HVC_FLAG_345 DET_OUTSIDE_SECTOR_345 DET_EXISTENCE_PROB_345 DET_POINT_TARGET_PROB_345 DET_SNR_345 DET_SUPER_RES_TARGET_345 DET_BI_STATIC_FLAG_345 DET_VALID_FLAG_345 DET_RCS_345 DET_ELEVATION_ERR_345 DET_ELEVATION_345 DET_AZIMUTH_ERR_345 DET_AZIMUTH_345 DET_RANGE_VELOCITY_ERR_345 DET_RANGE_VELOCITY_345 DET_RANGE_ERR_345 DET_RANGE_345 DET_CONFD_ELEVATION_346 DET_CONFD_AZIMUTH_346 DET_HVC_FLAG_346 DET_OUTSIDE_SECTOR_346 DET_EXISTENCE_PROB_346 DET_POINT_TARGET_PROB_346 DET_SNR_346 DET_SUPER_RES_TARGET_346 DET_BI_STATIC_FLAG_346 DET_VALID_FLAG_346 DET_RCS_346 DET_ELEVATION_ERR_346 DET_ELEVATION_346 DET_AZIMUTH_ERR_346 DET_AZIMUTH_346 DET_RANGE_VELOCITY_ERR_346 DET_RANGE_VELOCITY_346 DET_RANGE_ERR_346 DET_RANGE_346 DET_CONFD_ELEVATION_347 DET_CONFD_AZIMUTH_347 DET_HVC_FLAG_347 DET_OUTSIDE_SECTOR_347 DET_EXISTENCE_PROB_347 DET_POINT_TARGET_PROB_347 DET_SNR_347 DET_SUPER_RES_TARGET_347 DET_BI_STATIC_FLAG_347 DET_VALID_FLAG_347 DET_RCS_347 DET_ELEVATION_ERR_347 DET_ELEVATION_347 DET_AZIMUTH_ERR_347 DET_AZIMUTH_347 DET_RANGE_VELOCITY_ERR_347 DET_RANGE_VELOCITY_347 DET_RANGE_ERR_347 DET_RANGE_347 DET_CONFD_ELEVATION_348 DET_CONFD_AZIMUTH_348 DET_HVC_FLAG_348 DET_OUTSIDE_SECTOR_348 DET_EXISTENCE_PROB_348 DET_POINT_TARGET_PROB_348 DET_SNR_348 DET_SUPER_RES_TARGET_348 DET_BI_STATIC_FLAG_348 DET_VALID_FLAG_348 DET_RCS_348 DET_ELEVATION_ERR_348 DET_ELEVATION_348 DET_AZIMUTH_ERR_348 DET_AZIMUTH_348 DET_RANGE_VELOCITY_ERR_348 DET_RANGE_VELOCITY_348 DET_RANGE_ERR_348 DET_RANGE_348;
SIG_GROUP_ 1239 Detections_349_352 1 : DET_MH_CRC16_349_352 DET_MH_CYCLE_COUNTER_349_352 DET_MH_SCAN_INDEX_4LSB_349_352 DET_CONFD_ELEVATION_349 DET_CONFD_AZIMUTH_349 DET_HVC_FLAG_349 DET_OUTSIDE_SECTOR_349 DET_EXISTENCE_PROB_349 DET_POINT_TARGET_PROB_349 DET_SNR_349 DET_SUPER_RES_TARGET_349 DET_BI_STATIC_FLAG_349 DET_VALID_FLAG_349 DET_RCS_349 DET_ELEVATION_ERR_349 DET_ELEVATION_349 DET_AZIMUTH_ERR_349 DET_AZIMUTH_349 DET_RANGE_VELOCITY_ERR_349 DET_RANGE_VELOCITY_349 DET_RANGE_ERR_349 DET_RANGE_349 DET_CONFD_ELEVATION_350 DET_CONFD_AZIMUTH_350 DET_HVC_FLAG_350 DET_OUTSIDE_SECTOR_350 DET_EXISTENCE_PROB_350 DET_POINT_TARGET_PROB_350 DET_SNR_350 DET_SUPER_RES_TARGET_350 DET_BI_STATIC_FLAG_350 DET_VALID_FLAG_350 DET_RCS_350 DET_ELEVATION_ERR_350 DET_ELEVATION_350 DET_AZIMUTH_ERR_350 DET_AZIMUTH_350 DET_RANGE_VELOCITY_ERR_350 DET_RANGE_VELOCITY_350 DET_RANGE_ERR_350 DET_RANGE_350 DET_CONFD_ELEVATION_351 DET_CONFD_AZIMUTH_351 DET_HVC_FLAG_351 DET_OUTSIDE_SECTOR_351 DET_EXISTENCE_PROB_351 DET_POINT_TARGET_PROB_351 DET_SNR_351 DET_SUPER_RES_TARGET_351 DET_BI_STATIC_FLAG_351 DET_VALID_FLAG_351 DET_RCS_351 DET_ELEVATION_ERR_351 DET_ELEVATION_351 DET_AZIMUTH_ERR_351 DET_AZIMUTH_351 DET_RANGE_VELOCITY_ERR_351 DET_RANGE_VELOCITY_351 DET_RANGE_ERR_351 DET_RANGE_351 DET_CONFD_ELEVATION_352 DET_CONFD_AZIMUTH_352 DET_HVC_FLAG_352 DET_OUTSIDE_SECTOR_352 DET_EXISTENCE_PROB_352 DET_POINT_TARGET_PROB_352 DET_SNR_352 DET_SUPER_RES_TARGET_352 DET_BI_STATIC_FLAG_352 DET_VALID_FLAG_352 DET_RCS_352 DET_ELEVATION_ERR_352 DET_ELEVATION_352 DET_AZIMUTH_ERR_352 DET_AZIMUTH_352 DET_RANGE_VELOCITY_ERR_352 DET_RANGE_VELOCITY_352 DET_RANGE_ERR_352 DET_RANGE_352;
SIG_GROUP_ 1240 Detections_353_356 1 : DET_MH_CRC16_353_356 DET_MH_CYCLE_COUNTER_353_356 DET_MH_SCAN_INDEX_4LSB_353_356 DET_CONFD_ELEVATION_353 DET_CONFD_AZIMUTH_353 DET_HVC_FLAG_353 DET_OUTSIDE_SECTOR_353 DET_EXISTENCE_PROB_353 DET_POINT_TARGET_PROB_353 DET_SNR_353 DET_SUPER_RES_TARGET_353 DET_BI_STATIC_FLAG_353 DET_VALID_FLAG_353 DET_RCS_353 DET_ELEVATION_ERR_353 DET_ELEVATION_353 DET_AZIMUTH_ERR_353 DET_AZIMUTH_353 DET_RANGE_VELOCITY_ERR_353 DET_RANGE_VELOCITY_353 DET_RANGE_ERR_353 DET_RANGE_353 DET_CONFD_ELEVATION_354 DET_CONFD_AZIMUTH_354 DET_HVC_FLAG_354 DET_OUTSIDE_SECTOR_354 DET_EXISTENCE_PROB_354 DET_POINT_TARGET_PROB_354 DET_SNR_354 DET_SUPER_RES_TARGET_354 DET_BI_STATIC_FLAG_354 DET_VALID_FLAG_354 DET_RCS_354 DET_ELEVATION_ERR_354 DET_ELEVATION_354 DET_AZIMUTH_ERR_354 DET_AZIMUTH_354 DET_RANGE_VELOCITY_ERR_354 DET_RANGE_VELOCITY_354 DET_RANGE_ERR_354 DET_RANGE_354 DET_CONFD_ELEVATION_355 DET_CONFD_AZIMUTH_355 DET_HVC_FLAG_355 DET_OUTSIDE_SECTOR_355 DET_EXISTENCE_PROB_355 DET_POINT_TARGET_PROB_355 DET_SNR_355 DET_SUPER_RES_TARGET_355 DET_BI_STATIC_FLAG_355 DET_VALID_FLAG_355 DET_RCS_355 DET_ELEVATION_ERR_355 DET_ELEVATION_355 DET_AZIMUTH_ERR_355 DET_AZIMUTH_355 DET_RANGE_VELOCITY_ERR_355 DET_RANGE_VELOCITY_355 DET_RANGE_ERR_355 DET_RANGE_355 DET_CONFD_ELEVATION_356 DET_CONFD_AZIMUTH_356 DET_HVC_FLAG_356 DET_OUTSIDE_SECTOR_356 DET_EXISTENCE_PROB_356 DET_POINT_TARGET_PROB_356 DET_SNR_356 DET_SUPER_RES_TARGET_356 DET_BI_STATIC_FLAG_356 DET_VALID_FLAG_356 DET_RCS_356 DET_ELEVATION_ERR_356 DET_ELEVATION_356 DET_AZIMUTH_ERR_356 DET_AZIMUTH_356 DET_RANGE_VELOCITY_ERR_356 DET_RANGE_VELOCITY_356 DET_RANGE_ERR_356 DET_RANGE_356;
SIG_GROUP_ 1241 Detections_357_360 1 : DET_MH_CRC16_357_360 DET_MH_CYCLE_COUNTER_357_360 DET_MH_SCAN_INDEX_4LSB_357_360 DET_CONFD_ELEVATION_357 DET_CONFD_AZIMUTH_357 DET_HVC_FLAG_357 DET_OUTSIDE_SECTOR_357 DET_EXISTENCE_PROB_357 DET_POINT_TARGET_PROB_357 DET_SNR_357 DET_SUPER_RES_TARGET_357 DET_BI_STATIC_FLAG_357 DET_VALID_FLAG_357 DET_RCS_357 DET_ELEVATION_ERR_357 DET_ELEVATION_357 DET_AZIMUTH_ERR_357 DET_AZIMUTH_357 DET_RANGE_VELOCITY_ERR_357 DET_RANGE_VELOCITY_357 DET_RANGE_ERR_357 DET_RANGE_357 DET_CONFD_ELEVATION_358 DET_CONFD_AZIMUTH_358 DET_HVC_FLAG_358 DET_OUTSIDE_SECTOR_358 DET_EXISTENCE_PROB_358 DET_POINT_TARGET_PROB_358 DET_SNR_358 DET_SUPER_RES_TARGET_358 DET_BI_STATIC_FLAG_358 DET_VALID_FLAG_358 DET_RCS_358 DET_ELEVATION_ERR_358 DET_ELEVATION_358 DET_AZIMUTH_ERR_358 DET_AZIMUTH_358 DET_RANGE_VELOCITY_ERR_358 DET_RANGE_VELOCITY_358 DET_RANGE_ERR_358 DET_RANGE_358 DET_CONFD_ELEVATION_359 DET_CONFD_AZIMUTH_359 DET_HVC_FLAG_359 DET_OUTSIDE_SECTOR_359 DET_EXISTENCE_PROB_359 DET_POINT_TARGET_PROB_359 DET_SNR_359 DET_SUPER_RES_TARGET_359 DET_BI_STATIC_FLAG_359 DET_VALID_FLAG_359 DET_RCS_359 DET_ELEVATION_ERR_359 DET_ELEVATION_359 DET_AZIMUTH_ERR_359 DET_AZIMUTH_359 DET_RANGE_VELOCITY_ERR_359 DET_RANGE_VELOCITY_359 DET_RANGE_ERR_359 DET_RANGE_359 DET_CONFD_ELEVATION_360 DET_CONFD_AZIMUTH_360 DET_HVC_FLAG_360 DET_OUTSIDE_SECTOR_360 DET_EXISTENCE_PROB_360 DET_POINT_TARGET_PROB_360 DET_SNR_360 DET_SUPER_RES_TARGET_360 DET_BI_STATIC_FLAG_360 DET_VALID_FLAG_360 DET_RCS_360 DET_ELEVATION_ERR_360 DET_ELEVATION_360 DET_AZIMUTH_ERR_360 DET_AZIMUTH_360 DET_RANGE_VELOCITY_ERR_360 DET_RANGE_VELOCITY_360 DET_RANGE_ERR_360 DET_RANGE_360;
SIG_GROUP_ 1242 Detections_361_364 1 : DET_MH_CRC16_361_364 DET_MH_CYCLE_COUNTER_361_364 DET_MH_SCAN_INDEX_4LSB_361_364 DET_CONFD_ELEVATION_361 DET_CONFD_AZIMUTH_361 DET_HVC_FLAG_361 DET_OUTSIDE_SECTOR_361 DET_EXISTENCE_PROB_361 DET_POINT_TARGET_PROB_361 DET_SNR_361 DET_SUPER_RES_TARGET_361 DET_BI_STATIC_FLAG_361 DET_VALID_FLAG_361 DET_RCS_361 DET_ELEVATION_ERR_361 DET_ELEVATION_361 DET_AZIMUTH_ERR_361 DET_AZIMUTH_361 DET_RANGE_VELOCITY_ERR_361 DET_RANGE_VELOCITY_361 DET_RANGE_ERR_361 DET_RANGE_361 DET_CONFD_ELEVATION_362 DET_CONFD_AZIMUTH_362 DET_HVC_FLAG_362 DET_OUTSIDE_SECTOR_362 DET_EXISTENCE_PROB_362 DET_POINT_TARGET_PROB_362 DET_SNR_362 DET_SUPER_RES_TARGET_362 DET_BI_STATIC_FLAG_362 DET_VALID_FLAG_362 DET_RCS_362 DET_ELEVATION_ERR_362 DET_ELEVATION_362 DET_AZIMUTH_ERR_362 DET_AZIMUTH_362 DET_RANGE_VELOCITY_ERR_362 DET_RANGE_VELOCITY_362 DET_RANGE_ERR_362 DET_RANGE_362 DET_CONFD_ELEVATION_363 DET_CONFD_AZIMUTH_363 DET_HVC_FLAG_363 DET_OUTSIDE_SECTOR_363 DET_EXISTENCE_PROB_363 DET_POINT_TARGET_PROB_363 DET_SNR_363 DET_SUPER_RES_TARGET_363 DET_BI_STATIC_FLAG_363 DET_VALID_FLAG_363 DET_RCS_363 DET_ELEVATION_ERR_363 DET_ELEVATION_363 DET_AZIMUTH_ERR_363 DET_AZIMUTH_363 DET_RANGE_VELOCITY_ERR_363 DET_RANGE_VELOCITY_363 DET_RANGE_ERR_363 DET_RANGE_363 DET_CONFD_ELEVATION_364 DET_CONFD_AZIMUTH_364 DET_HVC_FLAG_364 DET_OUTSIDE_SECTOR_364 DET_EXISTENCE_PROB_364 DET_POINT_TARGET_PROB_364 DET_SNR_364 DET_SUPER_RES_TARGET_364 DET_BI_STATIC_FLAG_364 DET_VALID_FLAG_364 DET_RCS_364 DET_ELEVATION_ERR_364 DET_ELEVATION_364 DET_AZIMUTH_ERR_364 DET_AZIMUTH_364 DET_RANGE_VELOCITY_ERR_364 DET_RANGE_VELOCITY_364 DET_RANGE_ERR_364 DET_RANGE_364;
SIG_GROUP_ 1243 Detections_365_368 1 : DET_MH_CRC16_365_368 DET_MH_CYCLE_COUNTER_365_368 DET_MH_SCAN_INDEX_4LSB_365_368 DET_CONFD_ELEVATION_365 DET_CONFD_AZIMUTH_365 DET_HVC_FLAG_365 DET_OUTSIDE_SECTOR_365 DET_EXISTENCE_PROB_365 DET_POINT_TARGET_PROB_365 DET_SNR_365 DET_SUPER_RES_TARGET_365 DET_BI_STATIC_FLAG_365 DET_VALID_FLAG_365 DET_RCS_365 DET_ELEVATION_ERR_365 DET_ELEVATION_365 DET_AZIMUTH_ERR_365 DET_AZIMUTH_365 DET_RANGE_VELOCITY_ERR_365 DET_RANGE_VELOCITY_365 DET_RANGE_ERR_365 DET_RANGE_365 DET_CONFD_ELEVATION_366 DET_CONFD_AZIMUTH_366 DET_HVC_FLAG_366 DET_OUTSIDE_SECTOR_366 DET_EXISTENCE_PROB_366 DET_POINT_TARGET_PROB_366 DET_SNR_366 DET_SUPER_RES_TARGET_366 DET_BI_STATIC_FLAG_366 DET_VALID_FLAG_366 DET_RCS_366 DET_ELEVATION_ERR_366 DET_ELEVATION_366 DET_AZIMUTH_ERR_366 DET_AZIMUTH_366 DET_RANGE_VELOCITY_ERR_366 DET_RANGE_VELOCITY_366 DET_RANGE_ERR_366 DET_RANGE_366 DET_CONFD_ELEVATION_367 DET_CONFD_AZIMUTH_367 DET_HVC_FLAG_367 DET_OUTSIDE_SECTOR_367 DET_EXISTENCE_PROB_367 DET_POINT_TARGET_PROB_367 DET_SNR_367 DET_SUPER_RES_TARGET_367 DET_BI_STATIC_FLAG_367 DET_VALID_FLAG_367 DET_RCS_367 DET_ELEVATION_ERR_367 DET_ELEVATION_367 DET_AZIMUTH_ERR_367 DET_AZIMUTH_367 DET_RANGE_VELOCITY_ERR_367 DET_RANGE_VELOCITY_367 DET_RANGE_ERR_367 DET_RANGE_367 DET_CONFD_ELEVATION_368 DET_CONFD_AZIMUTH_368 DET_HVC_FLAG_368 DET_OUTSIDE_SECTOR_368 DET_EXISTENCE_PROB_368 DET_POINT_TARGET_PROB_368 DET_SNR_368 DET_SUPER_RES_TARGET_368 DET_BI_STATIC_FLAG_368 DET_VALID_FLAG_368 DET_RCS_368 DET_ELEVATION_ERR_368 DET_ELEVATION_368 DET_AZIMUTH_ERR_368 DET_AZIMUTH_368 DET_RANGE_VELOCITY_ERR_368 DET_RANGE_VELOCITY_368 DET_RANGE_ERR_368 DET_RANGE_368;
SIG_GROUP_ 1244 Detections_369_372 1 : DET_MH_CRC16_369_372 DET_MH_CYCLE_COUNTER_369_372 DET_MH_SCAN_INDEX_4LSB_369_372 DET_CONFD_ELEVATION_369 DET_CONFD_AZIMUTH_369 DET_HVC_FLAG_369 DET_OUTSIDE_SECTOR_369 DET_EXISTENCE_PROB_369 DET_POINT_TARGET_PROB_369 DET_SNR_369 DET_SUPER_RES_TARGET_369 DET_BI_STATIC_FLAG_369 DET_VALID_FLAG_369 DET_RCS_369 DET_ELEVATION_ERR_369 DET_ELEVATION_369 DET_AZIMUTH_ERR_369 DET_AZIMUTH_369 DET_RANGE_VELOCITY_ERR_369 DET_RANGE_VELOCITY_369 DET_RANGE_ERR_369 DET_RANGE_369 DET_CONFD_ELEVATION_370 DET_CONFD_AZIMUTH_370 DET_HVC_FLAG_370 DET_OUTSIDE_SECTOR_370 DET_EXISTENCE_PROB_370 DET_POINT_TARGET_PROB_370 DET_SNR_370 DET_SUPER_RES_TARGET_370 DET_BI_STATIC_FLAG_370 DET_VALID_FLAG_370 DET_RCS_370 DET_ELEVATION_ERR_370 DET_ELEVATION_370 DET_AZIMUTH_ERR_370 DET_AZIMUTH_370 DET_RANGE_VELOCITY_ERR_370 DET_RANGE_VELOCITY_370 DET_RANGE_ERR_370 DET_RANGE_370 DET_CONFD_ELEVATION_371 DET_CONFD_AZIMUTH_371 DET_HVC_FLAG_371 DET_OUTSIDE_SECTOR_371 DET_EXISTENCE_PROB_371 DET_POINT_TARGET_PROB_371 DET_SNR_371 DET_SUPER_RES_TARGET_371 DET_BI_STATIC_FLAG_371 DET_VALID_FLAG_371 DET_RCS_371 DET_ELEVATION_ERR_371 DET_ELEVATION_371 DET_AZIMUTH_ERR_371 DET_AZIMUTH_371 DET_RANGE_VELOCITY_ERR_371 DET_RANGE_VELOCITY_371 DET_RANGE_ERR_371 DET_RANGE_371 DET_CONFD_ELEVATION_372 DET_CONFD_AZIMUTH_372 DET_HVC_FLAG_372 DET_OUTSIDE_SECTOR_372 DET_EXISTENCE_PROB_372 DET_POINT_TARGET_PROB_372 DET_SNR_372 DET_SUPER_RES_TARGET_372 DET_BI_STATIC_FLAG_372 DET_VALID_FLAG_372 DET_RCS_372 DET_ELEVATION_ERR_372 DET_ELEVATION_372 DET_AZIMUTH_ERR_372 DET_AZIMUTH_372 DET_RANGE_VELOCITY_ERR_372 DET_RANGE_VELOCITY_372 DET_RANGE_ERR_372 DET_RANGE_372;
SIG_GROUP_ 1245 Detections_373_376 1 : DET_MH_CRC16_373_376 DET_MH_CYCLE_COUNTER_373_376 DET_MH_SCAN_INDEX_4LSB_373_376 DET_CONFD_ELEVATION_373 DET_CONFD_AZIMUTH_373 DET_HVC_FLAG_373 DET_OUTSIDE_SECTOR_373 DET_EXISTENCE_PROB_373 DET_POINT_TARGET_PROB_373 DET_SNR_373 DET_SUPER_RES_TARGET_373 DET_BI_STATIC_FLAG_373 DET_VALID_FLAG_373 DET_RCS_373 DET_ELEVATION_ERR_373 DET_ELEVATION_373 DET_AZIMUTH_ERR_373 DET_AZIMUTH_373 DET_RANGE_VELOCITY_ERR_373 DET_RANGE_VELOCITY_373 DET_RANGE_ERR_373 DET_RANGE_373 DET_CONFD_ELEVATION_374 DET_CONFD_AZIMUTH_374 DET_HVC_FLAG_374 DET_OUTSIDE_SECTOR_374 DET_EXISTENCE_PROB_374 DET_POINT_TARGET_PROB_374 DET_SNR_374 DET_SUPER_RES_TARGET_374 DET_BI_STATIC_FLAG_374 DET_VALID_FLAG_374 DET_RCS_374 DET_ELEVATION_ERR_374 DET_ELEVATION_374 DET_AZIMUTH_ERR_374 DET_AZIMUTH_374 DET_RANGE_VELOCITY_ERR_374 DET_RANGE_VELOCITY_374 DET_RANGE_ERR_374 DET_RANGE_374 DET_CONFD_ELEVATION_375 DET_CONFD_AZIMUTH_375 DET_HVC_FLAG_375 DET_OUTSIDE_SECTOR_375 DET_EXISTENCE_PROB_375 DET_POINT_TARGET_PROB_375 DET_SNR_375 DET_SUPER_RES_TARGET_375 DET_BI_STATIC_FLAG_375 DET_VALID_FLAG_375 DET_RCS_375 DET_ELEVATION_ERR_375 DET_ELEVATION_375 DET_AZIMUTH_ERR_375 DET_AZIMUTH_375 DET_RANGE_VELOCITY_ERR_375 DET_RANGE_VELOCITY_375 DET_RANGE_ERR_375 DET_RANGE_375 DET_CONFD_ELEVATION_376 DET_CONFD_AZIMUTH_376 DET_HVC_FLAG_376 DET_OUTSIDE_SECTOR_376 DET_EXISTENCE_PROB_376 DET_POINT_TARGET_PROB_376 DET_SNR_376 DET_SUPER_RES_TARGET_376 DET_BI_STATIC_FLAG_376 DET_VALID_FLAG_376 DET_RCS_376 DET_ELEVATION_ERR_376 DET_ELEVATION_376 DET_AZIMUTH_ERR_376 DET_AZIMUTH_376 DET_RANGE_VELOCITY_ERR_376 DET_RANGE_VELOCITY_376 DET_RANGE_ERR_376 DET_RANGE_376;
SIG_GROUP_ 1246 Detections_377_380 1 : DET_MH_CRC16_377_380 DET_MH_CYCLE_COUNTER_377_380 DET_MH_SCAN_INDEX_4LSB_377_380 DET_CONFD_ELEVATION_377 DET_CONFD_AZIMUTH_377 DET_HVC_FLAG_377 DET_OUTSIDE_SECTOR_377 DET_EXISTENCE_PROB_377 DET_POINT_TARGET_PROB_377 DET_SNR_377 DET_SUPER_RES_TARGET_377 DET_BI_STATIC_FLAG_377 DET_VALID_FLAG_377 DET_RCS_377 DET_ELEVATION_ERR_377 DET_ELEVATION_377 DET_AZIMUTH_ERR_377 DET_AZIMUTH_377 DET_RANGE_VELOCITY_ERR_377 DET_RANGE_VELOCITY_377 DET_RANGE_ERR_377 DET_RANGE_377 DET_CONFD_ELEVATION_378 DET_CONFD_AZIMUTH_378 DET_HVC_FLAG_378 DET_OUTSIDE_SECTOR_378 DET_EXISTENCE_PROB_378 DET_POINT_TARGET_PROB_378 DET_SNR_378 DET_SUPER_RES_TARGET_378 DET_BI_STATIC_FLAG_378 DET_VALID_FLAG_378 DET_RCS_378 DET_ELEVATION_ERR_378 DET_ELEVATION_378 DET_AZIMUTH_ERR_378 DET_AZIMUTH_378 DET_RANGE_VELOCITY_ERR_378 DET_RANGE_VELOCITY_378 DET_RANGE_ERR_378 DET_RANGE_378 DET_CONFD_ELEVATION_379 DET_CONFD_AZIMUTH_379 DET_HVC_FLAG_379 DET_OUTSIDE_SECTOR_379 DET_EXISTENCE_PROB_379 DET_POINT_TARGET_PROB_379 DET_SNR_379 DET_SUPER_RES_TARGET_379 DET_BI_STATIC_FLAG_379 DET_VALID_FLAG_379 DET_RCS_379 DET_ELEVATION_ERR_379 DET_ELEVATION_379 DET_AZIMUTH_ERR_379 DET_AZIMUTH_379 DET_RANGE_VELOCITY_ERR_379 DET_RANGE_VELOCITY_379 DET_RANGE_ERR_379 DET_RANGE_379 DET_CONFD_ELEVATION_380 DET_CONFD_AZIMUTH_380 DET_HVC_FLAG_380 DET_OUTSIDE_SECTOR_380 DET_EXISTENCE_PROB_380 DET_POINT_TARGET_PROB_380 DET_SNR_380 DET_SUPER_RES_TARGET_380 DET_BI_STATIC_FLAG_380 DET_VALID_FLAG_380 DET_RCS_380 DET_ELEVATION_ERR_380 DET_ELEVATION_380 DET_AZIMUTH_ERR_380 DET_AZIMUTH_380 DET_RANGE_VELOCITY_ERR_380 DET_RANGE_VELOCITY_380 DET_RANGE_ERR_380 DET_RANGE_380;
SIG_GROUP_ 1247 Detections_381_384 1 : DET_MH_CRC16_381_384 DET_MH_CYCLE_COUNTER_381_384 DET_MH_SCAN_INDEX_4LSB_381_384 DET_CONFD_ELEVATION_381 DET_CONFD_AZIMUTH_381 DET_HVC_FLAG_381 DET_OUTSIDE_SECTOR_381 DET_EXISTENCE_PROB_381 DET_POINT_TARGET_PROB_381 DET_SNR_381 DET_SUPER_RES_TARGET_381 DET_BI_STATIC_FLAG_381 DET_VALID_FLAG_381 DET_RCS_381 DET_ELEVATION_ERR_381 DET_ELEVATION_381 DET_AZIMUTH_ERR_381 DET_AZIMUTH_381 DET_RANGE_VELOCITY_ERR_381 DET_RANGE_VELOCITY_381 DET_RANGE_ERR_381 DET_RANGE_381 DET_CONFD_ELEVATION_382 DET_CONFD_AZIMUTH_382 DET_HVC_FLAG_382 DET_OUTSIDE_SECTOR_382 DET_EXISTENCE_PROB_382 DET_POINT_TARGET_PROB_382 DET_SNR_382 DET_SUPER_RES_TARGET_382 DET_BI_STATIC_FLAG_382 DET_VALID_FLAG_382 DET_RCS_382 DET_ELEVATION_ERR_382 DET_ELEVATION_382 DET_AZIMUTH_ERR_382 DET_AZIMUTH_382 DET_RANGE_VELOCITY_ERR_382 DET_RANGE_VELOCITY_382 DET_RANGE_ERR_382 DET_RANGE_382 DET_CONFD_ELEVATION_383 DET_CONFD_AZIMUTH_383 DET_HVC_FLAG_383 DET_OUTSIDE_SECTOR_383 DET_EXISTENCE_PROB_383 DET_POINT_TARGET_PROB_383 DET_SNR_383 DET_SUPER_RES_TARGET_383 DET_BI_STATIC_FLAG_383 DET_VALID_FLAG_383 DET_RCS_383 DET_ELEVATION_ERR_383 DET_ELEVATION_383 DET_AZIMUTH_ERR_383 DET_AZIMUTH_383 DET_RANGE_VELOCITY_ERR_383 DET_RANGE_VELOCITY_383 DET_RANGE_ERR_383 DET_RANGE_383 DET_CONFD_ELEVATION_384 DET_CONFD_AZIMUTH_384 DET_HVC_FLAG_384 DET_OUTSIDE_SECTOR_384 DET_EXISTENCE_PROB_384 DET_POINT_TARGET_PROB_384 DET_SNR_384 DET_SUPER_RES_TARGET_384 DET_BI_STATIC_FLAG_384 DET_VALID_FLAG_384 DET_RCS_384 DET_ELEVATION_ERR_384 DET_ELEVATION_384 DET_AZIMUTH_ERR_384 DET_AZIMUTH_384 DET_RANGE_VELOCITY_ERR_384 DET_RANGE_VELOCITY_384 DET_RANGE_ERR_384 DET_RANGE_384;
SIG_GROUP_ 1248 Detections_385_388 1 : DET_MH_CRC16_385_388 DET_MH_CYCLE_COUNTER_385_388 DET_MH_SCAN_INDEX_4LSB_385_388 DET_CONFD_ELEVATION_385 DET_CONFD_AZIMUTH_385 DET_HVC_FLAG_385 DET_OUTSIDE_SECTOR_385 DET_EXISTENCE_PROB_385 DET_POINT_TARGET_PROB_385 DET_SNR_385 DET_SUPER_RES_TARGET_385 DET_BI_STATIC_FLAG_385 DET_VALID_FLAG_385 DET_RCS_385 DET_ELEVATION_ERR_385 DET_ELEVATION_385 DET_AZIMUTH_ERR_385 DET_AZIMUTH_385 DET_RANGE_VELOCITY_ERR_385 DET_RANGE_VELOCITY_385 DET_RANGE_ERR_385 DET_RANGE_385 DET_CONFD_ELEVATION_386 DET_CONFD_AZIMUTH_386 DET_HVC_FLAG_386 DET_OUTSIDE_SECTOR_386 DET_EXISTENCE_PROB_386 DET_POINT_TARGET_PROB_386 DET_SNR_386 DET_SUPER_RES_TARGET_386 DET_BI_STATIC_FLAG_386 DET_VALID_FLAG_386 DET_RCS_386 DET_ELEVATION_ERR_386 DET_ELEVATION_386 DET_AZIMUTH_ERR_386 DET_AZIMUTH_386 DET_RANGE_VELOCITY_ERR_386 DET_RANGE_VELOCITY_386 DET_RANGE_ERR_386 DET_RANGE_386 DET_CONFD_ELEVATION_387 DET_CONFD_AZIMUTH_387 DET_HVC_FLAG_387 DET_OUTSIDE_SECTOR_387 DET_EXISTENCE_PROB_387 DET_POINT_TARGET_PROB_387 DET_SNR_387 DET_SUPER_RES_TARGET_387 DET_BI_STATIC_FLAG_387 DET_VALID_FLAG_387 DET_RCS_387 DET_ELEVATION_ERR_387 DET_ELEVATION_387 DET_AZIMUTH_ERR_387 DET_AZIMUTH_387 DET_RANGE_VELOCITY_ERR_387 DET_RANGE_VELOCITY_387 DET_RANGE_ERR_387 DET_RANGE_387 DET_CONFD_ELEVATION_388 DET_CONFD_AZIMUTH_388 DET_HVC_FLAG_388 DET_OUTSIDE_SECTOR_388 DET_EXISTENCE_PROB_388 DET_POINT_TARGET_PROB_388 DET_SNR_388 DET_SUPER_RES_TARGET_388 DET_BI_STATIC_FLAG_388 DET_VALID_FLAG_388 DET_RCS_388 DET_ELEVATION_ERR_388 DET_ELEVATION_388 DET_AZIMUTH_ERR_388 DET_AZIMUTH_388 DET_RANGE_VELOCITY_ERR_388 DET_RANGE_VELOCITY_388 DET_RANGE_ERR_388 DET_RANGE_388;
SIG_GROUP_ 1249 Detections_389_392 1 : DET_MH_CRC16_389_392 DET_MH_CYCLE_COUNTER_389_392 DET_MH_SCAN_INDEX_4LSB_389_392 DET_CONFD_ELEVATION_389 DET_CONFD_AZIMUTH_389 DET_HVC_FLAG_389 DET_OUTSIDE_SECTOR_389 DET_EXISTENCE_PROB_389 DET_POINT_TARGET_PROB_389 DET_SNR_389 DET_SUPER_RES_TARGET_389 DET_BI_STATIC_FLAG_389 DET_VALID_FLAG_389 DET_RCS_389 DET_ELEVATION_ERR_389 DET_ELEVATION_389 DET_AZIMUTH_ERR_389 DET_AZIMUTH_389 DET_RANGE_VELOCITY_ERR_389 DET_RANGE_VELOCITY_389 DET_RANGE_ERR_389 DET_RANGE_389 DET_CONFD_ELEVATION_390 DET_CONFD_AZIMUTH_390 DET_HVC_FLAG_390 DET_OUTSIDE_SECTOR_390 DET_EXISTENCE_PROB_390 DET_POINT_TARGET_PROB_390 DET_SNR_390 DET_SUPER_RES_TARGET_390 DET_BI_STATIC_FLAG_390 DET_VALID_FLAG_390 DET_RCS_390 DET_ELEVATION_ERR_390 DET_ELEVATION_390 DET_AZIMUTH_ERR_390 DET_AZIMUTH_390 DET_RANGE_VELOCITY_ERR_390 DET_RANGE_VELOCITY_390 DET_RANGE_ERR_390 DET_RANGE_390 DET_CONFD_ELEVATION_391 DET_CONFD_AZIMUTH_391 DET_HVC_FLAG_391 DET_OUTSIDE_SECTOR_391 DET_EXISTENCE_PROB_391 DET_POINT_TARGET_PROB_391 DET_SNR_391 DET_SUPER_RES_TARGET_391 DET_BI_STATIC_FLAG_391 DET_VALID_FLAG_391 DET_RCS_391 DET_ELEVATION_ERR_391 DET_ELEVATION_391 DET_AZIMUTH_ERR_391 DET_AZIMUTH_391 DET_RANGE_VELOCITY_ERR_391 DET_RANGE_VELOCITY_391 DET_RANGE_ERR_391 DET_RANGE_391 DET_CONFD_ELEVATION_392 DET_CONFD_AZIMUTH_392 DET_HVC_FLAG_392 DET_OUTSIDE_SECTOR_392 DET_EXISTENCE_PROB_392 DET_POINT_TARGET_PROB_392 DET_SNR_392 DET_SUPER_RES_TARGET_392 DET_BI_STATIC_FLAG_392 DET_VALID_FLAG_392 DET_RCS_392 DET_ELEVATION_ERR_392 DET_ELEVATION_392 DET_AZIMUTH_ERR_392 DET_AZIMUTH_392 DET_RANGE_VELOCITY_ERR_392 DET_RANGE_VELOCITY_392 DET_RANGE_ERR_392 DET_RANGE_392;
SIG_GROUP_ 1250 Detections_393_396 1 : DET_MH_CRC16_393_396 DET_MH_CYCLE_COUNTER_393_396 DET_MH_SCAN_INDEX_4LSB_393_396 DET_CONFD_ELEVATION_393 DET_CONFD_AZIMUTH_393 DET_HVC_FLAG_393 DET_OUTSIDE_SECTOR_393 DET_EXISTENCE_PROB_393 DET_POINT_TARGET_PROB_393 DET_SNR_393 DET_SUPER_RES_TARGET_393 DET_BI_STATIC_FLAG_393 DET_VALID_FLAG_393 DET_RCS_393 DET_ELEVATION_ERR_393 DET_ELEVATION_393 DET_AZIMUTH_ERR_393 DET_AZIMUTH_393 DET_RANGE_VELOCITY_ERR_393 DET_RANGE_VELOCITY_393 DET_RANGE_ERR_393 DET_RANGE_393 DET_CONFD_ELEVATION_394 DET_CONFD_AZIMUTH_394 DET_HVC_FLAG_394 DET_OUTSIDE_SECTOR_394 DET_EXISTENCE_PROB_394 DET_POINT_TARGET_PROB_394 DET_SNR_394 DET_SUPER_RES_TARGET_394 DET_BI_STATIC_FLAG_394 DET_VALID_FLAG_394 DET_RCS_394 DET_ELEVATION_ERR_394 DET_ELEVATION_394 DET_AZIMUTH_ERR_394 DET_AZIMUTH_394 DET_RANGE_VELOCITY_ERR_394 DET_RANGE_VELOCITY_394 DET_RANGE_ERR_394 DET_RANGE_394 DET_CONFD_ELEVATION_395 DET_CONFD_AZIMUTH_395 DET_HVC_FLAG_395 DET_OUTSIDE_SECTOR_395 DET_EXISTENCE_PROB_395 DET_POINT_TARGET_PROB_395 DET_SNR_395 DET_SUPER_RES_TARGET_395 DET_BI_STATIC_FLAG_395 DET_VALID_FLAG_395 DET_RCS_395 DET_ELEVATION_ERR_395 DET_ELEVATION_395 DET_AZIMUTH_ERR_395 DET_AZIMUTH_395 DET_RANGE_VELOCITY_ERR_395 DET_RANGE_VELOCITY_395 DET_RANGE_ERR_395 DET_RANGE_395 DET_CONFD_ELEVATION_396 DET_CONFD_AZIMUTH_396 DET_HVC_FLAG_396 DET_OUTSIDE_SECTOR_396 DET_EXISTENCE_PROB_396 DET_POINT_TARGET_PROB_396 DET_SNR_396 DET_SUPER_RES_TARGET_396 DET_BI_STATIC_FLAG_396 DET_VALID_FLAG_396 DET_RCS_396 DET_ELEVATION_ERR_396 DET_ELEVATION_396 DET_AZIMUTH_ERR_396 DET_AZIMUTH_396 DET_RANGE_VELOCITY_ERR_396 DET_RANGE_VELOCITY_396 DET_RANGE_ERR_396 DET_RANGE_396;
SIG_GROUP_ 1251 Detections_397_400 1 : DET_MH_CRC16_397_400 DET_MH_CYCLE_COUNTER_397_400 DET_MH_SCAN_INDEX_4LSB_397_400 DET_CONFD_ELEVATION_397 DET_CONFD_AZIMUTH_397 DET_HVC_FLAG_397 DET_OUTSIDE_SECTOR_397 DET_EXISTENCE_PROB_397 DET_POINT_TARGET_PROB_397 DET_SNR_397 DET_SUPER_RES_TARGET_397 DET_BI_STATIC_FLAG_397 DET_VALID_FLAG_397 DET_RCS_397 DET_ELEVATION_ERR_397 DET_ELEVATION_397 DET_AZIMUTH_ERR_397 DET_AZIMUTH_397 DET_RANGE_VELOCITY_ERR_397 DET_RANGE_VELOCITY_397 DET_RANGE_ERR_397 DET_RANGE_397 DET_CONFD_ELEVATION_398 DET_CONFD_AZIMUTH_398 DET_HVC_FLAG_398 DET_OUTSIDE_SECTOR_398 DET_EXISTENCE_PROB_398 DET_POINT_TARGET_PROB_398 DET_SNR_398 DET_SUPER_RES_TARGET_398 DET_BI_STATIC_FLAG_398 DET_VALID_FLAG_398 DET_RCS_398 DET_ELEVATION_ERR_398 DET_ELEVATION_398 DET_AZIMUTH_ERR_398 DET_AZIMUTH_398 DET_RANGE_VELOCITY_ERR_398 DET_RANGE_VELOCITY_398 DET_RANGE_ERR_398 DET_RANGE_398 DET_CONFD_ELEVATION_399 DET_CONFD_AZIMUTH_399 DET_HVC_FLAG_399 DET_OUTSIDE_SECTOR_399 DET_EXISTENCE_PROB_399 DET_POINT_TARGET_PROB_399 DET_SNR_399 DET_SUPER_RES_TARGET_399 DET_BI_STATIC_FLAG_399 DET_VALID_FLAG_399 DET_RCS_399 DET_ELEVATION_ERR_399 DET_ELEVATION_399 DET_AZIMUTH_ERR_399 DET_AZIMUTH_399 DET_RANGE_VELOCITY_ERR_399 DET_RANGE_VELOCITY_399 DET_RANGE_ERR_399 DET_RANGE_399 DET_CONFD_ELEVATION_400 DET_CONFD_AZIMUTH_400 DET_HVC_FLAG_400 DET_OUTSIDE_SECTOR_400 DET_EXISTENCE_PROB_400 DET_POINT_TARGET_PROB_400 DET_SNR_400 DET_SUPER_RES_TARGET_400 DET_BI_STATIC_FLAG_400 DET_VALID_FLAG_400 DET_RCS_400 DET_ELEVATION_ERR_400 DET_ELEVATION_400 DET_AZIMUTH_ERR_400 DET_AZIMUTH_400 DET_RANGE_VELOCITY_ERR_400 DET_RANGE_VELOCITY_400 DET_RANGE_ERR_400 DET_RANGE_400;

VERSION "created by canmatrix"

NS_ :

BS_:

BU_: External_Tool ADAS RDR08
VAL_TABLE_ STS_Coordinate_System_Input 2 "DRA_DET_COORD_SYS_ISO" 1 "DRA_DET_COORD_SYS_SAE" 0 "DRA_DET_COORD_SYS_UNDEFINED" ;
VAL_TABLE_ VitSig_Blockage_Sensitivity 3 "Invalid" 2 "High" 1 "Mid" 0 "Low" ;
VAL_TABLE_ VitSig_HED_AF_ALGO_PLATFORM 1 "FLR4p" 0 "GEN5" ;
VAL_TABLE_ VrSign_STS_VEH_SPLY_VOLTAGE 12 "highV2ToNorm" 11 "highV1ToNorm" 10 "highV2" 9 "highV1" 8 "highVtempToNorm" 7 "highVtemp" 6 "lowV2ToNorm" 5 "lowV1ToNorm" 4 "lowV2" 3 "lowV1" 2 "lowVtempToNorm" 1 "lowVtemp" 0 "normV" ;
VAL_TABLE_ Vt_InitLastSuccessfulAlignMode 5 "ExternalAlignment" 4 "StaticAlignment" 3 "ServiceAlignment" 2 "ShortTrackAlignment" 1 "NotUsed" 0 "None" ;
VAL_TABLE_ vtSig_CAN_PLATFORM_VARIANT 0 "VARIANT_INVALID" 1 "VARIANT_MRR3" 2 "VARIANT_SRR5" 3 "VARIANT_RACAM" 4 "VARIANT_MRR360" 5 "VARIANT_MRR3LLP_A01" 6 "VARIANT_MRR3LLP" ;
VAL_TABLE_ vtSig_HED_OPERATION_MODE 5 "Power_Off" 4 "Shutdown_Initiated" 3 "Faulty" 2 "Operational" 1 "Radar_Not_Configured" 0 "Init_MCU" ;
VAL_TABLE_ vtSig_HED_TIME_SYNC_SRC_MASTER 1 "GLOBAL" 0 "LOCAL" ;
VAL_TABLE_ vtSig_STS_HARDWARE 5 "RESERVED2" 4 "RESERVED1" 3 "RCM_RDI3_HIL" 2 "RCM_RDI3_LOG" 1 "RCM" 0 "UNKNOWN" ;

BO_ 78 SYS_KMS: 64 ADAS
 SG_ ADAS_KMS : 0|8@1+ (1,0) [0|255] ""  ADAS

BO_ 77 RDR_KMS: 64 RDR08
 SG_ Radar_KMS : 0|8@1+ (1,0) [0|255] ""  ADAS

BO_ 76 SYS_IDSM_Audit_Log: 64 ADAS
 SG_ ADAS_IDSM_Audit_Log : 0|8@1+ (1,0) [0|255] ""  RDR08

BO_ 75 RDR_IDSM_Audit_Log: 64 RDR08
 SG_ IDSM_Audit_Log : 0|8@1+ (1,0) [0|255] ""  ADAS

BO_ 79 RDR_ROE: 64 RDR08
 SG_ ROE_CRC_16 : 0|16@1+ (1,0) [0|65535] ""  ADAS,External_Tool
 SG_ ROE_CYCLE_COUNTER : 16|8@1+ (1,0) [0|255] ""  ADAS,External_Tool
 SG_ FltOccrCtr : 80|8@1+ (1,0) [0|255] ""  ADAS,External_Tool
 SG_ DTCSeverity : 72|3@1+ (1,0) [0|7] ""  ADAS,External_Tool
 SG_ StsBytePrev : 64|8@1+ (1,0) [0|255] ""  ADAS,External_Tool
 SG_ StsBittstFail : 62|1@1+ (1,0) [0|1] ""  ADAS,External_Tool
 SG_ StsBittstFailOprCycle : 61|1@1+ (1,0) [0|1] ""  ADAS,External_Tool
 SG_ StsBitPndingDTC : 60|1@1+ (1,0) [0|1] ""  ADAS,External_Tool
 SG_ StsBitcnfrmedDTC : 59|1@1+ (1,0) [0|1] ""  ADAS,External_Tool
 SG_ StsBittstFailsncLastClr : 58|1@1+ (1,0) [0|1] ""  ADAS,External_Tool
 SG_ StsBittstInCpltOprCyle : 57|1@1+ (1,0) [0|1] ""  ADAS,External_Tool
 SG_ StsBitWarnIndReq : 56|1@1+ (1,0) [0|1] ""  ADAS,External_Tool
 SG_ FailTypeByte : 48|8@1+ (1,0) [0|255] ""  ADAS,External_Tool
 SG_ DTCNumber : 32|16@1+ (1,0) [0|65535] ""  ADAS,External_Tool
 SG_ DiagAddr : 24|8@1+ (1,0) [0|255] ""  ADAS,External_Tool

BO_ 190 RDR_ALIGNMENT_STATUS_002: 64 RDR08
 SG_ AL_STS_002_CYCLE_COUNTER : 16|8@1+ (1,0) [0|255] "" Vector__XXX
 SG_ AL_STS_002_MH_CRC16 : 0|16@1+ (1,0) [0|65535] "" Vector__XXX
 SG_ STS_AlignmentShortTrackStatus : 91|3@1+ (1,0) [0|4] "NA"  ADAS
 SG_ STS_AverageSpeed : 208|16@1- (1,0) [-32768|32767] "ms"  ADAS
 SG_ STS_DurationEffective : 224|32@1+ (1,0) [0|4294967295] "ms"  ADAS
 SG_ STS_DurationAbsolute : 176|32@1+ (1,0) [0|4294967295] "ms"  ADAS
 SG_ STS_AverageNumberOfDetections : 128|16@1+ (1,0) [0|65535] "NA"  ADAS
 SG_ STS_DistanceEffective : 144|32@1+ (1,0) [0|4294967295] "m"  ADAS
 SG_ STS_DistanceAbsolute : 96|32@1+ (1,0) [0|4294967295] "m"  ADAS
 SG_ STS_VehicleCondition : 88|3@1+ (1,0) [0|6] "NA"  ADAS
 SG_ STS_AlignmentServiceStatus : 260|3@1+ (1,0) [0|4] "NA"  ADAS
 SG_ STS_ImpactByInterference : 259|1@1+ (1,0) [0|1] "NA"  ADAS
 SG_ STS_MeasuredRCSStd : 72|15@1+ (0.01,0) [0|327.67] "dBsm"  ADAS
 SG_ STS_MeasuredRCS : 64|8@1- (1,0) [-5|40] "dBsm"  ADAS
 SG_ STS_MeasuredRangeRateStd : 48|15@1+ (0.001,0) [0|32.767] "mm/s"  ADAS
 SG_ STS_MeasuredRangeRate : 40|3@1- (0.01,0) [-0.02|0.02] "mm/s"  ADAS
 SG_ STS_MeasuredRangeStd : 24|16@1+ (1,0) [0|65535] "mm"  ADAS
 SG_ STS_Measured_Range : 264|16@1+ (1,0) [940|5410] "mm"  ADAS
 SG_ STS_AlignmentStaticStatus : 256|3@1+ (1,0) [0|4] ""  ADAS

BO_ 189 RDR_ALIGNMENT_STATUS_001: 64 RDR08
 SG_ AL_STS_001_CYCLE_COUNTER : 16|8@1+ (1,0) [0|255] "" Vector__XXX
 SG_ AL_STS_001_MH_CRC16 : 0|16@1+ (1,0) [0|65535] "" Vector__XXX
 SG_ STS_ElevationUpdates : 312|32@1+ (1,0) [0|4294967295] "NA"  ADAS
 SG_ STS_AzimuthUpdates : 280|32@1+ (1,0) [0|4294967295] "NA"  ADAS
 SG_ STS_HostSpdCompensationFactorQF : 204|2@1+ (1,0) [0|2] "NA"  ADAS
 SG_ STS_HostSpeedCompensationFactor : 272|7@1+ (0.01,0) [0.95|1.05] "NA"  ADAS
 SG_ STS_ElevationErrorNegative : 264|7@1- (0.01,0) [-0.44|0] "rad"  ADAS
 SG_ STS_AzimuthErrorNegative : 248|10@1- (0.01,0) [-3.14|0] "rad"  ADAS
 SG_ STS_RollErrorPositive : 206|10@1- (0.01,0) [-3.14|3.14] "rad"  ADAS
 SG_ STS_ElevationErrorPositive : 224|6@1+ (0.01,0) [0|0.44] "rad"  ADAS
 SG_ STS_AzimuthErrorPositive : 230|9@1+ (0.01,0) [0|3.14] "rad"  ADAS
 SG_ STS_AAElevationStd : 240|8@1+ (1,0) [0|180] "degree"  ADAS
 SG_ STS_AAAzimuthStd : 216|8@1+ (1,0) [0|180] "degree"  ADAS
 SG_ STS_AACurrentElevation : 192|12@1- (0.0001,0) [-0.1745|0.1745] "rad"  ADAS
 SG_ STS_AACurrentAzimuth : 172|20@1- (1E-005,0) [-3.14159|3.14159] "rad"  ADAS
 SG_ STS_StartElevation : 163|9@1- (1,0) [-180|180] "degree"  ADAS
 SG_ STS_StartAzimuth : 151|9@1- (1,0) [-180|180] "degree"  ADAS
 SG_ STS_AutoAlignmentFailRootCause : 160|3@1+ (1,0) [0|9] "NA"  ADAS
 SG_ STS_AlignmentAutoStatus : 149|2@1+ (1,0) [0|3] "NA"  ADAS
 SG_ STS_CalDisplay : 148|1@1+ (1,0) [0|1] "NA"  ADAS
 SG_ STS_AlignmentError : 144|4@1+ (1,0) [0|18] "NA"  ADAS
 SG_ STS_ProgressPercent : 137|7@1+ (1,0) [0|100] "%"  ADAS
 SG_ STS_CalTime : 116|12@1+ (1,0) [0|3600] "s"  ADAS
 SG_ STS_ElevationStd : 128|9@1+ (0.01,0) [0|3.14] "degree"  ADAS
 SG_ STS_AzimuthStd : 63|9@1+ (0.01,0) [0|3.14] "degree"  ADAS
 SG_ STS_AlignmentElevation : 104|12@1- (0.0001,0) [-0.1745|0.1745] "rad"  ADAS
 SG_ STS_AlignmentAzimuth : 366|10@1- (0.01,0) [-3.14|3.14] "rad"  ADAS
 SG_ STS_InitAlignRsltHostSpdCompFac : 56|7@1+ (0.01,0) [0.95|1.05] "NA"  ADAS
 SG_ STS_InitAlignRsltElevationUpdate : 24|32@1+ (1,0) [0|4294967295] "NA"  ADAS
 SG_ STS_InitAlignResultAzimuthUpdate : 72|32@1+ (1,0) [0|4294967295] "NA"  ADAS
 SG_ STS_AlignmentModeOut : 360|3@1+ (1,0) [0|4] "NA"  ADAS
 SG_ STS_InitLastSuccessfulAlignMode : 363|3@1+ (1,0) [0|5] "NA"  ADAS
 SG_ STS_InitAlignmentResultElevation : 356|4@1- (1,0) [-6|6] "degree"  ADAS
 SG_ STS_InitAlignmentResultAzimuth : 352|4@1- (1,0) [-6|6] "degree"  ADAS
 SG_ STS_RadarTypeInput : 347|3@1+ (1,0) [0|7] "NA"  ADAS
 SG_ STS_CoordinateSystemInput : 350|2@1+ (1,0) [0|2] "NA"  ADAS
 SG_ STS_AlignmentModeIn : 344|3@1+ (1,0) [0|5] "NA"  ADAS

BO_ 191 RDR_CAPABILITY: 64 RDR08
 SG_ CAP_MaxDetRangePedestrian_2 : 153|9@1+ (1,0) [0|500] "m"  ADAS
 SG_ CAP_MaxDetRangePedestrian_1 : 144|9@1+ (1,0) [0|500] "m"  ADAS
 SG_ CAP_MaxDetRangeMotorbike_2 : 135|9@1+ (1,0) [0|500] "m"  ADAS
 SG_ CAP_MaxDetRangeMotorbike_0 : 126|9@1+ (1,0) [0|500] "m"  ADAS
 SG_ CAP_MaxDetectionRangeCar_2 : 117|9@1+ (1,0) [0|500] "m"  ADAS
 SG_ CAP_MaxDetectionRangeCar_1 : 108|9@1+ (1,0) [0|500] "m"  ADAS
 SG_ CAP_CYCLE_COUNTER : 16|8@1+ (1,0) [0|255] ""  ADAS
 SG_ CAP_MH_CRC16 : 0|16@1+ (1,0) [0|65535] ""  ADAS
 SG_ CAP_SideLobeLevelBeamformer : 168|8@1+ (1,0) [0|255] "NA"  ADAS
 SG_ CAP_SLLMonitoringStatus : 60|3@1+ (1,0) [0|4] "NA"  ADAS
 SG_ CAP_SLLMonitoringActive : 59|1@1+ (1,0) [0|1] "NA"  ADAS
 SG_ CAP_AngleAzimuthRangeEnd : 99|9@1- (1,0) [-180|180] "degree"  ADAS
 SG_ CAP_AngleAzimuthRangeStart : 90|9@1- (1,0) [-180|180] "degree"  ADAS
 SG_ CAP_MaxDetRangePedestrian_0 : 81|9@1+ (1,0) [0|500] "m"  ADAS
 SG_ CAP_MaxDetRangeMotorbike_1 : 72|9@1+ (1,0) [0|500] "m"  ADAS
 SG_ CAP_MaxDetectionRangeCar_0 : 63|9@1+ (1,0) [0|500] "m"  ADAS
 SG_ CAP_RangeEstimationStatus : 56|3@1+ (1,0) [0|4] "NA"  ADAS
 SG_ CAP_RangeEstimationActive : 31|1@1+ (1,0) [0|1] "NA"  ADAS
 SG_ CAP_DampingStandardDeviation : 48|8@1+ (1,0) [0|255] "dB"  ADAS
 SG_ CAP_DampingStatus : 181|3@1+ (1,0) [0|4] "NA"  ADAS
 SG_ CAP_DampingActive : 186|1@1+ (1,0) [0|1] "NA"  ADAS
 SG_ CAP_DampingCurrent : 32|16@1+ (0.01,0) [0|255] "dB"  ADAS
 SG_ CAP_SLBlockageFilterValue : 25|6@1+ (1,0) [0|35] "dB"  ADAS
 SG_ CAP_SLBlockageFlag : 24|1@1+ (1,0) [0|1] "NA"  ADAS
 SG_ CAP_FreeSightCheckStatus : 179|2@1+ (1,0) [0|2] "NA"  ADAS
 SG_ CAP_FreeSightCheckActive : 166|2@1+ (1,0) [0|3] "NA"  ADAS
 SG_ CAP_BlockageProbability : 192|7@1+ (1,0) [0|100] "%"  ADAS
 SG_ CAP_BlockageValue : 176|3@1+ (1,0) [0|6] "NA"  ADAS
 SG_ CAP_BlockageStatus : 163|3@1+ (1,0) [0|4] "NA"  ADAS
 SG_ CAP_BlockageActive : 162|1@1+ (1,0) [0|1] "NA"  ADAS
 SG_ CAP_BlockageSensitivity : 184|2@1+ (1,0) [0|3] "NA"  ADAS

BO_ 1281 SYS_NM: 64 ADAS
 SG_ SYS_NM_PNC_Reserved3 : 63|8@0+ (1,0) [0|255] ""  RDR08
 SG_ SYS_NM_PNC_Reserved2 : 55|8@0+ (1,0) [0|255] ""  RDR08
 SG_ SYS_NM_PNC_Reserved1 : 47|8@0+ (1,0) [0|255] ""  RDR08
 SG_ SYS_NM_Wakeup_And_Reason : 39|8@0+ (1,0) [0|255] ""  RDR08
 SG_ SYS_NM_CAN_NM_State : 31|8@0+ (1,0) [0|255] ""  RDR08
 SG_ SYS_NM_PN_User_Data : 23|8@0+ (1,0) [0|255] ""  RDR08
 SG_ SYS_NM_CBV_ResdBit_7 : 15|1@0+ (1,0) [0|1] ""  RDR08
 SG_ SYS_NM_CBV_ResdBit_5 : 13|1@0+ (1,0) [0|1] ""  RDR08
 SG_ SYS_NM_CBV_ResdBit_2 : 10|1@0+ (1,0) [0|1] ""  RDR08
 SG_ SYS_NM_CBV_ResdBit_1 : 9|1@0+ (1,0) [0|1] ""  RDR08
 SG_ SYS_NM_CBV_ReptMsgBit0 : 8|1@0+ (1,0) [0|1] ""  RDR08
 SG_ SYS_NM_CBV_PNIBit_6 : 14|1@0+ (1,0) [0|1] ""  RDR08
 SG_ SYS_NM_CBV_NMCoordBit_3 : 11|1@0+ (1,0) [0|1] ""  RDR08
 SG_ SYS_NM_CBV_ActWakeBit_4 : 12|1@0+ (1,0) [0|1] ""  RDR08
 SG_ SYS_NM_SrcNodeID : 7|8@0+ (1,0) [0|255] ""  RDR08

BO_ 1288 RDR_NM: 64 RDR08
 SG_ RDR_NM_PNC_Reserved3 : 63|8@0+ (1,0) [0|255] ""  ADAS
 SG_ RDR_NM_PNC_Reserved2 : 55|8@0+ (1,0) [0|255] ""  ADAS
 SG_ RDR_NM_PNC_Reserved1 : 47|8@0+ (1,0) [0|255] ""  ADAS
 SG_ RDR_NM_Wakeup_And_Reason : 39|8@0+ (1,0) [0|255] ""  ADAS
 SG_ RDR_NM_PN_User_Data : 23|8@0+ (1,0) [0|255] ""  ADAS
 SG_ RDR_NM_CAN_NM_State : 31|8@0+ (1,0) [0|255] ""  ADAS
 SG_ RDR_NM_CBV_ResdBit_7 : 15|1@0+ (1,0) [0|1] ""  ADAS
 SG_ RDR_NM_CBV_ResdBit_5 : 13|1@0+ (1,0) [0|1] ""  ADAS
 SG_ RDR_NM_CBV_ResdBit_2 : 10|1@0+ (1,0) [0|1] ""  ADAS
 SG_ RDR_NM_CBV_ResdBit_1 : 9|1@0+ (1,0) [0|1] ""  ADAS
 SG_ RDR_NM_CBV_ReptMsgBit0 : 8|1@0+ (1,0) [0|1] ""  ADAS
 SG_ RDR_NM_CBV_PNIBit_6 : 14|1@0+ (1,0) [0|1] ""  ADAS
 SG_ RDR_NM_CBV_NMCoordBit_3 : 11|1@0+ (1,0) [0|1] ""  ADAS
 SG_ RDR_NM_CBV_ActWakeBit_4 : 12|1@0+ (1,0) [0|1] ""  ADAS
 SG_ RDR_NM_SrcNodeID : 7|8@0+ (1,0) [0|255] ""  ADAS

BO_ 1152 RDR_DETECTION_001_004: 64 RDR08
 SG_ DET_RANGE_001 : 24|15@1+ (0.015625,0) [0|500] "m"  ADAS
 SG_ DET_RANGE_ERR_001 : 40|7@1+ (0.0075,0) [0|0.9525] "m"  ADAS
 SG_ DET_RANGE_VELOCITY_001 : 48|15@1+ (0.0078125,-128) [-128|127.9921875] "m/s"  ADAS
 SG_ DET_RANGE_VELOCITY_ERR_001 : 64|8@1+ (0.003,0) [0|0.765] "m/s"  ADAS
 SG_ DET_AZIMUTH_001 : 88|13@1+ (0.0004,-1.5708) [-1.5708|1.5708] "rad"  ADAS
 SG_ DET_AZIMUTH_ERR_001 : 105|7@1+ (0.00087267,0) [0|0.11082909] "rad"  ADAS
 SG_ DET_ELEVATION_001 : 72|8@1+ (0.00275,-0.34925) [-0.34925|0.34925] "rad"  ADAS
 SG_ DET_ELEVATION_ERR_001 : 80|6@1+ (0.00174533,0) [0|0.10995579] "rad"  ADAS
 SG_ DET_RCS_001 : 136|8@1+ (0.5,-64) [-64|63.5] "dBsm"  ADAS
 SG_ DET_VALID_FLAG_001 : 119|1@1+ (1,0) [0|1] ""  ADAS
 SG_ DET_BI_STATIC_FLAG_001 : 504|1@1+ (1,0) [0|1] ""  ADAS
 SG_ DET_SUPER_RES_TARGET_001 : 104|1@1+ (1,0) [0|1] ""  ADAS
 SG_ DET_SNR_001 : 128|8@1+ (0.35156,0) [0|89.6478] "dB"  ADAS
 SG_ DET_POINT_TARGET_PROB_001 : 114|4@1+ (6.67,0) [0|100] "%"  ADAS
 SG_ DET_EXISTENCE_PROB_001 : 120|6@1+ (1.588,0) [0|100] "%"  ADAS
 SG_ DET_OUTSIDE_SECTOR_001 : 159|1@1+ (1,0) [0|1] ""  ADAS
 SG_ DET_HVC_FLAG_001 : 118|1@1+ (1,0) [0|1] ""  ADAS
 SG_ DET_CONFD_AZIMUTH_001 : 126|2@1+ (1,0) [0|3] ""  ADAS
 SG_ DET_CONFD_ELEVATION_001 : 112|2@1+ (1,0) [0|3] ""  ADAS
 SG_ DET_RANGE_002 : 144|15@1+ (0.015625,0) [0|500] "m"  ADAS
 SG_ DET_RANGE_ERR_002 : 160|7@1+ (0.0075,0) [0|0.9525] "m"  ADAS
 SG_ DET_RANGE_VELOCITY_002 : 168|15@1+ (0.0078125,-128) [-128|127.9921875] "m/s"  ADAS
 SG_ DET_RANGE_VELOCITY_ERR_002 : 184|8@1+ (0.003,0) [0|0.765] "m/s"  ADAS
 SG_ DET_AZIMUTH_002 : 208|13@1+ (0.0004,-1.5708) [-1.5708|1.5708] "rad"  ADAS
 SG_ DET_AZIMUTH_ERR_002 : 224|7@1+ (0.00087267,0) [0|0.11082909] "rad"  ADAS
 SG_ DET_ELEVATION_002 : 192|8@1+ (0.00275,-0.34925) [-0.34925|0.34925] "rad"  ADAS
 SG_ DET_ELEVATION_ERR_002 : 200|6@1+ (0.00174533,0) [0|0.10995579] "rad"  ADAS
 SG_ DET_RCS_002 : 256|8@1+ (0.5,-64) [-64|63.5] "dBsm"  ADAS
 SG_ DET_VALID_FLAG_002 : 167|1@1+ (1,0) [0|1] ""  ADAS
 SG_ DET_BI_STATIC_FLAG_002 : 505|1@1+ (1,0) [0|1] ""  ADAS
 SG_ DET_SUPER_RES_TARGET_002 : 247|1@1+ (1,0) [0|1] ""  ADAS
 SG_ DET_SNR_002 : 248|8@1+ (0.35156,0) [0|89.6478] "dB"  ADAS
 SG_ DET_POINT_TARGET_PROB_002 : 240|4@1+ (6.67,0) [0|100] "%"  ADAS
 SG_ DET_EXISTENCE_PROB_002 : 232|6@1+ (1.588,0) [0|100] "%"  ADAS
 SG_ DET_OUTSIDE_SECTOR_002 : 183|1@1+ (1,0) [0|1] ""  ADAS
 SG_ DET_HVC_FLAG_002 : 246|1@1+ (1,0) [0|1] ""  ADAS
 SG_ DET_CONFD_AZIMUTH_002 : 206|2@1+ (1,0) [0|3] ""  ADAS
 SG_ DET_CONFD_ELEVATION_002 : 244|2@1+ (1,0) [0|3] ""  ADAS
 SG_ DET_RANGE_003 : 264|15@1+ (0.015625,0) [0|500] "m"  ADAS
 SG_ DET_RANGE_ERR_003 : 280|7@1+ (0.0075,0) [0|0.9525] "m"  ADAS
 SG_ DET_RANGE_VELOCITY_003 : 288|15@1+ (0.0078125,-128) [-128|127.9921875] "m/s"  ADAS
 SG_ DET_RANGE_VELOCITY_ERR_003 : 304|8@1+ (0.003,0) [0|0.765] "m/s"  ADAS
 SG_ DET_AZIMUTH_003 : 328|13@1+ (0.0004,-1.5708) [-1.5708|1.5708] "rad"  ADAS
 SG_ DET_AZIMUTH_ERR_003 : 345|7@1+ (0.00087267,0) [0|0.11082909] "rad"  ADAS
 SG_ DET_ELEVATION_003 : 312|8@1+ (0.00275,-0.34925) [-0.34925|0.34925] "rad"  ADAS
 SG_ DET_ELEVATION_ERR_003 : 320|6@1+ (0.00174533,0) [0|0.10995579] "rad"  ADAS
 SG_ DET_RCS_003 : 376|8@1+ (0.5,-64) [-64|63.5] "dBsm"  ADAS
 SG_ DET_VALID_FLAG_003 : 399|1@1+ (1,0) [0|1] ""  ADAS
 SG_ DET_BI_STATIC_FLAG_003 : 482|1@1+ (1,0) [0|1] ""  ADAS
 SG_ DET_SUPER_RES_TARGET_003 : 344|1@1+ (1,0) [0|1] ""  ADAS
 SG_ DET_SNR_003 : 368|8@1+ (0.35156,0) [0|89.6478] "dB"  ADAS
 SG_ DET_POINT_TARGET_PROB_003 : 360|4@1+ (6.67,0) [0|100] "%"  ADAS
 SG_ DET_EXISTENCE_PROB_003 : 352|6@1+ (1.588,0) [0|100] "%"  ADAS
 SG_ DET_OUTSIDE_SECTOR_003 : 407|1@1+ (1,0) [0|1] ""  ADAS
 SG_ DET_HVC_FLAG_003 : 364|1@1+ (1,0) [0|1] ""  ADAS
 SG_ DET_CONFD_AZIMUTH_003 : 365|2@1+ (1,0) [0|3] ""  ADAS
 SG_ DET_CONFD_ELEVATION_003 : 358|2@1+ (1,0) [0|3] ""  ADAS
 SG_ DET_RANGE_004 : 384|15@1+ (0.015625,0) [0|500] "m"  ADAS
 SG_ DET_RANGE_ERR_004 : 400|7@1+ (0.0075,0) [0|0.9525] "m"  ADAS
 SG_ DET_RANGE_VELOCITY_004 : 408|15@1+ (0.0078125,-128) [-128|127.9921875] "m/s"  ADAS
 SG_ DET_RANGE_VELOCITY_ERR_004 : 424|8@1+ (0.003,0) [0|0.765] "m/s"  ADAS
 SG_ DET_AZIMUTH_004 : 448|13@1+ (0.0004,-1.5708) [-1.5708|1.5708] "rad"  ADAS
 SG_ DET_AZIMUTH_ERR_004 : 465|7@1+ (0.00087267,0) [0|0.11082909] "rad"  ADAS
 SG_ DET_ELEVATION_004 : 432|8@1+ (0.00275,-0.34925) [-0.34925|0.34925] "rad"  ADAS
 SG_ DET_ELEVATION_ERR_004 : 440|6@1+ (0.00174533,0) [0|0.10995579] "rad"  ADAS
 SG_ DET_RCS_004 : 496|8@1+ (0.5,-64) [-64|63.5] "dBsm"  ADAS
 SG_ DET_VALID_FLAG_004 : 485|1@1+ (1,0) [0|1] ""  ADAS
 SG_ DET_BI_STATIC_FLAG_004 : 483|1@1+ (1,0) [0|1] ""  ADAS
 SG_ DET_SUPER_RES_TARGET_004 : 446|1@1+ (1,0) [0|1] ""  ADAS
 SG_ DET_SNR_004 : 488|8@1+ (0.35156,0) [0|89.6478] "dB"  ADAS
 SG_ DET_POINT_TARGET_PROB_004 : 472|4@1+ (6.67,0) [0|100] "%"  ADAS
 SG_ DET_EXISTENCE_PROB_004 : 506|6@1+ (1.588,0) [0|100] "%"  ADAS
 SG_ DET_OUTSIDE_SECTOR_004 : 481|1@1+ (1,0) [0|1] ""  ADAS
 SG_ DET_HVC_FLAG_004 : 464|1@1+ (1,0) [0|1] ""  ADAS
 SG_ DET_CONFD_AZIMUTH_004 : 486|2@1+ (1,0) [0|3] ""  ADAS
 SG_ DET_CONFD_ELEVATION_004 : 461|2@1+ (1,0) [0|3] ""  ADAS
 SG_ DET_MH_SCAN_INDEX_4LSB_001_004 : 476|4@1+ (1,0) [0|15] ""  ADAS
 SG_ DET_MH_CYCLE_COUNTER_001_004 : 16|8@1+ (1,0) [0|255] ""  ADAS
 SG_ DET_MH_CRC16_001_004 : 0|16@1+ (1,0) [0|65535] ""  ADAS

BO_ 1728 RDR_DIAG_REQ_PHYS: 64 ADAS
 SG_ Diag_Req_Phys : 7|64@0+ (1,0) [0|0] ""  RDR08

BO_ 1600 RDR_DIAG_RESP_PHYS: 64 RDR08
 SG_ Diag_Resp_Phys : 7|64@0+ (1,0) [0|0] ""  ADAS

BO_ 1 SYS_TIME_SYNC: 8 ADAS
 SG_ TSYN_USERBYTE m32 : 31|8@0+ (1,0) [0|0] ""  RDR08
 SG_ TSYN_TIMEDOMAIN : 23|4@0+ (1,0) [0|15] ""  RDR08
 SG_ TSYN_SYNCTIME_SEC m32 : 39|32@0+ (1,0) [0|4294967295] "s"  RDR08
 SG_ TSYN_SYNCTIME_NANOSEC m40 : 39|32@0+ (1,0) [0|999999999] "ns"  RDR08
 SG_ TSYN_SGW m40 : 26|1@0+ (1,0) [0|0] ""  RDR08
 SG_ TSYN_SEQUENCE_COUNTER : 19|4@0+ (1,0) [0|15] ""  RDR08
 SG_ TSYN_RESERVED m40 : 31|5@0+ (1,0) [0|0] ""  RDR08
 SG_ TSYN_PDU M : 7|8@0+ (1,0) [0|255] ""  RDR08
 SG_ TSYN_OVS m40 : 25|2@0+ (1,0) [0|0] ""  RDR08
 SG_ TSYNC_CRC : 15|8@0+ (1,0) [0|255] ""  RDR08

BO_ 2 SYS_VEHICLE_STATUS: 64 ADAS
 SG_ SSTS_VIN_Data_Byte6 : 232|8@1+ (1,0) [0|255] ""  RDR08
 SG_ SSTS_VIN_Data_Byte5 : 224|8@1+ (1,0) [0|255] ""  RDR08
 SG_ SSTS_VIN_Data_Byte4 : 216|8@1+ (1,0) [0|255] ""  RDR08
 SG_ SSTS_VIN_Data_Byte3 : 208|8@1+ (1,0) [0|255] ""  RDR08
 SG_ SSTS_VIN_Data_Byte1 : 192|8@1+ (1,0) [0|255] ""  RDR08
 SG_ SSTS_VIN_Data_Byte2 : 200|8@1+ (1,0) [0|255] ""  RDR08
 SG_ SSTS_VIN_Data_Byte0 : 184|8@1+ (1,0) [0|255] ""  RDR08
 SG_ SSTS_VIN_FrameIdx : 176|8@1+ (1,0) [0|3] ""  RDR08
 SG_ SSTS_DRIVE_DIR : 78|2@1+ (1,0) [0|3] ""  RDR08
 SG_ SSTS_DRIVE_REVERSE : 36|1@1+ (1,0) [0|1] ""  RDR08
 SG_ SSTS_VEHICLE_STATE : 85|3@1+ (1,0) [0|5] ""  RDR08
 SG_ SSTS_VEH_AbsoluteTime_Year : 168|8@1+ (1,1970) [1970|2100] "Year"  RDR08
 SG_ SSTS_VEH_AbsoluteTime_Second : 96|6@1+ (1,0) [0|59] "s"  RDR08
 SG_ SSTS_VEH_AbsoluteTime_Month : 92|4@1+ (1,0) [0|12] "Month"  RDR08
 SG_ SSTS_VEH_AbsoluteTime_Minute : 120|6@1+ (1,0) [0|59] "Min"  RDR08
 SG_ SSTS_VEH_AbsoluteTime_Hour : 112|5@1+ (1,0) [0|23] "H"  RDR08
 SG_ SSTS_VEH_AbsoluteTime_Day : 80|5@1+ (1,0) [1|31] "Day"  RDR08
 SG_ SSTS_VEH_SYSTEM_VOLTAGE : 152|12@1+ (0.1,0) [0|255] ""  RDR08
 SG_ SSTS_VEH_POWER_MODE_STATUS : 50|3@1+ (1,0) [0|7] ""  RDR08
 SG_ SSTS_VEH_ODOMETER : 128|20@1+ (1,0) [0|999999] "Km"  RDR08
 SG_ SSTS_SW_VERSION_ADAS : 248|32@1+ (1,0) [0|4294967295] ""  RDR08
 SG_ SSTS_CAN_PCAN_MINOR_ADAS : 24|8@1+ (1,0) [0|255] ""  RDR08
 SG_ SSTS_CAN_PCAN_MAJOR_ADAS : 240|8@1+ (1,0) [0|255] ""  RDR08
 SG_ SSTS_YAW_RATE_CALC_QF : 48|2@1+ (1,0) [0|3] ""  RDR08
 SG_ SSTS_YAW_RATE_BIAS : 32|4@1+ (0.025,0) [0|0.375] "rad/s"  RDR08
 SG_ SSTS_YAW_RATE_CALC : 38|10@1+ (0.005,-2.24) [-2.24|2.24] "rad/s"  RDR08
 SG_ SSTS_VEH_SPD_COMP_FACTOR : 56|8@1- (0.001953125,1) [0.75|1.248046875] "NA"  RDR08
 SG_ SSTS_VEHICLE_SPEED_CALC_QF : 54|2@1+ (1,0) [0|3] ""  RDR08
 SG_ SSTS_VEHICLE_SPEED_CALC : 64|14@1+ (0.01,0) [0|163.83] "m/s"  RDR08
 SG_ SSTS_IGN_STATUS : 88|4@1+ (1,0) [0|15] ""  RDR08
 SG_ SSTS_GEAR_POSITION : 148|4@1+ (1,0) [0|15] ""  RDR08
 SG_ SSTS_STEERING_ANGLE_SIGN : 37|1@1+ (1,0) [0|1] ""  RDR08
 SG_ SSTS_STEERING_ANGLE : 104|8@1+ (0.0174533,0) [0|3.141599] "rad"  RDR08
 SG_ SSTS_MH_VS_CYCLE_COUNTER : 16|8@1+ (1,0) [0|255] ""  RDR08
 SG_ SSTS_MH_VS_CRC16 : 0|16@1+ (1,0) [0|65535] ""  RDR08

BO_ 187 RDR_STATUS_001: 64 RDR08
 SG_ STS_SENSOR_POLARITY : 245|1@1+ (1,0) [0|1] ""  ADAS
 SG_ STS_SP_CORE_TIME_PEAK : 464|8@1+ (0.5,0) [0|127.5] "ms"  ADAS
 SG_ STS_SP_CORE_TIME_INST : 472|8@1+ (0.5,0) [0|127.5] "ms"  ADAS
 SG_ STS_RDD_CORE_TIME_PEAK : 456|8@1+ (0.5,0) [0|127.5] "ms"  ADAS
 SG_ STS_RDD_CORE_TIME_INST : 448|8@1+ (0.5,0) [0|127.5] "ms"  ADAS
 SG_ STS_MAIN_CORE_TIME_PEAK : 440|8@1+ (0.5,0) [0|127.5] "ms"  ADAS
 SG_ STS_MAIN_CORE_TIME_INST : 432|8@1+ (0.5,0) [0|127.5] "ms"  ADAS
 SG_ STS_AF_TIME_PEAK : 424|8@1+ (0.5,0) [0|127.5] "ms"  ADAS
 SG_ STS_AF_TIME_INST : 416|8@1+ (0.5,0) [0|127.5] "ms"  ADAS
 SG_ STS_PCAN_PROTOCOL_VER_MINOR : 128|8@1+ (1,0) [0|255] ""  ADAS
 SG_ STS_PCAN_PROTOCOL_VER_MAJOR : 120|8@1+ (1,0) [0|255] ""  ADAS
 SG_ STS_PLATFORM_VARIANT : 136|8@1+ (1,0) [0|65535] ""  ADAS
 SG_ STS_HARDWARE_VERSION : 112|4@1+ (1,0) [0|0] ""  ADAS
 SG_ STS_SERIAL_NUMBER_SEQUENCE : 156|12@1+ (1,0) [0|0] ""  ADAS
 SG_ STS_SERIAL_NUM_JULIAN_YEAR : 144|3@1+ (1,2020) [2020|2027] "years"  ADAS
 SG_ STS_SERIAL_NUM_JULIAN_DAY : 147|9@1+ (1,0) [0|0] ""  ADAS
 SG_ STS_SW_VERSION_FIELD1 : 168|8@1+ (1,0) [0|255] ""  ADAS
 SG_ STS_SW_VERSION_FIELD2 : 176|8@1+ (1,0) [0|255] ""  ADAS
 SG_ STS_SW_VERSION_FIELD3 : 184|8@1+ (1,0) [0|255] ""  ADAS
 SG_ STS_SW_VERSION_FIELD4 : 192|8@1+ (1,0) [0|255] ""  ADAS
 SG_ STS_PBL_VERSION_FIELD1 : 200|8@1+ (1,0) [0|255] ""  ADAS
 SG_ STS_PBL_VERSION_FIELD2 : 208|8@1+ (1,0) [0|255] ""  ADAS
 SG_ STS_PBL_VERSION_FIELD3 : 216|8@1+ (1,0) [0|255] ""  ADAS
 SG_ STS_PBL_VERSION_FIELD4 : 224|8@1+ (1,0) [0|255] ""  ADAS
 SG_ STS_USC_CAL_VER_MAJOR : 24|16@1+ (1,0) [0|65535] ""  ADAS
 SG_ STS_USC_CAL_VER_MINOR : 40|16@1+ (1,0) [0|65535] ""  ADAS
 SG_ STS_USC_SECTION_COMPTBLITY : 56|16@1+ (1,0) [0|255] ""  ADAS
 SG_ STS_SMC_CAL_VER_MAJOR : 72|16@1+ (1,0) [0|65535] ""  ADAS
 SG_ STS_SMC_CAL_VER_MINOR : 88|16@1+ (1,0) [0|65535] ""  ADAS
 SG_ STS_SMC_SECTION_COMPTBLITY : 480|16@1+ (1,0) [0|65535] ""  ADAS
 SG_ STS_SMC_PLATFROM_VERSION : 104|8@1+ (1,0) [0|65535] ""  ADAS
 SG_ STS_SENSOR_MOUNT_POS_X : 280|16@1- (0.0001,0) [-3.2768|3.2767] "m"  ADAS,External_Tool
 SG_ STS_SENSOR_MOUNT_POS_Y : 296|16@1- (0.0001,0) [-3.2768|3.2767] "m"  ADAS,External_Tool
 SG_ STS_SENSOR_MOUNT_POS_Z : 312|16@1- (0.0001,0) [-3.2768|3.2767] "m"  ADAS,External_Tool
 SG_ STS_SENSOR_MOUNT_ORNT_YAW : 232|13@1+ (0.0004,-1.5708) [-1.5708|1.7056] "rad"  ADAS,External_Tool
 SG_ STS_SENSOR_MOUNT_ORNT_PITCH : 251|13@1+ (0.0004,-1.5708) [-1.5708|1.7056] "rad"  ADAS,External_Tool
 SG_ STS_SENSOR_MOUNT_ORNT_ROLL : 267|13@1+ (0.0004,-1.5708) [-1.5708|1.7056] "rad"  ADAS,External_Tool
 SG_ STS_SENSOR_MOUNT_LOCATION : 328|4@1+ (1,0) [0|15] ""  ADAS,External_Tool
 SG_ STS_SENSOR_HEIGHT : 336|32@1+ (0.01,0) [0|42949672.95] "m"  ADAS,External_Tool
 SG_ STS_DET_DBC_BASE_VER_MINOR : 376|8@1+ (1,0) [0|255] ""  ADAS
 SG_ STS_DET_DBC_BASE_VER_MAJOR : 368|8@1+ (1,0) [0|255] ""  ADAS
 SG_ STS_TIME_SINCE_POWER_ON : 384|32@1+ (1,0) [0|4294967295] "s"  ADAS
 SG_ STS_SENSOR_POSITION : 116|4@1+ (1,0) [0|15] ""  ADAS
 SG_ STS_MH_001_CRC16 : 0|16@1+ (1,0) [0|65535] ""  ADAS
 SG_ STS_MH_001_CYCLE_COUNTER : 16|8@1+ (1,0) [0|255] ""  ADAS

BO_ 188 RDR_STATUS_002: 64 RDR08
 SG_ STS_MMIC_TEMP_TX0 : 160|8@1+ (1,-50) [-50|205] "C"  ADAS
 SG_ STS_VEHICLE_SUPPLY_VOLTAGE : 24|4@1+ (1,0) [0|15] "" Vector__XXX
 SG_ STS_MH_002_CYCLE_COUNTER : 16|8@1+ (1,0) [0|255] ""  ADAS
 SG_ STS_MH_002_CRC16 : 0|16@1+ (1,0) [0|65535] ""  ADAS
 SG_ STS_POINT_OF_TRIGGER : 48|10@1+ (0.1,0) [0|102.3] "ms"  ADAS
 SG_ STS_NO_TSYN_ERROR : 40|1@1+ (1,0) [0|1] ""  ADAS
 SG_ STS_BRR_STATUS : 41|2@1+ (1,0) [0|2] ""  ADAS
 SG_ STS_MMIC_TEMP_RX : 136|8@1+ (1,-50) [-50|205] "C"  ADAS
 SG_ STS_MMIC_RE_INIT_COUNT : 44|4@1+ (1,0) [0|15] "NA"  ADAS
 SG_ STS_MCU_TEMP : 80|8@1+ (1,-50) [-50|205] "C"  ADAS
 SG_ STS_MMIC_TEMP_TX3_4 : 72|8@1+ (1,-50) [-50|205] "C"  ADAS
 SG_ STS_MMIC_TEMP_TX1_2 : 64|8@1+ (1,-50) [-50|205] "C"  ADAS
 SG_ STS_RDD_CORE_THROUGHPUT : 128|6@1+ (1.588,0) [0|100] "%"  ADAS
 SG_ STS_AF_CORE_THROUGHPUT : 120|6@1+ (1.588,0) [0|100] "%"  ADAS
 SG_ STS_SCAN_TYPE : 58|1@1+ (1,0) [0|0] ""  ADAS
 SG_ STS_XCVR_OPERATIONAL : 43|1@1+ (1,0) [0|0] ""  ADAS
 SG_ STS_YAW_RATE_BIAS : 28|4@1+ (0.025,0) [0|0.375] "rad/s"  ADAS
 SG_ STS_CORE_ACTIVE_FAULTS : 88|32@1+ (1,0) [0|4294967295] ""  ADAS
 SG_ STS_VEH_SPEED_DIRECTION : 169|1@1+ (1,0) [0|0] ""  ADAS
 SG_ STS_STEERING_ANGLE_SIGN : 168|1@1+ (1,0) [0|1] ""  ADAS
 SG_ STS_STEERING_ANGLE : 32|8@1+ (0.0174533,0) [0|3.141599] "rad"  ADAS
 SG_ STS_VEHICLE_SPEED_CALC : 170|14@1+ (0.01,0) [0|163.83] "m/s"  ADAS
 SG_ STS_TIME_SYNC_OFFSET : 144|16@1- (1,0) [-32768|32767] "us"  ADAS

BO_ 184 RDR_HEADER_001: 64 RDR08
 SG_ HED_V_WRAPPING : 221|11@1+ (0.01,-40) [-40|-19.53] "mps"  ADAS
 SG_ HED_R_WRAPPING : 384|8@1+ (0.01,-0.9) [-0.9|1.65] "m"  ADAS
 SG_ HED_Auth_CRC32 : 392|32@1+ (1,0) [0|4294967295] ""  ADAS
 SG_ HED_SLOPE_CORR_EXECUTIONFLAG : 196|2@1+ (1,0) [0|3] ""  ADAS
 SG_ HED_PROCESSED_RANGE : 184|9@1+ (1,0) [0|500] ""  ADAS
 SG_ HED_LOOK_INDEX : 232|16@1+ (1,0) [0|65535] ""  ADAS
 SG_ HED_OPERATION_MODE : 371|3@1+ (1,0) [0|5] "" Vector__XXX
 SG_ HED_MAX_NUM_OF_DETECTIONS : 374|9@1+ (1,0) [0|400] "" Vector__XXX
 SG_ HED_NUM_OF_RESTBINS_USED : 48|9@1+ (1,0) [0|511] ""  ADAS
 SG_ HED_NUM_OF_VALID_DETECTIONS : 57|9@1+ (1,0) [0|500] ""  ADAS
 SG_ HED_INTRFC_VERSION_ID_MAJOR : 24|8@1+ (1,0) [0|255] ""  ADAS
 SG_ HED_INTRFC_VERSION_ID_MINOR : 32|8@1+ (1,0) [0|255] ""  ADAS
 SG_ HED_INTRFC_VERSION_ID_PATCH : 40|8@1+ (1,0) [0|255] ""  ADAS
 SG_ HED_LOOK_ID : 66|2@1+ (1,0) [0|3] ""  ADAS
 SG_ HED_SCAN_INDEX : 72|16@1+ (1,0) [0|65535] ""  ADAS
 SG_ HED_MH_CYCLE_COUNTER : 16|8@1+ (1,0) [0|255] ""  ADAS
 SG_ HED_DATA_QUALIFIER : 68|3@1+ (1,0) [0|7] ""  ADAS
 SG_ HED_DET_RANGE_MAX : 88|16@1+ (0.01,0) [0|500] "m"  ADAS
 SG_ HED_DET_SPEED_RANGE_MAX : 120|16@1+ (0.00390625,-128) [-128|127.99609375] "m/s"  ADAS
 SG_ HED_FOV_HOR_MAX : 160|8@1+ (0.0174533,0) [0|3.14159] "rad"  ADAS
 SG_ HED_FOV_VER_MAX : 176|8@1+ (0.0174533,0) [0|3.14159] "rad"  ADAS
 SG_ HED_DET_RANGE_MIN : 104|16@1+ (0.01,0) [0|500] "m"  ADAS
 SG_ HED_DET_SPEED_RANGE_MIN : 136|16@1+ (0.00390625,-128) [-128|127.99609375] "m/s"  ADAS
 SG_ HED_FOV_HOR_MIN : 152|8@1- (0.0174533,0) [-2.2340224|2.2165691] "rad"  ADAS
 SG_ HED_FOV_VER_MIN : 168|8@1- (0.0174533,0) [-2.2340224|2.2165691] "rad"  ADAS
 SG_ HED_ALIGN_VER_REF : 198|10@1+ (0.0005,-0.1745) [-0.1745|0.337] "rad"  ADAS,External_Tool
 SG_ HED_ALIGN_HOR_REF : 208|13@1+ (0.0005,-0.1745) [-0.1745|3.921] "rad"  ADAS,External_Tool
 SG_ HED_SENSOR_TIME_STAMP_NS : 248|32@1+ (1,0) [0|4294967295] "ns"  ADAS
 SG_ HED_SENSOR_TIME_STAMP_SEC : 280|32@1+ (1,0) [0|4294967295] "s"  ADAS
 SG_ HED_TIME_SYNC_SRC_MASTER : 193|1@1+ (1,0) [0|1] ""  ADAS
 SG_ HED_TIME_SYNC_VALIDITY_FLAG : 194|2@1+ (1,0) [0|2] ""  ADAS
 SG_ HED_MH_CRC16 : 0|16@1+ (1,0) [0|65535] ""  ADAS
 SG_ HED_DET_NUM_OF_1PASS : 320|10@1+ (1,0) [0|1023] ""  ADAS
 SG_ HED_DET_NUM_OF_2PASS : 330|9@1+ (1,0) [0|511] ""  ADAS
 SG_ HED_TRIGGER_TIME : 339|32@1+ (1,0) [0|4294967295] "ns"  ADAS
 SG_ HED_DET_BI_STATIC_COUNT : 312|8@1+ (1,0) [0|255] ""  ADAS

BO_ 1791 SYS_DIAG_REQ_FUNC: 64 ADAS
 SG_ Diag_Req_Func : 7|64@0+ (1,0) [0|0] ""  RDR08

BO_ 72 RDR_XCP_CTO_REQ: 64 External_Tool
 SG_ STS_XCP_REQ_CTO_Byte1 : 15|8@0+ (1,0) [0|0] ""  RDR08
 SG_ STS_XCP_REQ_CTO_Byte2 : 23|8@0+ (1,0) [0|0] ""  RDR08
 SG_ STS_XCP_REQ_CTO_Byte3 : 31|8@0+ (1,0) [0|0] ""  RDR08
 SG_ STS_XCP_REQ_CTO_Byte4 : 39|8@0+ (1,0) [0|0] ""  RDR08
 SG_ STS_XCP_REQ_CTO_Byte5 : 47|8@0+ (1,0) [0|0] ""  RDR08
 SG_ STS_XCP_REQ_CTO_Byte6 : 55|8@0+ (1,0) [0|0] ""  RDR08
 SG_ STS_XCP_REQ_CTO_Byte7 : 63|8@0+ (1,0) [0|0] ""  RDR08
 SG_ STS_XCP_REQ_CTO_Byte8 : 71|8@0+ (1,0) [0|0] ""  RDR08
 SG_ STS_XCP_REQ_CTO_Byte9 : 79|8@0+ (1,0) [0|0] ""  RDR08
 SG_ STS_XCP_REQ_CTO_Byte10 : 87|8@0+ (1,0) [0|0] ""  RDR08
 SG_ STS_XCP_REQ_CTO_Byte11 : 95|8@0+ (1,0) [0|0] ""  RDR08
 SG_ STS_XCP_REQ_CTO_Byte12 : 103|8@0+ (1,0) [0|0] ""  RDR08
 SG_ STS_XCP_REQ_CTO_Byte13 : 111|8@0+ (1,0) [0|0] ""  RDR08
 SG_ STS_XCP_REQ_CTO_Byte14 : 119|8@0+ (1,0) [0|0] ""  RDR08
 SG_ STS_XCP_REQ_CTO_Byte15 : 127|8@0+ (1,0) [0|0] ""  RDR08
 SG_ STS_XCP_REQ_CTO_Byte16 : 135|8@0+ (1,0) [0|0] ""  RDR08
 SG_ STS_XCP_REQ_CTO_Byte17 : 143|8@0+ (1,0) [0|0] ""  RDR08
 SG_ STS_XCP_REQ_CTO_Byte18 : 151|8@0+ (1,0) [0|0] ""  RDR08
 SG_ STS_XCP_REQ_CTO_Byte19 : 159|8@0+ (1,0) [0|0] ""  RDR08
 SG_ STS_XCP_REQ_CTO_Byte20 : 167|8@0+ (1,0) [0|0] ""  RDR08
 SG_ STS_XCP_REQ_CTO_Byte21 : 175|8@0+ (1,0) [0|0] ""  RDR08
 SG_ STS_XCP_REQ_CTO_Byte22 : 183|8@0+ (1,0) [0|0] ""  RDR08
 SG_ STS_XCP_REQ_CTO_Byte23 : 191|8@0+ (1,0) [0|0] ""  RDR08
 SG_ STS_XCP_REQ_CTO_Byte24 : 199|8@0+ (1,0) [0|0] ""  RDR08
 SG_ STS_XCP_REQ_CTO_Byte25 : 207|8@0+ (1,0) [0|0] ""  RDR08
 SG_ STS_XCP_REQ_CTO_Byte26 : 215|8@0+ (1,0) [0|0] ""  RDR08
 SG_ STS_XCP_REQ_CTO_Byte27 : 223|8@0+ (1,0) [0|0] ""  RDR08
 SG_ STS_XCP_REQ_CTO_Byte28 : 231|8@0+ (1,0) [0|0] ""  RDR08
 SG_ STS_XCP_REQ_CTO_Byte29 : 239|8@0+ (1,0) [0|0] ""  RDR08
 SG_ STS_XCP_REQ_CTO_Byte30 : 247|8@0+ (1,0) [0|0] ""  RDR08
 SG_ STS_XCP_REQ_CTO_Byte31 : 255|8@0+ (1,0) [0|0] ""  RDR08
 SG_ STS_XCP_REQ_CTO_Byte32 : 263|8@0+ (1,0) [0|0] ""  RDR08
 SG_ STS_XCP_REQ_CTO_Byte33 : 271|8@0+ (1,0) [0|0] ""  RDR08
 SG_ STS_XCP_REQ_CTO_Byte34 : 279|8@0+ (1,0) [0|0] ""  RDR08
 SG_ STS_XCP_REQ_CTO_Byte35 : 287|8@0+ (1,0) [0|0] ""  RDR08
 SG_ STS_XCP_REQ_CTO_Byte36 : 295|8@0+ (1,0) [0|0] ""  RDR08
 SG_ STS_XCP_REQ_CTO_Byte37 : 303|8@0+ (1,0) [0|0] ""  RDR08
 SG_ STS_XCP_REQ_CTO_Byte38 : 311|8@0+ (1,0) [0|0] ""  RDR08
 SG_ STS_XCP_REQ_CTO_Byte39 : 319|8@0+ (1,0) [0|0] ""  RDR08
 SG_ STS_XCP_REQ_CTO_Byte40 : 327|8@0+ (1,0) [0|0] ""  RDR08
 SG_ STS_XCP_REQ_CTO_Byte41 : 335|8@0+ (1,0) [0|0] ""  RDR08
 SG_ STS_XCP_REQ_CTO_Byte42 : 343|8@0+ (1,0) [0|0] ""  RDR08
 SG_ STS_XCP_REQ_CTO_Byte43 : 351|8@0+ (1,0) [0|0] ""  RDR08
 SG_ STS_XCP_REQ_CTO_Byte44 : 359|8@0+ (1,0) [0|0] ""  RDR08
 SG_ STS_XCP_REQ_CTO_Byte45 : 367|8@0+ (1,0) [0|0] ""  RDR08
 SG_ STS_XCP_REQ_CTO_Byte46 : 375|8@0+ (1,0) [0|0] ""  RDR08
 SG_ STS_XCP_REQ_CTO_Byte47 : 383|8@0+ (1,0) [0|0] ""  RDR08
 SG_ STS_XCP_REQ_CTO_Byte48 : 391|8@0+ (1,0) [0|0] ""  RDR08
 SG_ STS_XCP_REQ_CTO_Byte49 : 399|8@0+ (1,0) [0|0] ""  RDR08
 SG_ STS_XCP_REQ_CTO_Byte50 : 407|8@0+ (1,0) [0|0] ""  RDR08
 SG_ STS_XCP_REQ_CTO_Byte51 : 415|8@0+ (1,0) [0|0] ""  RDR08
 SG_ STS_XCP_REQ_CTO_Byte52 : 423|8@0+ (1,0) [0|0] ""  RDR08
 SG_ STS_XCP_REQ_CTO_Byte53 : 431|8@0+ (1,0) [0|0] ""  RDR08
 SG_ STS_XCP_REQ_CTO_Byte54 : 439|8@0+ (1,0) [0|0] ""  RDR08
 SG_ STS_XCP_REQ_CTO_Byte55 : 447|8@0+ (1,0) [0|0] ""  RDR08
 SG_ STS_XCP_REQ_CTO_Byte56 : 455|8@0+ (1,0) [0|0] ""  RDR08
 SG_ STS_XCP_REQ_CTO_Byte57 : 463|8@0+ (1,0) [0|0] ""  RDR08
 SG_ STS_XCP_REQ_CTO_Byte58 : 471|8@0+ (1,0) [0|0] ""  RDR08
 SG_ STS_XCP_REQ_CTO_Byte59 : 479|8@0+ (1,0) [0|0] ""  RDR08
 SG_ STS_XCP_REQ_CTO_Byte60 : 487|8@0+ (1,0) [0|0] ""  RDR08
 SG_ STS_XCP_REQ_CTO_Byte61 : 495|8@0+ (1,0) [0|0] ""  RDR08
 SG_ STS_XCP_REQ_CTO_Byte62 : 503|8@0+ (1,0) [0|0] ""  RDR08
 SG_ STS_XCP_REQ_CTO_Byte63 : 511|8@0+ (1,0) [0|0] ""  RDR08
 SG_ STS_PID : 7|8@0+ (1,0) [0|0] ""  RDR08

BO_ 73 RDR_XCP_CTO_RESP: 64 RDR08
 SG_ STS_XCP_RES_CTO_Byte0 : 7|8@0+ (1,0) [0|0] ""  External_Tool
 SG_ STS_XCP_RES_CTO_Byte1 : 15|8@0+ (1,0) [0|0] ""  External_Tool
 SG_ STS_XCP_RES_CTO_Byte2 : 23|8@0+ (1,0) [0|0] ""  External_Tool
 SG_ STS_XCP_RES_CTO_Byte3 : 31|8@0+ (1,0) [0|0] ""  External_Tool
 SG_ STS_XCP_RES_CTO_Byte4 : 39|8@0+ (1,0) [0|0] ""  External_Tool
 SG_ STS_XCP_RES_CTO_Byte5 : 47|8@0+ (1,0) [0|0] ""  External_Tool
 SG_ STS_XCP_RES_CTO_Byte6 : 55|8@0+ (1,0) [0|0] ""  External_Tool
 SG_ STS_XCP_RES_CTO_Byte7 : 63|8@0+ (1,0) [0|0] ""  External_Tool
 SG_ STS_XCP_RES_CTO_Byte8 : 71|8@0+ (1,0) [0|0] ""  External_Tool
 SG_ STS_XCP_RES_CTO_Byte9 : 79|8@0+ (1,0) [0|0] ""  External_Tool
 SG_ STS_XCP_RES_CTO_Byte10 : 87|8@0+ (1,0) [0|0] ""  External_Tool
 SG_ STS_XCP_RES_CTO_Byte11 : 95|8@0+ (1,0) [0|0] ""  External_Tool
 SG_ STS_XCP_RES_CTO_Byte12 : 103|8@0+ (1,0) [0|0] ""  External_Tool
 SG_ STS_XCP_RES_CTO_Byte13 : 111|8@0+ (1,0) [0|0] ""  External_Tool
 SG_ STS_XCP_RES_CTO_Byte14 : 119|8@0+ (1,0) [0|0] ""  External_Tool
 SG_ STS_XCP_RES_CTO_Byte15 : 127|8@0+ (1,0) [0|0] ""  External_Tool
 SG_ STS_XCP_RES_CTO_Byte16 : 135|8@0+ (1,0) [0|0] ""  External_Tool
 SG_ STS_XCP_RES_CTO_Byte17 : 143|8@0+ (1,0) [0|0] ""  External_Tool
 SG_ STS_XCP_RES_CTO_Byte18 : 151|8@0+ (1,0) [0|0] ""  External_Tool
 SG_ STS_XCP_RES_CTO_Byte19 : 159|8@0+ (1,0) [0|0] ""  External_Tool
 SG_ STS_XCP_RES_CTO_Byte20 : 167|8@0+ (1,0) [0|0] ""  External_Tool
 SG_ STS_XCP_RES_CTO_Byte21 : 175|8@0+ (1,0) [0|0] ""  External_Tool
 SG_ STS_XCP_RES_CTO_Byte22 : 183|8@0+ (1,0) [0|0] ""  External_Tool
 SG_ STS_XCP_RES_CTO_Byte23 : 191|8@0+ (1,0) [0|0] ""  External_Tool
 SG_ STS_XCP_RES_CTO_Byte24 : 199|8@0+ (1,0) [0|0] ""  External_Tool
 SG_ STS_XCP_RES_CTO_Byte25 : 207|8@0+ (1,0) [0|0] ""  External_Tool
 SG_ STS_XCP_RES_CTO_Byte26 : 215|8@0+ (1,0) [0|0] ""  External_Tool
 SG_ STS_XCP_RES_CTO_Byte27 : 223|8@0+ (1,0) [0|0] ""  External_Tool
 SG_ STS_XCP_RES_CTO_Byte28 : 231|8@0+ (1,0) [0|0] ""  External_Tool
 SG_ STS_XCP_RES_CTO_Byte29 : 239|8@0+ (1,0) [0|0] ""  External_Tool
 SG_ STS_XCP_RES_CTO_Byte30 : 247|8@0+ (1,0) [0|0] ""  External_Tool
 SG_ STS_XCP_RES_CTO_Byte31 : 255|8@0+ (1,0) [0|0] ""  External_Tool
 SG_ STS_XCP_RES_CTO_Byte32 : 263|8@0+ (1,0) [0|0] ""  External_Tool
 SG_ STS_XCP_RES_CTO_Byte33 : 271|8@0+ (1,0) [0|0] ""  External_Tool
 SG_ STS_XCP_RES_CTO_Byte34 : 279|8@0+ (1,0) [0|0] ""  External_Tool
 SG_ STS_XCP_RES_CTO_Byte35 : 287|8@0+ (1,0) [0|0] ""  External_Tool
 SG_ STS_XCP_RES_CTO_Byte36 : 295|8@0+ (1,0) [0|0] ""  External_Tool
 SG_ STS_XCP_RES_CTO_Byte37 : 303|8@0+ (1,0) [0|0] ""  External_Tool
 SG_ STS_XCP_RES_CTO_Byte38 : 311|8@0+ (1,0) [0|0] ""  External_Tool
 SG_ STS_XCP_RES_CTO_Byte39 : 319|8@0+ (1,0) [0|0] ""  External_Tool
 SG_ STS_XCP_RES_CTO_Byte40 : 327|8@0+ (1,0) [0|0] ""  External_Tool
 SG_ STS_XCP_RES_CTO_Byte41 : 335|8@0+ (1,0) [0|0] ""  External_Tool
 SG_ STS_XCP_RES_CTO_Byte42 : 343|8@0+ (1,0) [0|0] ""  External_Tool
 SG_ STS_XCP_RES_CTO_Byte43 : 351|8@0+ (1,0) [0|0] ""  External_Tool
 SG_ STS_XCP_RES_CTO_Byte44 : 359|8@0+ (1,0) [0|0] ""  External_Tool
 SG_ STS_XCP_RES_CTO_Byte45 : 367|8@0+ (1,0) [0|0] ""  External_Tool
 SG_ STS_XCP_RES_CTO_Byte46 : 375|8@0+ (1,0) [0|0] ""  External_Tool
 SG_ STS_XCP_RES_CTO_Byte47 : 383|8@0+ (1,0) [0|0] ""  External_Tool
 SG_ STS_XCP_RES_CTO_Byte48 : 391|8@0+ (1,0) [0|0] ""  External_Tool
 SG_ STS_XCP_RES_CTO_Byte49 : 399|8@0+ (1,0) [0|0] ""  External_Tool
 SG_ STS_XCP_RES_CTO_Byte50 : 407|8@0+ (1,0) [0|0] ""  External_Tool
 SG_ STS_XCP_RES_CTO_Byte51 : 415|8@0+ (1,0) [0|0] ""  External_Tool
 SG_ STS_XCP_RES_CTO_Byte52 : 423|8@0+ (1,0) [0|0] ""  External_Tool
 SG_ STS_XCP_RES_CTO_Byte53 : 431|8@0+ (1,0) [0|0] ""  External_Tool
 SG_ STS_XCP_RES_CTO_Byte54 : 439|8@0+ (1,0) [0|0] ""  External_Tool
 SG_ STS_XCP_RES_CTO_Byte55 : 447|8@0+ (1,0) [0|0] ""  External_Tool
 SG_ STS_XCP_RES_CTO_Byte56 : 455|8@0+ (1,0) [0|0] ""  External_Tool
 SG_ STS_XCP_RES_CTO_Byte57 : 463|8@0+ (1,0) [0|0] ""  External_Tool
 SG_ STS_XCP_RES_CTO_Byte58 : 471|8@0+ (1,0) [0|0] ""  External_Tool
 SG_ STS_XCP_RES_CTO_Byte59 : 479|8@0+ (1,0) [0|0] ""  External_Tool
 SG_ STS_XCP_RES_CTO_Byte60 : 487|8@0+ (1,0) [0|0] ""  External_Tool
 SG_ STS_XCP_RES_CTO_Byte61 : 495|8@0+ (1,0) [0|0] ""  External_Tool
 SG_ STS_XCP_RES_CTO_Byte62 : 503|8@0+ (1,0) [0|0] ""  External_Tool
 SG_ STS_XCP_RES_CTO_Byte63 : 511|8@0+ (1,0) [0|0] ""  External_Tool

BO_ 74 RDR_XCP_DAQ_RESP: 64 RDR08
 SG_ STS_XCP_RES_DAQ_Byte0 : 7|8@0+ (1,0) [0|0] ""  External_Tool
 SG_ STS_XCP_RES_DAQ_Byte1 : 15|8@0+ (1,0) [0|0] ""  External_Tool
 SG_ STS_XCP_RES_DAQ_Byte2 : 23|8@0+ (1,0) [0|0] ""  External_Tool
 SG_ STS_XCP_RES_DAQ_Byte3 : 31|8@0+ (1,0) [0|0] ""  External_Tool
 SG_ STS_XCP_RES_DAQ_Byte4 : 39|8@0+ (1,0) [0|0] ""  External_Tool
 SG_ STS_XCP_RES_DAQ_Byte5 : 47|8@0+ (1,0) [0|0] ""  External_Tool
 SG_ STS_XCP_RES_DAQ_Byte6 : 55|8@0+ (1,0) [0|0] ""  External_Tool
 SG_ STS_XCP_RES_DAQ_Byte7 : 63|8@0+ (1,0) [0|0] ""  External_Tool
 SG_ STS_XCP_RES_DAQ_Byte8 : 71|8@0+ (1,0) [0|0] ""  External_Tool
 SG_ STS_XCP_RES_DAQ_Byte9 : 79|8@0+ (1,0) [0|0] ""  External_Tool
 SG_ STS_XCP_RES_DAQ_Byte10 : 87|8@0+ (1,0) [0|0] ""  External_Tool
 SG_ STS_XCP_RES_DAQ_Byte11 : 95|8@0+ (1,0) [0|0] ""  External_Tool
 SG_ STS_XCP_RES_DAQ_Byte12 : 103|8@0+ (1,0) [0|0] ""  External_Tool
 SG_ STS_XCP_RES_DAQ_Byte13 : 111|8@0+ (1,0) [0|0] ""  External_Tool
 SG_ STS_XCP_RES_DAQ_Byte14 : 119|8@0+ (1,0) [0|0] ""  External_Tool
 SG_ STS_XCP_RES_DAQ_Byte15 : 127|8@0+ (1,0) [0|0] ""  External_Tool
 SG_ STS_XCP_RES_DAQ_Byte16 : 135|8@0+ (1,0) [0|0] ""  External_Tool
 SG_ STS_XCP_RES_DAQ_Byte17 : 143|8@0+ (1,0) [0|0] ""  External_Tool
 SG_ STS_XCP_RES_DAQ_Byte18 : 151|8@0+ (1,0) [0|0] ""  External_Tool
 SG_ STS_XCP_RES_DAQ_Byte19 : 159|8@0+ (1,0) [0|0] ""  External_Tool
 SG_ STS_XCP_RES_DAQ_Byte20 : 167|8@0+ (1,0) [0|0] ""  External_Tool
 SG_ STS_XCP_RES_DAQ_Byte21 : 175|8@0+ (1,0) [0|0] ""  External_Tool
 SG_ STS_XCP_RES_DAQ_Byte22 : 183|8@0+ (1,0) [0|0] ""  External_Tool
 SG_ STS_XCP_RES_DAQ_Byte23 : 191|8@0+ (1,0) [0|0] ""  External_Tool
 SG_ STS_XCP_RES_DAQ_Byte24 : 199|8@0+ (1,0) [0|0] ""  External_Tool
 SG_ STS_XCP_RES_DAQ_Byte25 : 207|8@0+ (1,0) [0|0] ""  External_Tool
 SG_ STS_XCP_RES_DAQ_Byte26 : 215|8@0+ (1,0) [0|0] ""  External_Tool
 SG_ STS_XCP_RES_DAQ_Byte27 : 223|8@0+ (1,0) [0|0] ""  External_Tool
 SG_ STS_XCP_RES_DAQ_Byte28 : 231|8@0+ (1,0) [0|0] ""  External_Tool
 SG_ STS_XCP_RES_DAQ_Byte29 : 239|8@0+ (1,0) [0|0] ""  External_Tool
 SG_ STS_XCP_RES_DAQ_Byte30 : 247|8@0+ (1,0) [0|0] ""  External_Tool
 SG_ STS_XCP_RES_DAQ_Byte31 : 255|8@0+ (1,0) [0|0] ""  External_Tool
 SG_ STS_XCP_RES_DAQ_Byte32 : 263|8@0+ (1,0) [0|0] ""  External_Tool
 SG_ STS_XCP_RES_DAQ_Byte33 : 271|8@0+ (1,0) [0|0] ""  External_Tool
 SG_ STS_XCP_RES_DAQ_Byte34 : 279|8@0+ (1,0) [0|0] ""  External_Tool
 SG_ STS_XCP_RES_DAQ_Byte35 : 287|8@0+ (1,0) [0|0] ""  External_Tool
 SG_ STS_XCP_RES_DAQ_Byte36 : 295|8@0+ (1,0) [0|0] ""  External_Tool
 SG_ STS_XCP_RES_DAQ_Byte37 : 303|8@0+ (1,0) [0|0] ""  External_Tool
 SG_ STS_XCP_RES_DAQ_Byte38 : 311|8@0+ (1,0) [0|0] ""  External_Tool
 SG_ STS_XCP_RES_DAQ_Byte39 : 319|8@0+ (1,0) [0|0] ""  External_Tool
 SG_ STS_XCP_RES_DAQ_Byte40 : 327|8@0+ (1,0) [0|0] ""  External_Tool
 SG_ STS_XCP_RES_DAQ_Byte41 : 335|8@0+ (1,0) [0|0] ""  External_Tool
 SG_ STS_XCP_RES_DAQ_Byte42 : 343|8@0+ (1,0) [0|0] ""  External_Tool
 SG_ STS_XCP_RES_DAQ_Byte43 : 351|8@0+ (1,0) [0|0] ""  External_Tool
 SG_ STS_XCP_RES_DAQ_Byte44 : 359|8@0+ (1,0) [0|0] ""  External_Tool
 SG_ STS_XCP_RES_DAQ_Byte45 : 367|8@0+ (1,0) [0|0] ""  External_Tool
 SG_ STS_XCP_RES_DAQ_Byte46 : 375|8@0+ (1,0) [0|0] ""  External_Tool
 SG_ STS_XCP_RES_DAQ_Byte47 : 383|8@0+ (1,0) [0|0] ""  External_Tool
 SG_ STS_XCP_RES_DAQ_Byte48 : 391|8@0+ (1,0) [0|0] ""  External_Tool
 SG_ STS_XCP_RES_DAQ_Byte49 : 399|8@0+ (1,0) [0|0] ""  External_Tool
 SG_ STS_XCP_RES_DAQ_Byte50 : 407|8@0+ (1,0) [0|0] ""  External_Tool
 SG_ STS_XCP_RES_DAQ_Byte51 : 415|8@0+ (1,0) [0|0] ""  External_Tool
 SG_ STS_XCP_RES_DAQ_Byte52 : 423|8@0+ (1,0) [0|0] ""  External_Tool
 SG_ STS_XCP_RES_DAQ_Byte53 : 431|8@0+ (1,0) [0|0] ""  External_Tool
 SG_ STS_XCP_RES_DAQ_Byte54 : 439|8@0+ (1,0) [0|0] ""  External_Tool
 SG_ STS_XCP_RES_DAQ_Byte55 : 447|8@0+ (1,0) [0|0] ""  External_Tool
 SG_ STS_XCP_RES_DAQ_Byte56 : 455|8@0+ (1,0) [0|0] ""  External_Tool
 SG_ STS_XCP_RES_DAQ_Byte57 : 463|8@0+ (1,0) [0|0] ""  External_Tool
 SG_ STS_XCP_RES_DAQ_Byte58 : 471|8@0+ (1,0) [0|0] ""  External_Tool
 SG_ STS_XCP_RES_DAQ_Byte59 : 479|8@0+ (1,0) [0|0] ""  External_Tool
 SG_ STS_XCP_RES_DAQ_Byte60 : 487|8@0+ (1,0) [0|0] ""  External_Tool
 SG_ STS_XCP_RES_DAQ_Byte61 : 495|8@0+ (1,0) [0|0] ""  External_Tool
 SG_ STS_XCP_RES_DAQ_Byte62 : 503|8@0+ (1,0) [0|0] ""  External_Tool
 SG_ STS_XCP_RES_DAQ_Byte63 : 511|8@0+ (1,0) [0|0] ""  External_Tool

BO_ 1153 RDR_DETECTION_005_008: 64 RDR08
 SG_ DET_RANGE_005 : 24|15@1+ (0.015625,0) [0|500] "m"  ADAS
 SG_ DET_RANGE_ERR_005 : 40|7@1+ (0.0075,0) [0|0.9525] "m"  ADAS
 SG_ DET_RANGE_VELOCITY_005 : 48|15@1+ (0.0078125,-128) [-128|127.9921875] "m/s"  ADAS
 SG_ DET_RANGE_VELOCITY_ERR_005 : 64|8@1+ (0.003,0) [0|0.765] "m/s"  ADAS
 SG_ DET_AZIMUTH_005 : 88|13@1+ (0.0004,-1.5708) [-1.5708|1.5708] "rad"  ADAS
 SG_ DET_AZIMUTH_ERR_005 : 105|7@1+ (0.00087267,0) [0|0.11082909] "rad"  ADAS
 SG_ DET_ELEVATION_005 : 72|8@1+ (0.00275,-0.34925) [-0.34925|0.34925] "rad"  ADAS
 SG_ DET_ELEVATION_ERR_005 : 80|6@1+ (0.00174533,0) [0|0.10995579] "rad"  ADAS
 SG_ DET_RCS_005 : 136|8@1+ (0.5,-64) [-64|63.5] "dBsm"  ADAS
 SG_ DET_VALID_FLAG_005 : 119|1@1+ (1,0) [0|1] ""  ADAS
 SG_ DET_BI_STATIC_FLAG_005 : 504|1@1+ (1,0) [0|1] ""  ADAS
 SG_ DET_SUPER_RES_TARGET_005 : 104|1@1+ (1,0) [0|1] ""  ADAS
 SG_ DET_SNR_005 : 128|8@1+ (0.35156,0) [0|89.6478] "dB"  ADAS
 SG_ DET_POINT_TARGET_PROB_005 : 114|4@1+ (6.67,0) [0|100] "%"  ADAS
 SG_ DET_EXISTENCE_PROB_005 : 120|6@1+ (1.588,0) [0|100] "%"  ADAS
 SG_ DET_OUTSIDE_SECTOR_005 : 159|1@1+ (1,0) [0|1] ""  ADAS
 SG_ DET_HVC_FLAG_005 : 118|1@1+ (1,0) [0|1] ""  ADAS
 SG_ DET_CONFD_AZIMUTH_005 : 126|2@1+ (1,0) [0|3] ""  ADAS
 SG_ DET_CONFD_ELEVATION_005 : 112|2@1+ (1,0) [0|3] ""  ADAS
 SG_ DET_RANGE_006 : 144|15@1+ (0.015625,0) [0|500] "m"  ADAS
 SG_ DET_RANGE_ERR_006 : 160|7@1+ (0.0075,0) [0|0.9525] "m"  ADAS
 SG_ DET_RANGE_VELOCITY_006 : 168|15@1+ (0.0078125,-128) [-128|127.9921875] "m/s"  ADAS
 SG_ DET_RANGE_VELOCITY_ERR_006 : 184|8@1+ (0.003,0) [0|0.765] "m/s"  ADAS
 SG_ DET_AZIMUTH_006 : 208|13@1+ (0.0004,-1.5708) [-1.5708|1.5708] "rad"  ADAS
 SG_ DET_AZIMUTH_ERR_006 : 224|7@1+ (0.00087267,0) [0|0.11082909] "rad"  ADAS
 SG_ DET_ELEVATION_006 : 192|8@1+ (0.00275,-0.34925) [-0.34925|0.34925] "rad"  ADAS
 SG_ DET_ELEVATION_ERR_006 : 200|6@1+ (0.00174533,0) [0|0.10995579] "rad"  ADAS
 SG_ DET_RCS_006 : 256|8@1+ (0.5,-64) [-64|63.5] "dBsm"  ADAS
 SG_ DET_VALID_FLAG_006 : 167|1@1+ (1,0) [0|1] ""  ADAS
 SG_ DET_BI_STATIC_FLAG_006 : 505|1@1+ (1,0) [0|1] ""  ADAS
 SG_ DET_SUPER_RES_TARGET_006 : 247|1@1+ (1,0) [0|1] ""  ADAS
 SG_ DET_SNR_006 : 248|8@1+ (0.35156,0) [0|89.6478] "dB"  ADAS
 SG_ DET_POINT_TARGET_PROB_006 : 240|4@1+ (6.67,0) [0|100] "%"  ADAS
 SG_ DET_EXISTENCE_PROB_006 : 232|6@1+ (1.588,0) [0|100] "%"  ADAS
 SG_ DET_OUTSIDE_SECTOR_006 : 183|1@1+ (1,0) [0|1] ""  ADAS
 SG_ DET_HVC_FLAG_006 : 246|1@1+ (1,0) [0|1] ""  ADAS
 SG_ DET_CONFD_AZIMUTH_006 : 206|2@1+ (1,0) [0|3] ""  ADAS
 SG_ DET_CONFD_ELEVATION_006 : 244|2@1+ (1,0) [0|3] ""  ADAS
 SG_ DET_RANGE_007 : 264|15@1+ (0.015625,0) [0|500] "m"  ADAS
 SG_ DET_RANGE_ERR_007 : 280|7@1+ (0.0075,0) [0|0.9525] "m"  ADAS
 SG_ DET_RANGE_VELOCITY_007 : 288|15@1+ (0.0078125,-128) [-128|127.9921875] "m/s"  ADAS
 SG_ DET_RANGE_VELOCITY_ERR_007 : 304|8@1+ (0.003,0) [0|0.765] "m/s"  ADAS
 SG_ DET_AZIMUTH_007 : 328|13@1+ (0.0004,-1.5708) [-1.5708|1.5708] "rad"  ADAS
 SG_ DET_AZIMUTH_ERR_007 : 345|7@1+ (0.00087267,0) [0|0.11082909] "rad"  ADAS
 SG_ DET_ELEVATION_007 : 312|8@1+ (0.00275,-0.34925) [-0.34925|0.34925] "rad"  ADAS
 SG_ DET_ELEVATION_ERR_007 : 320|6@1+ (0.00174533,0) [0|0.10995579] "rad"  ADAS
 SG_ DET_RCS_007 : 376|8@1+ (0.5,-64) [-64|63.5] "dBsm"  ADAS
 SG_ DET_VALID_FLAG_007 : 399|1@1+ (1,0) [0|1] ""  ADAS
 SG_ DET_BI_STATIC_FLAG_007 : 482|1@1+ (1,0) [0|1] ""  ADAS
 SG_ DET_SUPER_RES_TARGET_007 : 344|1@1+ (1,0) [0|1] ""  ADAS
 SG_ DET_SNR_007 : 368|8@1+ (0.35156,0) [0|89.6478] "dB"  ADAS
 SG_ DET_POINT_TARGET_PROB_007 : 360|4@1+ (6.67,0) [0|100] "%"  ADAS
 SG_ DET_EXISTENCE_PROB_007 : 352|6@1+ (1.588,0) [0|100] "%"  ADAS
 SG_ DET_OUTSIDE_SECTOR_007 : 407|1@1+ (1,0) [0|1] ""  ADAS
 SG_ DET_HVC_FLAG_007 : 364|1@1+ (1,0) [0|1] ""  ADAS
 SG_ DET_CONFD_AZIMUTH_007 : 365|2@1+ (1,0) [0|3] ""  ADAS
 SG_ DET_CONFD_ELEVATION_007 : 358|2@1+ (1,0) [0|3] ""  ADAS
 SG_ DET_RANGE_008 : 384|15@1+ (0.015625,0) [0|500] "m"  ADAS
 SG_ DET_RANGE_ERR_008 : 400|7@1+ (0.0075,0) [0|0.9525] "m"  ADAS
 SG_ DET_RANGE_VELOCITY_008 : 408|15@1+ (0.0078125,-128) [-128|127.9921875] "m/s"  ADAS
 SG_ DET_RANGE_VELOCITY_ERR_008 : 424|8@1+ (0.003,0) [0|0.765] "m/s"  ADAS
 SG_ DET_AZIMUTH_008 : 448|13@1+ (0.0004,-1.5708) [-1.5708|1.5708] "rad"  ADAS
 SG_ DET_AZIMUTH_ERR_008 : 465|7@1+ (0.00087267,0) [0|0.11082909] "rad"  ADAS
 SG_ DET_ELEVATION_008 : 432|8@1+ (0.00275,-0.34925) [-0.34925|0.34925] "rad"  ADAS
 SG_ DET_ELEVATION_ERR_008 : 440|6@1+ (0.00174533,0) [0|0.10995579] "rad"  ADAS
 SG_ DET_RCS_008 : 496|8@1+ (0.5,-64) [-64|63.5] "dBsm"  ADAS
 SG_ DET_VALID_FLAG_008 : 485|1@1+ (1,0) [0|1] ""  ADAS
 SG_ DET_BI_STATIC_FLAG_008 : 483|1@1+ (1,0) [0|1] ""  ADAS
 SG_ DET_SUPER_RES_TARGET_008 : 446|1@1+ (1,0) [0|1] ""  ADAS
 SG_ DET_SNR_008 : 488|8@1+ (0.35156,0) [0|89.6478] "dB"  ADAS
 SG_ DET_POINT_TARGET_PROB_008 : 472|4@1+ (6.67,0) [0|100] "%"  ADAS
 SG_ DET_EXISTENCE_PROB_008 : 506|6@1+ (1.588,0) [0|100] "%"  ADAS
 SG_ DET_OUTSIDE_SECTOR_008 : 481|1@1+ (1,0) [0|1] ""  ADAS
 SG_ DET_HVC_FLAG_008 : 464|1@1+ (1,0) [0|1] ""  ADAS
 SG_ DET_CONFD_AZIMUTH_008 : 486|2@1+ (1,0) [0|3] ""  ADAS
 SG_ DET_CONFD_ELEVATION_008 : 461|2@1+ (1,0) [0|3] ""  ADAS
 SG_ DET_MH_SCAN_INDEX_4LSB_005_008 : 476|4@1+ (1,0) [0|15] ""  ADAS
 SG_ DET_MH_CYCLE_COUNTER_005_008 : 16|8@1+ (1,0) [0|255] ""  ADAS
 SG_ DET_MH_CRC16_005_008 : 0|16@1+ (1,0) [0|65535] ""  ADAS

BO_ 1154 RDR_DETECTION_009_012: 64 RDR08
 SG_ DET_RANGE_009 : 24|15@1+ (0.015625,0) [0|500] "m"  ADAS
 SG_ DET_RANGE_ERR_009 : 40|7@1+ (0.0075,0) [0|0.9525] "m"  ADAS
 SG_ DET_RANGE_VELOCITY_009 : 48|15@1+ (0.0078125,-128) [-128|127.9921875] "m/s"  ADAS
 SG_ DET_RANGE_VELOCITY_ERR_009 : 64|8@1+ (0.003,0) [0|0.765] "m/s"  ADAS
 SG_ DET_AZIMUTH_009 : 88|13@1+ (0.0004,-1.5708) [-1.5708|1.5708] "rad"  ADAS
 SG_ DET_AZIMUTH_ERR_009 : 105|7@1+ (0.00087267,0) [0|0.11082909] "rad"  ADAS
 SG_ DET_ELEVATION_009 : 72|8@1+ (0.00275,-0.34925) [-0.34925|0.34925] "rad"  ADAS
 SG_ DET_ELEVATION_ERR_009 : 80|6@1+ (0.00174533,0) [0|0.10995579] "rad"  ADAS
 SG_ DET_RCS_009 : 136|8@1+ (0.5,-64) [-64|63.5] "dBsm"  ADAS
 SG_ DET_VALID_FLAG_009 : 119|1@1+ (1,0) [0|1] ""  ADAS
 SG_ DET_BI_STATIC_FLAG_009 : 504|1@1+ (1,0) [0|1] ""  ADAS
 SG_ DET_SUPER_RES_TARGET_009 : 104|1@1+ (1,0) [0|1] ""  ADAS
 SG_ DET_SNR_009 : 128|8@1+ (0.35156,0) [0|89.6478] "dB"  ADAS
 SG_ DET_POINT_TARGET_PROB_009 : 114|4@1+ (6.67,0) [0|100] "%"  ADAS
 SG_ DET_EXISTENCE_PROB_009 : 120|6@1+ (1.588,0) [0|100] "%"  ADAS
 SG_ DET_OUTSIDE_SECTOR_009 : 159|1@1+ (1,0) [0|1] ""  ADAS
 SG_ DET_HVC_FLAG_009 : 118|1@1+ (1,0) [0|1] ""  ADAS
 SG_ DET_CONFD_AZIMUTH_009 : 126|2@1+ (1,0) [0|3] ""  ADAS
 SG_ DET_CONFD_ELEVATION_009 : 112|2@1+ (1,0) [0|3] ""  ADAS
 SG_ DET_RANGE_010 : 144|15@1+ (0.015625,0) [0|500] "m"  ADAS
 SG_ DET_RANGE_ERR_010 : 160|7@1+ (0.0075,0) [0|0.9525] "m"  ADAS
 SG_ DET_RANGE_VELOCITY_010 : 168|15@1+ (0.0078125,-128) [-128|127.9921875] "m/s"  ADAS
 SG_ DET_RANGE_VELOCITY_ERR_010 : 184|8@1+ (0.003,0) [0|0.765] "m/s"  ADAS
 SG_ DET_AZIMUTH_010 : 208|13@1+ (0.0004,-1.5708) [-1.5708|1.5708] "rad"  ADAS
 SG_ DET_AZIMUTH_ERR_010 : 224|7@1+ (0.00087267,0) [0|0.11082909] "rad"  ADAS
 SG_ DET_ELEVATION_010 : 192|8@1+ (0.00275,-0.34925) [-0.34925|0.34925] "rad"  ADAS
 SG_ DET_ELEVATION_ERR_010 : 200|6@1+ (0.00174533,0) [0|0.10995579] "rad"  ADAS
 SG_ DET_RCS_010 : 256|8@1+ (0.5,-64) [-64|63.5] "dBsm"  ADAS
 SG_ DET_VALID_FLAG_010 : 167|1@1+ (1,0) [0|1] ""  ADAS
 SG_ DET_BI_STATIC_FLAG_010 : 505|1@1+ (1,0) [0|1] ""  ADAS
 SG_ DET_SUPER_RES_TARGET_010 : 247|1@1+ (1,0) [0|1] ""  ADAS
 SG_ DET_SNR_010 : 248|8@1+ (0.35156,0) [0|89.6478] "dB"  ADAS
 SG_ DET_POINT_TARGET_PROB_010 : 240|4@1+ (6.67,0) [0|100] "%"  ADAS
 SG_ DET_EXISTENCE_PROB_010 : 232|6@1+ (1.588,0) [0|100] "%"  ADAS
 SG_ DET_OUTSIDE_SECTOR_010 : 183|1@1+ (1,0) [0|1] ""  ADAS
 SG_ DET_HVC_FLAG_010 : 246|1@1+ (1,0) [0|1] ""  ADAS
 SG_ DET_CONFD_AZIMUTH_010 : 206|2@1+ (1,0) [0|3] ""  ADAS
 SG_ DET_CONFD_ELEVATION_010 : 244|2@1+ (1,0) [0|3] ""  ADAS
 SG_ DET_RANGE_011 : 264|15@1+ (0.015625,0) [0|500] "m"  ADAS
 SG_ DET_RANGE_ERR_011 : 280|7@1+ (0.0075,0) [0|0.9525] "m"  ADAS
 SG_ DET_RANGE_VELOCITY_011 : 288|15@1+ (0.0078125,-128) [-128|127.9921875] "m/s"  ADAS
 SG_ DET_RANGE_VELOCITY_ERR_011 : 304|8@1+ (0.003,0) [0|0.765] "m/s"  ADAS
 SG_ DET_AZIMUTH_011 : 328|13@1+ (0.0004,-1.5708) [-1.5708|1.5708] "rad"  ADAS
 SG_ DET_AZIMUTH_ERR_011 : 345|7@1+ (0.00087267,0) [0|0.11082909] "rad"  ADAS
 SG_ DET_ELEVATION_011 : 312|8@1+ (0.00275,-0.34925) [-0.34925|0.34925] "rad"  ADAS
 SG_ DET_ELEVATION_ERR_011 : 320|6@1+ (0.00174533,0) [0|0.10995579] "rad"  ADAS
 SG_ DET_RCS_011 : 376|8@1+ (0.5,-64) [-64|63.5] "dBsm"  ADAS
 SG_ DET_VALID_FLAG_011 : 399|1@1+ (1,0) [0|1] ""  ADAS
 SG_ DET_BI_STATIC_FLAG_011 : 482|1@1+ (1,0) [0|1] ""  ADAS
 SG_ DET_SUPER_RES_TARGET_011 : 344|1@1+ (1,0) [0|1] ""  ADAS
 SG_ DET_SNR_011 : 368|8@1+ (0.35156,0) [0|89.6478] "dB"  ADAS
 SG_ DET_POINT_TARGET_PROB_011 : 360|4@1+ (6.67,0) [0|100] "%"  ADAS
 SG_ DET_EXISTENCE_PROB_011 : 352|6@1+ (1.588,0) [0|100] "%"  ADAS
 SG_ DET_OUTSIDE_SECTOR_011 : 407|1@1+ (1,0) [0|1] ""  ADAS
 SG_ DET_HVC_FLAG_011 : 364|1@1+ (1,0) [0|1] ""  ADAS
 SG_ DET_CONFD_AZIMUTH_011 : 365|2@1+ (1,0) [0|3] ""  ADAS
 SG_ DET_CONFD_ELEVATION_011 : 358|2@1+ (1,0) [0|3] ""  ADAS
 SG_ DET_RANGE_012 : 384|15@1+ (0.015625,0) [0|500] "m"  ADAS
 SG_ DET_RANGE_ERR_012 : 400|7@1+ (0.0075,0) [0|0.9525] "m"  ADAS
 SG_ DET_RANGE_VELOCITY_012 : 408|15@1+ (0.0078125,-128) [-128|127.9921875] "m/s"  ADAS
 SG_ DET_RANGE_VELOCITY_ERR_012 : 424|8@1+ (0.003,0) [0|0.765] "m/s"  ADAS
 SG_ DET_AZIMUTH_012 : 448|13@1+ (0.0004,-1.5708) [-1.5708|1.5708] "rad"  ADAS
 SG_ DET_AZIMUTH_ERR_012 : 465|7@1+ (0.00087267,0) [0|0.11082909] "rad"  ADAS
 SG_ DET_ELEVATION_012 : 432|8@1+ (0.00275,-0.34925) [-0.34925|0.34925] "rad"  ADAS
 SG_ DET_ELEVATION_ERR_012 : 440|6@1+ (0.00174533,0) [0|0.10995579] "rad"  ADAS
 SG_ DET_RCS_012 : 496|8@1+ (0.5,-64) [-64|63.5] "dBsm"  ADAS
 SG_ DET_VALID_FLAG_012 : 485|1@1+ (1,0) [0|1] ""  ADAS
 SG_ DET_BI_STATIC_FLAG_012 : 483|1@1+ (1,0) [0|1] ""  ADAS
 SG_ DET_SUPER_RES_TARGET_012 : 446|1@1+ (1,0) [0|1] ""  ADAS
 SG_ DET_SNR_012 : 488|8@1+ (0.35156,0) [0|89.6478] "dB"  ADAS
 SG_ DET_POINT_TARGET_PROB_012 : 472|4@1+ (6.67,0) [0|100] "%"  ADAS
 SG_ DET_EXISTENCE_PROB_012 : 506|6@1+ (1.588,0) [0|100] "%"  ADAS
 SG_ DET_OUTSIDE_SECTOR_012 : 481|1@1+ (1,0) [0|1] ""  ADAS
 SG_ DET_HVC_FLAG_012 : 464|1@1+ (1,0) [0|1] ""  ADAS
 SG_ DET_CONFD_AZIMUTH_012 : 486|2@1+ (1,0) [0|3] ""  ADAS
 SG_ DET_CONFD_ELEVATION_012 : 461|2@1+ (1,0) [0|3] ""  ADAS
 SG_ DET_MH_SCAN_INDEX_4LSB_009_012 : 476|4@1+ (1,0) [0|15] ""  ADAS
 SG_ DET_MH_CYCLE_COUNTER_009_012 : 16|8@1+ (1,0) [0|255] ""  ADAS
 SG_ DET_MH_CRC16_009_012 : 0|16@1+ (1,0) [0|65535] ""  ADAS

BO_ 1155 RDR_DETECTION_013_016: 64 RDR08
 SG_ DET_RANGE_013 : 24|15@1+ (0.015625,0) [0|500] "m"  ADAS
 SG_ DET_RANGE_ERR_013 : 40|7@1+ (0.0075,0) [0|0.9525] "m"  ADAS
 SG_ DET_RANGE_VELOCITY_013 : 48|15@1+ (0.0078125,-128) [-128|127.9921875] "m/s"  ADAS
 SG_ DET_RANGE_VELOCITY_ERR_013 : 64|8@1+ (0.003,0) [0|0.765] "m/s"  ADAS
 SG_ DET_AZIMUTH_013 : 88|13@1+ (0.0004,-1.5708) [-1.5708|1.5708] "rad"  ADAS
 SG_ DET_AZIMUTH_ERR_013 : 105|7@1+ (0.00087267,0) [0|0.11082909] "rad"  ADAS
 SG_ DET_ELEVATION_013 : 72|8@1+ (0.00275,-0.34925) [-0.34925|0.34925] "rad"  ADAS
 SG_ DET_ELEVATION_ERR_013 : 80|6@1+ (0.00174533,0) [0|0.10995579] "rad"  ADAS
 SG_ DET_RCS_013 : 136|8@1+ (0.5,-64) [-64|63.5] "dBsm"  ADAS
 SG_ DET_VALID_FLAG_013 : 119|1@1+ (1,0) [0|1] ""  ADAS
 SG_ DET_BI_STATIC_FLAG_013 : 504|1@1+ (1,0) [0|1] ""  ADAS
 SG_ DET_SUPER_RES_TARGET_013 : 104|1@1+ (1,0) [0|1] ""  ADAS
 SG_ DET_SNR_013 : 128|8@1+ (0.35156,0) [0|89.6478] "dB"  ADAS
 SG_ DET_POINT_TARGET_PROB_013 : 114|4@1+ (6.67,0) [0|100] "%"  ADAS
 SG_ DET_EXISTENCE_PROB_013 : 120|6@1+ (1.588,0) [0|100] "%"  ADAS
 SG_ DET_OUTSIDE_SECTOR_013 : 159|1@1+ (1,0) [0|1] ""  ADAS
 SG_ DET_HVC_FLAG_013 : 118|1@1+ (1,0) [0|1] ""  ADAS
 SG_ DET_CONFD_AZIMUTH_013 : 126|2@1+ (1,0) [0|3] ""  ADAS
 SG_ DET_CONFD_ELEVATION_013 : 112|2@1+ (1,0) [0|3] ""  ADAS
 SG_ DET_RANGE_014 : 144|15@1+ (0.015625,0) [0|500] "m"  ADAS
 SG_ DET_RANGE_ERR_014 : 160|7@1+ (0.0075,0) [0|0.9525] "m"  ADAS
 SG_ DET_RANGE_VELOCITY_014 : 168|15@1+ (0.0078125,-128) [-128|127.9921875] "m/s"  ADAS
 SG_ DET_RANGE_VELOCITY_ERR_014 : 184|8@1+ (0.003,0) [0|0.765] "m/s"  ADAS
 SG_ DET_AZIMUTH_014 : 208|13@1+ (0.0004,-1.5708) [-1.5708|1.5708] "rad"  ADAS
 SG_ DET_AZIMUTH_ERR_014 : 224|7@1+ (0.00087267,0) [0|0.11082909] "rad"  ADAS
 SG_ DET_ELEVATION_014 : 192|8@1+ (0.00275,-0.34925) [-0.34925|0.34925] "rad"  ADAS
 SG_ DET_ELEVATION_ERR_014 : 200|6@1+ (0.00174533,0) [0|0.10995579] "rad"  ADAS
 SG_ DET_RCS_014 : 256|8@1+ (0.5,-64) [-64|63.5] "dBsm"  ADAS
 SG_ DET_VALID_FLAG_014 : 167|1@1+ (1,0) [0|1] ""  ADAS
 SG_ DET_BI_STATIC_FLAG_014 : 505|1@1+ (1,0) [0|1] ""  ADAS
 SG_ DET_SUPER_RES_TARGET_014 : 247|1@1+ (1,0) [0|1] ""  ADAS
 SG_ DET_SNR_014 : 248|8@1+ (0.35156,0) [0|89.6478] "dB"  ADAS
 SG_ DET_POINT_TARGET_PROB_014 : 240|4@1+ (6.67,0) [0|100] "%"  ADAS
 SG_ DET_EXISTENCE_PROB_014 : 232|6@1+ (1.588,0) [0|100] "%"  ADAS
 SG_ DET_OUTSIDE_SECTOR_014 : 183|1@1+ (1,0) [0|1] ""  ADAS
 SG_ DET_HVC_FLAG_014 : 246|1@1+ (1,0) [0|1] ""  ADAS
 SG_ DET_CONFD_AZIMUTH_014 : 206|2@1+ (1,0) [0|3] ""  ADAS
 SG_ DET_CONFD_ELEVATION_014 : 244|2@1+ (1,0) [0|3] ""  ADAS
 SG_ DET_RANGE_015 : 264|15@1+ (0.015625,0) [0|500] "m"  ADAS
 SG_ DET_RANGE_ERR_015 : 280|7@1+ (0.0075,0) [0|0.9525] "m"  ADAS
 SG_ DET_RANGE_VELOCITY_015 : 288|15@1+ (0.0078125,-128) [-128|127.9921875] "m/s"  ADAS
 SG_ DET_RANGE_VELOCITY_ERR_015 : 304|8@1+ (0.003,0) [0|0.765] "m/s"  ADAS
 SG_ DET_AZIMUTH_015 : 328|13@1+ (0.0004,-1.5708) [-1.5708|1.5708] "rad"  ADAS
 SG_ DET_AZIMUTH_ERR_015 : 345|7@1+ (0.00087267,0) [0|0.11082909] "rad"  ADAS
 SG_ DET_ELEVATION_015 : 312|8@1+ (0.00275,-0.34925) [-0.34925|0.34925] "rad"  ADAS
 SG_ DET_ELEVATION_ERR_015 : 320|6@1+ (0.00174533,0) [0|0.10995579] "rad"  ADAS
 SG_ DET_RCS_015 : 376|8@1+ (0.5,-64) [-64|63.5] "dBsm"  ADAS
 SG_ DET_VALID_FLAG_015 : 399|1@1+ (1,0) [0|1] ""  ADAS
 SG_ DET_BI_STATIC_FLAG_015 : 482|1@1+ (1,0) [0|1] ""  ADAS
 SG_ DET_SUPER_RES_TARGET_015 : 344|1@1+ (1,0) [0|1] ""  ADAS
 SG_ DET_SNR_015 : 368|8@1+ (0.35156,0) [0|89.6478] "dB"  ADAS
 SG_ DET_POINT_TARGET_PROB_015 : 360|4@1+ (6.67,0) [0|100] "%"  ADAS
 SG_ DET_EXISTENCE_PROB_015 : 352|6@1+ (1.588,0) [0|100] "%"  ADAS
 SG_ DET_OUTSIDE_SECTOR_015 : 407|1@1+ (1,0) [0|1] ""  ADAS
 SG_ DET_HVC_FLAG_015 : 364|1@1+ (1,0) [0|1] ""  ADAS
 SG_ DET_CONFD_AZIMUTH_015 : 365|2@1+ (1,0) [0|3] ""  ADAS
 SG_ DET_CONFD_ELEVATION_015 : 358|2@1+ (1,0) [0|3] ""  ADAS
 SG_ DET_RANGE_016 : 384|15@1+ (0.015625,0) [0|500] "m"  ADAS
 SG_ DET_RANGE_ERR_016 : 400|7@1+ (0.0075,0) [0|0.9525] "m"  ADAS
 SG_ DET_RANGE_VELOCITY_016 : 408|15@1+ (0.0078125,-128) [-128|127.9921875] "m/s"  ADAS
 SG_ DET_RANGE_VELOCITY_ERR_016 : 424|8@1+ (0.003,0) [0|0.765] "m/s"  ADAS
 SG_ DET_AZIMUTH_016 : 448|13@1+ (0.0004,-1.5708) [-1.5708|1.5708] "rad"  ADAS
 SG_ DET_AZIMUTH_ERR_016 : 465|7@1+ (0.00087267,0) [0|0.11082909] "rad"  ADAS
 SG_ DET_ELEVATION_016 : 432|8@1+ (0.00275,-0.34925) [-0.34925|0.34925] "rad"  ADAS
 SG_ DET_ELEVATION_ERR_016 : 440|6@1+ (0.00174533,0) [0|0.10995579] "rad"  ADAS
 SG_ DET_RCS_016 : 496|8@1+ (0.5,-64) [-64|63.5] "dBsm"  ADAS
 SG_ DET_VALID_FLAG_016 : 485|1@1+ (1,0) [0|1] ""  ADAS
 SG_ DET_BI_STATIC_FLAG_016 : 483|1@1+ (1,0) [0|1] ""  ADAS
 SG_ DET_SUPER_RES_TARGET_016 : 446|1@1+ (1,0) [0|1] ""  ADAS
 SG_ DET_SNR_016 : 488|8@1+ (0.35156,0) [0|89.6478] "dB"  ADAS
 SG_ DET_POINT_TARGET_PROB_016 : 472|4@1+ (6.67,0) [0|100] "%"  ADAS
 SG_ DET_EXISTENCE_PROB_016 : 506|6@1+ (1.588,0) [0|100] "%"  ADAS
 SG_ DET_OUTSIDE_SECTOR_016 : 481|1@1+ (1,0) [0|1] ""  ADAS
 SG_ DET_HVC_FLAG_016 : 464|1@1+ (1,0) [0|1] ""  ADAS
 SG_ DET_CONFD_AZIMUTH_016 : 486|2@1+ (1,0) [0|3] ""  ADAS
 SG_ DET_CONFD_ELEVATION_016 : 461|2@1+ (1,0) [0|3] ""  ADAS
 SG_ DET_MH_SCAN_INDEX_4LSB_013_016 : 476|4@1+ (1,0) [0|15] ""  ADAS
 SG_ DET_MH_CYCLE_COUNTER_013_016 : 16|8@1+ (1,0) [0|255] ""  ADAS
 SG_ DET_MH_CRC16_013_016 : 0|16@1+ (1,0) [0|65535] ""  ADAS

BO_ 1156 RDR_DETECTION_017_020: 64 RDR08
 SG_ DET_RANGE_017 : 24|15@1+ (0.015625,0) [0|500] "m"  ADAS
 SG_ DET_RANGE_ERR_017 : 40|7@1+ (0.0075,0) [0|0.9525] "m"  ADAS
 SG_ DET_RANGE_VELOCITY_017 : 48|15@1+ (0.0078125,-128) [-128|127.9921875] "m/s"  ADAS
 SG_ DET_RANGE_VELOCITY_ERR_017 : 64|8@1+ (0.003,0) [0|0.765] "m/s"  ADAS
 SG_ DET_AZIMUTH_017 : 88|13@1+ (0.0004,-1.5708) [-1.5708|1.5708] "rad"  ADAS
 SG_ DET_AZIMUTH_ERR_017 : 105|7@1+ (0.00087267,0) [0|0.11082909] "rad"  ADAS
 SG_ DET_ELEVATION_017 : 72|8@1+ (0.00275,-0.34925) [-0.34925|0.34925] "rad"  ADAS
 SG_ DET_ELEVATION_ERR_017 : 80|6@1+ (0.00174533,0) [0|0.10995579] "rad"  ADAS
 SG_ DET_RCS_017 : 136|8@1+ (0.5,-64) [-64|63.5] "dBsm"  ADAS
 SG_ DET_VALID_FLAG_017 : 119|1@1+ (1,0) [0|1] ""  ADAS
 SG_ DET_BI_STATIC_FLAG_017 : 504|1@1+ (1,0) [0|1] ""  ADAS
 SG_ DET_SUPER_RES_TARGET_017 : 104|1@1+ (1,0) [0|1] ""  ADAS
 SG_ DET_SNR_017 : 128|8@1+ (0.35156,0) [0|89.6478] "dB"  ADAS
 SG_ DET_POINT_TARGET_PROB_017 : 114|4@1+ (6.67,0) [0|100] "%"  ADAS
 SG_ DET_EXISTENCE_PROB_017 : 120|6@1+ (1.588,0) [0|100] "%"  ADAS
 SG_ DET_OUTSIDE_SECTOR_017 : 159|1@1+ (1,0) [0|1] ""  ADAS
 SG_ DET_HVC_FLAG_017 : 118|1@1+ (1,0) [0|1] ""  ADAS
 SG_ DET_CONFD_AZIMUTH_017 : 126|2@1+ (1,0) [0|3] ""  ADAS
 SG_ DET_CONFD_ELEVATION_017 : 112|2@1+ (1,0) [0|3] ""  ADAS
 SG_ DET_RANGE_018 : 144|15@1+ (0.015625,0) [0|500] "m"  ADAS
 SG_ DET_RANGE_ERR_018 : 160|7@1+ (0.0075,0) [0|0.9525] "m"  ADAS
 SG_ DET_RANGE_VELOCITY_018 : 168|15@1+ (0.0078125,-128) [-128|127.9921875] "m/s"  ADAS
 SG_ DET_RANGE_VELOCITY_ERR_018 : 184|8@1+ (0.003,0) [0|0.765] "m/s"  ADAS
 SG_ DET_AZIMUTH_018 : 208|13@1+ (0.0004,-1.5708) [-1.5708|1.5708] "rad"  ADAS
 SG_ DET_AZIMUTH_ERR_018 : 224|7@1+ (0.00087267,0) [0|0.11082909] "rad"  ADAS
 SG_ DET_ELEVATION_018 : 192|8@1+ (0.00275,-0.34925) [-0.34925|0.34925] "rad"  ADAS
 SG_ DET_ELEVATION_ERR_018 : 200|6@1+ (0.00174533,0) [0|0.10995579] "rad"  ADAS
 SG_ DET_RCS_018 : 256|8@1+ (0.5,-64) [-64|63.5] "dBsm"  ADAS
 SG_ DET_VALID_FLAG_018 : 167|1@1+ (1,0) [0|1] ""  ADAS
 SG_ DET_BI_STATIC_FLAG_018 : 505|1@1+ (1,0) [0|1] ""  ADAS
 SG_ DET_SUPER_RES_TARGET_018 : 247|1@1+ (1,0) [0|1] ""  ADAS
 SG_ DET_SNR_018 : 248|8@1+ (0.35156,0) [0|89.6478] "dB"  ADAS
 SG_ DET_POINT_TARGET_PROB_018 : 240|4@1+ (6.67,0) [0|100] "%"  ADAS
 SG_ DET_EXISTENCE_PROB_018 : 232|6@1+ (1.588,0) [0|100] "%"  ADAS
 SG_ DET_OUTSIDE_SECTOR_018 : 183|1@1+ (1,0) [0|1] ""  ADAS
 SG_ DET_HVC_FLAG_018 : 246|1@1+ (1,0) [0|1] ""  ADAS
 SG_ DET_CONFD_AZIMUTH_018 : 206|2@1+ (1,0) [0|3] ""  ADAS
 SG_ DET_CONFD_ELEVATION_018 : 244|2@1+ (1,0) [0|3] ""  ADAS
 SG_ DET_RANGE_019 : 264|15@1+ (0.015625,0) [0|500] "m"  ADAS
 SG_ DET_RANGE_ERR_019 : 280|7@1+ (0.0075,0) [0|0.9525] "m"  ADAS
 SG_ DET_RANGE_VELOCITY_019 : 288|15@1+ (0.0078125,-128) [-128|127.9921875] "m/s"  ADAS
 SG_ DET_RANGE_VELOCITY_ERR_019 : 304|8@1+ (0.003,0) [0|0.765] "m/s"  ADAS
 SG_ DET_AZIMUTH_019 : 328|13@1+ (0.0004,-1.5708) [-1.5708|1.5708] "rad"  ADAS
 SG_ DET_AZIMUTH_ERR_019 : 345|7@1+ (0.00087267,0) [0|0.11082909] "rad"  ADAS
 SG_ DET_ELEVATION_019 : 312|8@1+ (0.00275,-0.34925) [-0.34925|0.34925] "rad"  ADAS
 SG_ DET_ELEVATION_ERR_019 : 320|6@1+ (0.00174533,0) [0|0.10995579] "rad"  ADAS
 SG_ DET_RCS_019 : 376|8@1+ (0.5,-64) [-64|63.5] "dBsm"  ADAS
 SG_ DET_VALID_FLAG_019 : 399|1@1+ (1,0) [0|1] ""  ADAS
 SG_ DET_BI_STATIC_FLAG_019 : 482|1@1+ (1,0) [0|1] ""  ADAS
 SG_ DET_SUPER_RES_TARGET_019 : 344|1@1+ (1,0) [0|1] ""  ADAS
 SG_ DET_SNR_019 : 368|8@1+ (0.35156,0) [0|89.6478] "dB"  ADAS
 SG_ DET_POINT_TARGET_PROB_019 : 360|4@1+ (6.67,0) [0|100] "%"  ADAS
 SG_ DET_EXISTENCE_PROB_019 : 352|6@1+ (1.588,0) [0|100] "%"  ADAS
 SG_ DET_OUTSIDE_SECTOR_019 : 407|1@1+ (1,0) [0|1] ""  ADAS
 SG_ DET_HVC_FLAG_019 : 364|1@1+ (1,0) [0|1] ""  ADAS
 SG_ DET_CONFD_AZIMUTH_019 : 365|2@1+ (1,0) [0|3] ""  ADAS
 SG_ DET_CONFD_ELEVATION_019 : 358|2@1+ (1,0) [0|3] ""  ADAS
 SG_ DET_RANGE_020 : 384|15@1+ (0.015625,0) [0|500] "m"  ADAS
 SG_ DET_RANGE_ERR_020 : 400|7@1+ (0.0075,0) [0|0.9525] "m"  ADAS
 SG_ DET_RANGE_VELOCITY_020 : 408|15@1+ (0.0078125,-128) [-128|127.9921875] "m/s"  ADAS
 SG_ DET_RANGE_VELOCITY_ERR_020 : 424|8@1+ (0.003,0) [0|0.765] "m/s"  ADAS
 SG_ DET_AZIMUTH_020 : 448|13@1+ (0.0004,-1.5708) [-1.5708|1.5708] "rad"  ADAS
 SG_ DET_AZIMUTH_ERR_020 : 465|7@1+ (0.00087267,0) [0|0.11082909] "rad"  ADAS
 SG_ DET_ELEVATION_020 : 432|8@1+ (0.00275,-0.34925) [-0.34925|0.34925] "rad"  ADAS
 SG_ DET_ELEVATION_ERR_020 : 440|6@1+ (0.00174533,0) [0|0.10995579] "rad"  ADAS
 SG_ DET_RCS_020 : 496|8@1+ (0.5,-64) [-64|63.5] "dBsm"  ADAS
 SG_ DET_VALID_FLAG_020 : 485|1@1+ (1,0) [0|1] ""  ADAS
 SG_ DET_BI_STATIC_FLAG_020 : 483|1@1+ (1,0) [0|1] ""  ADAS
 SG_ DET_SUPER_RES_TARGET_020 : 446|1@1+ (1,0) [0|1] ""  ADAS
 SG_ DET_SNR_020 : 488|8@1+ (0.35156,0) [0|89.6478] "dB"  ADAS
 SG_ DET_POINT_TARGET_PROB_020 : 472|4@1+ (6.67,0) [0|100] "%"  ADAS
 SG_ DET_EXISTENCE_PROB_020 : 506|6@1+ (1.588,0) [0|100] "%"  ADAS
 SG_ DET_OUTSIDE_SECTOR_020 : 481|1@1+ (1,0) [0|1] ""  ADAS
 SG_ DET_HVC_FLAG_020 : 464|1@1+ (1,0) [0|1] ""  ADAS
 SG_ DET_CONFD_AZIMUTH_020 : 486|2@1+ (1,0) [0|3] ""  ADAS
 SG_ DET_CONFD_ELEVATION_020 : 461|2@1+ (1,0) [0|3] ""  ADAS
 SG_ DET_MH_SCAN_INDEX_4LSB_017_020 : 476|4@1+ (1,0) [0|15] ""  ADAS
 SG_ DET_MH_CYCLE_COUNTER_017_020 : 16|8@1+ (1,0) [0|255] ""  ADAS
 SG_ DET_MH_CRC16_017_020 : 0|16@1+ (1,0) [0|65535] ""  ADAS

BO_ 1157 RDR_DETECTION_021_024: 64 RDR08
 SG_ DET_RANGE_021 : 24|15@1+ (0.015625,0) [0|500] "m"  ADAS
 SG_ DET_RANGE_ERR_021 : 40|7@1+ (0.0075,0) [0|0.9525] "m"  ADAS
 SG_ DET_RANGE_VELOCITY_021 : 48|15@1+ (0.0078125,-128) [-128|127.9921875] "m/s"  ADAS
 SG_ DET_RANGE_VELOCITY_ERR_021 : 64|8@1+ (0.003,0) [0|0.765] "m/s"  ADAS
 SG_ DET_AZIMUTH_021 : 88|13@1+ (0.0004,-1.5708) [-1.5708|1.5708] "rad"  ADAS
 SG_ DET_AZIMUTH_ERR_021 : 105|7@1+ (0.00087267,0) [0|0.11082909] "rad"  ADAS
 SG_ DET_ELEVATION_021 : 72|8@1+ (0.00275,-0.34925) [-0.34925|0.34925] "rad"  ADAS
 SG_ DET_ELEVATION_ERR_021 : 80|6@1+ (0.00174533,0) [0|0.10995579] "rad"  ADAS
 SG_ DET_RCS_021 : 136|8@1+ (0.5,-64) [-64|63.5] "dBsm"  ADAS
 SG_ DET_VALID_FLAG_021 : 119|1@1+ (1,0) [0|1] ""  ADAS
 SG_ DET_BI_STATIC_FLAG_021 : 504|1@1+ (1,0) [0|1] ""  ADAS
 SG_ DET_SUPER_RES_TARGET_021 : 104|1@1+ (1,0) [0|1] ""  ADAS
 SG_ DET_SNR_021 : 128|8@1+ (0.35156,0) [0|89.6478] "dB"  ADAS
 SG_ DET_POINT_TARGET_PROB_021 : 114|4@1+ (6.67,0) [0|100] "%"  ADAS
 SG_ DET_EXISTENCE_PROB_021 : 120|6@1+ (1.588,0) [0|100] "%"  ADAS
 SG_ DET_OUTSIDE_SECTOR_021 : 159|1@1+ (1,0) [0|1] ""  ADAS
 SG_ DET_HVC_FLAG_021 : 118|1@1+ (1,0) [0|1] ""  ADAS
 SG_ DET_CONFD_AZIMUTH_021 : 126|2@1+ (1,0) [0|3] ""  ADAS
 SG_ DET_CONFD_ELEVATION_021 : 112|2@1+ (1,0) [0|3] ""  ADAS
 SG_ DET_RANGE_022 : 144|15@1+ (0.015625,0) [0|500] "m"  ADAS
 SG_ DET_RANGE_ERR_022 : 160|7@1+ (0.0075,0) [0|0.9525] "m"  ADAS
 SG_ DET_RANGE_VELOCITY_022 : 168|15@1+ (0.0078125,-128) [-128|127.9921875] "m/s"  ADAS
 SG_ DET_RANGE_VELOCITY_ERR_022 : 184|8@1+ (0.003,0) [0|0.765] "m/s"  ADAS
 SG_ DET_AZIMUTH_022 : 208|13@1+ (0.0004,-1.5708) [-1.5708|1.5708] "rad"  ADAS
 SG_ DET_AZIMUTH_ERR_022 : 224|7@1+ (0.00087267,0) [0|0.11082909] "rad"  ADAS
 SG_ DET_ELEVATION_022 : 192|8@1+ (0.00275,-0.34925) [-0.34925|0.34925] "rad"  ADAS
 SG_ DET_ELEVATION_ERR_022 : 200|6@1+ (0.00174533,0) [0|0.10995579] "rad"  ADAS
 SG_ DET_RCS_022 : 256|8@1+ (0.5,-64) [-64|63.5] "dBsm"  ADAS
 SG_ DET_VALID_FLAG_022 : 167|1@1+ (1,0) [0|1] ""  ADAS
 SG_ DET_BI_STATIC_FLAG_022 : 505|1@1+ (1,0) [0|1] ""  ADAS
 SG_ DET_SUPER_RES_TARGET_022 : 247|1@1+ (1,0) [0|1] ""  ADAS
 SG_ DET_SNR_022 : 248|8@1+ (0.35156,0) [0|89.6478] "dB"  ADAS
 SG_ DET_POINT_TARGET_PROB_022 : 240|4@1+ (6.67,0) [0|100] "%"  ADAS
 SG_ DET_EXISTENCE_PROB_022 : 232|6@1+ (1.588,0) [0|100] "%"  ADAS
 SG_ DET_OUTSIDE_SECTOR_022 : 183|1@1+ (1,0) [0|1] ""  ADAS
 SG_ DET_HVC_FLAG_022 : 246|1@1+ (1,0) [0|1] ""  ADAS
 SG_ DET_CONFD_AZIMUTH_022 : 206|2@1+ (1,0) [0|3] ""  ADAS
 SG_ DET_CONFD_ELEVATION_022 : 244|2@1+ (1,0) [0|3] ""  ADAS
 SG_ DET_RANGE_023 : 264|15@1+ (0.015625,0) [0|500] "m"  ADAS
 SG_ DET_RANGE_ERR_023 : 280|7@1+ (0.0075,0) [0|0.9525] "m"  ADAS
 SG_ DET_RANGE_VELOCITY_023 : 288|15@1+ (0.0078125,-128) [-128|127.9921875] "m/s"  ADAS
 SG_ DET_RANGE_VELOCITY_ERR_023 : 304|8@1+ (0.003,0) [0|0.765] "m/s"  ADAS
 SG_ DET_AZIMUTH_023 : 328|13@1+ (0.0004,-1.5708) [-1.5708|1.5708] "rad"  ADAS
 SG_ DET_AZIMUTH_ERR_023 : 345|7@1+ (0.00087267,0) [0|0.11082909] "rad"  ADAS
 SG_ DET_ELEVATION_023 : 312|8@1+ (0.00275,-0.34925) [-0.34925|0.34925] "rad"  ADAS
 SG_ DET_ELEVATION_ERR_023 : 320|6@1+ (0.00174533,0) [0|0.10995579] "rad"  ADAS
 SG_ DET_RCS_023 : 376|8@1+ (0.5,-64) [-64|63.5] "dBsm"  ADAS
 SG_ DET_VALID_FLAG_023 : 399|1@1+ (1,0) [0|1] ""  ADAS
 SG_ DET_BI_STATIC_FLAG_023 : 482|1@1+ (1,0) [0|1] ""  ADAS
 SG_ DET_SUPER_RES_TARGET_023 : 344|1@1+ (1,0) [0|1] ""  ADAS
 SG_ DET_SNR_023 : 368|8@1+ (0.35156,0) [0|89.6478] "dB"  ADAS
 SG_ DET_POINT_TARGET_PROB_023 : 360|4@1+ (6.67,0) [0|100] "%"  ADAS
 SG_ DET_EXISTENCE_PROB_023 : 352|6@1+ (1.588,0) [0|100] "%"  ADAS
 SG_ DET_OUTSIDE_SECTOR_023 : 407|1@1+ (1,0) [0|1] ""  ADAS
 SG_ DET_HVC_FLAG_023 : 364|1@1+ (1,0) [0|1] ""  ADAS
 SG_ DET_CONFD_AZIMUTH_023 : 365|2@1+ (1,0) [0|3] ""  ADAS
 SG_ DET_CONFD_ELEVATION_023 : 358|2@1+ (1,0) [0|3] ""  ADAS
 SG_ DET_RANGE_024 : 384|15@1+ (0.015625,0) [0|500] "m"  ADAS
 SG_ DET_RANGE_ERR_024 : 400|7@1+ (0.0075,0) [0|0.9525] "m"  ADAS
 SG_ DET_RANGE_VELOCITY_024 : 408|15@1+ (0.0078125,-128) [-128|127.9921875] "m/s"  ADAS
 SG_ DET_RANGE_VELOCITY_ERR_024 : 424|8@1+ (0.003,0) [0|0.765] "m/s"  ADAS
 SG_ DET_AZIMUTH_024 : 448|13@1+ (0.0004,-1.5708) [-1.5708|1.5708] "rad"  ADAS
 SG_ DET_AZIMUTH_ERR_024 : 465|7@1+ (0.00087267,0) [0|0.11082909] "rad"  ADAS
 SG_ DET_ELEVATION_024 : 432|8@1+ (0.00275,-0.34925) [-0.34925|0.34925] "rad"  ADAS
 SG_ DET_ELEVATION_ERR_024 : 440|6@1+ (0.00174533,0) [0|0.10995579] "rad"  ADAS
 SG_ DET_RCS_024 : 496|8@1+ (0.5,-64) [-64|63.5] "dBsm"  ADAS
 SG_ DET_VALID_FLAG_024 : 485|1@1+ (1,0) [0|1] ""  ADAS
 SG_ DET_BI_STATIC_FLAG_024 : 483|1@1+ (1,0) [0|1] ""  ADAS
 SG_ DET_SUPER_RES_TARGET_024 : 446|1@1+ (1,0) [0|1] ""  ADAS
 SG_ DET_SNR_024 : 488|8@1+ (0.35156,0) [0|89.6478] "dB"  ADAS
 SG_ DET_POINT_TARGET_PROB_024 : 472|4@1+ (6.67,0) [0|100] "%"  ADAS
 SG_ DET_EXISTENCE_PROB_024 : 506|6@1+ (1.588,0) [0|100] "%"  ADAS
 SG_ DET_OUTSIDE_SECTOR_024 : 481|1@1+ (1,0) [0|1] ""  ADAS
 SG_ DET_HVC_FLAG_024 : 464|1@1+ (1,0) [0|1] ""  ADAS
 SG_ DET_CONFD_AZIMUTH_024 : 486|2@1+ (1,0) [0|3] ""  ADAS
 SG_ DET_CONFD_ELEVATION_024 : 461|2@1+ (1,0) [0|3] ""  ADAS
 SG_ DET_MH_SCAN_INDEX_4LSB_021_024 : 476|4@1+ (1,0) [0|15] ""  ADAS
 SG_ DET_MH_CYCLE_COUNTER_021_024 : 16|8@1+ (1,0) [0|255] ""  ADAS
 SG_ DET_MH_CRC16_021_024 : 0|16@1+ (1,0) [0|65535] ""  ADAS

BO_ 1158 RDR_DETECTION_025_028: 64 RDR08
 SG_ DET_RANGE_025 : 24|15@1+ (0.015625,0) [0|500] "m"  ADAS
 SG_ DET_RANGE_ERR_025 : 40|7@1+ (0.0075,0) [0|0.9525] "m"  ADAS
 SG_ DET_RANGE_VELOCITY_025 : 48|15@1+ (0.0078125,-128) [-128|127.9921875] "m/s"  ADAS
 SG_ DET_RANGE_VELOCITY_ERR_025 : 64|8@1+ (0.003,0) [0|0.765] "m/s"  ADAS
 SG_ DET_AZIMUTH_025 : 88|13@1+ (0.0004,-1.5708) [-1.5708|1.5708] "rad"  ADAS
 SG_ DET_AZIMUTH_ERR_025 : 105|7@1+ (0.00087267,0) [0|0.11082909] "rad"  ADAS
 SG_ DET_ELEVATION_025 : 72|8@1+ (0.00275,-0.34925) [-0.34925|0.34925] "rad"  ADAS
 SG_ DET_ELEVATION_ERR_025 : 80|6@1+ (0.00174533,0) [0|0.10995579] "rad"  ADAS
 SG_ DET_RCS_025 : 136|8@1+ (0.5,-64) [-64|63.5] "dBsm"  ADAS
 SG_ DET_VALID_FLAG_025 : 119|1@1+ (1,0) [0|1] ""  ADAS
 SG_ DET_BI_STATIC_FLAG_025 : 504|1@1+ (1,0) [0|1] ""  ADAS
 SG_ DET_SUPER_RES_TARGET_025 : 104|1@1+ (1,0) [0|1] ""  ADAS
 SG_ DET_SNR_025 : 128|8@1+ (0.35156,0) [0|89.6478] "dB"  ADAS
 SG_ DET_POINT_TARGET_PROB_025 : 114|4@1+ (6.67,0) [0|100] "%"  ADAS
 SG_ DET_EXISTENCE_PROB_025 : 120|6@1+ (1.588,0) [0|100] "%"  ADAS
 SG_ DET_OUTSIDE_SECTOR_025 : 159|1@1+ (1,0) [0|1] ""  ADAS
 SG_ DET_HVC_FLAG_025 : 118|1@1+ (1,0) [0|1] ""  ADAS
 SG_ DET_CONFD_AZIMUTH_025 : 126|2@1+ (1,0) [0|3] ""  ADAS
 SG_ DET_CONFD_ELEVATION_025 : 112|2@1+ (1,0) [0|3] ""  ADAS
 SG_ DET_RANGE_026 : 144|15@1+ (0.015625,0) [0|500] "m"  ADAS
 SG_ DET_RANGE_ERR_026 : 160|7@1+ (0.0075,0) [0|0.9525] "m"  ADAS
 SG_ DET_RANGE_VELOCITY_026 : 168|15@1+ (0.0078125,-128) [-128|127.9921875] "m/s"  ADAS
 SG_ DET_RANGE_VELOCITY_ERR_026 : 184|8@1+ (0.003,0) [0|0.765] "m/s"  ADAS
 SG_ DET_AZIMUTH_026 : 208|13@1+ (0.0004,-1.5708) [-1.5708|1.5708] "rad"  ADAS
 SG_ DET_AZIMUTH_ERR_026 : 224|7@1+ (0.00087267,0) [0|0.11082909] "rad"  ADAS
 SG_ DET_ELEVATION_026 : 192|8@1+ (0.00275,-0.34925) [-0.34925|0.34925] "rad"  ADAS
 SG_ DET_ELEVATION_ERR_026 : 200|6@1+ (0.00174533,0) [0|0.10995579] "rad"  ADAS
 SG_ DET_RCS_026 : 256|8@1+ (0.5,-64) [-64|63.5] "dBsm"  ADAS
 SG_ DET_VALID_FLAG_026 : 167|1@1+ (1,0) [0|1] ""  ADAS
 SG_ DET_BI_STATIC_FLAG_026 : 505|1@1+ (1,0) [0|1] ""  ADAS
 SG_ DET_SUPER_RES_TARGET_026 : 247|1@1+ (1,0) [0|1] ""  ADAS
 SG_ DET_SNR_026 : 248|8@1+ (0.35156,0) [0|89.6478] "dB"  ADAS
 SG_ DET_POINT_TARGET_PROB_026 : 240|4@1+ (6.67,0) [0|100] "%"  ADAS
 SG_ DET_EXISTENCE_PROB_026 : 232|6@1+ (1.588,0) [0|100] "%"  ADAS
 SG_ DET_OUTSIDE_SECTOR_026 : 183|1@1+ (1,0) [0|1] ""  ADAS
 SG_ DET_HVC_FLAG_026 : 246|1@1+ (1,0) [0|1] ""  ADAS
 SG_ DET_CONFD_AZIMUTH_026 : 206|2@1+ (1,0) [0|3] ""  ADAS
 SG_ DET_CONFD_ELEVATION_026 : 244|2@1+ (1,0) [0|3] ""  ADAS
 SG_ DET_RANGE_027 : 264|15@1+ (0.015625,0) [0|500] "m"  ADAS
 SG_ DET_RANGE_ERR_027 : 280|7@1+ (0.0075,0) [0|0.9525] "m"  ADAS
 SG_ DET_RANGE_VELOCITY_027 : 288|15@1+ (0.0078125,-128) [-128|127.9921875] "m/s"  ADAS
 SG_ DET_RANGE_VELOCITY_ERR_027 : 304|8@1+ (0.003,0) [0|0.765] "m/s"  ADAS
 SG_ DET_AZIMUTH_027 : 328|13@1+ (0.0004,-1.5708) [-1.5708|1.5708] "rad"  ADAS
 SG_ DET_AZIMUTH_ERR_027 : 345|7@1+ (0.00087267,0) [0|0.11082909] "rad"  ADAS
 SG_ DET_ELEVATION_027 : 312|8@1+ (0.00275,-0.34925) [-0.34925|0.34925] "rad"  ADAS
 SG_ DET_ELEVATION_ERR_027 : 320|6@1+ (0.00174533,0) [0|0.10995579] "rad"  ADAS
 SG_ DET_RCS_027 : 376|8@1+ (0.5,-64) [-64|63.5] "dBsm"  ADAS
 SG_ DET_VALID_FLAG_027 : 399|1@1+ (1,0) [0|1] ""  ADAS
 SG_ DET_BI_STATIC_FLAG_027 : 482|1@1+ (1,0) [0|1] ""  ADAS
 SG_ DET_SUPER_RES_TARGET_027 : 344|1@1+ (1,0) [0|1] ""  ADAS
 SG_ DET_SNR_027 : 368|8@1+ (0.35156,0) [0|89.6478] "dB"  ADAS
 SG_ DET_POINT_TARGET_PROB_027 : 360|4@1+ (6.67,0) [0|100] "%"  ADAS
 SG_ DET_EXISTENCE_PROB_027 : 352|6@1+ (1.588,0) [0|100] "%"  ADAS
 SG_ DET_OUTSIDE_SECTOR_027 : 407|1@1+ (1,0) [0|1] ""  ADAS
 SG_ DET_HVC_FLAG_027 : 364|1@1+ (1,0) [0|1] ""  ADAS
 SG_ DET_CONFD_AZIMUTH_027 : 365|2@1+ (1,0) [0|3] ""  ADAS
 SG_ DET_CONFD_ELEVATION_027 : 358|2@1+ (1,0) [0|3] ""  ADAS
 SG_ DET_RANGE_028 : 384|15@1+ (0.015625,0) [0|500] "m"  ADAS
 SG_ DET_RANGE_ERR_028 : 400|7@1+ (0.0075,0) [0|0.9525] "m"  ADAS
 SG_ DET_RANGE_VELOCITY_028 : 408|15@1+ (0.0078125,-128) [-128|127.9921875] "m/s"  ADAS
 SG_ DET_RANGE_VELOCITY_ERR_028 : 424|8@1+ (0.003,0) [0|0.765] "m/s"  ADAS
 SG_ DET_AZIMUTH_028 : 448|13@1+ (0.0004,-1.5708) [-1.5708|1.5708] "rad"  ADAS
 SG_ DET_AZIMUTH_ERR_028 : 465|7@1+ (0.00087267,0) [0|0.11082909] "rad"  ADAS
 SG_ DET_ELEVATION_028 : 432|8@1+ (0.00275,-0.34925) [-0.34925|0.34925] "rad"  ADAS
 SG_ DET_ELEVATION_ERR_028 : 440|6@1+ (0.00174533,0) [0|0.10995579] "rad"  ADAS
 SG_ DET_RCS_028 : 496|8@1+ (0.5,-64) [-64|63.5] "dBsm"  ADAS
 SG_ DET_VALID_FLAG_028 : 485|1@1+ (1,0) [0|1] ""  ADAS
 SG_ DET_BI_STATIC_FLAG_028 : 483|1@1+ (1,0) [0|1] ""  ADAS
 SG_ DET_SUPER_RES_TARGET_028 : 446|1@1+ (1,0) [0|1] ""  ADAS
 SG_ DET_SNR_028 : 488|8@1+ (0.35156,0) [0|89.6478] "dB"  ADAS
 SG_ DET_POINT_TARGET_PROB_028 : 472|4@1+ (6.67,0) [0|100] "%"  ADAS
 SG_ DET_EXISTENCE_PROB_028 : 506|6@1+ (1.588,0) [0|100] "%"  ADAS
 SG_ DET_OUTSIDE_SECTOR_028 : 481|1@1+ (1,0) [0|1] ""  ADAS
 SG_ DET_HVC_FLAG_028 : 464|1@1+ (1,0) [0|1] ""  ADAS
 SG_ DET_CONFD_AZIMUTH_028 : 486|2@1+ (1,0) [0|3] ""  ADAS
 SG_ DET_CONFD_ELEVATION_028 : 461|2@1+ (1,0) [0|3] ""  ADAS
 SG_ DET_MH_SCAN_INDEX_4LSB_025_028 : 476|4@1+ (1,0) [0|15] ""  ADAS
 SG_ DET_MH_CYCLE_COUNTER_025_028 : 16|8@1+ (1,0) [0|255] ""  ADAS
 SG_ DET_MH_CRC16_025_028 : 0|16@1+ (1,0) [0|65535] ""  ADAS

BO_ 1159 RDR_DETECTION_029_032: 64 RDR08
 SG_ DET_RANGE_029 : 24|15@1+ (0.015625,0) [0|500] "m"  ADAS
 SG_ DET_RANGE_ERR_029 : 40|7@1+ (0.0075,0) [0|0.9525] "m"  ADAS
 SG_ DET_RANGE_VELOCITY_029 : 48|15@1+ (0.0078125,-128) [-128|127.9921875] "m/s"  ADAS
 SG_ DET_RANGE_VELOCITY_ERR_029 : 64|8@1+ (0.003,0) [0|0.765] "m/s"  ADAS
 SG_ DET_AZIMUTH_029 : 88|13@1+ (0.0004,-1.5708) [-1.5708|1.5708] "rad"  ADAS
 SG_ DET_AZIMUTH_ERR_029 : 105|7@1+ (0.00087267,0) [0|0.11082909] "rad"  ADAS
 SG_ DET_ELEVATION_029 : 72|8@1+ (0.00275,-0.34925) [-0.34925|0.34925] "rad"  ADAS
 SG_ DET_ELEVATION_ERR_029 : 80|6@1+ (0.00174533,0) [0|0.10995579] "rad"  ADAS
 SG_ DET_RCS_029 : 136|8@1+ (0.5,-64) [-64|63.5] "dBsm"  ADAS
 SG_ DET_VALID_FLAG_029 : 119|1@1+ (1,0) [0|1] ""  ADAS
 SG_ DET_BI_STATIC_FLAG_029 : 504|1@1+ (1,0) [0|1] ""  ADAS
 SG_ DET_SUPER_RES_TARGET_029 : 104|1@1+ (1,0) [0|1] ""  ADAS
 SG_ DET_SNR_029 : 128|8@1+ (0.35156,0) [0|89.6478] "dB"  ADAS
 SG_ DET_POINT_TARGET_PROB_029 : 114|4@1+ (6.67,0) [0|100] "%"  ADAS
 SG_ DET_EXISTENCE_PROB_029 : 120|6@1+ (1.588,0) [0|100] "%"  ADAS
 SG_ DET_OUTSIDE_SECTOR_029 : 159|1@1+ (1,0) [0|1] ""  ADAS
 SG_ DET_HVC_FLAG_029 : 118|1@1+ (1,0) [0|1] ""  ADAS
 SG_ DET_CONFD_AZIMUTH_029 : 126|2@1+ (1,0) [0|3] ""  ADAS
 SG_ DET_CONFD_ELEVATION_029 : 112|2@1+ (1,0) [0|3] ""  ADAS
 SG_ DET_RANGE_030 : 144|15@1+ (0.015625,0) [0|500] "m"  ADAS
 SG_ DET_RANGE_ERR_030 : 160|7@1+ (0.0075,0) [0|0.9525] "m"  ADAS
 SG_ DET_RANGE_VELOCITY_030 : 168|15@1+ (0.0078125,-128) [-128|127.9921875] "m/s"  ADAS
 SG_ DET_RANGE_VELOCITY_ERR_030 : 184|8@1+ (0.003,0) [0|0.765] "m/s"  ADAS
 SG_ DET_AZIMUTH_030 : 208|13@1+ (0.0004,-1.5708) [-1.5708|1.5708] "rad"  ADAS
 SG_ DET_AZIMUTH_ERR_030 : 224|7@1+ (0.00087267,0) [0|0.11082909] "rad"  ADAS
 SG_ DET_ELEVATION_030 : 192|8@1+ (0.00275,-0.34925) [-0.34925|0.34925] "rad"  ADAS
 SG_ DET_ELEVATION_ERR_030 : 200|6@1+ (0.00174533,0) [0|0.10995579] "rad"  ADAS
 SG_ DET_RCS_030 : 256|8@1+ (0.5,-64) [-64|63.5] "dBsm"  ADAS
 SG_ DET_VALID_FLAG_030 : 167|1@1+ (1,0) [0|1] ""  ADAS
 SG_ DET_BI_STATIC_FLAG_030 : 505|1@1+ (1,0) [0|1] ""  ADAS
 SG_ DET_SUPER_RES_TARGET_030 : 247|1@1+ (1,0) [0|1] ""  ADAS
 SG_ DET_SNR_030 : 248|8@1+ (0.35156,0) [0|89.6478] "dB"  ADAS
 SG_ DET_POINT_TARGET_PROB_030 : 240|4@1+ (6.67,0) [0|100] "%"  ADAS
 SG_ DET_EXISTENCE_PROB_030 : 232|6@1+ (1.588,0) [0|100] "%"  ADAS
 SG_ DET_OUTSIDE_SECTOR_030 : 183|1@1+ (1,0) [0|1] ""  ADAS
 SG_ DET_HVC_FLAG_030 : 246|1@1+ (1,0) [0|1] ""  ADAS
 SG_ DET_CONFD_AZIMUTH_030 : 206|2@1+ (1,0) [0|3] ""  ADAS
 SG_ DET_CONFD_ELEVATION_030 : 244|2@1+ (1,0) [0|3] ""  ADAS
 SG_ DET_RANGE_031 : 264|15@1+ (0.015625,0) [0|500] "m"  ADAS
 SG_ DET_RANGE_ERR_031 : 280|7@1+ (0.0075,0) [0|0.9525] "m"  ADAS
 SG_ DET_RANGE_VELOCITY_031 : 288|15@1+ (0.0078125,-128) [-128|127.9921875] "m/s"  ADAS
 SG_ DET_RANGE_VELOCITY_ERR_031 : 304|8@1+ (0.003,0) [0|0.765] "m/s"  ADAS
 SG_ DET_AZIMUTH_031 : 328|13@1+ (0.0004,-1.5708) [-1.5708|1.5708] "rad"  ADAS
 SG_ DET_AZIMUTH_ERR_031 : 345|7@1+ (0.00087267,0) [0|0.11082909] "rad"  ADAS
 SG_ DET_ELEVATION_031 : 312|8@1+ (0.00275,-0.34925) [-0.34925|0.34925] "rad"  ADAS
 SG_ DET_ELEVATION_ERR_031 : 320|6@1+ (0.00174533,0) [0|0.10995579] "rad"  ADAS
 SG_ DET_RCS_031 : 376|8@1+ (0.5,-64) [-64|63.5] "dBsm"  ADAS
 SG_ DET_VALID_FLAG_031 : 399|1@1+ (1,0) [0|1] ""  ADAS
 SG_ DET_BI_STATIC_FLAG_031 : 482|1@1+ (1,0) [0|1] ""  ADAS
 SG_ DET_SUPER_RES_TARGET_031 : 344|1@1+ (1,0) [0|1] ""  ADAS
 SG_ DET_SNR_031 : 368|8@1+ (0.35156,0) [0|89.6478] "dB"  ADAS
 SG_ DET_POINT_TARGET_PROB_031 : 360|4@1+ (6.67,0) [0|100] "%"  ADAS
 SG_ DET_EXISTENCE_PROB_031 : 352|6@1+ (1.588,0) [0|100] "%"  ADAS
 SG_ DET_OUTSIDE_SECTOR_031 : 407|1@1+ (1,0) [0|1] ""  ADAS
 SG_ DET_HVC_FLAG_031 : 364|1@1+ (1,0) [0|1] ""  ADAS
 SG_ DET_CONFD_AZIMUTH_031 : 365|2@1+ (1,0) [0|3] ""  ADAS
 SG_ DET_CONFD_ELEVATION_031 : 358|2@1+ (1,0) [0|3] ""  ADAS
 SG_ DET_RANGE_032 : 384|15@1+ (0.015625,0) [0|500] "m"  ADAS
 SG_ DET_RANGE_ERR_032 : 400|7@1+ (0.0075,0) [0|0.9525] "m"  ADAS
 SG_ DET_RANGE_VELOCITY_032 : 408|15@1+ (0.0078125,-128) [-128|127.9921875] "m/s"  ADAS
 SG_ DET_RANGE_VELOCITY_ERR_032 : 424|8@1+ (0.003,0) [0|0.765] "m/s"  ADAS
 SG_ DET_AZIMUTH_032 : 448|13@1+ (0.0004,-1.5708) [-1.5708|1.5708] "rad"  ADAS
 SG_ DET_AZIMUTH_ERR_032 : 465|7@1+ (0.00087267,0) [0|0.11082909] "rad"  ADAS
 SG_ DET_ELEVATION_032 : 432|8@1+ (0.00275,-0.34925) [-0.34925|0.34925] "rad"  ADAS
 SG_ DET_ELEVATION_ERR_032 : 440|6@1+ (0.00174533,0) [0|0.10995579] "rad"  ADAS
 SG_ DET_RCS_032 : 496|8@1+ (0.5,-64) [-64|63.5] "dBsm"  ADAS
 SG_ DET_VALID_FLAG_032 : 485|1@1+ (1,0) [0|1] ""  ADAS
 SG_ DET_BI_STATIC_FLAG_032 : 483|1@1+ (1,0) [0|1] ""  ADAS
 SG_ DET_SUPER_RES_TARGET_032 : 446|1@1+ (1,0) [0|1] ""  ADAS
 SG_ DET_SNR_032 : 488|8@1+ (0.35156,0) [0|89.6478] "dB"  ADAS
 SG_ DET_POINT_TARGET_PROB_032 : 472|4@1+ (6.67,0) [0|100] "%"  ADAS
 SG_ DET_EXISTENCE_PROB_032 : 506|6@1+ (1.588,0) [0|100] "%"  ADAS
 SG_ DET_OUTSIDE_SECTOR_032 : 481|1@1+ (1,0) [0|1] ""  ADAS
 SG_ DET_HVC_FLAG_032 : 464|1@1+ (1,0) [0|1] ""  ADAS
 SG_ DET_CONFD_AZIMUTH_032 : 486|2@1+ (1,0) [0|3] ""  ADAS
 SG_ DET_CONFD_ELEVATION_032 : 461|2@1+ (1,0) [0|3] ""  ADAS
 SG_ DET_MH_SCAN_INDEX_4LSB_029_032 : 476|4@1+ (1,0) [0|15] ""  ADAS
 SG_ DET_MH_CYCLE_COUNTER_029_032 : 16|8@1+ (1,0) [0|255] ""  ADAS
 SG_ DET_MH_CRC16_029_032 : 0|16@1+ (1,0) [0|65535] ""  ADAS

BO_ 1160 RDR_DETECTION_033_036: 64 RDR08
 SG_ DET_RANGE_033 : 24|15@1+ (0.015625,0) [0|500] "m"  ADAS
 SG_ DET_RANGE_ERR_033 : 40|7@1+ (0.0075,0) [0|0.9525] "m"  ADAS
 SG_ DET_RANGE_VELOCITY_033 : 48|15@1+ (0.0078125,-128) [-128|127.9921875] "m/s"  ADAS
 SG_ DET_RANGE_VELOCITY_ERR_033 : 64|8@1+ (0.003,0) [0|0.765] "m/s"  ADAS
 SG_ DET_AZIMUTH_033 : 88|13@1+ (0.0004,-1.5708) [-1.5708|1.5708] "rad"  ADAS
 SG_ DET_AZIMUTH_ERR_033 : 105|7@1+ (0.00087267,0) [0|0.11082909] "rad"  ADAS
 SG_ DET_ELEVATION_033 : 72|8@1+ (0.00275,-0.34925) [-0.34925|0.34925] "rad"  ADAS
 SG_ DET_ELEVATION_ERR_033 : 80|6@1+ (0.00174533,0) [0|0.10995579] "rad"  ADAS
 SG_ DET_RCS_033 : 136|8@1+ (0.5,-64) [-64|63.5] "dBsm"  ADAS
 SG_ DET_VALID_FLAG_033 : 119|1@1+ (1,0) [0|1] ""  ADAS
 SG_ DET_BI_STATIC_FLAG_033 : 504|1@1+ (1,0) [0|1] ""  ADAS
 SG_ DET_SUPER_RES_TARGET_033 : 104|1@1+ (1,0) [0|1] ""  ADAS
 SG_ DET_SNR_033 : 128|8@1+ (0.35156,0) [0|89.6478] "dB"  ADAS
 SG_ DET_POINT_TARGET_PROB_033 : 114|4@1+ (6.67,0) [0|100] "%"  ADAS
 SG_ DET_EXISTENCE_PROB_033 : 120|6@1+ (1.588,0) [0|100] "%"  ADAS
 SG_ DET_OUTSIDE_SECTOR_033 : 159|1@1+ (1,0) [0|1] ""  ADAS
 SG_ DET_HVC_FLAG_033 : 118|1@1+ (1,0) [0|1] ""  ADAS
 SG_ DET_CONFD_AZIMUTH_033 : 126|2@1+ (1,0) [0|3] ""  ADAS
 SG_ DET_CONFD_ELEVATION_033 : 112|2@1+ (1,0) [0|3] ""  ADAS
 SG_ DET_RANGE_034 : 144|15@1+ (0.015625,0) [0|500] "m"  ADAS
 SG_ DET_RANGE_ERR_034 : 160|7@1+ (0.0075,0) [0|0.9525] "m"  ADAS
 SG_ DET_RANGE_VELOCITY_034 : 168|15@1+ (0.0078125,-128) [-128|127.9921875] "m/s"  ADAS
 SG_ DET_RANGE_VELOCITY_ERR_034 : 184|8@1+ (0.003,0) [0|0.765] "m/s"  ADAS
 SG_ DET_AZIMUTH_034 : 208|13@1+ (0.0004,-1.5708) [-1.5708|1.5708] "rad"  ADAS
 SG_ DET_AZIMUTH_ERR_034 : 224|7@1+ (0.00087267,0) [0|0.11082909] "rad"  ADAS
 SG_ DET_ELEVATION_034 : 192|8@1+ (0.00275,-0.34925) [-0.34925|0.34925] "rad"  ADAS
 SG_ DET_ELEVATION_ERR_034 : 200|6@1+ (0.00174533,0) [0|0.10995579] "rad"  ADAS
 SG_ DET_RCS_034 : 256|8@1+ (0.5,-64) [-64|63.5] "dBsm"  ADAS
 SG_ DET_VALID_FLAG_034 : 167|1@1+ (1,0) [0|1] ""  ADAS
 SG_ DET_BI_STATIC_FLAG_034 : 505|1@1+ (1,0) [0|1] ""  ADAS
 SG_ DET_SUPER_RES_TARGET_034 : 247|1@1+ (1,0) [0|1] ""  ADAS
 SG_ DET_SNR_034 : 248|8@1+ (0.35156,0) [0|89.6478] "dB"  ADAS
 SG_ DET_POINT_TARGET_PROB_034 : 240|4@1+ (6.67,0) [0|100] "%"  ADAS
 SG_ DET_EXISTENCE_PROB_034 : 232|6@1+ (1.588,0) [0|100] "%"  ADAS
 SG_ DET_OUTSIDE_SECTOR_034 : 183|1@1+ (1,0) [0|1] ""  ADAS
 SG_ DET_HVC_FLAG_034 : 246|1@1+ (1,0) [0|1] ""  ADAS
 SG_ DET_CONFD_AZIMUTH_034 : 206|2@1+ (1,0) [0|3] ""  ADAS
 SG_ DET_CONFD_ELEVATION_034 : 244|2@1+ (1,0) [0|3] ""  ADAS
 SG_ DET_RANGE_035 : 264|15@1+ (0.015625,0) [0|500] "m"  ADAS
 SG_ DET_RANGE_ERR_035 : 280|7@1+ (0.0075,0) [0|0.9525] "m"  ADAS
 SG_ DET_RANGE_VELOCITY_035 : 288|15@1+ (0.0078125,-128) [-128|127.9921875] "m/s"  ADAS
 SG_ DET_RANGE_VELOCITY_ERR_035 : 304|8@1+ (0.003,0) [0|0.765] "m/s"  ADAS
 SG_ DET_AZIMUTH_035 : 328|13@1+ (0.0004,-1.5708) [-1.5708|1.5708] "rad"  ADAS
 SG_ DET_AZIMUTH_ERR_035 : 345|7@1+ (0.00087267,0) [0|0.11082909] "rad"  ADAS
 SG_ DET_ELEVATION_035 : 312|8@1+ (0.00275,-0.34925) [-0.34925|0.34925] "rad"  ADAS
 SG_ DET_ELEVATION_ERR_035 : 320|6@1+ (0.00174533,0) [0|0.10995579] "rad"  ADAS
 SG_ DET_RCS_035 : 376|8@1+ (0.5,-64) [-64|63.5] "dBsm"  ADAS
 SG_ DET_VALID_FLAG_035 : 399|1@1+ (1,0) [0|1] ""  ADAS
 SG_ DET_BI_STATIC_FLAG_035 : 482|1@1+ (1,0) [0|1] ""  ADAS
 SG_ DET_SUPER_RES_TARGET_035 : 344|1@1+ (1,0) [0|1] ""  ADAS
 SG_ DET_SNR_035 : 368|8@1+ (0.35156,0) [0|89.6478] "dB"  ADAS
 SG_ DET_POINT_TARGET_PROB_035 : 360|4@1+ (6.67,0) [0|100] "%"  ADAS
 SG_ DET_EXISTENCE_PROB_035 : 352|6@1+ (1.588,0) [0|100] "%"  ADAS
 SG_ DET_OUTSIDE_SECTOR_035 : 407|1@1+ (1,0) [0|1] ""  ADAS
 SG_ DET_HVC_FLAG_035 : 364|1@1+ (1,0) [0|1] ""  ADAS
 SG_ DET_CONFD_AZIMUTH_035 : 365|2@1+ (1,0) [0|3] ""  ADAS
 SG_ DET_CONFD_ELEVATION_035 : 358|2@1+ (1,0) [0|3] ""  ADAS
 SG_ DET_RANGE_036 : 384|15@1+ (0.015625,0) [0|500] "m"  ADAS
 SG_ DET_RANGE_ERR_036 : 400|7@1+ (0.0075,0) [0|0.9525] "m"  ADAS
 SG_ DET_RANGE_VELOCITY_036 : 408|15@1+ (0.0078125,-128) [-128|127.9921875] "m/s"  ADAS
 SG_ DET_RANGE_VELOCITY_ERR_036 : 424|8@1+ (0.003,0) [0|0.765] "m/s"  ADAS
 SG_ DET_AZIMUTH_036 : 448|13@1+ (0.0004,-1.5708) [-1.5708|1.5708] "rad"  ADAS
 SG_ DET_AZIMUTH_ERR_036 : 465|7@1+ (0.00087267,0) [0|0.11082909] "rad"  ADAS
 SG_ DET_ELEVATION_036 : 432|8@1+ (0.00275,-0.34925) [-0.34925|0.34925] "rad"  ADAS
 SG_ DET_ELEVATION_ERR_036 : 440|6@1+ (0.00174533,0) [0|0.10995579] "rad"  ADAS
 SG_ DET_RCS_036 : 496|8@1+ (0.5,-64) [-64|63.5] "dBsm"  ADAS
 SG_ DET_VALID_FLAG_036 : 485|1@1+ (1,0) [0|1] ""  ADAS
 SG_ DET_BI_STATIC_FLAG_036 : 483|1@1+ (1,0) [0|1] ""  ADAS
 SG_ DET_SUPER_RES_TARGET_036 : 446|1@1+ (1,0) [0|1] ""  ADAS
 SG_ DET_SNR_036 : 488|8@1+ (0.35156,0) [0|89.6478] "dB"  ADAS
 SG_ DET_POINT_TARGET_PROB_036 : 472|4@1+ (6.67,0) [0|100] "%"  ADAS
 SG_ DET_EXISTENCE_PROB_036 : 506|6@1+ (1.588,0) [0|100] "%"  ADAS
 SG_ DET_OUTSIDE_SECTOR_036 : 481|1@1+ (1,0) [0|1] ""  ADAS
 SG_ DET_HVC_FLAG_036 : 464|1@1+ (1,0) [0|1] ""  ADAS
 SG_ DET_CONFD_AZIMUTH_036 : 486|2@1+ (1,0) [0|3] ""  ADAS
 SG_ DET_CONFD_ELEVATION_036 : 461|2@1+ (1,0) [0|3] ""  ADAS
 SG_ DET_MH_SCAN_INDEX_4LSB_033_036 : 476|4@1+ (1,0) [0|15] ""  ADAS
 SG_ DET_MH_CYCLE_COUNTER_033_036 : 16|8@1+ (1,0) [0|255] ""  ADAS
 SG_ DET_MH_CRC16_033_036 : 0|16@1+ (1,0) [0|65535] ""  ADAS

BO_ 1161 RDR_DETECTION_037_040: 64 RDR08
 SG_ DET_RANGE_037 : 24|15@1+ (0.015625,0) [0|500] "m"  ADAS
 SG_ DET_RANGE_ERR_037 : 40|7@1+ (0.0075,0) [0|0.9525] "m"  ADAS
 SG_ DET_RANGE_VELOCITY_037 : 48|15@1+ (0.0078125,-128) [-128|127.9921875] "m/s"  ADAS
 SG_ DET_RANGE_VELOCITY_ERR_037 : 64|8@1+ (0.003,0) [0|0.765] "m/s"  ADAS
 SG_ DET_AZIMUTH_037 : 88|13@1+ (0.0004,-1.5708) [-1.5708|1.5708] "rad"  ADAS
 SG_ DET_AZIMUTH_ERR_037 : 105|7@1+ (0.00087267,0) [0|0.11082909] "rad"  ADAS
 SG_ DET_ELEVATION_037 : 72|8@1+ (0.00275,-0.34925) [-0.34925|0.34925] "rad"  ADAS
 SG_ DET_ELEVATION_ERR_037 : 80|6@1+ (0.00174533,0) [0|0.10995579] "rad"  ADAS
 SG_ DET_RCS_037 : 136|8@1+ (0.5,-64) [-64|63.5] "dBsm"  ADAS
 SG_ DET_VALID_FLAG_037 : 119|1@1+ (1,0) [0|1] ""  ADAS
 SG_ DET_BI_STATIC_FLAG_037 : 504|1@1+ (1,0) [0|1] ""  ADAS
 SG_ DET_SUPER_RES_TARGET_037 : 104|1@1+ (1,0) [0|1] ""  ADAS
 SG_ DET_SNR_037 : 128|8@1+ (0.35156,0) [0|89.6478] "dB"  ADAS
 SG_ DET_POINT_TARGET_PROB_037 : 114|4@1+ (6.67,0) [0|100] "%"  ADAS
 SG_ DET_EXISTENCE_PROB_037 : 120|6@1+ (1.588,0) [0|100] "%"  ADAS
 SG_ DET_OUTSIDE_SECTOR_037 : 159|1@1+ (1,0) [0|1] ""  ADAS
 SG_ DET_HVC_FLAG_037 : 118|1@1+ (1,0) [0|1] ""  ADAS
 SG_ DET_CONFD_AZIMUTH_037 : 126|2@1+ (1,0) [0|3] ""  ADAS
 SG_ DET_CONFD_ELEVATION_037 : 112|2@1+ (1,0) [0|3] ""  ADAS
 SG_ DET_RANGE_038 : 144|15@1+ (0.015625,0) [0|500] "m"  ADAS
 SG_ DET_RANGE_ERR_038 : 160|7@1+ (0.0075,0) [0|0.9525] "m"  ADAS
 SG_ DET_RANGE_VELOCITY_038 : 168|15@1+ (0.0078125,-128) [-128|127.9921875] "m/s"  ADAS
 SG_ DET_RANGE_VELOCITY_ERR_038 : 184|8@1+ (0.003,0) [0|0.765] "m/s"  ADAS
 SG_ DET_AZIMUTH_038 : 208|13@1+ (0.0004,-1.5708) [-1.5708|1.5708] "rad"  ADAS
 SG_ DET_AZIMUTH_ERR_038 : 224|7@1+ (0.00087267,0) [0|0.11082909] "rad"  ADAS
 SG_ DET_ELEVATION_038 : 192|8@1+ (0.00275,-0.34925) [-0.34925|0.34925] "rad"  ADAS
 SG_ DET_ELEVATION_ERR_038 : 200|6@1+ (0.00174533,0) [0|0.10995579] "rad"  ADAS
 SG_ DET_RCS_038 : 256|8@1+ (0.5,-64) [-64|63.5] "dBsm"  ADAS
 SG_ DET_VALID_FLAG_038 : 167|1@1+ (1,0) [0|1] ""  ADAS
 SG_ DET_BI_STATIC_FLAG_038 : 505|1@1+ (1,0) [0|1] ""  ADAS
 SG_ DET_SUPER_RES_TARGET_038 : 247|1@1+ (1,0) [0|1] ""  ADAS
 SG_ DET_SNR_038 : 248|8@1+ (0.35156,0) [0|89.6478] "dB"  ADAS
 SG_ DET_POINT_TARGET_PROB_038 : 240|4@1+ (6.67,0) [0|100] "%"  ADAS
 SG_ DET_EXISTENCE_PROB_038 : 232|6@1+ (1.588,0) [0|100] "%"  ADAS
 SG_ DET_OUTSIDE_SECTOR_038 : 183|1@1+ (1,0) [0|1] ""  ADAS
 SG_ DET_HVC_FLAG_038 : 246|1@1+ (1,0) [0|1] ""  ADAS
 SG_ DET_CONFD_AZIMUTH_038 : 206|2@1+ (1,0) [0|3] ""  ADAS
 SG_ DET_CONFD_ELEVATION_038 : 244|2@1+ (1,0) [0|3] ""  ADAS
 SG_ DET_RANGE_039 : 264|15@1+ (0.015625,0) [0|500] "m"  ADAS
 SG_ DET_RANGE_ERR_039 : 280|7@1+ (0.0075,0) [0|0.9525] "m"  ADAS
 SG_ DET_RANGE_VELOCITY_039 : 288|15@1+ (0.0078125,-128) [-128|127.9921875] "m/s"  ADAS
 SG_ DET_RANGE_VELOCITY_ERR_039 : 304|8@1+ (0.003,0) [0|0.765] "m/s"  ADAS
 SG_ DET_AZIMUTH_039 : 328|13@1+ (0.0004,-1.5708) [-1.5708|1.5708] "rad"  ADAS
 SG_ DET_AZIMUTH_ERR_039 : 345|7@1+ (0.00087267,0) [0|0.11082909] "rad"  ADAS
 SG_ DET_ELEVATION_039 : 312|8@1+ (0.00275,-0.34925) [-0.34925|0.34925] "rad"  ADAS
 SG_ DET_ELEVATION_ERR_039 : 320|6@1+ (0.00174533,0) [0|0.10995579] "rad"  ADAS
 SG_ DET_RCS_039 : 376|8@1+ (0.5,-64) [-64|63.5] "dBsm"  ADAS
 SG_ DET_VALID_FLAG_039 : 399|1@1+ (1,0) [0|1] ""  ADAS
 SG_ DET_BI_STATIC_FLAG_039 : 482|1@1+ (1,0) [0|1] ""  ADAS
 SG_ DET_SUPER_RES_TARGET_039 : 344|1@1+ (1,0) [0|1] ""  ADAS
 SG_ DET_SNR_039 : 368|8@1+ (0.35156,0) [0|89.6478] "dB"  ADAS
 SG_ DET_POINT_TARGET_PROB_039 : 360|4@1+ (6.67,0) [0|100] "%"  ADAS
 SG_ DET_EXISTENCE_PROB_039 : 352|6@1+ (1.588,0) [0|100] "%"  ADAS
 SG_ DET_OUTSIDE_SECTOR_039 : 407|1@1+ (1,0) [0|1] ""  ADAS
 SG_ DET_HVC_FLAG_039 : 364|1@1+ (1,0) [0|1] ""  ADAS
 SG_ DET_CONFD_AZIMUTH_039 : 365|2@1+ (1,0) [0|3] ""  ADAS
 SG_ DET_CONFD_ELEVATION_039 : 358|2@1+ (1,0) [0|3] ""  ADAS
 SG_ DET_RANGE_040 : 384|15@1+ (0.015625,0) [0|500] "m"  ADAS
 SG_ DET_RANGE_ERR_040 : 400|7@1+ (0.0075,0) [0|0.9525] "m"  ADAS
 SG_ DET_RANGE_VELOCITY_040 : 408|15@1+ (0.0078125,-128) [-128|127.9921875] "m/s"  ADAS
 SG_ DET_RANGE_VELOCITY_ERR_040 : 424|8@1+ (0.003,0) [0|0.765] "m/s"  ADAS
 SG_ DET_AZIMUTH_040 : 448|13@1+ (0.0004,-1.5708) [-1.5708|1.5708] "rad"  ADAS
 SG_ DET_AZIMUTH_ERR_040 : 465|7@1+ (0.00087267,0) [0|0.11082909] "rad"  ADAS
 SG_ DET_ELEVATION_040 : 432|8@1+ (0.00275,-0.34925) [-0.34925|0.34925] "rad"  ADAS
 SG_ DET_ELEVATION_ERR_040 : 440|6@1+ (0.00174533,0) [0|0.10995579] "rad"  ADAS
 SG_ DET_RCS_040 : 496|8@1+ (0.5,-64) [-64|63.5] "dBsm"  ADAS
 SG_ DET_VALID_FLAG_040 : 485|1@1+ (1,0) [0|1] ""  ADAS
 SG_ DET_BI_STATIC_FLAG_040 : 483|1@1+ (1,0) [0|1] ""  ADAS
 SG_ DET_SUPER_RES_TARGET_040 : 446|1@1+ (1,0) [0|1] ""  ADAS
 SG_ DET_SNR_040 : 488|8@1+ (0.35156,0) [0|89.6478] "dB"  ADAS
 SG_ DET_POINT_TARGET_PROB_040 : 472|4@1+ (6.67,0) [0|100] "%"  ADAS
 SG_ DET_EXISTENCE_PROB_040 : 506|6@1+ (1.588,0) [0|100] "%"  ADAS
 SG_ DET_OUTSIDE_SECTOR_040 : 481|1@1+ (1,0) [0|1] ""  ADAS
 SG_ DET_HVC_FLAG_040 : 464|1@1+ (1,0) [0|1] ""  ADAS
 SG_ DET_CONFD_AZIMUTH_040 : 486|2@1+ (1,0) [0|3] ""  ADAS
 SG_ DET_CONFD_ELEVATION_040 : 461|2@1+ (1,0) [0|3] ""  ADAS
 SG_ DET_MH_SCAN_INDEX_4LSB_037_040 : 476|4@1+ (1,0) [0|15] ""  ADAS
 SG_ DET_MH_CYCLE_COUNTER_037_040 : 16|8@1+ (1,0) [0|255] ""  ADAS
 SG_ DET_MH_CRC16_037_040 : 0|16@1+ (1,0) [0|65535] ""  ADAS

BO_ 1162 RDR_DETECTION_041_044: 64 RDR08
 SG_ DET_RANGE_041 : 24|15@1+ (0.015625,0) [0|500] "m"  ADAS
 SG_ DET_RANGE_ERR_041 : 40|7@1+ (0.0075,0) [0|0.9525] "m"  ADAS
 SG_ DET_RANGE_VELOCITY_041 : 48|15@1+ (0.0078125,-128) [-128|127.9921875] "m/s"  ADAS
 SG_ DET_RANGE_VELOCITY_ERR_041 : 64|8@1+ (0.003,0) [0|0.765] "m/s"  ADAS
 SG_ DET_AZIMUTH_041 : 88|13@1+ (0.0004,-1.5708) [-1.5708|1.5708] "rad"  ADAS
 SG_ DET_AZIMUTH_ERR_041 : 105|7@1+ (0.00087267,0) [0|0.11082909] "rad"  ADAS
 SG_ DET_ELEVATION_041 : 72|8@1+ (0.00275,-0.34925) [-0.34925|0.34925] "rad"  ADAS
 SG_ DET_ELEVATION_ERR_041 : 80|6@1+ (0.00174533,0) [0|0.10995579] "rad"  ADAS
 SG_ DET_RCS_041 : 136|8@1+ (0.5,-64) [-64|63.5] "dBsm"  ADAS
 SG_ DET_VALID_FLAG_041 : 119|1@1+ (1,0) [0|1] ""  ADAS
 SG_ DET_BI_STATIC_FLAG_041 : 504|1@1+ (1,0) [0|1] ""  ADAS
 SG_ DET_SUPER_RES_TARGET_041 : 104|1@1+ (1,0) [0|1] ""  ADAS
 SG_ DET_SNR_041 : 128|8@1+ (0.35156,0) [0|89.6478] "dB"  ADAS
 SG_ DET_POINT_TARGET_PROB_041 : 114|4@1+ (6.67,0) [0|100] "%"  ADAS
 SG_ DET_EXISTENCE_PROB_041 : 120|6@1+ (1.588,0) [0|100] "%"  ADAS
 SG_ DET_OUTSIDE_SECTOR_041 : 159|1@1+ (1,0) [0|1] ""  ADAS
 SG_ DET_HVC_FLAG_041 : 118|1@1+ (1,0) [0|1] ""  ADAS
 SG_ DET_CONFD_AZIMUTH_041 : 126|2@1+ (1,0) [0|3] ""  ADAS
 SG_ DET_CONFD_ELEVATION_041 : 112|2@1+ (1,0) [0|3] ""  ADAS
 SG_ DET_RANGE_042 : 144|15@1+ (0.015625,0) [0|500] "m"  ADAS
 SG_ DET_RANGE_ERR_042 : 160|7@1+ (0.0075,0) [0|0.9525] "m"  ADAS
 SG_ DET_RANGE_VELOCITY_042 : 168|15@1+ (0.0078125,-128) [-128|127.9921875] "m/s"  ADAS
 SG_ DET_RANGE_VELOCITY_ERR_042 : 184|8@1+ (0.003,0) [0|0.765] "m/s"  ADAS
 SG_ DET_AZIMUTH_042 : 208|13@1+ (0.0004,-1.5708) [-1.5708|1.5708] "rad"  ADAS
 SG_ DET_AZIMUTH_ERR_042 : 224|7@1+ (0.00087267,0) [0|0.11082909] "rad"  ADAS
 SG_ DET_ELEVATION_042 : 192|8@1+ (0.00275,-0.34925) [-0.34925|0.34925] "rad"  ADAS
 SG_ DET_ELEVATION_ERR_042 : 200|6@1+ (0.00174533,0) [0|0.10995579] "rad"  ADAS
 SG_ DET_RCS_042 : 256|8@1+ (0.5,-64) [-64|63.5] "dBsm"  ADAS
 SG_ DET_VALID_FLAG_042 : 167|1@1+ (1,0) [0|1] ""  ADAS
 SG_ DET_BI_STATIC_FLAG_042 : 505|1@1+ (1,0) [0|1] ""  ADAS
 SG_ DET_SUPER_RES_TARGET_042 : 247|1@1+ (1,0) [0|1] ""  ADAS
 SG_ DET_SNR_042 : 248|8@1+ (0.35156,0) [0|89.6478] "dB"  ADAS
 SG_ DET_POINT_TARGET_PROB_042 : 240|4@1+ (6.67,0) [0|100] "%"  ADAS
 SG_ DET_EXISTENCE_PROB_042 : 232|6@1+ (1.588,0) [0|100] "%"  ADAS
 SG_ DET_OUTSIDE_SECTOR_042 : 183|1@1+ (1,0) [0|1] ""  ADAS
 SG_ DET_HVC_FLAG_042 : 246|1@1+ (1,0) [0|1] ""  ADAS
 SG_ DET_CONFD_AZIMUTH_042 : 206|2@1+ (1,0) [0|3] ""  ADAS
 SG_ DET_CONFD_ELEVATION_042 : 244|2@1+ (1,0) [0|3] ""  ADAS
 SG_ DET_RANGE_043 : 264|15@1+ (0.015625,0) [0|500] "m"  ADAS
 SG_ DET_RANGE_ERR_043 : 280|7@1+ (0.0075,0) [0|0.9525] "m"  ADAS
 SG_ DET_RANGE_VELOCITY_043 : 288|15@1+ (0.0078125,-128) [-128|127.9921875] "m/s"  ADAS
 SG_ DET_RANGE_VELOCITY_ERR_043 : 304|8@1+ (0.003,0) [0|0.765] "m/s"  ADAS
 SG_ DET_AZIMUTH_043 : 328|13@1+ (0.0004,-1.5708) [-1.5708|1.5708] "rad"  ADAS
 SG_ DET_AZIMUTH_ERR_043 : 345|7@1+ (0.00087267,0) [0|0.11082909] "rad"  ADAS
 SG_ DET_ELEVATION_043 : 312|8@1+ (0.00275,-0.34925) [-0.34925|0.34925] "rad"  ADAS
 SG_ DET_ELEVATION_ERR_043 : 320|6@1+ (0.00174533,0) [0|0.10995579] "rad"  ADAS
 SG_ DET_RCS_043 : 376|8@1+ (0.5,-64) [-64|63.5] "dBsm"  ADAS
 SG_ DET_VALID_FLAG_043 : 399|1@1+ (1,0) [0|1] ""  ADAS
 SG_ DET_BI_STATIC_FLAG_043 : 482|1@1+ (1,0) [0|1] ""  ADAS
 SG_ DET_SUPER_RES_TARGET_043 : 344|1@1+ (1,0) [0|1] ""  ADAS
 SG_ DET_SNR_043 : 368|8@1+ (0.35156,0) [0|89.6478] "dB"  ADAS
 SG_ DET_POINT_TARGET_PROB_043 : 360|4@1+ (6.67,0) [0|100] "%"  ADAS
 SG_ DET_EXISTENCE_PROB_043 : 352|6@1+ (1.588,0) [0|100] "%"  ADAS
 SG_ DET_OUTSIDE_SECTOR_043 : 407|1@1+ (1,0) [0|1] ""  ADAS
 SG_ DET_HVC_FLAG_043 : 364|1@1+ (1,0) [0|1] ""  ADAS
 SG_ DET_CONFD_AZIMUTH_043 : 365|2@1+ (1,0) [0|3] ""  ADAS
 SG_ DET_CONFD_ELEVATION_043 : 358|2@1+ (1,0) [0|3] ""  ADAS
 SG_ DET_RANGE_044 : 384|15@1+ (0.015625,0) [0|500] "m"  ADAS
 SG_ DET_RANGE_ERR_044 : 400|7@1+ (0.0075,0) [0|0.9525] "m"  ADAS
 SG_ DET_RANGE_VELOCITY_044 : 408|15@1+ (0.0078125,-128) [-128|127.9921875] "m/s"  ADAS
 SG_ DET_RANGE_VELOCITY_ERR_044 : 424|8@1+ (0.003,0) [0|0.765] "m/s"  ADAS
 SG_ DET_AZIMUTH_044 : 448|13@1+ (0.0004,-1.5708) [-1.5708|1.5708] "rad"  ADAS
 SG_ DET_AZIMUTH_ERR_044 : 465|7@1+ (0.00087267,0) [0|0.11082909] "rad"  ADAS
 SG_ DET_ELEVATION_044 : 432|8@1+ (0.00275,-0.34925) [-0.34925|0.34925] "rad"  ADAS
 SG_ DET_ELEVATION_ERR_044 : 440|6@1+ (0.00174533,0) [0|0.10995579] "rad"  ADAS
 SG_ DET_RCS_044 : 496|8@1+ (0.5,-64) [-64|63.5] "dBsm"  ADAS
 SG_ DET_VALID_FLAG_044 : 485|1@1+ (1,0) [0|1] ""  ADAS
 SG_ DET_BI_STATIC_FLAG_044 : 483|1@1+ (1,0) [0|1] ""  ADAS
 SG_ DET_SUPER_RES_TARGET_044 : 446|1@1+ (1,0) [0|1] ""  ADAS
 SG_ DET_SNR_044 : 488|8@1+ (0.35156,0) [0|89.6478] "dB"  ADAS
 SG_ DET_POINT_TARGET_PROB_044 : 472|4@1+ (6.67,0) [0|100] "%"  ADAS
 SG_ DET_EXISTENCE_PROB_044 : 506|6@1+ (1.588,0) [0|100] "%"  ADAS
 SG_ DET_OUTSIDE_SECTOR_044 : 481|1@1+ (1,0) [0|1] ""  ADAS
 SG_ DET_HVC_FLAG_044 : 464|1@1+ (1,0) [0|1] ""  ADAS
 SG_ DET_CONFD_AZIMUTH_044 : 486|2@1+ (1,0) [0|3] ""  ADAS
 SG_ DET_CONFD_ELEVATION_044 : 461|2@1+ (1,0) [0|3] ""  ADAS
 SG_ DET_MH_SCAN_INDEX_4LSB_041_044 : 476|4@1+ (1,0) [0|15] ""  ADAS
 SG_ DET_MH_CYCLE_COUNTER_041_044 : 16|8@1+ (1,0) [0|255] ""  ADAS
 SG_ DET_MH_CRC16_041_044 : 0|16@1+ (1,0) [0|65535] ""  ADAS

CM_ SG_ 1152 DET_RANGE_001 " measured position  of the detection";
CM_ SG_ 1152 DET_RANGE_ERR_001 "RMSE or standard deviation of the measured angle  of the detection";
CM_ SG_ 1152 DET_RANGE_VELOCITY_001 "Radial velocity of the detection positive in direction to the sensor";
CM_ SG_ 1152 DET_RANGE_VELOCITY_ERR_001 "RMSE or standard deviation of the measure radial velocity of the detection";
CM_ SG_ 1152 DET_AZIMUTH_001 "Measured angle  of the detection";
CM_ SG_ 1152 DET_AZIMUTH_ERR_001 "RMSE or standard deviation of the measured angle  of the detection";
CM_ SG_ 1152 DET_ELEVATION_001 "measured elevation of the detection";
CM_ SG_ 1152 DET_ELEVATION_ERR_001 "RMSE or standard deviation of the measured elevation  of the detection";
CM_ SG_ 1152 DET_RCS_001 "Radar Cross Section or Amplitude, is a measure of how detectable an object is by radar. A larger RCS indicates that an object is more easily detected.";
CM_ SG_ 1152 DET_VALID_FLAG_001 "is set if the measured detection is valid";
CM_ SG_ 1152 DET_BI_STATIC_FLAG_001 "1 if detection is bi-static 0 otherwise";
CM_ SG_ 1152 DET_SUPER_RES_TARGET_001 "flasg is set if the detection is super resolution target";
CM_ SG_ 1152 DET_SNR_001 "The signal to noise ratio (SNR) of the radar detection";
CM_ SG_ 1152 DET_POINT_TARGET_PROB_001 "Describes the possibility if more than one real-world object has led to this detection. 0[%] := 100[%] Multi target probability";
CM_ SG_ 1152 DET_EXISTENCE_PROB_001 "Existence probability of the detection not based on history. Value does  not depend on any past experience with similar detections.
\note Use as confidence measure where a low value means less confidence
and a high value indicates strong confidence.";
CM_ SG_ 1152 DET_OUTSIDE_SECTOR_001 "Flag to indicate detections outside the sector, set if the wrong sector calibration matrix was used";
CM_ SG_ 1152 DET_HVC_FLAG_001 "Core2 Vehicle clutter flag";
CM_ SG_ 1152 DET_CONFD_AZIMUTH_001 "Define the Confidence of Azimuth for Detection ";
CM_ SG_ 1152 DET_CONFD_ELEVATION_001 "Define the Confidence of Elevation for the Detection ";
CM_ SG_ 1152 DET_BI_STATIC_FLAG_002 "1 if detection is bi-static 0 otherwise";
CM_ SG_ 1152 DET_BI_STATIC_FLAG_003 "1 if detection is bi-static 0 otherwise";
CM_ SG_ 1152 DET_BI_STATIC_FLAG_004 "1 if detection is bi-static 0 otherwise";
CM_ SG_ 1152 DET_MH_SCAN_INDEX_4LSB_001_004 "Scan index of the measured detection";
CM_ SG_ 1152 DET_MH_CYCLE_COUNTER_001_004 "Detection Alive Counter";
CM_ BO_ 1 "The CAN message from the Time Master is a multiplexed message, viz. CAN-SYN and CAN-FUP";
CM_ SG_ 1 TSYN_USERBYTE "User specific data within the time measurement and synchronization protocol";
CM_ SG_ 1 TSYN_TIMEDOMAIN "Time Domian ID";
CM_ SG_ 1 TSYN_SYNCTIME_SEC "TIme in Seconds";
CM_ SG_ 1 TSYN_SYNCTIME_NANOSEC "Time in Nano Seconds";
CM_ SG_ 1 TSYN_SGW "Sync to Global Time or Sync to Sub Domian";
CM_ SG_ 1 TSYN_SEQUENCE_COUNTER "Sequence Counter (SC) of 4 bit is representing numbers from 0 to 15 per Time
Domain";
CM_ SG_ 1 TSYN_RESERVED "resreved for future extension";
CM_ SG_ 1 TSYN_PDU "TSyn_PDU signal value of 0x20 is  CAN-SYN. and TSyn_PDU signal value of 0x28 is CAN-FUP";
CM_ SG_ 1 TSYN_OVS "Overflow of seconds. If the value calculated for TSyn_SynTimeNSec overflows";
CM_ SG_ 1 TSYNC_CRC "CRC CRC8H2F";
CM_ SG_ 2 SSTS_YAW_RATE_CALC_QF "Yaw Rate quallity factor";
CM_ SG_ 2 SSTS_VEHICLE_SPEED_CALC_QF "Speed Quality factor";
CM_ SG_ 2 SSTS_STEERING_ANGLE_SIGN "Actual steering angle direction, from the centre position of the steering wheel.";
CM_ SG_ 2 SSTS_STEERING_ANGLE "Actual steering wheel angle. Datum (zero) of the steering wheel position is determined at the time of calibration in the factory.   This is only the magnitude of the steering wheel angle.";
CM_ SG_ 187 STS_AF_TIME_PEAK "Angle Finding Latency peak";
CM_ SG_ 187 STS_AF_TIME_INST "Angle Finding Latency instantaneous";
CM_ SG_ 187 STS_SW_VERSION_FIELD1 "Release_Number is incremented for major every release";
CM_ SG_ 187 STS_SW_VERSION_FIELD2 "Promote_Revision, increment with every promote or minor release";
CM_ SG_ 187 STS_SW_VERSION_FIELD3 "Field_Revision  or Variant number";
CM_ SG_ 187 STS_SW_VERSION_FIELD4 "Increment with SW patch release";
CM_ SG_ 187 STS_PBL_VERSION_FIELD1 "Release_Number is incremented for major every release";
CM_ SG_ 187 STS_PBL_VERSION_FIELD2 "Promote_Revision, increment with every promote or minor release";
CM_ SG_ 187 STS_PBL_VERSION_FIELD3 "Field_Revision  or Variant number";
CM_ SG_ 187 STS_PBL_VERSION_FIELD4 "Increment with patch release";
CM_ SG_ 187 STS_SMC_SECTION_COMPTBLITY "Section compatiblity bits as specified in EXEC spec";
CM_ SG_ 187 STS_SMC_PLATFROM_VERSION "Variant ID";
CM_ SG_ 187 STS_SENSOR_MOUNT_POS_X "Correction of the mounting position w.r.t. the optimal position. Correction is determined by calibration";
CM_ SG_ 187 STS_SENSOR_MOUNT_ORNT_PITCH "Correction of the mounting position orientation w.r.t. the optimal orientation";
CM_ SG_ 187 STS_SENSOR_HEIGHT "Radar height from ground to center of radar elevation field-of-view";
CM_ SG_ 187 STS_DET_DBC_BASE_VER_MINOR "Detection base dbc Minor version";
CM_ SG_ 187 STS_DET_DBC_BASE_VER_MAJOR "Detection base dbc Major version";
CM_ SG_ 188 STS_POINT_OF_TRIGGER "Delay betwen TymSyc message received and actual trigger";
CM_ SG_ 188 STS_BRR_STATUS "Current status of BRR , active/inactive/fault";
CM_ SG_ 188 STS_MMIC_TEMP_TX1_2 "Internal MMIC Temperature #1";
CM_ SG_ 188 STS_XCVR_OPERATIONAL "Indication that the transceiver is operational";
CM_ SG_ 188 STS_VEH_SPEED_DIRECTION "Provides indication of vehicle direction of travel";
CM_ SG_ 188 STS_STEERING_ANGLE_SIGN "Actual steering angle direction, from the centre position of the steering wheel.";
CM_ SG_ 188 STS_STEERING_ANGLE "Actual steering wheel angle. Datum (zero) of the steering wheel position is determined at the time of calibration in the factory.   This is only the magnitude of the steering wheel angle.";
CM_ SG_ 188 STS_VEHICLE_SPEED_CALC "Vehicle speed";
CM_ SG_ 188 STS_TIME_SYNC_OFFSET "Current offset from desired Time Sync Sync point";
CM_ SG_ 184 HED_NUM_OF_VALID_DETECTIONS "The current number of valid detections in the detections list";
CM_ SG_ 184 HED_INTRFC_VERSION_ID_MAJOR "Version number for major";
CM_ SG_ 184 HED_INTRFC_VERSION_ID_MINOR "Version number for minor";
CM_ SG_ 184 HED_INTRFC_VERSION_ID_PATCH "Version number for patch";
CM_ SG_ 184 HED_LOOK_ID "Indicates the look type values 1 to 4 base on medium/long look and near/far look. Each radar scan is a look.";
CM_ SG_ 184 HED_SCAN_INDEX "Scan index";
CM_ SG_ 184 HED_MH_CYCLE_COUNTER "ALIVE counter";
CM_ SG_ 184 HED_DATA_QUALIFIER "Data qualifier communicates the overall availability of the interface or expresses to what extent the content of this event can be relied on ";
CM_ SG_ 184 HED_DET_RANGE_MAX "Detection range max is the farthest possible detection with respect to the sensor origin.";
CM_ SG_ 184 HED_DET_SPEED_RANGE_MAX "Describes the relative radial speed range in the sensor coordinate system. Range is defined by
two range values: negative values indicate lower speed than the ego-vehicle, positive values
indicate higher velocity than ego-vehicle";
CM_ SG_ 184 HED_FOV_HOR_MAX "Field of view defined by opening angles in sensor XY-plane.";
CM_ SG_ 184 HED_FOV_VER_MAX "Field of view defined by opening angles in sensor XZ-plane.";
CM_ SG_ 184 HED_DET_RANGE_MIN "Detection range max is the Closest possible detection with respect to the sensor origin.";
CM_ SG_ 184 HED_DET_SPEED_RANGE_MIN "Describes the relative radial speed range in the sensor coordinate system. Range is defined by
two range values: negative values indicate lower speed than the ego-vehicle, positive values
indicate higher velocity than ego-vehicle";
CM_ SG_ 184 HED_FOV_HOR_MIN "Field of view defined by opening angles in sensor XY-plane.";
CM_ SG_ 184 HED_FOV_VER_MIN "Field of view defined by opening angles in sensor XZ-plane.";
CM_ SG_ 184 HED_ALIGN_HOR_REF "Alignment horizontal reference";
CM_ SG_ 184 HED_SENSOR_TIME_STAMP_NS "sensor absolute time when the radar measurement was taken";
CM_ SG_ 184 HED_TIME_SYNC_SRC_MASTER "Indicate if sensor is synch to global master or local master";
CM_ SG_ 184 HED_TIME_SYNC_VALIDITY_FLAG "indicates the validity of Time Sync message data";
CM_ SG_ 184 HED_TRIGGER_TIME "Data Acquisition start time";
CM_ SG_ 1153 DET_RANGE_005 " measured position  of the detection";
CM_ SG_ 1153 DET_RANGE_ERR_005 "RMSE or standard deviation of the measured angle  of the detection";
CM_ SG_ 1153 DET_RANGE_VELOCITY_005 "Radial velocity of the detection positive in direction to the sensor";
CM_ SG_ 1153 DET_RANGE_VELOCITY_ERR_005 "RMSE or standard deviation of the measure radial velocity of the detection";
CM_ SG_ 1153 DET_AZIMUTH_005 "Measured angle  of the detection";
CM_ SG_ 1153 DET_AZIMUTH_ERR_005 "RMSE or standard deviation of the measured angle  of the detection";
CM_ SG_ 1153 DET_ELEVATION_005 "measured elevation of the detection";
CM_ SG_ 1153 DET_ELEVATION_ERR_005 "RMSE or standard deviation of the measured elevation  of the detection";
CM_ SG_ 1153 DET_RCS_005 "Radar Cross Section or Amplitude, is a measure of how detectable an object is by radar. A larger RCS indicates that an object is more easily detected.";
CM_ SG_ 1153 DET_VALID_FLAG_005 "is set if the measured detection is valid";
CM_ SG_ 1153 DET_BI_STATIC_FLAG_005 "1 if detection is bi-static 0 otherwise";
CM_ SG_ 1153 DET_SUPER_RES_TARGET_005 "flasg is set if the detection is super resolution target";
CM_ SG_ 1153 DET_SNR_005 "The signal to noise ratio (SNR) of the radar detection";
CM_ SG_ 1153 DET_POINT_TARGET_PROB_005 "Describes the possibility if more than one real-world object has led to this detection. 0[%] := 100[%] Multi target probability";
CM_ SG_ 1153 DET_EXISTENCE_PROB_005 "Existence probability of the detection not based on history. Value does  not depend on any past experience with similar detections.
\note Use as confidence measure where a low value means less confidence
and a high value indicates strong confidence.";
CM_ SG_ 1153 DET_OUTSIDE_SECTOR_005 "Flag to indicate detections outside the sector, set if the wrong sector calibration matrix was used";
CM_ SG_ 1153 DET_HVC_FLAG_005 "Core2 Vehicle clutter flag";
CM_ SG_ 1153 DET_CONFD_AZIMUTH_005 "Define the Confidence of Azimuth for Detection ";
CM_ SG_ 1153 DET_CONFD_ELEVATION_005 "Define the Confidence of Elevation for the Detection ";
CM_ SG_ 1153 DET_BI_STATIC_FLAG_006 "1 if detection is bi-static 0 otherwise";
CM_ SG_ 1153 DET_BI_STATIC_FLAG_007 "1 if detection is bi-static 0 otherwise";
CM_ SG_ 1153 DET_BI_STATIC_FLAG_008 "1 if detection is bi-static 0 otherwise";
CM_ SG_ 1153 DET_MH_SCAN_INDEX_4LSB_005_008 "Scan index of the measured detection";
CM_ SG_ 1153 DET_MH_CYCLE_COUNTER_005_008 "Detection Alive Counter";
CM_ SG_ 1154 DET_RANGE_009 " measured position  of the detection";
CM_ SG_ 1154 DET_RANGE_ERR_009 "RMSE or standard deviation of the measured angle  of the detection";
CM_ SG_ 1154 DET_RANGE_VELOCITY_009 "Radial velocity of the detection positive in direction to the sensor";
CM_ SG_ 1154 DET_RANGE_VELOCITY_ERR_009 "RMSE or standard deviation of the measure radial velocity of the detection";
CM_ SG_ 1154 DET_AZIMUTH_009 "Measured angle  of the detection";
CM_ SG_ 1154 DET_AZIMUTH_ERR_009 "RMSE or standard deviation of the measured angle  of the detection";
CM_ SG_ 1154 DET_ELEVATION_009 "measured elevation of the detection";
CM_ SG_ 1154 DET_ELEVATION_ERR_009 "RMSE or standard deviation of the measured elevation  of the detection";
CM_ SG_ 1154 DET_RCS_009 "Radar Cross Section or Amplitude, is a measure of how detectable an object is by radar. A larger RCS indicates that an object is more easily detected.";
CM_ SG_ 1154 DET_VALID_FLAG_009 "is set if the measured detection is valid";
CM_ SG_ 1154 DET_BI_STATIC_FLAG_009 "1 if detection is bi-static 0 otherwise";
CM_ SG_ 1154 DET_SUPER_RES_TARGET_009 "flasg is set if the detection is super resolution target";
CM_ SG_ 1154 DET_SNR_009 "The signal to noise ratio (SNR) of the radar detection";
CM_ SG_ 1154 DET_POINT_TARGET_PROB_009 "Describes the possibility if more than one real-world object has led to this detection. 0[%] := 100[%] Multi target probability";
CM_ SG_ 1154 DET_EXISTENCE_PROB_009 "Existence probability of the detection not based on history. Value does  not depend on any past experience with similar detections.
\note Use as confidence measure where a low value means less confidence
and a high value indicates strong confidence.";
CM_ SG_ 1154 DET_OUTSIDE_SECTOR_009 "Flag to indicate detections outside the sector, set if the wrong sector calibration matrix was used";
CM_ SG_ 1154 DET_HVC_FLAG_009 "Core2 Vehicle clutter flag";
CM_ SG_ 1154 DET_CONFD_AZIMUTH_009 "Define the Confidence of Azimuth for Detection ";
CM_ SG_ 1154 DET_CONFD_ELEVATION_009 "Define the Confidence of Elevation for the Detection ";
CM_ SG_ 1154 DET_BI_STATIC_FLAG_010 "1 if detection is bi-static 0 otherwise";
CM_ SG_ 1154 DET_BI_STATIC_FLAG_011 "1 if detection is bi-static 0 otherwise";
CM_ SG_ 1154 DET_BI_STATIC_FLAG_012 "1 if detection is bi-static 0 otherwise";
CM_ SG_ 1154 DET_MH_SCAN_INDEX_4LSB_009_012 "Scan index of the measured detection";
CM_ SG_ 1154 DET_MH_CYCLE_COUNTER_009_012 "Detection Alive Counter";
CM_ SG_ 1155 DET_RANGE_013 " measured position  of the detection";
CM_ SG_ 1155 DET_RANGE_ERR_013 "RMSE or standard deviation of the measured angle  of the detection";
CM_ SG_ 1155 DET_RANGE_VELOCITY_013 "Radial velocity of the detection positive in direction to the sensor";
CM_ SG_ 1155 DET_RANGE_VELOCITY_ERR_013 "RMSE or standard deviation of the measure radial velocity of the detection";
CM_ SG_ 1155 DET_AZIMUTH_013 "Measured angle  of the detection";
CM_ SG_ 1155 DET_AZIMUTH_ERR_013 "RMSE or standard deviation of the measured angle  of the detection";
CM_ SG_ 1155 DET_ELEVATION_013 "measured elevation of the detection";
CM_ SG_ 1155 DET_ELEVATION_ERR_013 "RMSE or standard deviation of the measured elevation  of the detection";
CM_ SG_ 1155 DET_RCS_013 "Radar Cross Section or Amplitude, is a measure of how detectable an object is by radar. A larger RCS indicates that an object is more easily detected.";
CM_ SG_ 1155 DET_VALID_FLAG_013 "is set if the measured detection is valid";
CM_ SG_ 1155 DET_BI_STATIC_FLAG_013 "1 if detection is bi-static 0 otherwise";
CM_ SG_ 1155 DET_SUPER_RES_TARGET_013 "flasg is set if the detection is super resolution target";
CM_ SG_ 1155 DET_SNR_013 "The signal to noise ratio (SNR) of the radar detection";
CM_ SG_ 1155 DET_POINT_TARGET_PROB_013 "Describes the possibility if more than one real-world object has led to this detection. 0[%] := 100[%] Multi target probability";
CM_ SG_ 1155 DET_EXISTENCE_PROB_013 "Existence probability of the detection not based on history. Value does  not depend on any past experience with similar detections.
\note Use as confidence measure where a low value means less confidence
and a high value indicates strong confidence.";
CM_ SG_ 1155 DET_OUTSIDE_SECTOR_013 "Flag to indicate detections outside the sector, set if the wrong sector calibration matrix was used";
CM_ SG_ 1155 DET_HVC_FLAG_013 "Core2 Vehicle clutter flag";
CM_ SG_ 1155 DET_CONFD_AZIMUTH_013 "Define the Confidence of Azimuth for Detection ";
CM_ SG_ 1155 DET_CONFD_ELEVATION_013 "Define the Confidence of Elevation for the Detection ";
CM_ SG_ 1155 DET_BI_STATIC_FLAG_014 "1 if detection is bi-static 0 otherwise";
CM_ SG_ 1155 DET_BI_STATIC_FLAG_015 "1 if detection is bi-static 0 otherwise";
CM_ SG_ 1155 DET_BI_STATIC_FLAG_016 "1 if detection is bi-static 0 otherwise";
CM_ SG_ 1155 DET_MH_SCAN_INDEX_4LSB_013_016 "Scan index of the measured detection";
CM_ SG_ 1155 DET_MH_CYCLE_COUNTER_013_016 "Detection Alive Counter";
CM_ SG_ 1156 DET_RANGE_017 " measured position  of the detection";
CM_ SG_ 1156 DET_RANGE_ERR_017 "RMSE or standard deviation of the measured angle  of the detection";
CM_ SG_ 1156 DET_RANGE_VELOCITY_017 "Radial velocity of the detection positive in direction to the sensor";
CM_ SG_ 1156 DET_RANGE_VELOCITY_ERR_017 "RMSE or standard deviation of the measure radial velocity of the detection";
CM_ SG_ 1156 DET_AZIMUTH_017 "Measured angle  of the detection";
CM_ SG_ 1156 DET_AZIMUTH_ERR_017 "RMSE or standard deviation of the measured angle  of the detection";
CM_ SG_ 1156 DET_ELEVATION_017 "measured elevation of the detection";
CM_ SG_ 1156 DET_ELEVATION_ERR_017 "RMSE or standard deviation of the measured elevation  of the detection";
CM_ SG_ 1156 DET_RCS_017 "Radar Cross Section or Amplitude, is a measure of how detectable an object is by radar. A larger RCS indicates that an object is more easily detected.";
CM_ SG_ 1156 DET_VALID_FLAG_017 "is set if the measured detection is valid";
CM_ SG_ 1156 DET_BI_STATIC_FLAG_017 "1 if detection is bi-static 0 otherwise";
CM_ SG_ 1156 DET_SUPER_RES_TARGET_017 "flasg is set if the detection is super resolution target";
CM_ SG_ 1156 DET_SNR_017 "The signal to noise ratio (SNR) of the radar detection";
CM_ SG_ 1156 DET_POINT_TARGET_PROB_017 "Describes the possibility if more than one real-world object has led to this detection. 0[%] := 100[%] Multi target probability";
CM_ SG_ 1156 DET_EXISTENCE_PROB_017 "Existence probability of the detection not based on history. Value does  not depend on any past experience with similar detections.
\note Use as confidence measure where a low value means less confidence
and a high value indicates strong confidence.";
CM_ SG_ 1156 DET_OUTSIDE_SECTOR_017 "Flag to indicate detections outside the sector, set if the wrong sector calibration matrix was used";
CM_ SG_ 1156 DET_HVC_FLAG_017 "Core2 Vehicle clutter flag";
CM_ SG_ 1156 DET_CONFD_AZIMUTH_017 "Define the Confidence of Azimuth for Detection ";
CM_ SG_ 1156 DET_CONFD_ELEVATION_017 "Define the Confidence of Elevation for the Detection ";
CM_ SG_ 1156 DET_BI_STATIC_FLAG_018 "1 if detection is bi-static 0 otherwise";
CM_ SG_ 1156 DET_BI_STATIC_FLAG_019 "1 if detection is bi-static 0 otherwise";
CM_ SG_ 1156 DET_BI_STATIC_FLAG_020 "1 if detection is bi-static 0 otherwise";
CM_ SG_ 1156 DET_MH_SCAN_INDEX_4LSB_017_020 "Scan index of the measured detection";
CM_ SG_ 1156 DET_MH_CYCLE_COUNTER_017_020 "Detection Alive Counter";
CM_ SG_ 1157 DET_RANGE_021 " measured position  of the detection";
CM_ SG_ 1157 DET_RANGE_ERR_021 "RMSE or standard deviation of the measured angle  of the detection";
CM_ SG_ 1157 DET_RANGE_VELOCITY_021 "Radial velocity of the detection positive in direction to the sensor";
CM_ SG_ 1157 DET_RANGE_VELOCITY_ERR_021 "RMSE or standard deviation of the measure radial velocity of the detection";
CM_ SG_ 1157 DET_AZIMUTH_021 "Measured angle  of the detection";
CM_ SG_ 1157 DET_AZIMUTH_ERR_021 "RMSE or standard deviation of the measured angle  of the detection";
CM_ SG_ 1157 DET_ELEVATION_021 "measured elevation of the detection";
CM_ SG_ 1157 DET_ELEVATION_ERR_021 "RMSE or standard deviation of the measured elevation  of the detection";
CM_ SG_ 1157 DET_RCS_021 "Radar Cross Section or Amplitude, is a measure of how detectable an object is by radar. A larger RCS indicates that an object is more easily detected.";
CM_ SG_ 1157 DET_VALID_FLAG_021 "is set if the measured detection is valid";
CM_ SG_ 1157 DET_BI_STATIC_FLAG_021 "1 if detection is bi-static 0 otherwise";
CM_ SG_ 1157 DET_SUPER_RES_TARGET_021 "flasg is set if the detection is super resolution target";
CM_ SG_ 1157 DET_SNR_021 "The signal to noise ratio (SNR) of the radar detection";
CM_ SG_ 1157 DET_POINT_TARGET_PROB_021 "Describes the possibility if more than one real-world object has led to this detection. 0[%] := 100[%] Multi target probability";
CM_ SG_ 1157 DET_EXISTENCE_PROB_021 "Existence probability of the detection not based on history. Value does  not depend on any past experience with similar detections.
\note Use as confidence measure where a low value means less confidence
and a high value indicates strong confidence.";
CM_ SG_ 1157 DET_OUTSIDE_SECTOR_021 "Flag to indicate detections outside the sector, set if the wrong sector calibration matrix was used";
CM_ SG_ 1157 DET_HVC_FLAG_021 "Core2 Vehicle clutter flag";
CM_ SG_ 1157 DET_CONFD_AZIMUTH_021 "Define the Confidence of Azimuth for Detection ";
CM_ SG_ 1157 DET_CONFD_ELEVATION_021 "Define the Confidence of Elevation for the Detection ";
CM_ SG_ 1157 DET_BI_STATIC_FLAG_022 "1 if detection is bi-static 0 otherwise";
CM_ SG_ 1157 DET_BI_STATIC_FLAG_023 "1 if detection is bi-static 0 otherwise";
CM_ SG_ 1157 DET_BI_STATIC_FLAG_024 "1 if detection is bi-static 0 otherwise";
CM_ SG_ 1157 DET_MH_SCAN_INDEX_4LSB_021_024 "Scan index of the measured detection";
CM_ SG_ 1157 DET_MH_CYCLE_COUNTER_021_024 "Detection Alive Counter";
CM_ SG_ 1158 DET_RANGE_025 " measured position  of the detection";
CM_ SG_ 1158 DET_RANGE_ERR_025 "RMSE or standard deviation of the measured angle  of the detection";
CM_ SG_ 1158 DET_RANGE_VELOCITY_025 "Radial velocity of the detection positive in direction to the sensor";
CM_ SG_ 1158 DET_RANGE_VELOCITY_ERR_025 "RMSE or standard deviation of the measure radial velocity of the detection";
CM_ SG_ 1158 DET_AZIMUTH_025 "Measured angle  of the detection";
CM_ SG_ 1158 DET_AZIMUTH_ERR_025 "RMSE or standard deviation of the measured angle  of the detection";
CM_ SG_ 1158 DET_ELEVATION_025 "measured elevation of the detection";
CM_ SG_ 1158 DET_ELEVATION_ERR_025 "RMSE or standard deviation of the measured elevation  of the detection";
CM_ SG_ 1158 DET_RCS_025 "Radar Cross Section or Amplitude, is a measure of how detectable an object is by radar. A larger RCS indicates that an object is more easily detected.";
CM_ SG_ 1158 DET_VALID_FLAG_025 "is set if the measured detection is valid";
CM_ SG_ 1158 DET_BI_STATIC_FLAG_025 "1 if detection is bi-static 0 otherwise";
CM_ SG_ 1158 DET_SUPER_RES_TARGET_025 "flasg is set if the detection is super resolution target";
CM_ SG_ 1158 DET_SNR_025 "The signal to noise ratio (SNR) of the radar detection";
CM_ SG_ 1158 DET_POINT_TARGET_PROB_025 "Describes the possibility if more than one real-world object has led to this detection. 0[%] := 100[%] Multi target probability";
CM_ SG_ 1158 DET_EXISTENCE_PROB_025 "Existence probability of the detection not based on history. Value does  not depend on any past experience with similar detections.
\note Use as confidence measure where a low value means less confidence
and a high value indicates strong confidence.";
CM_ SG_ 1158 DET_OUTSIDE_SECTOR_025 "Flag to indicate detections outside the sector, set if the wrong sector calibration matrix was used";
CM_ SG_ 1158 DET_HVC_FLAG_025 "Core2 Vehicle clutter flag";
CM_ SG_ 1158 DET_CONFD_AZIMUTH_025 "Define the Confidence of Azimuth for Detection ";
CM_ SG_ 1158 DET_CONFD_ELEVATION_025 "Define the Confidence of Elevation for the Detection ";
CM_ SG_ 1158 DET_BI_STATIC_FLAG_026 "1 if detection is bi-static 0 otherwise";
CM_ SG_ 1158 DET_BI_STATIC_FLAG_027 "1 if detection is bi-static 0 otherwise";
CM_ SG_ 1158 DET_BI_STATIC_FLAG_028 "1 if detection is bi-static 0 otherwise";
CM_ SG_ 1158 DET_MH_SCAN_INDEX_4LSB_025_028 "Scan index of the measured detection";
CM_ SG_ 1158 DET_MH_CYCLE_COUNTER_025_028 "Detection Alive Counter";
CM_ SG_ 1159 DET_RANGE_029 " measured position  of the detection";
CM_ SG_ 1159 DET_RANGE_ERR_029 "RMSE or standard deviation of the measured angle  of the detection";
CM_ SG_ 1159 DET_RANGE_VELOCITY_029 "Radial velocity of the detection positive in direction to the sensor";
CM_ SG_ 1159 DET_RANGE_VELOCITY_ERR_029 "RMSE or standard deviation of the measure radial velocity of the detection";
CM_ SG_ 1159 DET_AZIMUTH_029 "Measured angle  of the detection";
CM_ SG_ 1159 DET_AZIMUTH_ERR_029 "RMSE or standard deviation of the measured angle  of the detection";
CM_ SG_ 1159 DET_ELEVATION_029 "measured elevation of the detection";
CM_ SG_ 1159 DET_ELEVATION_ERR_029 "RMSE or standard deviation of the measured elevation  of the detection";
CM_ SG_ 1159 DET_RCS_029 "Radar Cross Section or Amplitude, is a measure of how detectable an object is by radar. A larger RCS indicates that an object is more easily detected.";
CM_ SG_ 1159 DET_VALID_FLAG_029 "is set if the measured detection is valid";
CM_ SG_ 1159 DET_BI_STATIC_FLAG_029 "1 if detection is bi-static 0 otherwise";
CM_ SG_ 1159 DET_SUPER_RES_TARGET_029 "flasg is set if the detection is super resolution target";
CM_ SG_ 1159 DET_SNR_029 "The signal to noise ratio (SNR) of the radar detection";
CM_ SG_ 1159 DET_POINT_TARGET_PROB_029 "Describes the possibility if more than one real-world object has led to this detection. 0[%] := 100[%] Multi target probability";
CM_ SG_ 1159 DET_EXISTENCE_PROB_029 "Existence probability of the detection not based on history. Value does  not depend on any past experience with similar detections.
\note Use as confidence measure where a low value means less confidence
and a high value indicates strong confidence.";
CM_ SG_ 1159 DET_OUTSIDE_SECTOR_029 "Flag to indicate detections outside the sector, set if the wrong sector calibration matrix was used";
CM_ SG_ 1159 DET_HVC_FLAG_029 "Core2 Vehicle clutter flag";
CM_ SG_ 1159 DET_CONFD_AZIMUTH_029 "Define the Confidence of Azimuth for Detection ";
CM_ SG_ 1159 DET_CONFD_ELEVATION_029 "Define the Confidence of Elevation for the Detection ";
CM_ SG_ 1159 DET_BI_STATIC_FLAG_030 "1 if detection is bi-static 0 otherwise";
CM_ SG_ 1159 DET_BI_STATIC_FLAG_031 "1 if detection is bi-static 0 otherwise";
CM_ SG_ 1159 DET_BI_STATIC_FLAG_032 "1 if detection is bi-static 0 otherwise";
CM_ SG_ 1159 DET_MH_SCAN_INDEX_4LSB_029_032 "Scan index of the measured detection";
CM_ SG_ 1159 DET_MH_CYCLE_COUNTER_029_032 "Detection Alive Counter";
CM_ SG_ 1160 DET_RANGE_033 " measured position  of the detection";
CM_ SG_ 1160 DET_RANGE_ERR_033 "RMSE or standard deviation of the measured angle  of the detection";
CM_ SG_ 1160 DET_RANGE_VELOCITY_033 "Radial velocity of the detection positive in direction to the sensor";
CM_ SG_ 1160 DET_RANGE_VELOCITY_ERR_033 "RMSE or standard deviation of the measure radial velocity of the detection";
CM_ SG_ 1160 DET_AZIMUTH_033 "Measured angle  of the detection";
CM_ SG_ 1160 DET_AZIMUTH_ERR_033 "RMSE or standard deviation of the measured angle  of the detection";
CM_ SG_ 1160 DET_ELEVATION_033 "measured elevation of the detection";
CM_ SG_ 1160 DET_ELEVATION_ERR_033 "RMSE or standard deviation of the measured elevation  of the detection";
CM_ SG_ 1160 DET_RCS_033 "Radar Cross Section or Amplitude, is a measure of how detectable an object is by radar. A larger RCS indicates that an object is more easily detected.";
CM_ SG_ 1160 DET_VALID_FLAG_033 "is set if the measured detection is valid";
CM_ SG_ 1160 DET_BI_STATIC_FLAG_033 "1 if detection is bi-static 0 otherwise";
CM_ SG_ 1160 DET_SUPER_RES_TARGET_033 "flasg is set if the detection is super resolution target";
CM_ SG_ 1160 DET_SNR_033 "The signal to noise ratio (SNR) of the radar detection";
CM_ SG_ 1160 DET_POINT_TARGET_PROB_033 "Describes the possibility if more than one real-world object has led to this detection. 0[%] := 100[%] Multi target probability";
CM_ SG_ 1160 DET_EXISTENCE_PROB_033 "Existence probability of the detection not based on history. Value does  not depend on any past experience with similar detections.
\note Use as confidence measure where a low value means less confidence
and a high value indicates strong confidence.";
CM_ SG_ 1160 DET_OUTSIDE_SECTOR_033 "Flag to indicate detections outside the sector, set if the wrong sector calibration matrix was used";
CM_ SG_ 1160 DET_HVC_FLAG_033 "Core2 Vehicle clutter flag";
CM_ SG_ 1160 DET_CONFD_AZIMUTH_033 "Define the Confidence of Azimuth for Detection ";
CM_ SG_ 1160 DET_CONFD_ELEVATION_033 "Define the Confidence of Elevation for the Detection ";
CM_ SG_ 1160 DET_BI_STATIC_FLAG_034 "1 if detection is bi-static 0 otherwise";
CM_ SG_ 1160 DET_BI_STATIC_FLAG_035 "1 if detection is bi-static 0 otherwise";
CM_ SG_ 1160 DET_BI_STATIC_FLAG_036 "1 if detection is bi-static 0 otherwise";
CM_ SG_ 1160 DET_MH_SCAN_INDEX_4LSB_033_036 "Scan index of the measured detection";
CM_ SG_ 1160 DET_MH_CYCLE_COUNTER_033_036 "Detection Alive Counter";
CM_ SG_ 1161 DET_RANGE_037 " measured position  of the detection";
CM_ SG_ 1161 DET_RANGE_ERR_037 "RMSE or standard deviation of the measured angle  of the detection";
CM_ SG_ 1161 DET_RANGE_VELOCITY_037 "Radial velocity of the detection positive in direction to the sensor";
CM_ SG_ 1161 DET_RANGE_VELOCITY_ERR_037 "RMSE or standard deviation of the measure radial velocity of the detection";
CM_ SG_ 1161 DET_AZIMUTH_037 "Measured angle  of the detection";
CM_ SG_ 1161 DET_AZIMUTH_ERR_037 "RMSE or standard deviation of the measured angle  of the detection";
CM_ SG_ 1161 DET_ELEVATION_037 "measured elevation of the detection";
CM_ SG_ 1161 DET_ELEVATION_ERR_037 "RMSE or standard deviation of the measured elevation  of the detection";
CM_ SG_ 1161 DET_RCS_037 "Radar Cross Section or Amplitude, is a measure of how detectable an object is by radar. A larger RCS indicates that an object is more easily detected.";
CM_ SG_ 1161 DET_VALID_FLAG_037 "is set if the measured detection is valid";
CM_ SG_ 1161 DET_BI_STATIC_FLAG_037 "1 if detection is bi-static 0 otherwise";
CM_ SG_ 1161 DET_SUPER_RES_TARGET_037 "flasg is set if the detection is super resolution target";
CM_ SG_ 1161 DET_SNR_037 "The signal to noise ratio (SNR) of the radar detection";
CM_ SG_ 1161 DET_POINT_TARGET_PROB_037 "Describes the possibility if more than one real-world object has led to this detection. 0[%] := 100[%] Multi target probability";
CM_ SG_ 1161 DET_EXISTENCE_PROB_037 "Existence probability of the detection not based on history. Value does  not depend on any past experience with similar detections.
\note Use as confidence measure where a low value means less confidence
and a high value indicates strong confidence.";
CM_ SG_ 1161 DET_OUTSIDE_SECTOR_037 "Flag to indicate detections outside the sector, set if the wrong sector calibration matrix was used";
CM_ SG_ 1161 DET_HVC_FLAG_037 "Core2 Vehicle clutter flag";
CM_ SG_ 1161 DET_CONFD_AZIMUTH_037 "Define the Confidence of Azimuth for Detection ";
CM_ SG_ 1161 DET_CONFD_ELEVATION_037 "Define the Confidence of Elevation for the Detection ";
CM_ SG_ 1161 DET_BI_STATIC_FLAG_038 "1 if detection is bi-static 0 otherwise";
CM_ SG_ 1161 DET_BI_STATIC_FLAG_039 "1 if detection is bi-static 0 otherwise";
CM_ SG_ 1161 DET_BI_STATIC_FLAG_040 "1 if detection is bi-static 0 otherwise";
CM_ SG_ 1161 DET_MH_SCAN_INDEX_4LSB_037_040 "Scan index of the measured detection";
CM_ SG_ 1161 DET_MH_CYCLE_COUNTER_037_040 "Detection Alive Counter";
CM_ SG_ 1162 DET_RANGE_041 " measured position  of the detection";
CM_ SG_ 1162 DET_RANGE_ERR_041 "RMSE or standard deviation of the measured angle  of the detection";
CM_ SG_ 1162 DET_RANGE_VELOCITY_041 "Radial velocity of the detection positive in direction to the sensor";
CM_ SG_ 1162 DET_RANGE_VELOCITY_ERR_041 "RMSE or standard deviation of the measure radial velocity of the detection";
CM_ SG_ 1162 DET_AZIMUTH_041 "Measured angle  of the detection";
CM_ SG_ 1162 DET_AZIMUTH_ERR_041 "RMSE or standard deviation of the measured angle  of the detection";
CM_ SG_ 1162 DET_ELEVATION_041 "measured elevation of the detection";
CM_ SG_ 1162 DET_ELEVATION_ERR_041 "RMSE or standard deviation of the measured elevation  of the detection";
CM_ SG_ 1162 DET_RCS_041 "Radar Cross Section or Amplitude, is a measure of how detectable an object is by radar. A larger RCS indicates that an object is more easily detected.";
CM_ SG_ 1162 DET_VALID_FLAG_041 "is set if the measured detection is valid";
CM_ SG_ 1162 DET_BI_STATIC_FLAG_041 "1 if detection is bi-static 0 otherwise";
CM_ SG_ 1162 DET_SUPER_RES_TARGET_041 "flasg is set if the detection is super resolution target";
CM_ SG_ 1162 DET_SNR_041 "The signal to noise ratio (SNR) of the radar detection";
CM_ SG_ 1162 DET_POINT_TARGET_PROB_041 "Describes the possibility if more than one real-world object has led to this detection. 0[%] := 100[%] Multi target probability";
CM_ SG_ 1162 DET_EXISTENCE_PROB_041 "Existence probability of the detection not based on history. Value does  not depend on any past experience with similar detections.
\note Use as confidence measure where a low value means less confidence
and a high value indicates strong confidence.";
CM_ SG_ 1162 DET_OUTSIDE_SECTOR_041 "Flag to indicate detections outside the sector, set if the wrong sector calibration matrix was used";
CM_ SG_ 1162 DET_HVC_FLAG_041 "Core2 Vehicle clutter flag";
CM_ SG_ 1162 DET_CONFD_AZIMUTH_041 "Define the Confidence of Azimuth for Detection ";
CM_ SG_ 1162 DET_CONFD_ELEVATION_041 "Define the Confidence of Elevation for the Detection ";
CM_ SG_ 1162 DET_BI_STATIC_FLAG_042 "1 if detection is bi-static 0 otherwise";
CM_ SG_ 1162 DET_BI_STATIC_FLAG_043 "1 if detection is bi-static 0 otherwise";
CM_ SG_ 1162 DET_BI_STATIC_FLAG_044 "1 if detection is bi-static 0 otherwise";
CM_ SG_ 1162 DET_MH_SCAN_INDEX_4LSB_041_044 "Scan index of the measured detection";
CM_ SG_ 1162 DET_MH_CYCLE_COUNTER_041_044 "Detection Alive Counter";
BA_DEF_ BO_  "CanTpBs" INT 0 255;
BA_DEF_ BO_  "DiagRequest" ENUM  "No","Yes";
BA_DEF_ BO_  "DiagResponse" ENUM  "No","Yes";
BA_DEF_ BO_  "E2EDataId" INT 0 65535;
BA_DEF_ BO_  "E2EDataLength" INT 0 65535;
BA_DEF_ BO_  "E2EProfile" STRING ;
BA_DEF_ BO_  "EventRateOfChange" INT 10 10000;
BA_DEF_ BO_  "GenMsgCycleTime" INT 0 100000;
BA_DEF_ BO_  "GenMsgILSupport" ENUM  "No","Yes";
BA_DEF_ BO_  "GenMsgNrOfRepetition" INT 0 100;
BA_DEF_ BO_  "GenMsgSendType" ENUM  "FixedPeriodic","Event","EnabledPeriodic","NotUsed","NotUsed","EventPeriodic","NotUsed","NotUsed","NoMsgSendType";
BA_DEF_ BO_  "NetworkInitialization" ENUM  "No","Yes";
BA_DEF_ BO_  "NmAsrMessage" ENUM  "No","Yes";
BA_DEF_ BO_  "NmMessage" ENUM  "No","Yes";
BA_DEF_ BO_  "SCP_AuthInfoTxLength" INT 0 512;
BA_DEF_ BO_  "SCP_DataId" INT 0 65535;
BA_DEF_ BO_  "SCP_FreshnessValueId" INT 0 65535;
BA_DEF_ BO_  "SCP_FreshnessValueLength" INT 0 512;
BA_DEF_ BO_  "SCP_FreshnessValueTxLength" INT 0 512;
BA_DEF_ BO_  "SC_Message" ENUM  "No","Yes","Yes, split message";
BA_DEF_ BO_  "TpTxIndex" INT 0 255;
BA_DEF_ BO_  "VFrameFormat" ENUM  "StandardCAN","ExtendedCAN","reserved","reserved","reserved","reserved","reserved","reserved","reserved","reserved","reserved","reserved","reserved","reserved","StandardCAN_FD","ExtendedCAN_FD";
BA_DEF_ SG_  "GenSigCmt" STRING ;
BA_DEF_ SG_  "GenSigCycleTime" INT 0 0;
BA_DEF_ SG_  "GenSigSendType" ENUM  "Cyclic","OnWrite","vector_leerstring","OnChange","vector_leerstring","IfActive","vector_leerstring","NoSigSendType";
BA_DEF_ SG_  "GenSigStartValue" INT 0 1000000000;
BA_DEF_ SG_  "GenSigTimeoutTime" INT 0 0;
BA_DEF_ SG_  "GenSigVtEn" STRING ;
BA_DEF_ SG_  "GenSigVtName" STRING ;
BA_DEF_ SG_  "InvalidValue" STRING ;
BA_DEF_ BU_  "NmAsrNodeIdentifier" HEX 128 255;
BA_DEF_ BU_  "NmStationAddress" HEX 0 0;
BA_DEF_ BU_  "NodeStartUpTime" INT 0 10000;
BA_DEF_ BU_  "NodeWakeUpTime" INT 0 10000;
BA_DEF_ BU_  "PowerType" ENUM  "Switched","Latched","Sleep","vector_leerstring","vector_leerstring";
BA_DEF_ BU_  "TpOwnSystemEcuNumber" HEX 0 255;
BA_DEF_  "BusType" STRING ;
BA_DEF_  "DBName" STRING ;
BA_DEF_  "E2EP05MaxDeltaCounter" INT 0 65535;
BA_DEF_  "E2EP05MaxErrorStateInit" INT 0 65535;
BA_DEF_  "E2EP05MaxErrorStateInvalid" INT 0 65535;
BA_DEF_  "E2EP05MaxErrorStateValid" INT 0 65535;
BA_DEF_  "E2EP05MinOkStateInit" INT 0 65535;
BA_DEF_  "E2EP05MinOkStateInvalid" INT 0 65535;
BA_DEF_  "E2EP05MinOkStateValid" INT 0 65535;
BA_DEF_  "E2EP05ProfileName" STRING ;
BA_DEF_  "E2EP05WindowSize" INT 0 65535;
BA_DEF_  "GenAuthor" STRING ;
BA_DEF_  "GenCompany" STRING ;
BA_DEF_  "GenDescription" STRING ;
BA_DEF_  "GenNetworkBaudrate" STRING ;
BA_DEF_  "GenNetworkMuxEn" STRING ;
BA_DEF_  "GenNetworkName" STRING ;
BA_DEF_  "GenRevision" STRING ;
BA_DEF_  "GenRevisionDate" STRING ;
BA_DEF_  "Manufacturer" STRING ;
BA_DEF_  "NetworkSpeed" ENUM  "500kBits/s","125kBit/s","2MBits/s";
BA_DEF_  "NmAsrBaseAddress" HEX 1280 1408;
BA_DEF_  "NmAsrMessageCount" INT 64 128;
BA_DEF_  "NmBaseAddress" HEX 1280 1280;
BA_DEF_  "NmMessageCount" INT 0 128;
BA_DEF_  "NmType" STRING ;
BA_DEF_  "VersionDay" INT 1 31;
BA_DEF_  "VersionMonth" INT 1 12;
BA_DEF_  "VersionYear" INT 2000 3000;
BA_DEF_DEF_  "CanTpBs" 255;
BA_DEF_DEF_  "DiagRequest" "No";
BA_DEF_DEF_  "DiagResponse" "No";
BA_DEF_DEF_  "E2EDataId" 0;
BA_DEF_DEF_  "E2EDataLength" 0;
BA_DEF_DEF_  "E2EProfile" "";
BA_DEF_DEF_  "EventRateOfChange" 10000;
BA_DEF_DEF_  "GenMsgCycleTime" 0;
BA_DEF_DEF_  "GenMsgILSupport" "Yes";
BA_DEF_DEF_  "GenMsgNrOfRepetition" 0;
BA_DEF_DEF_  "GenMsgSendType" "NoMsgSendType";
BA_DEF_DEF_  "NetworkInitialization" "Yes";
BA_DEF_DEF_  "NmAsrMessage" "No";
BA_DEF_DEF_  "NmMessage" "No";
BA_DEF_DEF_  "SCP_AuthInfoTxLength" 28;
BA_DEF_DEF_  "SCP_DataId" 0;
BA_DEF_DEF_  "SCP_FreshnessValueId" 0;
BA_DEF_DEF_  "SCP_FreshnessValueLength" 48;
BA_DEF_DEF_  "SCP_FreshnessValueTxLength" 4;
BA_DEF_DEF_  "SC_Message" "No";
BA_DEF_DEF_  "TpTxIndex" 0;
BA_DEF_DEF_  "VFrameFormat" "StandardCAN_FD";
BA_DEF_DEF_  "GenSigCmt" "";
BA_DEF_DEF_  "GenSigCycleTime" 0;
BA_DEF_DEF_  "GenSigSendType" "NoSigSendType";
BA_DEF_DEF_  "GenSigStartValue" 0;
BA_DEF_DEF_  "GenSigTimeoutTime" 0;
BA_DEF_DEF_  "GenSigVtEn" "";
BA_DEF_DEF_  "GenSigVtName" "";
BA_DEF_DEF_  "InvalidValue" "";
BA_DEF_DEF_  "NmAsrNodeIdentifier" 128;
BA_DEF_DEF_  "NmStationAddress" 0;
BA_DEF_DEF_  "NodeStartUpTime" 250;
BA_DEF_DEF_  "NodeWakeUpTime" 10;
BA_DEF_DEF_  "PowerType" "Switched";
BA_DEF_DEF_  "TpOwnSystemEcuNumber" 0;
BA_DEF_DEF_  "BusType" "CAN";
BA_DEF_DEF_  "DBName" "";
BA_DEF_DEF_  "E2EP05MaxDeltaCounter" 1;
BA_DEF_DEF_  "E2EP05MaxErrorStateInit" 1;
BA_DEF_DEF_  "E2EP05MaxErrorStateInvalid" 1;
BA_DEF_DEF_  "E2EP05MaxErrorStateValid" 1;
BA_DEF_DEF_  "E2EP05MinOkStateInit" 1;
BA_DEF_DEF_  "E2EP05MinOkStateInvalid" 2;
BA_DEF_DEF_  "E2EP05MinOkStateValid" 1;
BA_DEF_DEF_  "E2EP05ProfileName" "PROFILE_05";
BA_DEF_DEF_  "E2EP05WindowSize" 3;
BA_DEF_DEF_  "GenAuthor" "xx";
BA_DEF_DEF_  "GenCompany" "APTIV";
BA_DEF_DEF_  "GenDescription" "CAN bus that communicates the radars";
BA_DEF_DEF_  "GenNetworkBaudrate" "500 kbps";
BA_DEF_DEF_  "GenNetworkMuxEn" "FALSE";
BA_DEF_DEF_  "GenNetworkName" "PCAN";
BA_DEF_DEF_  "GenRevision" "v1.00";
BA_DEF_DEF_  "GenRevisionDate" "March 30, 2021";
BA_DEF_DEF_  "Manufacturer" "APTIV";
BA_DEF_DEF_  "NetworkSpeed" "2MBits/s";
BA_DEF_DEF_  "NmAsrBaseAddress" 1280;
BA_DEF_DEF_  "NmAsrMessageCount" 64;
BA_DEF_DEF_  "NmBaseAddress" 1280;
BA_DEF_DEF_  "NmMessageCount" 128;
BA_DEF_DEF_  "NmType" "NmAsr";
BA_DEF_DEF_  "VersionDay" 2;
BA_DEF_DEF_  "VersionMonth" 1;
BA_DEF_DEF_  "VersionYear" 2021;
BA_ "VersionYear" 2025;
BA_ "VersionMonth" 5;
BA_ "VersionDay" 13;
BA_ "NmMessageCount" 64;
BA_ "Manufacturer" "";
BA_ "GenRevision" "V03.00";
BA_ "GenNetworkBaudrate" "500000";
BA_ "GenCompany" "Aptiv";
BA_ "BusType" "CAN FD";
BA_ "DBName" "PCAN_RADAR";
BA_ "TpTxIndex" BO_ 78 1;
BA_ "TpTxIndex" BO_ 77 1;
BA_ "TpTxIndex" BO_ 76 1;
BA_ "TpTxIndex" BO_ 75 1;
BA_ "GenMsgSendType" BO_ 190 1;
BA_ "E2EProfile" BO_ 190 "P05";
BA_ "E2EDataLength" BO_ 190 280;
BA_ "E2EDataId" BO_ 190 2238;
BA_ "GenMsgSendType" BO_ 189 0;
BA_ "GenMsgCycleTime" BO_ 189 50;
BA_ "E2EProfile" BO_ 189 "P05";
BA_ "E2EDataLength" BO_ 189 376;
BA_ "E2EDataId" BO_ 189 2237;
BA_ "GenMsgSendType" BO_ 191 0;
BA_ "GenMsgCycleTime" BO_ 191 50;
BA_ "E2EProfile" BO_ 191 "P05";
BA_ "E2EDataLength" BO_ 191 200;
BA_ "E2EDataId" BO_ 191 2239;
BA_ "NmMessage" BO_ 1281 1;
BA_ "NmAsrMessage" BO_ 1281 1;
BA_ "GenMsgSendType" BO_ 1281 0;
BA_ "GenMsgCycleTime" BO_ 1281 640;
BA_ "NmMessage" BO_ 1288 1;
BA_ "NmAsrMessage" BO_ 1288 1;
BA_ "GenMsgSendType" BO_ 1288 0;
BA_ "GenMsgCycleTime" BO_ 1288 640;
BA_ "GenMsgSendType" BO_ 1152 1;
BA_ "GenMsgSendType" BO_ 1728 1;
BA_ "DiagRequest" BO_ 1728 1;
BA_ "GenMsgSendType" BO_ 1600 1;
BA_ "DiagResponse" BO_ 1600 1;
BA_ "GenMsgSendType" BO_ 1 0;
BA_ "GenMsgCycleTime" BO_ 1 1000;
BA_ "SC_Message" BO_ 2 1;
BA_ "SCP_FreshnessValueTxLength" BO_ 2 8;
BA_ "SCP_FreshnessValueLength" BO_ 2 56;
BA_ "SCP_FreshnessValueId" BO_ 2 1;
BA_ "SCP_DataId" BO_ 2 200;
BA_ "SCP_AuthInfoTxLength" BO_ 2 24;
BA_ "GenMsgSendType" BO_ 2 0;
BA_ "GenMsgCycleTime" BO_ 2 25;
BA_ "E2EProfile" BO_ 2 "P05";
BA_ "E2EDataLength" BO_ 2 280;
BA_ "E2EDataId" BO_ 2 258;
BA_ "GenMsgSendType" BO_ 187 0;
BA_ "GenMsgCycleTime" BO_ 187 1000;
BA_ "GenMsgSendType" BO_ 188 0;
BA_ "GenMsgCycleTime" BO_ 188 50;
BA_ "SC_Message" BO_ 184 1;
BA_ "SCP_FreshnessValueTxLength" BO_ 184 8;
BA_ "SCP_FreshnessValueLength" BO_ 184 56;
BA_ "SCP_FreshnessValueId" BO_ 184 1;
BA_ "SCP_DataId" BO_ 184 100;
BA_ "SCP_AuthInfoTxLength" BO_ 184 24;
BA_ "GenMsgSendType" BO_ 184 1;
BA_ "E2EProfile" BO_ 184 "P05";
BA_ "E2EDataLength" BO_ 184 424;
BA_ "E2EDataId" BO_ 184 2232;
BA_ "GenMsgSendType" BO_ 1791 1;
BA_ "DiagRequest" BO_ 1791 1;
BA_ "GenMsgSendType" BO_ 72 1;
BA_ "GenMsgSendType" BO_ 73 1;
BA_ "GenMsgSendType" BO_ 74 1;
BA_ "GenMsgSendType" BO_ 1153 1;
BA_ "GenMsgSendType" BO_ 1154 1;
BA_ "GenMsgSendType" BO_ 1155 1;
BA_ "GenMsgSendType" BO_ 1156 1;
BA_ "GenMsgSendType" BO_ 1157 1;
BA_ "GenMsgSendType" BO_ 1158 1;
BA_ "GenMsgSendType" BO_ 1159 1;
BA_ "GenMsgSendType" BO_ 1160 1;
BA_ "GenMsgSendType" BO_ 1161 1;
BA_ "GenMsgSendType" BO_ 1162 1;
BA_ "GenSigStartValue" SG_ 190 STS_VehicleCondition 6;
BA_ "GenSigStartValue" SG_ 190 STS_Measured_Range 1200;
BA_ "GenSigSendType" SG_ 189 STS_ElevationUpdates 0;
BA_ "GenSigCycleTime" SG_ 189 STS_ElevationUpdates 50;
BA_ "GenSigSendType" SG_ 189 STS_AzimuthUpdates 0;
BA_ "GenSigCycleTime" SG_ 189 STS_AzimuthUpdates 50;
BA_ "GenSigSendType" SG_ 189 STS_HostSpdCompensationFactorQF 0;
BA_ "GenSigCycleTime" SG_ 189 STS_HostSpdCompensationFactorQF 50;
BA_ "GenSigStartValue" SG_ 189 STS_HostSpeedCompensationFactor 100;
BA_ "GenSigSendType" SG_ 189 STS_HostSpeedCompensationFactor 0;
BA_ "GenSigCycleTime" SG_ 189 STS_HostSpeedCompensationFactor 50;
BA_ "GenSigSendType" SG_ 189 STS_ElevationErrorNegative 0;
BA_ "GenSigCycleTime" SG_ 189 STS_ElevationErrorNegative 50;
BA_ "GenSigSendType" SG_ 189 STS_AzimuthErrorNegative 0;
BA_ "GenSigCycleTime" SG_ 189 STS_AzimuthErrorNegative 50;
BA_ "GenSigSendType" SG_ 189 STS_RollErrorPositive 0;
BA_ "GenSigCycleTime" SG_ 189 STS_RollErrorPositive 50;
BA_ "GenSigSendType" SG_ 189 STS_ElevationErrorPositive 0;
BA_ "GenSigCycleTime" SG_ 189 STS_ElevationErrorPositive 50;
BA_ "GenSigSendType" SG_ 189 STS_AzimuthErrorPositive 0;
BA_ "GenSigCycleTime" SG_ 189 STS_AzimuthErrorPositive 50;
BA_ "GenSigSendType" SG_ 189 STS_AAElevationStd 0;
BA_ "GenSigCycleTime" SG_ 189 STS_AAElevationStd 50;
BA_ "GenSigSendType" SG_ 189 STS_AAAzimuthStd 0;
BA_ "GenSigCycleTime" SG_ 189 STS_AAAzimuthStd 50;
BA_ "GenSigSendType" SG_ 189 STS_AACurrentElevation 0;
BA_ "GenSigCycleTime" SG_ 189 STS_AACurrentElevation 50;
BA_ "GenSigSendType" SG_ 189 STS_AACurrentAzimuth 0;
BA_ "GenSigCycleTime" SG_ 189 STS_AACurrentAzimuth 50;
BA_ "GenSigSendType" SG_ 189 STS_StartElevation 0;
BA_ "GenSigCycleTime" SG_ 189 STS_StartElevation 50;
BA_ "GenSigSendType" SG_ 189 STS_StartAzimuth 0;
BA_ "GenSigCycleTime" SG_ 189 STS_StartAzimuth 50;
BA_ "GenSigStartValue" SG_ 189 STS_AutoAlignmentFailRootCause 5;
BA_ "GenSigSendType" SG_ 189 STS_AutoAlignmentFailRootCause 0;
BA_ "GenSigCycleTime" SG_ 189 STS_AutoAlignmentFailRootCause 50;
BA_ "GenSigSendType" SG_ 189 STS_AlignmentAutoStatus 0;
BA_ "GenSigCycleTime" SG_ 189 STS_AlignmentAutoStatus 50;
BA_ "GenSigSendType" SG_ 189 STS_CalDisplay 0;
BA_ "GenSigCycleTime" SG_ 189 STS_CalDisplay 50;
BA_ "GenSigSendType" SG_ 189 STS_AlignmentError 0;
BA_ "GenSigCycleTime" SG_ 189 STS_AlignmentError 50;
BA_ "GenSigSendType" SG_ 189 STS_ProgressPercent 0;
BA_ "GenSigCycleTime" SG_ 189 STS_ProgressPercent 50;
BA_ "GenSigSendType" SG_ 189 STS_CalTime 0;
BA_ "GenSigCycleTime" SG_ 189 STS_CalTime 50;
BA_ "GenSigSendType" SG_ 189 STS_ElevationStd 0;
BA_ "GenSigCycleTime" SG_ 189 STS_ElevationStd 50;
BA_ "GenSigSendType" SG_ 189 STS_AzimuthStd 0;
BA_ "GenSigCycleTime" SG_ 189 STS_AzimuthStd 50;
BA_ "GenSigSendType" SG_ 189 STS_AlignmentElevation 0;
BA_ "GenSigCycleTime" SG_ 189 STS_AlignmentElevation 50;
BA_ "GenSigSendType" SG_ 189 STS_AlignmentAzimuth 0;
BA_ "GenSigCycleTime" SG_ 189 STS_AlignmentAzimuth 50;
BA_ "GenSigStartValue" SG_ 189 STS_InitAlignRsltHostSpdCompFac 100;
BA_ "GenSigSendType" SG_ 189 STS_InitAlignRsltHostSpdCompFac 0;
BA_ "GenSigCycleTime" SG_ 189 STS_InitAlignRsltHostSpdCompFac 50;
BA_ "GenSigSendType" SG_ 189 STS_InitAlignRsltElevationUpdate 0;
BA_ "GenSigCycleTime" SG_ 189 STS_InitAlignRsltElevationUpdate 50;
BA_ "GenSigSendType" SG_ 189 STS_InitAlignResultAzimuthUpdate 0;
BA_ "GenSigCycleTime" SG_ 189 STS_InitAlignResultAzimuthUpdate 50;
BA_ "GenSigSendType" SG_ 189 STS_AlignmentModeOut 0;
BA_ "GenSigCycleTime" SG_ 189 STS_AlignmentModeOut 50;
BA_ "GenSigSendType" SG_ 189 STS_InitLastSuccessfulAlignMode 0;
BA_ "GenSigCycleTime" SG_ 189 STS_InitLastSuccessfulAlignMode 50;
BA_ "GenSigSendType" SG_ 189 STS_InitAlignmentResultElevation 0;
BA_ "GenSigCycleTime" SG_ 189 STS_InitAlignmentResultElevation 50;
BA_ "GenSigSendType" SG_ 189 STS_InitAlignmentResultAzimuth 0;
BA_ "GenSigCycleTime" SG_ 189 STS_InitAlignmentResultAzimuth 50;
BA_ "GenSigSendType" SG_ 189 STS_RadarTypeInput 0;
BA_ "GenSigCycleTime" SG_ 189 STS_RadarTypeInput 50;
BA_ "GenSigSendType" SG_ 189 STS_CoordinateSystemInput 0;
BA_ "GenSigCycleTime" SG_ 189 STS_CoordinateSystemInput 50;
BA_ "GenSigSendType" SG_ 189 STS_AlignmentModeIn 0;
BA_ "GenSigCycleTime" SG_ 189 STS_AlignmentModeIn 50;
BA_ "GenSigSendType" SG_ 191 CAP_MaxDetRangePedestrian_2 0;
BA_ "GenSigCycleTime" SG_ 191 CAP_MaxDetRangePedestrian_2 50;
BA_ "GenSigSendType" SG_ 191 CAP_MaxDetRangePedestrian_1 0;
BA_ "GenSigCycleTime" SG_ 191 CAP_MaxDetRangePedestrian_1 50;
BA_ "GenSigSendType" SG_ 191 CAP_MaxDetRangeMotorbike_2 0;
BA_ "GenSigCycleTime" SG_ 191 CAP_MaxDetRangeMotorbike_2 50;
BA_ "GenSigSendType" SG_ 191 CAP_MaxDetRangeMotorbike_0 0;
BA_ "GenSigCycleTime" SG_ 191 CAP_MaxDetRangeMotorbike_0 50;
BA_ "GenSigSendType" SG_ 191 CAP_MaxDetectionRangeCar_2 0;
BA_ "GenSigCycleTime" SG_ 191 CAP_MaxDetectionRangeCar_2 50;
BA_ "GenSigSendType" SG_ 191 CAP_MaxDetectionRangeCar_1 0;
BA_ "GenSigCycleTime" SG_ 191 CAP_MaxDetectionRangeCar_1 50;
BA_ "GenSigSendType" SG_ 191 CAP_SideLobeLevelBeamformer 0;
BA_ "GenSigCycleTime" SG_ 191 CAP_SideLobeLevelBeamformer 50;
BA_ "InvalidValue" SG_ 191 CAP_SLLMonitoringStatus "4";
BA_ "GenSigStartValue" SG_ 191 CAP_SLLMonitoringStatus 3;
BA_ "GenSigSendType" SG_ 191 CAP_SLLMonitoringStatus 0;
BA_ "GenSigCycleTime" SG_ 191 CAP_SLLMonitoringStatus 50;
BA_ "GenSigStartValue" SG_ 191 CAP_SLLMonitoringActive 1;
BA_ "GenSigSendType" SG_ 191 CAP_SLLMonitoringActive 0;
BA_ "GenSigCycleTime" SG_ 191 CAP_SLLMonitoringActive 50;
BA_ "GenSigSendType" SG_ 191 CAP_AngleAzimuthRangeEnd 0;
BA_ "GenSigCycleTime" SG_ 191 CAP_AngleAzimuthRangeEnd 50;
BA_ "GenSigSendType" SG_ 191 CAP_AngleAzimuthRangeStart 0;
BA_ "GenSigCycleTime" SG_ 191 CAP_AngleAzimuthRangeStart 50;
BA_ "GenSigSendType" SG_ 191 CAP_MaxDetRangePedestrian_0 0;
BA_ "GenSigCycleTime" SG_ 191 CAP_MaxDetRangePedestrian_0 50;
BA_ "GenSigSendType" SG_ 191 CAP_MaxDetRangeMotorbike_1 0;
BA_ "GenSigCycleTime" SG_ 191 CAP_MaxDetRangeMotorbike_1 50;
BA_ "GenSigSendType" SG_ 191 CAP_MaxDetectionRangeCar_0 0;
BA_ "GenSigCycleTime" SG_ 191 CAP_MaxDetectionRangeCar_0 50;
BA_ "InvalidValue" SG_ 191 CAP_RangeEstimationStatus "4";
BA_ "GenSigStartValue" SG_ 191 CAP_RangeEstimationStatus 3;
BA_ "GenSigSendType" SG_ 191 CAP_RangeEstimationStatus 0;
BA_ "GenSigCycleTime" SG_ 191 CAP_RangeEstimationStatus 50;
BA_ "GenSigStartValue" SG_ 191 CAP_RangeEstimationActive 1;
BA_ "GenSigSendType" SG_ 191 CAP_RangeEstimationActive 0;
BA_ "GenSigCycleTime" SG_ 191 CAP_RangeEstimationActive 50;
BA_ "GenSigSendType" SG_ 191 CAP_DampingStandardDeviation 0;
BA_ "GenSigCycleTime" SG_ 191 CAP_DampingStandardDeviation 50;
BA_ "InvalidValue" SG_ 191 CAP_DampingStatus "4";
BA_ "GenSigStartValue" SG_ 191 CAP_DampingStatus 3;
BA_ "GenSigSendType" SG_ 191 CAP_DampingStatus 0;
BA_ "GenSigCycleTime" SG_ 191 CAP_DampingStatus 50;
BA_ "GenSigSendType" SG_ 191 CAP_DampingActive 0;
BA_ "GenSigCycleTime" SG_ 191 CAP_DampingActive 50;
BA_ "GenSigStartValue" SG_ 191 CAP_DampingCurrent 25500;
BA_ "GenSigSendType" SG_ 191 CAP_DampingCurrent 0;
BA_ "GenSigCycleTime" SG_ 191 CAP_DampingCurrent 50;
BA_ "GenSigSendType" SG_ 191 CAP_SLBlockageFilterValue 0;
BA_ "GenSigCycleTime" SG_ 191 CAP_SLBlockageFilterValue 50;
BA_ "GenSigSendType" SG_ 191 CAP_SLBlockageFlag 0;
BA_ "GenSigCycleTime" SG_ 191 CAP_SLBlockageFlag 50;
BA_ "InvalidValue" SG_ 191 CAP_FreeSightCheckStatus "2";
BA_ "GenSigSendType" SG_ 191 CAP_FreeSightCheckStatus 0;
BA_ "GenSigCycleTime" SG_ 191 CAP_FreeSightCheckStatus 50;
BA_ "InvalidValue" SG_ 191 CAP_FreeSightCheckActive "3";
BA_ "GenSigSendType" SG_ 191 CAP_FreeSightCheckActive 0;
BA_ "GenSigCycleTime" SG_ 191 CAP_FreeSightCheckActive 50;
BA_ "GenSigSendType" SG_ 191 CAP_BlockageProbability 0;
BA_ "GenSigCycleTime" SG_ 191 CAP_BlockageProbability 50;
BA_ "InvalidValue" SG_ 191 CAP_BlockageValue "6";
BA_ "GenSigStartValue" SG_ 191 CAP_BlockageValue 5;
BA_ "InvalidValue" SG_ 191 CAP_BlockageStatus "4";
BA_ "GenSigStartValue" SG_ 191 CAP_BlockageStatus 3;
BA_ "GenSigSendType" SG_ 191 CAP_BlockageStatus 0;
BA_ "GenSigCycleTime" SG_ 191 CAP_BlockageStatus 50;
BA_ "GenSigStartValue" SG_ 191 CAP_BlockageActive 1;
BA_ "GenSigSendType" SG_ 191 CAP_BlockageActive 0;
BA_ "GenSigCycleTime" SG_ 191 CAP_BlockageActive 50;
BA_ "InvalidValue" SG_ 191 CAP_BlockageSensitivity "3";
BA_ "GenSigStartValue" SG_ 191 CAP_BlockageSensitivity 1;
BA_ "GenSigSendType" SG_ 191 CAP_BlockageSensitivity 0;
BA_ "GenSigCycleTime" SG_ 191 CAP_BlockageSensitivity 50;
BA_ "GenSigStartValue" SG_ 1152 DET_RANGE_VELOCITY_001 16384;
BA_ "GenSigStartValue" SG_ 1152 DET_RCS_001 128;
BA_ "GenSigStartValue" SG_ 1152 DET_RANGE_VELOCITY_002 16384;
BA_ "GenSigStartValue" SG_ 1152 DET_RCS_002 128;
BA_ "GenSigStartValue" SG_ 1152 DET_RANGE_VELOCITY_003 16384;
BA_ "GenSigStartValue" SG_ 1152 DET_RCS_003 128;
BA_ "GenSigStartValue" SG_ 1152 DET_RANGE_VELOCITY_004 16384;
BA_ "GenSigStartValue" SG_ 1152 DET_RCS_004 128;
BA_ "GenSigStartValue" SG_ 2 SSTS_VEH_AbsoluteTime_Month 1;
BA_ "GenSigStartValue" SG_ 2 SSTS_VEH_AbsoluteTime_Day 1;
BA_ "InvalidValue" SG_ 2 SSTS_VEH_POWER_MODE_STATUS "7";
BA_ "GenSigVtName" SG_ 2 SSTS_YAW_RATE_CALC_QF "VtSig_CAN_YAW_RATE_CALC_QF";
BA_ "GenSigVtEn" SG_ 2 SSTS_YAW_RATE_CALC_QF "TRUE";
BA_ "GenSigCmt" SG_ 2 SSTS_YAW_RATE_CALC_QF "Quality factor of the CAN_YAW_RATE_CALC signal";
BA_ "GenSigCmt" SG_ 2 SSTS_YAW_RATE_BIAS "Yaw rate bias";
BA_ "GenSigStartValue" SG_ 2 SSTS_YAW_RATE_CALC 448;
BA_ "GenSigCmt" SG_ 2 SSTS_YAW_RATE_CALC "Contains the bias-compensated yaw rate";
BA_ "GenSigCmt" SG_ 2 SSTS_VEH_SPD_COMP_FACTOR "Compensated vehicle speed factor";
BA_ "GenSigVtName" SG_ 2 SSTS_VEHICLE_SPEED_CALC_QF "VtSig_CAN_VEHICLE_SPEED_CALC_QF";
BA_ "GenSigVtEn" SG_ 2 SSTS_VEHICLE_SPEED_CALC_QF "TRUE";
BA_ "GenSigCmt" SG_ 2 SSTS_VEHICLE_SPEED_CALC_QF "Quality factor of the CAN_VEHICLE_SPEED_CALC";
BA_ "GenSigCmt" SG_ 2 SSTS_VEHICLE_SPEED_CALC "Contains the compensated vehicle speed used within the FCR";
BA_ "InvalidValue" SG_ 2 SSTS_IGN_STATUS "F";
BA_ "GenSigVtName" SG_ 2 SSTS_GEAR_POSITION "VtSig_CAN_GEAR_POSITION";
BA_ "GenSigVtEn" SG_ 2 SSTS_GEAR_POSITION "TRUE";
BA_ "GenSigCmt" SG_ 2 SSTS_GEAR_POSITION "Gear Position";
BA_ "GenSigTimeoutTime" SG_ 187 STS_PCAN_PROTOCOL_VER_MINOR 150;
BA_ "GenSigSendType" SG_ 187 STS_PCAN_PROTOCOL_VER_MINOR 0;
BA_ "GenSigCycleTime" SG_ 187 STS_PCAN_PROTOCOL_VER_MINOR 50;
BA_ "GenSigTimeoutTime" SG_ 187 STS_PCAN_PROTOCOL_VER_MAJOR 150;
BA_ "GenSigSendType" SG_ 187 STS_PCAN_PROTOCOL_VER_MAJOR 0;
BA_ "GenSigCycleTime" SG_ 187 STS_PCAN_PROTOCOL_VER_MAJOR 50;
BA_ "GenSigTimeoutTime" SG_ 187 STS_SERIAL_NUMBER_SEQUENCE 150;
BA_ "GenSigSendType" SG_ 187 STS_SERIAL_NUMBER_SEQUENCE 0;
BA_ "GenSigCycleTime" SG_ 187 STS_SERIAL_NUMBER_SEQUENCE 50;
BA_ "GenSigTimeoutTime" SG_ 187 STS_SERIAL_NUM_JULIAN_YEAR 150;
BA_ "GenSigSendType" SG_ 187 STS_SERIAL_NUM_JULIAN_YEAR 0;
BA_ "GenSigCycleTime" SG_ 187 STS_SERIAL_NUM_JULIAN_YEAR 50;
BA_ "GenSigTimeoutTime" SG_ 187 STS_SERIAL_NUM_JULIAN_DAY 150;
BA_ "GenSigSendType" SG_ 187 STS_SERIAL_NUM_JULIAN_DAY 0;
BA_ "GenSigCycleTime" SG_ 187 STS_SERIAL_NUM_JULIAN_DAY 50;
BA_ "GenSigStartValue" SG_ 187 STS_SENSOR_MOUNT_ORNT_YAW 3927;
BA_ "GenSigStartValue" SG_ 187 STS_SENSOR_MOUNT_ORNT_PITCH 3927;
BA_ "GenSigStartValue" SG_ 187 STS_SENSOR_MOUNT_ORNT_ROLL 3927;
BA_ "GenSigTimeoutTime" SG_ 188 STS_SCAN_TYPE 150;
BA_ "GenSigSendType" SG_ 188 STS_SCAN_TYPE 0;
BA_ "GenSigCycleTime" SG_ 188 STS_SCAN_TYPE 50;
BA_ "GenSigTimeoutTime" SG_ 188 STS_XCVR_OPERATIONAL 150;
BA_ "GenSigSendType" SG_ 188 STS_XCVR_OPERATIONAL 0;
BA_ "GenSigCycleTime" SG_ 188 STS_XCVR_OPERATIONAL 50;
BA_ "GenSigTimeoutTime" SG_ 188 STS_YAW_RATE_BIAS 150;
BA_ "GenSigSendType" SG_ 188 STS_YAW_RATE_BIAS 0;
BA_ "GenSigCycleTime" SG_ 188 STS_YAW_RATE_BIAS 50;
BA_ "GenSigCmt" SG_ 188 STS_CORE_ACTIVE_FAULTS "Active faults";
BA_ "GenSigTimeoutTime" SG_ 188 STS_VEH_SPEED_DIRECTION 150;
BA_ "GenSigSendType" SG_ 188 STS_VEH_SPEED_DIRECTION 0;
BA_ "GenSigCycleTime" SG_ 188 STS_VEH_SPEED_DIRECTION 50;
BA_ "GenSigTimeoutTime" SG_ 188 STS_STEERING_ANGLE_SIGN 150;
BA_ "GenSigSendType" SG_ 188 STS_STEERING_ANGLE_SIGN 0;
BA_ "GenSigCycleTime" SG_ 188 STS_STEERING_ANGLE_SIGN 50;
BA_ "GenSigTimeoutTime" SG_ 188 STS_STEERING_ANGLE 150;
BA_ "GenSigSendType" SG_ 188 STS_STEERING_ANGLE 0;
BA_ "GenSigCycleTime" SG_ 188 STS_STEERING_ANGLE 50;
BA_ "GenSigTimeoutTime" SG_ 188 STS_VEHICLE_SPEED_CALC 150;
BA_ "GenSigSendType" SG_ 188 STS_VEHICLE_SPEED_CALC 0;
BA_ "GenSigCycleTime" SG_ 188 STS_VEHICLE_SPEED_CALC 50;
BA_ "GenSigStartValue" SG_ 184 HED_R_WRAPPING 90;
BA_ "GenSigCmt" SG_ 184 HED_NUM_OF_VALID_DETECTIONS "Number of detections sent";
BA_ "GenSigCmt" SG_ 184 HED_LOOK_ID "Indicates the look type values 1 to 4 base on medium/long look and near/far look";
BA_ "GenSigCmt" SG_ 184 HED_SCAN_INDEX "Scan index for SODFL";
BA_ "GenSigCmt" SG_ 184 HED_DET_RANGE_MAX "CAN range coverage";
BA_ "GenSigStartValue" SG_ 184 HED_DET_SPEED_RANGE_MAX 32768;
BA_ "GenSigCmt" SG_ 184 HED_DET_SPEED_RANGE_MAX "CAN range coverage";
BA_ "GenSigCmt" SG_ 184 HED_FOV_HOR_MAX "CAN range coverage";
BA_ "GenSigCmt" SG_ 184 HED_FOV_VER_MAX "CAN range coverage";
BA_ "GenSigStartValue" SG_ 184 HED_DET_SPEED_RANGE_MIN 32768;
BA_ "GenSigStartValue" SG_ 1153 DET_RANGE_VELOCITY_005 16384;
BA_ "GenSigStartValue" SG_ 1153 DET_RCS_005 128;
BA_ "GenSigStartValue" SG_ 1153 DET_RANGE_VELOCITY_006 16384;
BA_ "GenSigStartValue" SG_ 1153 DET_RCS_006 128;
BA_ "GenSigStartValue" SG_ 1153 DET_RANGE_VELOCITY_007 16384;
BA_ "GenSigStartValue" SG_ 1153 DET_RCS_007 128;
BA_ "GenSigStartValue" SG_ 1153 DET_RANGE_VELOCITY_008 16384;
BA_ "GenSigStartValue" SG_ 1153 DET_RCS_008 128;
BA_ "GenSigStartValue" SG_ 1154 DET_RANGE_VELOCITY_009 16384;
BA_ "GenSigStartValue" SG_ 1154 DET_RCS_009 128;
BA_ "GenSigStartValue" SG_ 1154 DET_RANGE_VELOCITY_010 16384;
BA_ "GenSigStartValue" SG_ 1154 DET_RCS_010 128;
BA_ "GenSigStartValue" SG_ 1154 DET_RANGE_VELOCITY_011 16384;
BA_ "GenSigStartValue" SG_ 1154 DET_RCS_011 128;
BA_ "GenSigStartValue" SG_ 1154 DET_RANGE_VELOCITY_012 16384;
BA_ "GenSigStartValue" SG_ 1154 DET_RCS_012 128;
BA_ "GenSigStartValue" SG_ 1155 DET_RANGE_VELOCITY_013 16384;
BA_ "GenSigStartValue" SG_ 1155 DET_RCS_013 128;
BA_ "GenSigStartValue" SG_ 1155 DET_RANGE_VELOCITY_014 16384;
BA_ "GenSigStartValue" SG_ 1155 DET_RCS_014 128;
BA_ "GenSigStartValue" SG_ 1155 DET_RANGE_VELOCITY_015 16384;
BA_ "GenSigStartValue" SG_ 1155 DET_RCS_015 128;
BA_ "GenSigStartValue" SG_ 1155 DET_RANGE_VELOCITY_016 16384;
BA_ "GenSigStartValue" SG_ 1155 DET_RCS_016 128;
BA_ "GenSigStartValue" SG_ 1156 DET_RANGE_VELOCITY_017 16384;
BA_ "GenSigStartValue" SG_ 1156 DET_RCS_017 128;
BA_ "GenSigStartValue" SG_ 1156 DET_RANGE_VELOCITY_018 16384;
BA_ "GenSigStartValue" SG_ 1156 DET_RCS_018 128;
BA_ "GenSigStartValue" SG_ 1156 DET_RANGE_VELOCITY_019 16384;
BA_ "GenSigStartValue" SG_ 1156 DET_RCS_019 128;
BA_ "GenSigStartValue" SG_ 1156 DET_RANGE_VELOCITY_020 16384;
BA_ "GenSigStartValue" SG_ 1156 DET_RCS_020 128;
BA_ "GenSigStartValue" SG_ 1157 DET_RANGE_VELOCITY_021 16384;
BA_ "GenSigStartValue" SG_ 1157 DET_RCS_021 128;
BA_ "GenSigStartValue" SG_ 1157 DET_RANGE_VELOCITY_022 16384;
BA_ "GenSigStartValue" SG_ 1157 DET_RCS_022 128;
BA_ "GenSigStartValue" SG_ 1157 DET_RANGE_VELOCITY_023 16384;
BA_ "GenSigStartValue" SG_ 1157 DET_RCS_023 128;
BA_ "GenSigStartValue" SG_ 1157 DET_RANGE_VELOCITY_024 16384;
BA_ "GenSigStartValue" SG_ 1157 DET_RCS_024 128;
BA_ "GenSigStartValue" SG_ 1158 DET_RANGE_VELOCITY_025 16384;
BA_ "GenSigStartValue" SG_ 1158 DET_RCS_025 128;
BA_ "GenSigStartValue" SG_ 1158 DET_RANGE_VELOCITY_026 16384;
BA_ "GenSigStartValue" SG_ 1158 DET_RCS_026 128;
BA_ "GenSigStartValue" SG_ 1158 DET_RANGE_VELOCITY_027 16384;
BA_ "GenSigStartValue" SG_ 1158 DET_RCS_027 128;
BA_ "GenSigStartValue" SG_ 1158 DET_RANGE_VELOCITY_028 16384;
BA_ "GenSigStartValue" SG_ 1158 DET_RCS_028 128;
BA_ "GenSigStartValue" SG_ 1159 DET_RANGE_VELOCITY_029 16384;
BA_ "GenSigStartValue" SG_ 1159 DET_RCS_029 128;
BA_ "GenSigStartValue" SG_ 1159 DET_RANGE_VELOCITY_030 16384;
BA_ "GenSigStartValue" SG_ 1159 DET_RCS_030 128;
BA_ "GenSigStartValue" SG_ 1159 DET_RANGE_VELOCITY_031 16384;
BA_ "GenSigStartValue" SG_ 1159 DET_RCS_031 128;
BA_ "GenSigStartValue" SG_ 1159 DET_RANGE_VELOCITY_032 16384;
BA_ "GenSigStartValue" SG_ 1159 DET_RCS_032 128;
BA_ "GenSigStartValue" SG_ 1160 DET_RANGE_VELOCITY_033 16384;
BA_ "GenSigStartValue" SG_ 1160 DET_RCS_033 128;
BA_ "GenSigStartValue" SG_ 1160 DET_RANGE_VELOCITY_034 16384;
BA_ "GenSigStartValue" SG_ 1160 DET_RCS_034 128;
BA_ "GenSigStartValue" SG_ 1160 DET_RANGE_VELOCITY_035 16384;
BA_ "GenSigStartValue" SG_ 1160 DET_RCS_035 128;
BA_ "GenSigStartValue" SG_ 1160 DET_RANGE_VELOCITY_036 16384;
BA_ "GenSigStartValue" SG_ 1160 DET_RCS_036 128;
BA_ "GenSigStartValue" SG_ 1161 DET_RANGE_VELOCITY_037 16384;
BA_ "GenSigStartValue" SG_ 1161 DET_RCS_037 128;
BA_ "GenSigStartValue" SG_ 1161 DET_RANGE_VELOCITY_038 16384;
BA_ "GenSigStartValue" SG_ 1161 DET_RCS_038 128;
BA_ "GenSigStartValue" SG_ 1161 DET_RANGE_VELOCITY_039 16384;
BA_ "GenSigStartValue" SG_ 1161 DET_RCS_039 128;
BA_ "GenSigStartValue" SG_ 1161 DET_RANGE_VELOCITY_040 16384;
BA_ "GenSigStartValue" SG_ 1161 DET_RCS_040 128;
BA_ "GenSigStartValue" SG_ 1162 DET_RANGE_VELOCITY_041 16384;
BA_ "GenSigStartValue" SG_ 1162 DET_RCS_041 128;
BA_ "GenSigStartValue" SG_ 1162 DET_RANGE_VELOCITY_042 16384;
BA_ "GenSigStartValue" SG_ 1162 DET_RCS_042 128;
BA_ "GenSigStartValue" SG_ 1162 DET_RANGE_VELOCITY_043 16384;
BA_ "GenSigStartValue" SG_ 1162 DET_RCS_043 128;
BA_ "GenSigStartValue" SG_ 1162 DET_RANGE_VELOCITY_044 16384;
BA_ "GenSigStartValue" SG_ 1162 DET_RCS_044 128;
VAL_ 190 STS_AlignmentShortTrackStatus 0 "Off" 1 "Running" 2 "Paused" 3 "Failed" 4 "Success" ;
VAL_ 190 STS_VehicleCondition 0 "VelocityTooLow" 1 "VelocityTooHigh" 2 "YawRateTooHigh" 3 "QualityFctrVelocityInsufficient" 4 "QualityFctrYawRateInsufficient" 5 "VehicleInReverse" 6 "NoIssue" ;
VAL_ 190 STS_AlignmentServiceStatus 0 "Off" 1 "Running" 2 "Paused" 3 "Failed" 4 "Success" ;
VAL_ 190 STS_AlignmentStaticStatus 0 "Off" 1 "Running" 2 "Paused" 3 "Failed" 4 "Success" ;
VAL_ 189 STS_HostSpdCompensationFactorQF 0 "DRA_QF_INIT" 1 "DRA_QF_REDUCED" 2 "DRA_QF_OK" ;
VAL_ 189 STS_AutoAlignmentFailRootCause 0 "InvalidInput" 1 "SensorFacingUpwards" 2 "SensorFacingDownwards" 3 "SensorFacingRight" 4 "SensorFacingLeft" 5 "InvalidVehicleSignal" 6 "Blockage" 7 "OperationModeFaulty" 8 "DataQualifierInvalid" 9 "None" ;
VAL_ 189 STS_AlignmentAutoStatus 0 "Off" 1 "Active" 2 "Paused" 3 "Failed" ;
VAL_ 189 STS_CalDisplay 0 "None" 1 "Display" ;
VAL_ 189 STS_AlignmentError 0 "NoError" 1 "SensorFacingUpwards" 2 "SensorFacingDownwards" 3 "SensorFacingRight" 4 "SensorFacingLeft" 5 "TargetSignalTooWeak" 6 "TargetSignalTooStrong" 7 "TargetNotStatic" 8 "TargetDistanceTooHigh" 9 "TargetDistanceTooLow" 10 "TargetNotFound" 11 "Interference" 12 "InvalidInput" 13 "InvalidVehicleSignal" 14 "Blockage" 15 "MaxDistanceCrossed" 16 "MaxDurationCrossed" 17 "OperationModeFaulty _Dyn" 18 "DataQualifierInvalid_Dyn" ;
VAL_ 189 STS_AlignmentModeOut 0 "Off" 1 "AutoAlignment" 2 "ShortTrackAlignment" 3 "ServiceAlignment" 4 "StaticAlignment" ;
VAL_ 189 STS_InitLastSuccessfulAlignMode 0 "None" 1 "NotUsed" 2 "ShortTrackAlignment" 3 "ServiceAlignment" 4 "StaticAlignment" 5 "ExternalAlignment" ;
VAL_ 189 STS_RadarTypeInput 0 "DRA_RADAR_TYPE_UNKNOWN" 1 "DRA_RADAR_TYPE_SRR6" 2 "DRA_RADAR_TYPE_SRR6P_HIGH_GAIN" 3 "DRA_RADAR_TYPE_SRR6P_LOW_GAIN" 4 "DRA_RADAR_TYPE_SRR7P" 5 "DRA_RADAR_TYPE_FLR4 " 6 "DRA_RADAR_TYPE_FLR4P" 7 "DRA_RADAR_TYPE_FLR7" ;
VAL_ 189 STS_CoordinateSystemInput 0 "DRA_DET_COORD_SYS_UNDEFINED" 1 "DRA_DET_COORD_SYS_SAE" 2 "DRA_DET_COORD_SYS_ISO" ;
VAL_ 189 STS_AlignmentModeIn 0 "Off" 1 "AutoAlignment" 2 "ShortTrackAlignment" 3 "ServiceAlignment" 4 "StaticAlignment" 5 "ManualAlignment" ;
VAL_ 191 CAP_SLLMonitoringStatus 0 "Faulty" 1 "Ok" 2 "Reserved" 3 "Initialization" 4 "Invalid" ;
VAL_ 191 CAP_SLLMonitoringActive 0 "Off" 1 "Active" ;
VAL_ 191 CAP_RangeEstimationStatus 0 "Faulty" 1 "Ok" 2 "Reserved" 3 "Initialization" 4 "Invalid" ;
VAL_ 191 CAP_RangeEstimationActive 0 "Off" 1 "Active" ;
VAL_ 191 CAP_DampingStatus 0 "Faulty" 1 "Ok" 2 "Reserved" 3 "Initialization" 4 "Invalid" ;
VAL_ 191 CAP_DampingActive 0 "Off" 1 "Active" ;
VAL_ 191 CAP_SLBlockageFlag 0 "Not_Degraded" 1 "Degraded" ;
VAL_ 191 CAP_FreeSightCheckStatus 0 "Ok" 1 "Failed" 2 "Invalid" ;
VAL_ 191 CAP_FreeSightCheckActive 0 "Active" 1 "Inactive" 2 "Paused" 3 "Invalid" ;
VAL_ 191 CAP_BlockageValue 0 "Not_Blocked" 1 "Slightly_Blocked" 2 "Moderately_Blocked" 3 "Highly_Blocked" 4 "Fully_Blocked" 5 "Limited_Sight" 6 "Invalid" ;
VAL_ 191 CAP_BlockageStatus 0 "Faulty" 1 "Ok" 2 "Reserved" 3 "Initialization" 4 "Invalid" ;
VAL_ 191 CAP_BlockageActive 0 "Active" 1 "Off" ;
VAL_ 191 CAP_BlockageSensitivity 0 "Low" 1 "Mid" 2 "High" 3 "Invalid" ;
VAL_ 1152 DET_CONFD_AZIMUTH_001 0 "High" 1 "MidHigh" 2 "MidLow" 3 "Low" ;
VAL_ 1152 DET_CONFD_ELEVATION_001 0 "High" 1 "MidHigh" 2 "MidLow" 3 "Low" ;
VAL_ 1152 DET_CONFD_AZIMUTH_002 0 "High" 1 "MidHigh" 2 "MidLow" 3 "Low" ;
VAL_ 1152 DET_CONFD_ELEVATION_002 0 "High" 1 "MidHigh" 2 "MidLow" 3 "Low" ;
VAL_ 1152 DET_CONFD_AZIMUTH_003 0 "High" 1 "MidHigh" 2 "MidLow" 3 "Low" ;
VAL_ 1152 DET_CONFD_ELEVATION_003 0 "High" 1 "MidHigh" 2 "MidLow" 3 "Low" ;
VAL_ 1 TSYN_SGW 0 "SyncToGTM" 1 "SyncToSubDomain" ;
VAL_ 1 TSYN_PDU 32 "CAN-SYN" 40 "CAN-FUP" ;
VAL_ 2 SSTS_VEHICLE_STATE 0 "Unknown" 1 "VehicleParked" 2 "VehicleAlive" 3 "VehicleEntry" 4 "VehicleDriving" 5 "VehicleUpgrade" ;
VAL_ 2 SSTS_VEH_POWER_MODE_STATUS 0 "Off" 1 "Standby" 2 "Accessories" 3 "Ignition_On" 4 "HV_On" 5 "Reserved" 6 "Reserved" 7 "Invalid" ;
VAL_ 2 SSTS_YAW_RATE_CALC_QF 0 "Undefined" 1 "Temporarily Undefined" 2 "Innaccurate" 3 "Accurate" ;
VAL_ 2 SSTS_VEHICLE_SPEED_CALC_QF 0 "Undefined" 1 "Temporarily Undefined" 2 "Innaccurate" 3 "Accurate" ;
VAL_ 2 SSTS_IGN_STATUS 0 "Unknown" 1 "Off" 2 "Accessory" 4 "Run" 8 "Start" 15 "Invalid" ;
VAL_ 2 SSTS_GEAR_POSITION 0 "Park" 1 "Reverse" 2 "Neutral" 3 "Drive" 4 "Sport_DriveSport" 5 "Low" 6 "first" 7 "second" 8 "third" 9 "fourth" 10 "fifth" 11 "sixth" 12 "NotUsed_1" 13 "NotUsed_2" 14 "Unknown_Position" 15 "Fault" ;
VAL_ 187 STS_PLATFORM_VARIANT 0 "VARIANT_INVALID" 1 "VARIANT_MRR3" 2 "VARIANT_SRR5" 3 "VARIANT_RACAM" 4 "VARIANT_MRR360" 5 "VARIANT_MRR3LLP" 6 "VARIANT_MRR3LLP_STD" 7 "VARIANT_MRR3LLP_AMOD" 8 "VARIANT_SRRAD" 9 "VARIANT_FLR4" 10 "VARIANT_FLR4PLUS" 11 "VARIANT_SRR6" 12 "VARIANT_SRR6PLUS" ;
VAL_ 187 STS_HARDWARE_VERSION 0 "UNKNOWN" 1 "RCM" 2 "RCM_RDI3_LOG" 3 "RCM_RDI3_HIL" 4 "RESERVED1" 5 "RESERVED2" ;
VAL_ 187 STS_SMC_PLATFROM_VERSION 0 "INVALID" 1 "MRR3" 2 "SRR5" 3 "RACAM" 4 "MRR360" 5 "MRR3LLP" 6 "MRRLLP_STD" 7 "MRRLLP_AMOD" 8 "SRRAD" 9 "FLR4" 10 "FLR4PLUS" 11 "SRR6" 12 "SRR6PLUS" ;
VAL_ 188 STS_VEHICLE_SUPPLY_VOLTAGE 0 "normV" 1 "lowVtemp" 2 "lowVtempToNorm" 3 "lowV1" 4 "lowV2" 5 "lowV1ToNorm" 6 "lowV2ToNorm" 7 "highVtemp" 8 "highVtempToNorm" 9 "highV1" 10 "highV2" 11 "highV1ToNorm" 12 "highV2ToNorm" ;
VAL_ 188 STS_BRR_STATUS 0 "INACTIVE" 1 "ACTIVE" 2 "FAULT" ;
VAL_ 188 STS_SCAN_TYPE 0 "MEDIUM_LOOK" 1 "LONG_LOOK" ;
VAL_ 184 HED_SLOPE_CORR_EXECUTIONFLAG 0 "AzimuthElevationNotCompensated" 1 "AzimuthCompensated" 2 "ElevationCompensated" 3 "AzimuthElevationCompensated" ;
VAL_ 184 HED_OPERATION_MODE 0 "Init_MCU" 1 "Radar_Not_Configured" 2 "Operational" 3 "Faulty" 4 "Shutdown_Initiated" 5 "Power_Off" ;
VAL_ 184 HED_LOOK_ID 0 "LOOK_A" 1 "LOOK_B" 2 "LOOK_C" 3 "LOOK_D" ;
VAL_ 184 HED_DATA_QUALIFIER 0 "Invalid" 1 "Not_Available" 2 "Reduced_In_Performance" 3 "Test_Mode" 4 "Normal" 5 "Reduced_In_Coverage" 6 "Reduced_In_Perf_And_Cov" 7 "Unknown" ;
VAL_ 184 HED_TIME_SYNC_SRC_MASTER 0 "LOCAL" 1 "GLOBAL" ;
VAL_ 184 HED_TIME_SYNC_VALIDITY_FLAG 0 "OUT_OF_SYNC" 1 "SYNCED_AT_LEAST_ONCE" 2 "SYNC_MSG_TIMEOUT_OR_CRC_ERR" ;
VAL_ 1153 DET_CONFD_AZIMUTH_005 0 "High" 1 "MidHigh" 2 "MidLow" 3 "Low" ;
VAL_ 1153 DET_CONFD_ELEVATION_005 0 "High" 1 "MidHigh" 2 "MidLow" 3 "Low" ;
VAL_ 1153 DET_CONFD_AZIMUTH_006 0 "High" 1 "MidHigh" 2 "MidLow" 3 "Low" ;
VAL_ 1153 DET_CONFD_ELEVATION_006 0 "High" 1 "MidHigh" 2 "MidLow" 3 "Low" ;
VAL_ 1153 DET_CONFD_AZIMUTH_007 0 "High" 1 "MidHigh" 2 "MidLow" 3 "Low" ;
VAL_ 1153 DET_CONFD_ELEVATION_007 0 "High" 1 "MidHigh" 2 "MidLow" 3 "Low" ;
VAL_ 1154 DET_CONFD_AZIMUTH_009 0 "High" 1 "MidHigh" 2 "MidLow" 3 "Low" ;
VAL_ 1154 DET_CONFD_ELEVATION_009 0 "High" 1 "MidHigh" 2 "MidLow" 3 "Low" ;
VAL_ 1154 DET_CONFD_AZIMUTH_010 0 "High" 1 "MidHigh" 2 "MidLow" 3 "Low" ;
VAL_ 1154 DET_CONFD_ELEVATION_010 0 "High" 1 "MidHigh" 2 "MidLow" 3 "Low" ;
VAL_ 1154 DET_CONFD_AZIMUTH_011 0 "High" 1 "MidHigh" 2 "MidLow" 3 "Low" ;
VAL_ 1154 DET_CONFD_ELEVATION_011 0 "High" 1 "MidHigh" 2 "MidLow" 3 "Low" ;
VAL_ 1155 DET_CONFD_AZIMUTH_013 0 "High" 1 "MidHigh" 2 "MidLow" 3 "Low" ;
VAL_ 1155 DET_CONFD_ELEVATION_013 0 "High" 1 "MidHigh" 2 "MidLow" 3 "Low" ;
VAL_ 1155 DET_CONFD_AZIMUTH_014 0 "High" 1 "MidHigh" 2 "MidLow" 3 "Low" ;
VAL_ 1155 DET_CONFD_ELEVATION_014 0 "High" 1 "MidHigh" 2 "MidLow" 3 "Low" ;
VAL_ 1155 DET_CONFD_AZIMUTH_015 0 "High" 1 "MidHigh" 2 "MidLow" 3 "Low" ;
VAL_ 1155 DET_CONFD_ELEVATION_015 0 "High" 1 "MidHigh" 2 "MidLow" 3 "Low" ;
VAL_ 1156 DET_CONFD_AZIMUTH_017 0 "High" 1 "MidHigh" 2 "MidLow" 3 "Low" ;
VAL_ 1156 DET_CONFD_ELEVATION_017 0 "High" 1 "MidHigh" 2 "MidLow" 3 "Low" ;
VAL_ 1156 DET_CONFD_AZIMUTH_018 0 "High" 1 "MidHigh" 2 "MidLow" 3 "Low" ;
VAL_ 1156 DET_CONFD_ELEVATION_018 0 "High" 1 "MidHigh" 2 "MidLow" 3 "Low" ;
VAL_ 1156 DET_CONFD_AZIMUTH_019 0 "High" 1 "MidHigh" 2 "MidLow" 3 "Low" ;
VAL_ 1156 DET_CONFD_ELEVATION_019 0 "High" 1 "MidHigh" 2 "MidLow" 3 "Low" ;
VAL_ 1157 DET_CONFD_AZIMUTH_021 0 "High" 1 "MidHigh" 2 "MidLow" 3 "Low" ;
VAL_ 1157 DET_CONFD_ELEVATION_021 0 "High" 1 "MidHigh" 2 "MidLow" 3 "Low" ;
VAL_ 1157 DET_CONFD_AZIMUTH_022 0 "High" 1 "MidHigh" 2 "MidLow" 3 "Low" ;
VAL_ 1157 DET_CONFD_ELEVATION_022 0 "High" 1 "MidHigh" 2 "MidLow" 3 "Low" ;
VAL_ 1157 DET_CONFD_AZIMUTH_023 0 "High" 1 "MidHigh" 2 "MidLow" 3 "Low" ;
VAL_ 1157 DET_CONFD_ELEVATION_023 0 "High" 1 "MidHigh" 2 "MidLow" 3 "Low" ;
VAL_ 1158 DET_CONFD_AZIMUTH_025 0 "High" 1 "MidHigh" 2 "MidLow" 3 "Low" ;
VAL_ 1158 DET_CONFD_ELEVATION_025 0 "High" 1 "MidHigh" 2 "MidLow" 3 "Low" ;
VAL_ 1158 DET_CONFD_AZIMUTH_026 0 "High" 1 "MidHigh" 2 "MidLow" 3 "Low" ;
VAL_ 1158 DET_CONFD_ELEVATION_026 0 "High" 1 "MidHigh" 2 "MidLow" 3 "Low" ;
VAL_ 1158 DET_CONFD_AZIMUTH_027 0 "High" 1 "MidHigh" 2 "MidLow" 3 "Low" ;
VAL_ 1158 DET_CONFD_ELEVATION_027 0 "High" 1 "MidHigh" 2 "MidLow" 3 "Low" ;
VAL_ 1159 DET_CONFD_AZIMUTH_029 0 "High" 1 "MidHigh" 2 "MidLow" 3 "Low" ;
VAL_ 1159 DET_CONFD_ELEVATION_029 0 "High" 1 "MidHigh" 2 "MidLow" 3 "Low" ;
VAL_ 1159 DET_CONFD_AZIMUTH_030 0 "High" 1 "MidHigh" 2 "MidLow" 3 "Low" ;
VAL_ 1159 DET_CONFD_ELEVATION_030 0 "High" 1 "MidHigh" 2 "MidLow" 3 "Low" ;
VAL_ 1159 DET_CONFD_AZIMUTH_031 0 "High" 1 "MidHigh" 2 "MidLow" 3 "Low" ;
VAL_ 1159 DET_CONFD_ELEVATION_031 0 "High" 1 "MidHigh" 2 "MidLow" 3 "Low" ;
VAL_ 1160 DET_CONFD_AZIMUTH_033 0 "High" 1 "MidHigh" 2 "MidLow" 3 "Low" ;
VAL_ 1160 DET_CONFD_ELEVATION_033 0 "High" 1 "MidHigh" 2 "MidLow" 3 "Low" ;
VAL_ 1160 DET_CONFD_AZIMUTH_034 0 "High" 1 "MidHigh" 2 "MidLow" 3 "Low" ;
VAL_ 1160 DET_CONFD_ELEVATION_034 0 "High" 1 "MidHigh" 2 "MidLow" 3 "Low" ;
VAL_ 1160 DET_CONFD_AZIMUTH_035 0 "High" 1 "MidHigh" 2 "MidLow" 3 "Low" ;
VAL_ 1160 DET_CONFD_ELEVATION_035 0 "High" 1 "MidHigh" 2 "MidLow" 3 "Low" ;
VAL_ 1161 DET_CONFD_AZIMUTH_037 0 "High" 1 "MidHigh" 2 "MidLow" 3 "Low" ;
VAL_ 1161 DET_CONFD_ELEVATION_037 0 "High" 1 "MidHigh" 2 "MidLow" 3 "Low" ;
VAL_ 1161 DET_CONFD_AZIMUTH_038 0 "High" 1 "MidHigh" 2 "MidLow" 3 "Low" ;
VAL_ 1161 DET_CONFD_ELEVATION_038 0 "High" 1 "MidHigh" 2 "MidLow" 3 "Low" ;
VAL_ 1161 DET_CONFD_AZIMUTH_039 0 "High" 1 "MidHigh" 2 "MidLow" 3 "Low" ;
VAL_ 1161 DET_CONFD_ELEVATION_039 0 "High" 1 "MidHigh" 2 "MidLow" 3 "Low" ;
VAL_ 1162 DET_CONFD_AZIMUTH_041 0 "High" 1 "MidHigh" 2 "MidLow" 3 "Low" ;
VAL_ 1162 DET_CONFD_ELEVATION_041 0 "High" 1 "MidHigh" 2 "MidLow" 3 "Low" ;
VAL_ 1162 DET_CONFD_AZIMUTH_042 0 "High" 1 "MidHigh" 2 "MidLow" 3 "Low" ;
VAL_ 1162 DET_CONFD_ELEVATION_042 0 "High" 1 "MidHigh" 2 "MidLow" 3 "Low" ;
VAL_ 1162 DET_CONFD_AZIMUTH_043 0 "High" 1 "MidHigh" 2 "MidLow" 3 "Low" ;
VAL_ 1162 DET_CONFD_ELEVATION_043 0 "High" 1 "MidHigh" 2 "MidLow" 3 "Low" ;
SIG_GROUP_ 79 RDR_ROE 1 : ROE_CYCLE_COUNTER ROE_CRC_16 StsBittstFail StsBittstFailOprCycle StsBitPndingDTC StsBitcnfrmedDTC StsBittstFailsncLastClr StsBittstInCpltOprCyle StsBitWarnIndReq FailTypeByte DTCNumber DiagAddr StsBytePrev DTCSeverity FltOccrCtr;
SIG_GROUP_ 190 AlignmentStatus2 1 : AL_STS_002_MH_CRC16 AL_STS_002_CYCLE_COUNTER STS_AlignmentStaticStatus STS_Measured_Range STS_MeasuredRangeStd STS_MeasuredRangeRate STS_MeasuredRangeRateStd STS_MeasuredRCS STS_MeasuredRCSStd STS_ImpactByInterference STS_AlignmentServiceStatus STS_VehicleCondition STS_DistanceAbsolute STS_DistanceEffective STS_AverageNumberOfDetections STS_DurationAbsolute STS_DurationEffective STS_AverageSpeed STS_AlignmentShortTrackStatus;
SIG_GROUP_ 189 AlignmentStatus1 1 : AL_STS_001_MH_CRC16 AL_STS_001_CYCLE_COUNTER STS_AlignmentModeIn STS_CoordinateSystemInput STS_RadarTypeInput STS_InitAlignmentResultAzimuth STS_InitAlignmentResultElevation STS_InitLastSuccessfulAlignMode STS_AlignmentModeOut STS_InitAlignResultAzimuthUpdate STS_InitAlignRsltElevationUpdate STS_InitAlignRsltHostSpdCompFac STS_AlignmentAzimuth STS_AlignmentElevation STS_AzimuthStd STS_ElevationStd STS_CalTime STS_ProgressPercent STS_AlignmentError STS_CalDisplay STS_AlignmentAutoStatus STS_AutoAlignmentFailRootCause STS_StartAzimuth STS_StartElevation STS_AACurrentAzimuth STS_AACurrentElevation STS_AAAzimuthStd STS_AAElevationStd STS_AzimuthErrorPositive STS_ElevationErrorPositive STS_RollErrorPositive STS_AzimuthErrorNegative STS_ElevationErrorNegative STS_HostSpeedCompensationFactor STS_HostSpdCompensationFactorQF STS_AzimuthUpdates STS_ElevationUpdates;
SIG_GROUP_ 191 RadarCapability 1 : CAP_MH_CRC16 CAP_CYCLE_COUNTER CAP_BlockageSensitivity CAP_BlockageActive CAP_BlockageStatus CAP_BlockageValue CAP_BlockageProbability CAP_FreeSightCheckActive CAP_FreeSightCheckStatus CAP_SLBlockageFlag CAP_SLBlockageFilterValue CAP_DampingCurrent CAP_DampingActive CAP_DampingStatus CAP_DampingStandardDeviation CAP_SLLMonitoringActive CAP_SLLMonitoringStatus CAP_SideLobeLevelBeamformer CAP_RangeEstimationActive CAP_RangeEstimationStatus CAP_MaxDetectionRangeCar_0 CAP_MaxDetRangeMotorbike_1 CAP_MaxDetRangePedestrian_0 CAP_AngleAzimuthRangeStart CAP_AngleAzimuthRangeEnd CAP_MaxDetectionRangeCar_1 CAP_MaxDetectionRangeCar_2 CAP_MaxDetRangeMotorbike_0 CAP_MaxDetRangeMotorbike_2 CAP_MaxDetRangePedestrian_1 CAP_MaxDetRangePedestrian_2;
SIG_GROUP_ 1152 Detections_001_004 1 : DET_MH_CRC16_001_004 DET_MH_CYCLE_COUNTER_001_004 DET_MH_SCAN_INDEX_4LSB_001_004 DET_CONFD_ELEVATION_001 DET_CONFD_AZIMUTH_001 DET_HVC_FLAG_001 DET_OUTSIDE_SECTOR_001 DET_EXISTENCE_PROB_001 DET_POINT_TARGET_PROB_001 DET_SNR_001 DET_SUPER_RES_TARGET_001 DET_BI_STATIC_FLAG_001 DET_VALID_FLAG_001 DET_RCS_001 DET_ELEVATION_ERR_001 DET_ELEVATION_001 DET_AZIMUTH_ERR_001 DET_AZIMUTH_001 DET_RANGE_VELOCITY_ERR_001 DET_RANGE_VELOCITY_001 DET_RANGE_ERR_001 DET_RANGE_001 DET_CONFD_ELEVATION_002 DET_CONFD_AZIMUTH_002 DET_HVC_FLAG_002 DET_OUTSIDE_SECTOR_002 DET_EXISTENCE_PROB_002 DET_POINT_TARGET_PROB_002 DET_SNR_002 DET_SUPER_RES_TARGET_002 DET_BI_STATIC_FLAG_002 DET_VALID_FLAG_002 DET_RCS_002 DET_ELEVATION_ERR_002 DET_ELEVATION_002 DET_AZIMUTH_ERR_002 DET_AZIMUTH_002 DET_RANGE_VELOCITY_ERR_002 DET_RANGE_VELOCITY_002 DET_RANGE_ERR_002 DET_RANGE_002 DET_CONFD_ELEVATION_003 DET_CONFD_AZIMUTH_003 DET_HVC_FLAG_003 DET_OUTSIDE_SECTOR_003 DET_EXISTENCE_PROB_003 DET_POINT_TARGET_PROB_003 DET_SNR_003 DET_SUPER_RES_TARGET_003 DET_BI_STATIC_FLAG_003 DET_VALID_FLAG_003 DET_RCS_003 DET_ELEVATION_ERR_003 DET_ELEVATION_003 DET_AZIMUTH_ERR_003 DET_AZIMUTH_003 DET_RANGE_VELOCITY_ERR_003 DET_RANGE_VELOCITY_003 DET_RANGE_ERR_003 DET_RANGE_003 DET_CONFD_ELEVATION_004 DET_CONFD_AZIMUTH_004 DET_HVC_FLAG_004 DET_OUTSIDE_SECTOR_004 DET_EXISTENCE_PROB_004 DET_POINT_TARGET_PROB_004 DET_SNR_004 DET_SUPER_RES_TARGET_004 DET_BI_STATIC_FLAG_004 DET_VALID_FLAG_004 DET_RCS_004 DET_ELEVATION_ERR_004 DET_ELEVATION_004 DET_AZIMUTH_ERR_004 DET_AZIMUTH_004 DET_RANGE_VELOCITY_ERR_004 DET_RANGE_VELOCITY_004 DET_RANGE_ERR_004 DET_RANGE_004;
SIG_GROUP_ 2 VehicleStatus 1 : SSTS_MH_VS_CRC16 SSTS_MH_VS_CYCLE_COUNTER SSTS_CAN_PCAN_MAJOR_ADAS SSTS_CAN_PCAN_MINOR_ADAS SSTS_YAW_RATE_CALC SSTS_SW_VERSION_ADAS SSTS_GEAR_POSITION SSTS_IGN_STATUS SSTS_DRIVE_REVERSE SSTS_DRIVE_DIR SSTS_STEERING_ANGLE SSTS_STEERING_ANGLE_SIGN SSTS_VEHICLE_SPEED_CALC SSTS_VEHICLE_SPEED_CALC_QF SSTS_VEH_SPD_COMP_FACTOR SSTS_YAW_RATE_BIAS SSTS_YAW_RATE_CALC_QF SSTS_VEH_ODOMETER SSTS_VEH_POWER_MODE_STATUS SSTS_VEHICLE_STATE SSTS_VEH_SYSTEM_VOLTAGE SSTS_VEH_AbsoluteTime_Day SSTS_VEH_AbsoluteTime_Hour SSTS_VEH_AbsoluteTime_Minute SSTS_VEH_AbsoluteTime_Month SSTS_VEH_AbsoluteTime_Second SSTS_VEH_AbsoluteTime_Year SSTS_VIN_FrameIdx SSTS_VIN_Data_Byte0 SSTS_VIN_Data_Byte2 SSTS_VIN_Data_Byte1 SSTS_VIN_Data_Byte3 SSTS_VIN_Data_Byte4 SSTS_VIN_Data_Byte5 SSTS_VIN_Data_Byte6;
SIG_GROUP_ 187 RadarStatus1 1 : STS_MH_001_CYCLE_COUNTER STS_MH_001_CRC16 STS_SMC_PLATFROM_VERSION STS_SMC_SECTION_COMPTBLITY STS_SMC_CAL_VER_MINOR STS_SMC_CAL_VER_MAJOR STS_USC_SECTION_COMPTBLITY STS_USC_CAL_VER_MINOR STS_USC_CAL_VER_MAJOR STS_SENSOR_POSITION STS_SENSOR_HEIGHT STS_SENSOR_MOUNT_LOCATION STS_SENSOR_MOUNT_ORNT_ROLL STS_SENSOR_MOUNT_ORNT_PITCH STS_SENSOR_MOUNT_ORNT_YAW STS_SENSOR_MOUNT_POS_Z STS_SENSOR_MOUNT_POS_Y STS_SENSOR_MOUNT_POS_X STS_SENSOR_POLARITY STS_PBL_VERSION_FIELD4 STS_PBL_VERSION_FIELD3 STS_PBL_VERSION_FIELD2 STS_PBL_VERSION_FIELD1 STS_SW_VERSION_FIELD4 STS_SW_VERSION_FIELD3 STS_SW_VERSION_FIELD2 STS_SW_VERSION_FIELD1 STS_DET_DBC_BASE_VER_MAJOR STS_DET_DBC_BASE_VER_MINOR STS_SERIAL_NUM_JULIAN_DAY STS_SERIAL_NUM_JULIAN_YEAR STS_SERIAL_NUMBER_SEQUENCE STS_HARDWARE_VERSION STS_PCAN_PROTOCOL_VER_MAJOR STS_PLATFORM_VARIANT STS_PCAN_PROTOCOL_VER_MINOR STS_TIME_SINCE_POWER_ON STS_AF_TIME_INST STS_AF_TIME_PEAK STS_MAIN_CORE_TIME_INST STS_MAIN_CORE_TIME_PEAK STS_RDD_CORE_TIME_INST STS_RDD_CORE_TIME_PEAK STS_SP_CORE_TIME_INST STS_SP_CORE_TIME_PEAK;
SIG_GROUP_ 188 RadarStatus2 1 : STS_TIME_SYNC_OFFSET STS_RDD_CORE_THROUGHPUT STS_MH_002_CRC16 STS_MH_002_CYCLE_COUNTER STS_NO_TSYN_ERROR STS_POINT_OF_TRIGGER STS_BRR_STATUS STS_CORE_ACTIVE_FAULTS STS_MMIC_TEMP_TX1_2 STS_MMIC_TEMP_TX3_4 STS_MCU_TEMP STS_MMIC_TEMP_RX STS_MMIC_TEMP_TX0 STS_XCVR_OPERATIONAL STS_SCAN_TYPE STS_AF_CORE_THROUGHPUT STS_MMIC_RE_INIT_COUNT STS_VEHICLE_SPEED_CALC STS_STEERING_ANGLE STS_STEERING_ANGLE_SIGN STS_VEH_SPEED_DIRECTION STS_YAW_RATE_BIAS STS_VEHICLE_SUPPLY_VOLTAGE;
SIG_GROUP_ 184 RadarHeader 1 : HED_MH_CRC16 HED_MH_CYCLE_COUNTER HED_Auth_CRC32 HED_FOV_VER_MIN HED_FOV_HOR_MIN HED_DET_SPEED_RANGE_MIN HED_DET_RANGE_MIN HED_FOV_VER_MAX HED_FOV_HOR_MAX HED_DET_SPEED_RANGE_MAX HED_DET_RANGE_MAX HED_R_WRAPPING HED_V_WRAPPING HED_DATA_QUALIFIER HED_SCAN_INDEX HED_LOOK_ID HED_NUM_OF_VALID_DETECTIONS HED_ALIGN_HOR_REF HED_LOOK_INDEX HED_ALIGN_VER_REF HED_TRIGGER_TIME HED_TIME_SYNC_VALIDITY_FLAG HED_TIME_SYNC_SRC_MASTER HED_SENSOR_TIME_STAMP_NS HED_SENSOR_TIME_STAMP_SEC HED_DET_BI_STATIC_COUNT HED_DET_NUM_OF_2PASS HED_DET_NUM_OF_1PASS HED_NUM_OF_RESTBINS_USED HED_MAX_NUM_OF_DETECTIONS HED_OPERATION_MODE HED_PROCESSED_RANGE HED_SLOPE_CORR_EXECUTIONFLAG HED_INTRFC_VERSION_ID_PATCH HED_INTRFC_VERSION_ID_MINOR HED_INTRFC_VERSION_ID_MAJOR;
SIG_GROUP_ 72 XcpCTOReq 1 : STS_XCP_REQ_CTO_Byte63 STS_XCP_REQ_CTO_Byte62 STS_XCP_REQ_CTO_Byte61 STS_XCP_REQ_CTO_Byte60 STS_XCP_REQ_CTO_Byte59 STS_XCP_REQ_CTO_Byte58 STS_XCP_REQ_CTO_Byte57 STS_XCP_REQ_CTO_Byte56 STS_XCP_REQ_CTO_Byte55 STS_XCP_REQ_CTO_Byte54 STS_XCP_REQ_CTO_Byte53 STS_XCP_REQ_CTO_Byte52 STS_XCP_REQ_CTO_Byte51 STS_XCP_REQ_CTO_Byte50 STS_XCP_REQ_CTO_Byte49 STS_XCP_REQ_CTO_Byte48 STS_XCP_REQ_CTO_Byte47 STS_XCP_REQ_CTO_Byte46 STS_XCP_REQ_CTO_Byte45 STS_XCP_REQ_CTO_Byte44 STS_XCP_REQ_CTO_Byte43 STS_XCP_REQ_CTO_Byte42 STS_XCP_REQ_CTO_Byte41 STS_XCP_REQ_CTO_Byte40 STS_XCP_REQ_CTO_Byte39 STS_XCP_REQ_CTO_Byte38 STS_XCP_REQ_CTO_Byte37 STS_XCP_REQ_CTO_Byte36 STS_XCP_REQ_CTO_Byte35 STS_XCP_REQ_CTO_Byte34 STS_XCP_REQ_CTO_Byte33 STS_XCP_REQ_CTO_Byte32 STS_PID STS_XCP_REQ_CTO_Byte1 STS_XCP_REQ_CTO_Byte2 STS_XCP_REQ_CTO_Byte3 STS_XCP_REQ_CTO_Byte4 STS_XCP_REQ_CTO_Byte5 STS_XCP_REQ_CTO_Byte6 STS_XCP_REQ_CTO_Byte7 STS_XCP_REQ_CTO_Byte8 STS_XCP_REQ_CTO_Byte9 STS_XCP_REQ_CTO_Byte10 STS_XCP_REQ_CTO_Byte11 STS_XCP_REQ_CTO_Byte12 STS_XCP_REQ_CTO_Byte13 STS_XCP_REQ_CTO_Byte14 STS_XCP_REQ_CTO_Byte15 STS_XCP_REQ_CTO_Byte16 STS_XCP_REQ_CTO_Byte17 STS_XCP_REQ_CTO_Byte18 STS_XCP_REQ_CTO_Byte19 STS_XCP_REQ_CTO_Byte20 STS_XCP_REQ_CTO_Byte21 STS_XCP_REQ_CTO_Byte22 STS_XCP_REQ_CTO_Byte23 STS_XCP_REQ_CTO_Byte24 STS_XCP_REQ_CTO_Byte25 STS_XCP_REQ_CTO_Byte26 STS_XCP_REQ_CTO_Byte27 STS_XCP_REQ_CTO_Byte28 STS_XCP_REQ_CTO_Byte29 STS_XCP_REQ_CTO_Byte30 STS_XCP_REQ_CTO_Byte31;
SIG_GROUP_ 73 XcpCTOResp 1 : STS_XCP_RES_CTO_Byte63 STS_XCP_RES_CTO_Byte62 STS_XCP_RES_CTO_Byte61 STS_XCP_RES_CTO_Byte60 STS_XCP_RES_CTO_Byte59 STS_XCP_RES_CTO_Byte58 STS_XCP_RES_CTO_Byte57 STS_XCP_RES_CTO_Byte56 STS_XCP_RES_CTO_Byte55 STS_XCP_RES_CTO_Byte54 STS_XCP_RES_CTO_Byte53 STS_XCP_RES_CTO_Byte52 STS_XCP_RES_CTO_Byte51 STS_XCP_RES_CTO_Byte50 STS_XCP_RES_CTO_Byte49 STS_XCP_RES_CTO_Byte48 STS_XCP_RES_CTO_Byte47 STS_XCP_RES_CTO_Byte46 STS_XCP_RES_CTO_Byte45 STS_XCP_RES_CTO_Byte44 STS_XCP_RES_CTO_Byte43 STS_XCP_RES_CTO_Byte42 STS_XCP_RES_CTO_Byte41 STS_XCP_RES_CTO_Byte40 STS_XCP_RES_CTO_Byte39 STS_XCP_RES_CTO_Byte38 STS_XCP_RES_CTO_Byte37 STS_XCP_RES_CTO_Byte36 STS_XCP_RES_CTO_Byte35 STS_XCP_RES_CTO_Byte34 STS_XCP_RES_CTO_Byte33 STS_XCP_RES_CTO_Byte32 STS_XCP_RES_CTO_Byte0 STS_XCP_RES_CTO_Byte1 STS_XCP_RES_CTO_Byte2 STS_XCP_RES_CTO_Byte3 STS_XCP_RES_CTO_Byte4 STS_XCP_RES_CTO_Byte5 STS_XCP_RES_CTO_Byte6 STS_XCP_RES_CTO_Byte7 STS_XCP_RES_CTO_Byte8 STS_XCP_RES_CTO_Byte9 STS_XCP_RES_CTO_Byte10 STS_XCP_RES_CTO_Byte11 STS_XCP_RES_CTO_Byte12 STS_XCP_RES_CTO_Byte13 STS_XCP_RES_CTO_Byte14 STS_XCP_RES_CTO_Byte15 STS_XCP_RES_CTO_Byte16 STS_XCP_RES_CTO_Byte17 STS_XCP_RES_CTO_Byte18 STS_XCP_RES_CTO_Byte19 STS_XCP_RES_CTO_Byte20 STS_XCP_RES_CTO_Byte21 STS_XCP_RES_CTO_Byte22 STS_XCP_RES_CTO_Byte23 STS_XCP_RES_CTO_Byte24 STS_XCP_RES_CTO_Byte25 STS_XCP_RES_CTO_Byte26 STS_XCP_RES_CTO_Byte27 STS_XCP_RES_CTO_Byte28 STS_XCP_RES_CTO_Byte29 STS_XCP_RES_CTO_Byte30 STS_XCP_RES_CTO_Byte31;
SIG_GROUP_ 74 XcpDAQResp 1 : STS_XCP_RES_DAQ_Byte63 STS_XCP_RES_DAQ_Byte62 STS_XCP_RES_DAQ_Byte61 STS_XCP_RES_DAQ_Byte60 STS_XCP_RES_DAQ_Byte59 STS_XCP_RES_DAQ_Byte58 STS_XCP_RES_DAQ_Byte57 STS_XCP_RES_DAQ_Byte56 STS_XCP_RES_DAQ_Byte55 STS_XCP_RES_DAQ_Byte54 STS_XCP_RES_DAQ_Byte53 STS_XCP_RES_DAQ_Byte52 STS_XCP_RES_DAQ_Byte51 STS_XCP_RES_DAQ_Byte50 STS_XCP_RES_DAQ_Byte49 STS_XCP_RES_DAQ_Byte48 STS_XCP_RES_DAQ_Byte47 STS_XCP_RES_DAQ_Byte46 STS_XCP_RES_DAQ_Byte45 STS_XCP_RES_DAQ_Byte44 STS_XCP_RES_DAQ_Byte43 STS_XCP_RES_DAQ_Byte42 STS_XCP_RES_DAQ_Byte41 STS_XCP_RES_DAQ_Byte40 STS_XCP_RES_DAQ_Byte39 STS_XCP_RES_DAQ_Byte38 STS_XCP_RES_DAQ_Byte37 STS_XCP_RES_DAQ_Byte36 STS_XCP_RES_DAQ_Byte35 STS_XCP_RES_DAQ_Byte34 STS_XCP_RES_DAQ_Byte33 STS_XCP_RES_DAQ_Byte32 STS_XCP_RES_DAQ_Byte31 STS_XCP_RES_DAQ_Byte30 STS_XCP_RES_DAQ_Byte29 STS_XCP_RES_DAQ_Byte28 STS_XCP_RES_DAQ_Byte27 STS_XCP_RES_DAQ_Byte26 STS_XCP_RES_DAQ_Byte25 STS_XCP_RES_DAQ_Byte24 STS_XCP_RES_DAQ_Byte23 STS_XCP_RES_DAQ_Byte22 STS_XCP_RES_DAQ_Byte21 STS_XCP_RES_DAQ_Byte20 STS_XCP_RES_DAQ_Byte19 STS_XCP_RES_DAQ_Byte18 STS_XCP_RES_DAQ_Byte17 STS_XCP_RES_DAQ_Byte16 STS_XCP_RES_DAQ_Byte15 STS_XCP_RES_DAQ_Byte14 STS_XCP_RES_DAQ_Byte13 STS_XCP_RES_DAQ_Byte12 STS_XCP_RES_DAQ_Byte11 STS_XCP_RES_DAQ_Byte10 STS_XCP_RES_DAQ_Byte9 STS_XCP_RES_DAQ_Byte8 STS_XCP_RES_DAQ_Byte7 STS_XCP_RES_DAQ_Byte6 STS_XCP_RES_DAQ_Byte5 STS_XCP_RES_DAQ_Byte4 STS_XCP_RES_DAQ_Byte3 STS_XCP_RES_DAQ_Byte2 STS_XCP_RES_DAQ_Byte1 STS_XCP_RES_DAQ_Byte0;
SIG_GROUP_ 1153 Detections_005_008 1 : DET_MH_CRC16_005_008 DET_MH_CYCLE_COUNTER_005_008 DET_MH_SCAN_INDEX_4LSB_005_008 DET_CONFD_ELEVATION_005 DET_CONFD_AZIMUTH_005 DET_HVC_FLAG_005 DET_OUTSIDE_SECTOR_005 DET_EXISTENCE_PROB_005 DET_POINT_TARGET_PROB_005 DET_SNR_005 DET_SUPER_RES_TARGET_005 DET_BI_STATIC_FLAG_005 DET_VALID_FLAG_005 DET_RCS_005 DET_ELEVATION_ERR_005 DET_ELEVATION_005 DET_AZIMUTH_ERR_005 DET_AZIMUTH_005 DET_RANGE_VELOCITY_ERR_005 DET_RANGE_VELOCITY_005 DET_RANGE_ERR_005 DET_RANGE_005 DET_CONFD_ELEVATION_006 DET_CONFD_AZIMUTH_006 DET_HVC_FLAG_006 DET_OUTSIDE_SECTOR_006 DET_EXISTENCE_PROB_006 DET_POINT_TARGET_PROB_006 DET_SNR_006 DET_SUPER_RES_TARGET_006 DET_BI_STATIC_FLAG_006 DET_VALID_FLAG_006 DET_RCS_006 DET_ELEVATION_ERR_006 DET_ELEVATION_006 DET_AZIMUTH_ERR_006 DET_AZIMUTH_006 DET_RANGE_VELOCITY_ERR_006 DET_RANGE_VELOCITY_006 DET_RANGE_ERR_006 DET_RANGE_006 DET_CONFD_ELEVATION_007 DET_CONFD_AZIMUTH_007 DET_HVC_FLAG_007 DET_OUTSIDE_SECTOR_007 DET_EXISTENCE_PROB_007 DET_POINT_TARGET_PROB_007 DET_SNR_007 DET_SUPER_RES_TARGET_007 DET_BI_STATIC_FLAG_007 DET_VALID_FLAG_007 DET_RCS_007 DET_ELEVATION_ERR_007 DET_ELEVATION_007 DET_AZIMUTH_ERR_007 DET_AZIMUTH_007 DET_RANGE_VELOCITY_ERR_007 DET_RANGE_VELOCITY_007 DET_RANGE_ERR_007 DET_RANGE_007 DET_CONFD_ELEVATION_008 DET_CONFD_AZIMUTH_008 DET_HVC_FLAG_008 DET_OUTSIDE_SECTOR_008 DET_EXISTENCE_PROB_008 DET_POINT_TARGET_PROB_008 DET_SNR_008 DET_SUPER_RES_TARGET_008 DET_BI_STATIC_FLAG_008 DET_VALID_FLAG_008 DET_RCS_008 DET_ELEVATION_ERR_008 DET_ELEVATION_008 DET_AZIMUTH_ERR_008 DET_AZIMUTH_008 DET_RANGE_VELOCITY_ERR_008 DET_RANGE_VELOCITY_008 DET_RANGE_ERR_008 DET_RANGE_008;
SIG_GROUP_ 1154 Detections_009_012 1 : DET_MH_CRC16_009_012 DET_MH_CYCLE_COUNTER_009_012 DET_MH_SCAN_INDEX_4LSB_009_012 DET_CONFD_ELEVATION_009 DET_CONFD_AZIMUTH_009 DET_HVC_FLAG_009 DET_OUTSIDE_SECTOR_009 DET_EXISTENCE_PROB_009 DET_POINT_TARGET_PROB_009 DET_SNR_009 DET_SUPER_RES_TARGET_009 DET_BI_STATIC_FLAG_009 DET_VALID_FLAG_009 DET_RCS_009 DET_ELEVATION_ERR_009 DET_ELEVATION_009 DET_AZIMUTH_ERR_009 DET_AZIMUTH_009 DET_RANGE_VELOCITY_ERR_009 DET_RANGE_VELOCITY_009 DET_RANGE_ERR_009 DET_RANGE_009 DET_CONFD_ELEVATION_010 DET_CONFD_AZIMUTH_010 DET_HVC_FLAG_010 DET_OUTSIDE_SECTOR_010 DET_EXISTENCE_PROB_010 DET_POINT_TARGET_PROB_010 DET_SNR_010 DET_SUPER_RES_TARGET_010 DET_BI_STATIC_FLAG_010 DET_VALID_FLAG_010 DET_RCS_010 DET_ELEVATION_ERR_010 DET_ELEVATION_010 DET_AZIMUTH_ERR_010 DET_AZIMUTH_010 DET_RANGE_VELOCITY_ERR_010 DET_RANGE_VELOCITY_010 DET_RANGE_ERR_010 DET_RANGE_010 DET_CONFD_ELEVATION_011 DET_CONFD_AZIMUTH_011 DET_HVC_FLAG_011 DET_OUTSIDE_SECTOR_011 DET_EXISTENCE_PROB_011 DET_POINT_TARGET_PROB_011 DET_SNR_011 DET_SUPER_RES_TARGET_011 DET_BI_STATIC_FLAG_011 DET_VALID_FLAG_011 DET_RCS_011 DET_ELEVATION_ERR_011 DET_ELEVATION_011 DET_AZIMUTH_ERR_011 DET_AZIMUTH_011 DET_RANGE_VELOCITY_ERR_011 DET_RANGE_VELOCITY_011 DET_RANGE_ERR_011 DET_RANGE_011 DET_CONFD_ELEVATION_012 DET_CONFD_AZIMUTH_012 DET_HVC_FLAG_012 DET_OUTSIDE_SECTOR_012 DET_EXISTENCE_PROB_012 DET_POINT_TARGET_PROB_012 DET_SNR_012 DET_SUPER_RES_TARGET_012 DET_BI_STATIC_FLAG_012 DET_VALID_FLAG_012 DET_RCS_012 DET_ELEVATION_ERR_012 DET_ELEVATION_012 DET_AZIMUTH_ERR_012 DET_AZIMUTH_012 DET_RANGE_VELOCITY_ERR_012 DET_RANGE_VELOCITY_012 DET_RANGE_ERR_012 DET_RANGE_012;
SIG_GROUP_ 1155 Detections_013_016 1 : DET_MH_CRC16_013_016 DET_MH_CYCLE_COUNTER_013_016 DET_MH_SCAN_INDEX_4LSB_013_016 DET_CONFD_ELEVATION_013 DET_CONFD_AZIMUTH_013 DET_HVC_FLAG_013 DET_OUTSIDE_SECTOR_013 DET_EXISTENCE_PROB_013 DET_POINT_TARGET_PROB_013 DET_SNR_013 DET_SUPER_RES_TARGET_013 DET_BI_STATIC_FLAG_013 DET_VALID_FLAG_013 DET_RCS_013 DET_ELEVATION_ERR_013 DET_ELEVATION_013 DET_AZIMUTH_ERR_013 DET_AZIMUTH_013 DET_RANGE_VELOCITY_ERR_013 DET_RANGE_VELOCITY_013 DET_RANGE_ERR_013 DET_RANGE_013 DET_CONFD_ELEVATION_014 DET_CONFD_AZIMUTH_014 DET_HVC_FLAG_014 DET_OUTSIDE_SECTOR_014 DET_EXISTENCE_PROB_014 DET_POINT_TARGET_PROB_014 DET_SNR_014 DET_SUPER_RES_TARGET_014 DET_BI_STATIC_FLAG_014 DET_VALID_FLAG_014 DET_RCS_014 DET_ELEVATION_ERR_014 DET_ELEVATION_014 DET_AZIMUTH_ERR_014 DET_AZIMUTH_014 DET_RANGE_VELOCITY_ERR_014 DET_RANGE_VELOCITY_014 DET_RANGE_ERR_014 DET_RANGE_014 DET_CONFD_ELEVATION_015 DET_CONFD_AZIMUTH_015 DET_HVC_FLAG_015 DET_OUTSIDE_SECTOR_015 DET_EXISTENCE_PROB_015 DET_POINT_TARGET_PROB_015 DET_SNR_015 DET_SUPER_RES_TARGET_015 DET_BI_STATIC_FLAG_015 DET_VALID_FLAG_015 DET_RCS_015 DET_ELEVATION_ERR_015 DET_ELEVATION_015 DET_AZIMUTH_ERR_015 DET_AZIMUTH_015 DET_RANGE_VELOCITY_ERR_015 DET_RANGE_VELOCITY_015 DET_RANGE_ERR_015 DET_RANGE_015 DET_CONFD_ELEVATION_016 DET_CONFD_AZIMUTH_016 DET_HVC_FLAG_016 DET_OUTSIDE_SECTOR_016 DET_EXISTENCE_PROB_016 DET_POINT_TARGET_PROB_016 DET_SNR_016 DET_SUPER_RES_TARGET_016 DET_BI_STATIC_FLAG_016 DET_VALID_FLAG_016 DET_RCS_016 DET_ELEVATION_ERR_016 DET_ELEVATION_016 DET_AZIMUTH_ERR_016 DET_AZIMUTH_016 DET_RANGE_VELOCITY_ERR_016 DET_RANGE_VELOCITY_016 DET_RANGE_ERR_016 DET_RANGE_016;
SIG_GROUP_ 1156 Detections_017_020 1 : DET_MH_CRC16_017_020 DET_MH_CYCLE_COUNTER_017_020 DET_MH_SCAN_INDEX_4LSB_017_020 DET_CONFD_ELEVATION_017 DET_CONFD_AZIMUTH_017 DET_HVC_FLAG_017 DET_OUTSIDE_SECTOR_017 DET_EXISTENCE_PROB_017 DET_POINT_TARGET_PROB_017 DET_SNR_017 DET_SUPER_RES_TARGET_017 DET_BI_STATIC_FLAG_017 DET_VALID_FLAG_017 DET_RCS_017 DET_ELEVATION_ERR_017 DET_ELEVATION_017 DET_AZIMUTH_ERR_017 DET_AZIMUTH_017 DET_RANGE_VELOCITY_ERR_017 DET_RANGE_VELOCITY_017 DET_RANGE_ERR_017 DET_RANGE_017 DET_CONFD_ELEVATION_018 DET_CONFD_AZIMUTH_018 DET_HVC_FLAG_018 DET_OUTSIDE_SECTOR_018 DET_EXISTENCE_PROB_018 DET_POINT_TARGET_PROB_018 DET_SNR_018 DET_SUPER_RES_TARGET_018 DET_BI_STATIC_FLAG_018 DET_VALID_FLAG_018 DET_RCS_018 DET_ELEVATION_ERR_018 DET_ELEVATION_018 DET_AZIMUTH_ERR_018 DET_AZIMUTH_018 DET_RANGE_VELOCITY_ERR_018 DET_RANGE_VELOCITY_018 DET_RANGE_ERR_018 DET_RANGE_018 DET_CONFD_ELEVATION_019 DET_CONFD_AZIMUTH_019 DET_HVC_FLAG_019 DET_OUTSIDE_SECTOR_019 DET_EXISTENCE_PROB_019 DET_POINT_TARGET_PROB_019 DET_SNR_019 DET_SUPER_RES_TARGET_019 DET_BI_STATIC_FLAG_019 DET_VALID_FLAG_019 DET_RCS_019 DET_ELEVATION_ERR_019 DET_ELEVATION_019 DET_AZIMUTH_ERR_019 DET_AZIMUTH_019 DET_RANGE_VELOCITY_ERR_019 DET_RANGE_VELOCITY_019 DET_RANGE_ERR_019 DET_RANGE_019 DET_CONFD_ELEVATION_020 DET_CONFD_AZIMUTH_020 DET_HVC_FLAG_020 DET_OUTSIDE_SECTOR_020 DET_EXISTENCE_PROB_020 DET_POINT_TARGET_PROB_020 DET_SNR_020 DET_SUPER_RES_TARGET_020 DET_BI_STATIC_FLAG_020 DET_VALID_FLAG_020 DET_RCS_020 DET_ELEVATION_ERR_020 DET_ELEVATION_020 DET_AZIMUTH_ERR_020 DET_AZIMUTH_020 DET_RANGE_VELOCITY_ERR_020 DET_RANGE_VELOCITY_020 DET_RANGE_ERR_020 DET_RANGE_020;
SIG_GROUP_ 1157 Detections_021_024 1 : DET_MH_CRC16_021_024 DET_MH_CYCLE_COUNTER_021_024 DET_MH_SCAN_INDEX_4LSB_021_024 DET_CONFD_ELEVATION_021 DET_CONFD_AZIMUTH_021 DET_HVC_FLAG_021 DET_OUTSIDE_SECTOR_021 DET_EXISTENCE_PROB_021 DET_POINT_TARGET_PROB_021 DET_SNR_021 DET_SUPER_RES_TARGET_021 DET_BI_STATIC_FLAG_021 DET_VALID_FLAG_021 DET_RCS_021 DET_ELEVATION_ERR_021 DET_ELEVATION_021 DET_AZIMUTH_ERR_021 DET_AZIMUTH_021 DET_RANGE_VELOCITY_ERR_021 DET_RANGE_VELOCITY_021 DET_RANGE_ERR_021 DET_RANGE_021 DET_CONFD_ELEVATION_022 DET_CONFD_AZIMUTH_022 DET_HVC_FLAG_022 DET_OUTSIDE_SECTOR_022 DET_EXISTENCE_PROB_022 DET_POINT_TARGET_PROB_022 DET_SNR_022 DET_SUPER_RES_TARGET_022 DET_BI_STATIC_FLAG_022 DET_VALID_FLAG_022 DET_RCS_022 DET_ELEVATION_ERR_022 DET_ELEVATION_022 DET_AZIMUTH_ERR_022 DET_AZIMUTH_022 DET_RANGE_VELOCITY_ERR_022 DET_RANGE_VELOCITY_022 DET_RANGE_ERR_022 DET_RANGE_022 DET_CONFD_ELEVATION_023 DET_CONFD_AZIMUTH_023 DET_HVC_FLAG_023 DET_OUTSIDE_SECTOR_023 DET_EXISTENCE_PROB_023 DET_POINT_TARGET_PROB_023 DET_SNR_023 DET_SUPER_RES_TARGET_023 DET_BI_STATIC_FLAG_023 DET_VALID_FLAG_023 DET_RCS_023 DET_ELEVATION_ERR_023 DET_ELEVATION_023 DET_AZIMUTH_ERR_023 DET_AZIMUTH_023 DET_RANGE_VELOCITY_ERR_023 DET_RANGE_VELOCITY_023 DET_RANGE_ERR_023 DET_RANGE_023 DET_CONFD_ELEVATION_024 DET_CONFD_AZIMUTH_024 DET_HVC_FLAG_024 DET_OUTSIDE_SECTOR_024 DET_EXISTENCE_PROB_024 DET_POINT_TARGET_PROB_024 DET_SNR_024 DET_SUPER_RES_TARGET_024 DET_BI_STATIC_FLAG_024 DET_VALID_FLAG_024 DET_RCS_024 DET_ELEVATION_ERR_024 DET_ELEVATION_024 DET_AZIMUTH_ERR_024 DET_AZIMUTH_024 DET_RANGE_VELOCITY_ERR_024 DET_RANGE_VELOCITY_024 DET_RANGE_ERR_024 DET_RANGE_024;
SIG_GROUP_ 1158 Detections_025_028 1 : DET_MH_CRC16_025_028 DET_MH_CYCLE_COUNTER_025_028 DET_MH_SCAN_INDEX_4LSB_025_028 DET_CONFD_ELEVATION_025 DET_CONFD_AZIMUTH_025 DET_HVC_FLAG_025 DET_OUTSIDE_SECTOR_025 DET_EXISTENCE_PROB_025 DET_POINT_TARGET_PROB_025 DET_SNR_025 DET_SUPER_RES_TARGET_025 DET_BI_STATIC_FLAG_025 DET_VALID_FLAG_025 DET_RCS_025 DET_ELEVATION_ERR_025 DET_ELEVATION_025 DET_AZIMUTH_ERR_025 DET_AZIMUTH_025 DET_RANGE_VELOCITY_ERR_025 DET_RANGE_VELOCITY_025 DET_RANGE_ERR_025 DET_RANGE_025 DET_CONFD_ELEVATION_026 DET_CONFD_AZIMUTH_026 DET_HVC_FLAG_026 DET_OUTSIDE_SECTOR_026 DET_EXISTENCE_PROB_026 DET_POINT_TARGET_PROB_026 DET_SNR_026 DET_SUPER_RES_TARGET_026 DET_BI_STATIC_FLAG_026 DET_VALID_FLAG_026 DET_RCS_026 DET_ELEVATION_ERR_026 DET_ELEVATION_026 DET_AZIMUTH_ERR_026 DET_AZIMUTH_026 DET_RANGE_VELOCITY_ERR_026 DET_RANGE_VELOCITY_026 DET_RANGE_ERR_026 DET_RANGE_026 DET_CONFD_ELEVATION_027 DET_CONFD_AZIMUTH_027 DET_HVC_FLAG_027 DET_OUTSIDE_SECTOR_027 DET_EXISTENCE_PROB_027 DET_POINT_TARGET_PROB_027 DET_SNR_027 DET_SUPER_RES_TARGET_027 DET_BI_STATIC_FLAG_027 DET_VALID_FLAG_027 DET_RCS_027 DET_ELEVATION_ERR_027 DET_ELEVATION_027 DET_AZIMUTH_ERR_027 DET_AZIMUTH_027 DET_RANGE_VELOCITY_ERR_027 DET_RANGE_VELOCITY_027 DET_RANGE_ERR_027 DET_RANGE_027 DET_CONFD_ELEVATION_028 DET_CONFD_AZIMUTH_028 DET_HVC_FLAG_028 DET_OUTSIDE_SECTOR_028 DET_EXISTENCE_PROB_028 DET_POINT_TARGET_PROB_028 DET_SNR_028 DET_SUPER_RES_TARGET_028 DET_BI_STATIC_FLAG_028 DET_VALID_FLAG_028 DET_RCS_028 DET_ELEVATION_ERR_028 DET_ELEVATION_028 DET_AZIMUTH_ERR_028 DET_AZIMUTH_028 DET_RANGE_VELOCITY_ERR_028 DET_RANGE_VELOCITY_028 DET_RANGE_ERR_028 DET_RANGE_028;
SIG_GROUP_ 1159 Detections_029_032 1 : DET_MH_CRC16_029_032 DET_MH_CYCLE_COUNTER_029_032 DET_MH_SCAN_INDEX_4LSB_029_032 DET_CONFD_ELEVATION_029 DET_CONFD_AZIMUTH_029 DET_HVC_FLAG_029 DET_OUTSIDE_SECTOR_029 DET_EXISTENCE_PROB_029 DET_POINT_TARGET_PROB_029 DET_SNR_029 DET_SUPER_RES_TARGET_029 DET_BI_STATIC_FLAG_029 DET_VALID_FLAG_029 DET_RCS_029 DET_ELEVATION_ERR_029 DET_ELEVATION_029 DET_AZIMUTH_ERR_029 DET_AZIMUTH_029 DET_RANGE_VELOCITY_ERR_029 DET_RANGE_VELOCITY_029 DET_RANGE_ERR_029 DET_RANGE_029 DET_CONFD_ELEVATION_030 DET_CONFD_AZIMUTH_030 DET_HVC_FLAG_030 DET_OUTSIDE_SECTOR_030 DET_EXISTENCE_PROB_030 DET_POINT_TARGET_PROB_030 DET_SNR_030 DET_SUPER_RES_TARGET_030 DET_BI_STATIC_FLAG_030 DET_VALID_FLAG_030 DET_RCS_030 DET_ELEVATION_ERR_030 DET_ELEVATION_030 DET_AZIMUTH_ERR_030 DET_AZIMUTH_030 DET_RANGE_VELOCITY_ERR_030 DET_RANGE_VELOCITY_030 DET_RANGE_ERR_030 DET_RANGE_030 DET_CONFD_ELEVATION_031 DET_CONFD_AZIMUTH_031 DET_HVC_FLAG_031 DET_OUTSIDE_SECTOR_031 DET_EXISTENCE_PROB_031 DET_POINT_TARGET_PROB_031 DET_SNR_031 DET_SUPER_RES_TARGET_031 DET_BI_STATIC_FLAG_031 DET_VALID_FLAG_031 DET_RCS_031 DET_ELEVATION_ERR_031 DET_ELEVATION_031 DET_AZIMUTH_ERR_031 DET_AZIMUTH_031 DET_RANGE_VELOCITY_ERR_031 DET_RANGE_VELOCITY_031 DET_RANGE_ERR_031 DET_RANGE_031 DET_CONFD_ELEVATION_032 DET_CONFD_AZIMUTH_032 DET_HVC_FLAG_032 DET_OUTSIDE_SECTOR_032 DET_EXISTENCE_PROB_032 DET_POINT_TARGET_PROB_032 DET_SNR_032 DET_SUPER_RES_TARGET_032 DET_BI_STATIC_FLAG_032 DET_VALID_FLAG_032 DET_RCS_032 DET_ELEVATION_ERR_032 DET_ELEVATION_032 DET_AZIMUTH_ERR_032 DET_AZIMUTH_032 DET_RANGE_VELOCITY_ERR_032 DET_RANGE_VELOCITY_032 DET_RANGE_ERR_032 DET_RANGE_032;
SIG_GROUP_ 1160 Detections_033_036 1 : DET_MH_CRC16_033_036 DET_MH_CYCLE_COUNTER_033_036 DET_MH_SCAN_INDEX_4LSB_033_036 DET_CONFD_ELEVATION_033 DET_CONFD_AZIMUTH_033 DET_HVC_FLAG_033 DET_OUTSIDE_SECTOR_033 DET_EXISTENCE_PROB_033 DET_POINT_TARGET_PROB_033 DET_SNR_033 DET_SUPER_RES_TARGET_033 DET_BI_STATIC_FLAG_033 DET_VALID_FLAG_033 DET_RCS_033 DET_ELEVATION_ERR_033 DET_ELEVATION_033 DET_AZIMUTH_ERR_033 DET_AZIMUTH_033 DET_RANGE_VELOCITY_ERR_033 DET_RANGE_VELOCITY_033 DET_RANGE_ERR_033 DET_RANGE_033 DET_CONFD_ELEVATION_034 DET_CONFD_AZIMUTH_034 DET_HVC_FLAG_034 DET_OUTSIDE_SECTOR_034 DET_EXISTENCE_PROB_034 DET_POINT_TARGET_PROB_034 DET_SNR_034 DET_SUPER_RES_TARGET_034 DET_BI_STATIC_FLAG_034 DET_VALID_FLAG_034 DET_RCS_034 DET_ELEVATION_ERR_034 DET_ELEVATION_034 DET_AZIMUTH_ERR_034 DET_AZIMUTH_034 DET_RANGE_VELOCITY_ERR_034 DET_RANGE_VELOCITY_034 DET_RANGE_ERR_034 DET_RANGE_034 DET_CONFD_ELEVATION_035 DET_CONFD_AZIMUTH_035 DET_HVC_FLAG_035 DET_OUTSIDE_SECTOR_035 DET_EXISTENCE_PROB_035 DET_POINT_TARGET_PROB_035 DET_SNR_035 DET_SUPER_RES_TARGET_035 DET_BI_STATIC_FLAG_035 DET_VALID_FLAG_035 DET_RCS_035 DET_ELEVATION_ERR_035 DET_ELEVATION_035 DET_AZIMUTH_ERR_035 DET_AZIMUTH_035 DET_RANGE_VELOCITY_ERR_035 DET_RANGE_VELOCITY_035 DET_RANGE_ERR_035 DET_RANGE_035 DET_CONFD_ELEVATION_036 DET_CONFD_AZIMUTH_036 DET_HVC_FLAG_036 DET_OUTSIDE_SECTOR_036 DET_EXISTENCE_PROB_036 DET_POINT_TARGET_PROB_036 DET_SNR_036 DET_SUPER_RES_TARGET_036 DET_BI_STATIC_FLAG_036 DET_VALID_FLAG_036 DET_RCS_036 DET_ELEVATION_ERR_036 DET_ELEVATION_036 DET_AZIMUTH_ERR_036 DET_AZIMUTH_036 DET_RANGE_VELOCITY_ERR_036 DET_RANGE_VELOCITY_036 DET_RANGE_ERR_036 DET_RANGE_036;
SIG_GROUP_ 1161 Detections_037_040 1 : DET_MH_CRC16_037_040 DET_MH_CYCLE_COUNTER_037_040 DET_MH_SCAN_INDEX_4LSB_037_040 DET_CONFD_ELEVATION_037 DET_CONFD_AZIMUTH_037 DET_HVC_FLAG_037 DET_OUTSIDE_SECTOR_037 DET_EXISTENCE_PROB_037 DET_POINT_TARGET_PROB_037 DET_SNR_037 DET_SUPER_RES_TARGET_037 DET_BI_STATIC_FLAG_037 DET_VALID_FLAG_037 DET_RCS_037 DET_ELEVATION_ERR_037 DET_ELEVATION_037 DET_AZIMUTH_ERR_037 DET_AZIMUTH_037 DET_RANGE_VELOCITY_ERR_037 DET_RANGE_VELOCITY_037 DET_RANGE_ERR_037 DET_RANGE_037 DET_CONFD_ELEVATION_038 DET_CONFD_AZIMUTH_038 DET_HVC_FLAG_038 DET_OUTSIDE_SECTOR_038 DET_EXISTENCE_PROB_038 DET_POINT_TARGET_PROB_038 DET_SNR_038 DET_SUPER_RES_TARGET_038 DET_BI_STATIC_FLAG_038 DET_VALID_FLAG_038 DET_RCS_038 DET_ELEVATION_ERR_038 DET_ELEVATION_038 DET_AZIMUTH_ERR_038 DET_AZIMUTH_038 DET_RANGE_VELOCITY_ERR_038 DET_RANGE_VELOCITY_038 DET_RANGE_ERR_038 DET_RANGE_038 DET_CONFD_ELEVATION_039 DET_CONFD_AZIMUTH_039 DET_HVC_FLAG_039 DET_OUTSIDE_SECTOR_039 DET_EXISTENCE_PROB_039 DET_POINT_TARGET_PROB_039 DET_SNR_039 DET_SUPER_RES_TARGET_039 DET_BI_STATIC_FLAG_039 DET_VALID_FLAG_039 DET_RCS_039 DET_ELEVATION_ERR_039 DET_ELEVATION_039 DET_AZIMUTH_ERR_039 DET_AZIMUTH_039 DET_RANGE_VELOCITY_ERR_039 DET_RANGE_VELOCITY_039 DET_RANGE_ERR_039 DET_RANGE_039 DET_CONFD_ELEVATION_040 DET_CONFD_AZIMUTH_040 DET_HVC_FLAG_040 DET_OUTSIDE_SECTOR_040 DET_EXISTENCE_PROB_040 DET_POINT_TARGET_PROB_040 DET_SNR_040 DET_SUPER_RES_TARGET_040 DET_BI_STATIC_FLAG_040 DET_VALID_FLAG_040 DET_RCS_040 DET_ELEVATION_ERR_040 DET_ELEVATION_040 DET_AZIMUTH_ERR_040 DET_AZIMUTH_040 DET_RANGE_VELOCITY_ERR_040 DET_RANGE_VELOCITY_040 DET_RANGE_ERR_040 DET_RANGE_040;
SIG_GROUP_ 1162 Detections_041_044 1 : DET_MH_CRC16_041_044 DET_MH_CYCLE_COUNTER_041_044 DET_MH_SCAN_INDEX_4LSB_041_044 DET_CONFD_ELEVATION_041 DET_CONFD_AZIMUTH_041 DET_HVC_FLAG_041 DET_OUTSIDE_SECTOR_041 DET_EXISTENCE_PROB_041 DET_POINT_TARGET_PROB_041 DET_SNR_041 DET_SUPER_RES_TARGET_041 DET_BI_STATIC_FLAG_041 DET_VALID_FLAG_041 DET_RCS_041 DET_ELEVATION_ERR_041 DET_ELEVATION_041 DET_AZIMUTH_ERR_041 DET_AZIMUTH_041 DET_RANGE_VELOCITY_ERR_041 DET_RANGE_VELOCITY_041 DET_RANGE_ERR_041 DET_RANGE_041 DET_CONFD_ELEVATION_042 DET_CONFD_AZIMUTH_042 DET_HVC_FLAG_042 DET_OUTSIDE_SECTOR_042 DET_EXISTENCE_PROB_042 DET_POINT_TARGET_PROB_042 DET_SNR_042 DET_SUPER_RES_TARGET_042 DET_BI_STATIC_FLAG_042 DET_VALID_FLAG_042 DET_RCS_042 DET_ELEVATION_ERR_042 DET_ELEVATION_042 DET_AZIMUTH_ERR_042 DET_AZIMUTH_042 DET_RANGE_VELOCITY_ERR_042 DET_RANGE_VELOCITY_042 DET_RANGE_ERR_042 DET_RANGE_042 DET_CONFD_ELEVATION_043 DET_CONFD_AZIMUTH_043 DET_HVC_FLAG_043 DET_OUTSIDE_SECTOR_043 DET_EXISTENCE_PROB_043 DET_POINT_TARGET_PROB_043 DET_SNR_043 DET_SUPER_RES_TARGET_043 DET_BI_STATIC_FLAG_043 DET_VALID_FLAG_043 DET_RCS_043 DET_ELEVATION_ERR_043 DET_ELEVATION_043 DET_AZIMUTH_ERR_043 DET_AZIMUTH_043 DET_RANGE_VELOCITY_ERR_043 DET_RANGE_VELOCITY_043 DET_RANGE_ERR_043 DET_RANGE_043 DET_CONFD_ELEVATION_044 DET_CONFD_AZIMUTH_044 DET_HVC_FLAG_044 DET_OUTSIDE_SECTOR_044 DET_EXISTENCE_PROB_044 DET_POINT_TARGET_PROB_044 DET_SNR_044 DET_SUPER_RES_TARGET_044 DET_BI_STATIC_FLAG_044 DET_VALID_FLAG_044 DET_RCS_044 DET_ELEVATION_ERR_044 DET_ELEVATION_044 DET_AZIMUTH_ERR_044 DET_AZIMUTH_044 DET_RANGE_VELOCITY_ERR_044 DET_RANGE_VELOCITY_044 DET_RANGE_ERR_044 DET_RANGE_044;

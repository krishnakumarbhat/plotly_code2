VERSION "created by canmatrix"

NS_ :

BS_:

BU_: External_Tool ADAS RDR07

BO_ 1071 RDR_DETECTION_189_192: 64 RDR07
 SG_ DET_RANGE_189 : 24|15@1+ (0.015625,0) [0|500] "m"  ADAS
 SG_ DET_RANGE_ERR_189 : 40|7@1+ (0.0075,0) [0|0.9525] "m"  ADAS
 SG_ DET_RANGE_VELOCITY_189 : 48|15@1+ (0.0078125,-128) [-128|127.9921875] "m/s"  ADAS
 SG_ DET_RANGE_VELOCITY_ERR_189 : 64|8@1+ (0.003,0) [0|0.765] "m/s"  ADAS
 SG_ DET_AZIMUTH_189 : 88|13@1+ (0.0004,-1.5708) [-1.5708|1.5708] "rad"  ADAS
 SG_ DET_AZIMUTH_ERR_189 : 105|7@1+ (0.00087267,0) [0|0.11082909] "rad"  ADAS
 SG_ DET_ELEVATION_189 : 72|8@1+ (0.00275,-0.34925) [-0.34925|0.34925] "rad"  ADAS
 SG_ DET_ELEVATION_ERR_189 : 80|6@1+ (0.00174533,0) [0|0.10995579] "rad"  ADAS
 SG_ DET_RCS_189 : 136|8@1+ (0.5,-64) [-64|63.5] "dBsm"  ADAS
 SG_ DET_VALID_FLAG_189 : 119|1@1+ (1,0) [0|1] ""  ADAS
 SG_ DET_BI_STATIC_FLAG_189 : 504|1@1+ (1,0) [0|1] ""  ADAS
 SG_ DET_SUPER_RES_TARGET_189 : 104|1@1+ (1,0) [0|1] ""  ADAS
 SG_ DET_SNR_189 : 128|8@1+ (0.35156,0) [0|89.6478] "dB"  ADAS
 SG_ DET_POINT_TARGET_PROB_189 : 114|4@1+ (6.67,0) [0|100] "%"  ADAS
 SG_ DET_EXISTENCE_PROB_189 : 120|6@1+ (1.588,0) [0|100] "%"  ADAS
 SG_ DET_OUTSIDE_SECTOR_189 : 159|1@1+ (1,0) [0|1] ""  ADAS
 SG_ DET_HVC_FLAG_189 : 118|1@1+ (1,0) [0|1] ""  ADAS
 SG_ DET_CONFD_AZIMUTH_189 : 126|2@1+ (1,0) [0|3] ""  ADAS
 SG_ DET_CONFD_ELEVATION_189 : 112|2@1+ (1,0) [0|3] ""  ADAS
 SG_ DET_RANGE_190 : 144|15@1+ (0.015625,0) [0|500] "m"  ADAS
 SG_ DET_RANGE_ERR_190 : 160|7@1+ (0.0075,0) [0|0.9525] "m"  ADAS
 SG_ DET_RANGE_VELOCITY_190 : 168|15@1+ (0.0078125,-128) [-128|127.9921875] "m/s"  ADAS
 SG_ DET_RANGE_VELOCITY_ERR_190 : 184|8@1+ (0.003,0) [0|0.765] "m/s"  ADAS
 SG_ DET_AZIMUTH_190 : 208|13@1+ (0.0004,-1.5708) [-1.5708|1.5708] "rad"  ADAS
 SG_ DET_AZIMUTH_ERR_190 : 224|7@1+ (0.00087267,0) [0|0.11082909] "rad"  ADAS
 SG_ DET_ELEVATION_190 : 192|8@1+ (0.00275,-0.34925) [-0.34925|0.34925] "rad"  ADAS
 SG_ DET_ELEVATION_ERR_190 : 200|6@1+ (0.00174533,0) [0|0.10995579] "rad"  ADAS
 SG_ DET_RCS_190 : 256|8@1+ (0.5,-64) [-64|63.5] "dBsm"  ADAS
 SG_ DET_VALID_FLAG_190 : 167|1@1+ (1,0) [0|1] ""  ADAS
 SG_ DET_BI_STATIC_FLAG_190 : 505|1@1+ (1,0) [0|1] ""  ADAS
 SG_ DET_SUPER_RES_TARGET_190 : 247|1@1+ (1,0) [0|1] ""  ADAS
 SG_ DET_SNR_190 : 248|8@1+ (0.35156,0) [0|89.6478] "dB"  ADAS
 SG_ DET_POINT_TARGET_PROB_190 : 240|4@1+ (6.67,0) [0|100] "%"  ADAS
 SG_ DET_EXISTENCE_PROB_190 : 232|6@1+ (1.588,0) [0|100] "%"  ADAS
 SG_ DET_OUTSIDE_SECTOR_190 : 183|1@1+ (1,0) [0|1] ""  ADAS
 SG_ DET_HVC_FLAG_190 : 246|1@1+ (1,0) [0|1] ""  ADAS
 SG_ DET_CONFD_AZIMUTH_190 : 206|2@1+ (1,0) [0|3] ""  ADAS
 SG_ DET_CONFD_ELEVATION_190 : 244|2@1+ (1,0) [0|3] ""  ADAS
 SG_ DET_RANGE_191 : 264|15@1+ (0.015625,0) [0|500] "m"  ADAS
 SG_ DET_RANGE_ERR_191 : 280|7@1+ (0.0075,0) [0|0.9525] "m"  ADAS
 SG_ DET_RANGE_VELOCITY_191 : 288|15@1+ (0.0078125,-128) [-128|127.9921875] "m/s"  ADAS
 SG_ DET_RANGE_VELOCITY_ERR_191 : 304|8@1+ (0.003,0) [0|0.765] "m/s"  ADAS
 SG_ DET_AZIMUTH_191 : 328|13@1+ (0.0004,-1.5708) [-1.5708|1.5708] "rad"  ADAS
 SG_ DET_AZIMUTH_ERR_191 : 345|7@1+ (0.00087267,0) [0|0.11082909] "rad"  ADAS
 SG_ DET_ELEVATION_191 : 312|8@1+ (0.00275,-0.34925) [-0.34925|0.34925] "rad"  ADAS
 SG_ DET_ELEVATION_ERR_191 : 320|6@1+ (0.00174533,0) [0|0.10995579] "rad"  ADAS
 SG_ DET_RCS_191 : 376|8@1+ (0.5,-64) [-64|63.5] "dBsm"  ADAS
 SG_ DET_VALID_FLAG_191 : 399|1@1+ (1,0) [0|1] ""  ADAS
 SG_ DET_BI_STATIC_FLAG_191 : 482|1@1+ (1,0) [0|1] ""  ADAS
 SG_ DET_SUPER_RES_TARGET_191 : 344|1@1+ (1,0) [0|1] ""  ADAS
 SG_ DET_SNR_191 : 368|8@1+ (0.35156,0) [0|89.6478] "dB"  ADAS
 SG_ DET_POINT_TARGET_PROB_191 : 360|4@1+ (6.67,0) [0|100] "%"  ADAS
 SG_ DET_EXISTENCE_PROB_191 : 352|6@1+ (1.588,0) [0|100] "%"  ADAS
 SG_ DET_OUTSIDE_SECTOR_191 : 407|1@1+ (1,0) [0|1] ""  ADAS
 SG_ DET_HVC_FLAG_191 : 364|1@1+ (1,0) [0|1] ""  ADAS
 SG_ DET_CONFD_AZIMUTH_191 : 365|2@1+ (1,0) [0|3] ""  ADAS
 SG_ DET_CONFD_ELEVATION_191 : 358|2@1+ (1,0) [0|3] ""  ADAS
 SG_ DET_RANGE_192 : 384|15@1+ (0.015625,0) [0|500] "m"  ADAS
 SG_ DET_RANGE_ERR_192 : 400|7@1+ (0.0075,0) [0|0.9525] "m"  ADAS
 SG_ DET_RANGE_VELOCITY_192 : 408|15@1+ (0.0078125,-128) [-128|127.9921875] "m/s"  ADAS
 SG_ DET_RANGE_VELOCITY_ERR_192 : 424|8@1+ (0.003,0) [0|0.765] "m/s"  ADAS
 SG_ DET_AZIMUTH_192 : 448|13@1+ (0.0004,-1.5708) [-1.5708|1.5708] "rad"  ADAS
 SG_ DET_AZIMUTH_ERR_192 : 465|7@1+ (0.00087267,0) [0|0.11082909] "rad"  ADAS
 SG_ DET_ELEVATION_192 : 432|8@1+ (0.00275,-0.34925) [-0.34925|0.34925] "rad"  ADAS
 SG_ DET_ELEVATION_ERR_192 : 440|6@1+ (0.00174533,0) [0|0.10995579] "rad"  ADAS
 SG_ DET_RCS_192 : 496|8@1+ (0.5,-64) [-64|63.5] "dBsm"  ADAS
 SG_ DET_VALID_FLAG_192 : 485|1@1+ (1,0) [0|1] ""  ADAS
 SG_ DET_BI_STATIC_FLAG_192 : 483|1@1+ (1,0) [0|1] ""  ADAS
 SG_ DET_SUPER_RES_TARGET_192 : 446|1@1+ (1,0) [0|1] ""  ADAS
 SG_ DET_SNR_192 : 488|8@1+ (0.35156,0) [0|89.6478] "dB"  ADAS
 SG_ DET_POINT_TARGET_PROB_192 : 472|4@1+ (6.67,0) [0|100] "%"  ADAS
 SG_ DET_EXISTENCE_PROB_192 : 506|6@1+ (1.588,0) [0|100] "%"  ADAS
 SG_ DET_OUTSIDE_SECTOR_192 : 481|1@1+ (1,0) [0|1] ""  ADAS
 SG_ DET_HVC_FLAG_192 : 464|1@1+ (1,0) [0|1] ""  ADAS
 SG_ DET_CONFD_AZIMUTH_192 : 486|2@1+ (1,0) [0|3] ""  ADAS
 SG_ DET_CONFD_ELEVATION_192 : 461|2@1+ (1,0) [0|3] ""  ADAS
 SG_ DET_MH_SCAN_INDEX_4LSB_189_192 : 476|4@1+ (1,0) [0|15] ""  ADAS
 SG_ DET_MH_CYCLE_COUNTER_189_192 : 16|8@1+ (1,0) [0|255] ""  ADAS
 SG_ DET_MH_CRC16_189_192 : 0|16@1+ (1,0) [0|65535] ""  ADAS

BO_ 1072 RDR_DETECTION_193_196: 64 RDR07
 SG_ DET_RANGE_193 : 24|15@1+ (0.015625,0) [0|500] "m"  ADAS
 SG_ DET_RANGE_ERR_193 : 40|7@1+ (0.0075,0) [0|0.9525] "m"  ADAS
 SG_ DET_RANGE_VELOCITY_193 : 48|15@1+ (0.0078125,-128) [-128|127.9921875] "m/s"  ADAS
 SG_ DET_RANGE_VELOCITY_ERR_193 : 64|8@1+ (0.003,0) [0|0.765] "m/s"  ADAS
 SG_ DET_AZIMUTH_193 : 88|13@1+ (0.0004,-1.5708) [-1.5708|1.5708] "rad"  ADAS
 SG_ DET_AZIMUTH_ERR_193 : 105|7@1+ (0.00087267,0) [0|0.11082909] "rad"  ADAS
 SG_ DET_ELEVATION_193 : 72|8@1+ (0.00275,-0.34925) [-0.34925|0.34925] "rad"  ADAS
 SG_ DET_ELEVATION_ERR_193 : 80|6@1+ (0.00174533,0) [0|0.10995579] "rad"  ADAS
 SG_ DET_RCS_193 : 136|8@1+ (0.5,-64) [-64|63.5] "dBsm"  ADAS
 SG_ DET_VALID_FLAG_193 : 119|1@1+ (1,0) [0|1] ""  ADAS
 SG_ DET_BI_STATIC_FLAG_193 : 504|1@1+ (1,0) [0|1] ""  ADAS
 SG_ DET_SUPER_RES_TARGET_193 : 104|1@1+ (1,0) [0|1] ""  ADAS
 SG_ DET_SNR_193 : 128|8@1+ (0.35156,0) [0|89.6478] "dB"  ADAS
 SG_ DET_POINT_TARGET_PROB_193 : 114|4@1+ (6.67,0) [0|100] "%"  ADAS
 SG_ DET_EXISTENCE_PROB_193 : 120|6@1+ (1.588,0) [0|100] "%"  ADAS
 SG_ DET_OUTSIDE_SECTOR_193 : 159|1@1+ (1,0) [0|1] ""  ADAS
 SG_ DET_HVC_FLAG_193 : 118|1@1+ (1,0) [0|1] ""  ADAS
 SG_ DET_CONFD_AZIMUTH_193 : 126|2@1+ (1,0) [0|3] ""  ADAS
 SG_ DET_CONFD_ELEVATION_193 : 112|2@1+ (1,0) [0|3] ""  ADAS
 SG_ DET_RANGE_194 : 144|15@1+ (0.015625,0) [0|500] "m"  ADAS
 SG_ DET_RANGE_ERR_194 : 160|7@1+ (0.0075,0) [0|0.9525] "m"  ADAS
 SG_ DET_RANGE_VELOCITY_194 : 168|15@1+ (0.0078125,-128) [-128|127.9921875] "m/s"  ADAS
 SG_ DET_RANGE_VELOCITY_ERR_194 : 184|8@1+ (0.003,0) [0|0.765] "m/s"  ADAS
 SG_ DET_AZIMUTH_194 : 208|13@1+ (0.0004,-1.5708) [-1.5708|1.5708] "rad"  ADAS
 SG_ DET_AZIMUTH_ERR_194 : 224|7@1+ (0.00087267,0) [0|0.11082909] "rad"  ADAS
 SG_ DET_ELEVATION_194 : 192|8@1+ (0.00275,-0.34925) [-0.34925|0.34925] "rad"  ADAS
 SG_ DET_ELEVATION_ERR_194 : 200|6@1+ (0.00174533,0) [0|0.10995579] "rad"  ADAS
 SG_ DET_RCS_194 : 256|8@1+ (0.5,-64) [-64|63.5] "dBsm"  ADAS
 SG_ DET_VALID_FLAG_194 : 167|1@1+ (1,0) [0|1] ""  ADAS
 SG_ DET_BI_STATIC_FLAG_194 : 505|1@1+ (1,0) [0|1] ""  ADAS
 SG_ DET_SUPER_RES_TARGET_194 : 247|1@1+ (1,0) [0|1] ""  ADAS
 SG_ DET_SNR_194 : 248|8@1+ (0.35156,0) [0|89.6478] "dB"  ADAS
 SG_ DET_POINT_TARGET_PROB_194 : 240|4@1+ (6.67,0) [0|100] "%"  ADAS
 SG_ DET_EXISTENCE_PROB_194 : 232|6@1+ (1.588,0) [0|100] "%"  ADAS
 SG_ DET_OUTSIDE_SECTOR_194 : 183|1@1+ (1,0) [0|1] ""  ADAS
 SG_ DET_HVC_FLAG_194 : 246|1@1+ (1,0) [0|1] ""  ADAS
 SG_ DET_CONFD_AZIMUTH_194 : 206|2@1+ (1,0) [0|3] ""  ADAS
 SG_ DET_CONFD_ELEVATION_194 : 244|2@1+ (1,0) [0|3] ""  ADAS
 SG_ DET_RANGE_195 : 264|15@1+ (0.015625,0) [0|500] "m"  ADAS
 SG_ DET_RANGE_ERR_195 : 280|7@1+ (0.0075,0) [0|0.9525] "m"  ADAS
 SG_ DET_RANGE_VELOCITY_195 : 288|15@1+ (0.0078125,-128) [-128|127.9921875] "m/s"  ADAS
 SG_ DET_RANGE_VELOCITY_ERR_195 : 304|8@1+ (0.003,0) [0|0.765] "m/s"  ADAS
 SG_ DET_AZIMUTH_195 : 328|13@1+ (0.0004,-1.5708) [-1.5708|1.5708] "rad"  ADAS
 SG_ DET_AZIMUTH_ERR_195 : 345|7@1+ (0.00087267,0) [0|0.11082909] "rad"  ADAS
 SG_ DET_ELEVATION_195 : 312|8@1+ (0.00275,-0.34925) [-0.34925|0.34925] "rad"  ADAS
 SG_ DET_ELEVATION_ERR_195 : 320|6@1+ (0.00174533,0) [0|0.10995579] "rad"  ADAS
 SG_ DET_RCS_195 : 376|8@1+ (0.5,-64) [-64|63.5] "dBsm"  ADAS
 SG_ DET_VALID_FLAG_195 : 399|1@1+ (1,0) [0|1] ""  ADAS
 SG_ DET_BI_STATIC_FLAG_195 : 482|1@1+ (1,0) [0|1] ""  ADAS
 SG_ DET_SUPER_RES_TARGET_195 : 344|1@1+ (1,0) [0|1] ""  ADAS
 SG_ DET_SNR_195 : 368|8@1+ (0.35156,0) [0|89.6478] "dB"  ADAS
 SG_ DET_POINT_TARGET_PROB_195 : 360|4@1+ (6.67,0) [0|100] "%"  ADAS
 SG_ DET_EXISTENCE_PROB_195 : 352|6@1+ (1.588,0) [0|100] "%"  ADAS
 SG_ DET_OUTSIDE_SECTOR_195 : 407|1@1+ (1,0) [0|1] ""  ADAS
 SG_ DET_HVC_FLAG_195 : 364|1@1+ (1,0) [0|1] ""  ADAS
 SG_ DET_CONFD_AZIMUTH_195 : 365|2@1+ (1,0) [0|3] ""  ADAS
 SG_ DET_CONFD_ELEVATION_195 : 358|2@1+ (1,0) [0|3] ""  ADAS
 SG_ DET_RANGE_196 : 384|15@1+ (0.015625,0) [0|500] "m"  ADAS
 SG_ DET_RANGE_ERR_196 : 400|7@1+ (0.0075,0) [0|0.9525] "m"  ADAS
 SG_ DET_RANGE_VELOCITY_196 : 408|15@1+ (0.0078125,-128) [-128|127.9921875] "m/s"  ADAS
 SG_ DET_RANGE_VELOCITY_ERR_196 : 424|8@1+ (0.003,0) [0|0.765] "m/s"  ADAS
 SG_ DET_AZIMUTH_196 : 448|13@1+ (0.0004,-1.5708) [-1.5708|1.5708] "rad"  ADAS
 SG_ DET_AZIMUTH_ERR_196 : 465|7@1+ (0.00087267,0) [0|0.11082909] "rad"  ADAS
 SG_ DET_ELEVATION_196 : 432|8@1+ (0.00275,-0.34925) [-0.34925|0.34925] "rad"  ADAS
 SG_ DET_ELEVATION_ERR_196 : 440|6@1+ (0.00174533,0) [0|0.10995579] "rad"  ADAS
 SG_ DET_RCS_196 : 496|8@1+ (0.5,-64) [-64|63.5] "dBsm"  ADAS
 SG_ DET_VALID_FLAG_196 : 485|1@1+ (1,0) [0|1] ""  ADAS
 SG_ DET_BI_STATIC_FLAG_196 : 483|1@1+ (1,0) [0|1] ""  ADAS
 SG_ DET_SUPER_RES_TARGET_196 : 446|1@1+ (1,0) [0|1] ""  ADAS
 SG_ DET_SNR_196 : 488|8@1+ (0.35156,0) [0|89.6478] "dB"  ADAS
 SG_ DET_POINT_TARGET_PROB_196 : 472|4@1+ (6.67,0) [0|100] "%"  ADAS
 SG_ DET_EXISTENCE_PROB_196 : 506|6@1+ (1.588,0) [0|100] "%"  ADAS
 SG_ DET_OUTSIDE_SECTOR_196 : 481|1@1+ (1,0) [0|1] ""  ADAS
 SG_ DET_HVC_FLAG_196 : 464|1@1+ (1,0) [0|1] ""  ADAS
 SG_ DET_CONFD_AZIMUTH_196 : 486|2@1+ (1,0) [0|3] ""  ADAS
 SG_ DET_CONFD_ELEVATION_196 : 461|2@1+ (1,0) [0|3] ""  ADAS
 SG_ DET_MH_SCAN_INDEX_4LSB_193_196 : 476|4@1+ (1,0) [0|15] ""  ADAS
 SG_ DET_MH_CYCLE_COUNTER_193_196 : 16|8@1+ (1,0) [0|255] ""  ADAS
 SG_ DET_MH_CRC16_193_196 : 0|16@1+ (1,0) [0|65535] ""  ADAS

BO_ 1073 RDR_DETECTION_197_200: 64 RDR07
 SG_ DET_RANGE_197 : 24|15@1+ (0.015625,0) [0|500] "m"  ADAS
 SG_ DET_RANGE_ERR_197 : 40|7@1+ (0.0075,0) [0|0.9525] "m"  ADAS
 SG_ DET_RANGE_VELOCITY_197 : 48|15@1+ (0.0078125,-128) [-128|127.9921875] "m/s"  ADAS
 SG_ DET_RANGE_VELOCITY_ERR_197 : 64|8@1+ (0.003,0) [0|0.765] "m/s"  ADAS
 SG_ DET_AZIMUTH_197 : 88|13@1+ (0.0004,-1.5708) [-1.5708|1.5708] "rad"  ADAS
 SG_ DET_AZIMUTH_ERR_197 : 105|7@1+ (0.00087267,0) [0|0.11082909] "rad"  ADAS
 SG_ DET_ELEVATION_197 : 72|8@1+ (0.00275,-0.34925) [-0.34925|0.34925] "rad"  ADAS
 SG_ DET_ELEVATION_ERR_197 : 80|6@1+ (0.00174533,0) [0|0.10995579] "rad"  ADAS
 SG_ DET_RCS_197 : 136|8@1+ (0.5,-64) [-64|63.5] "dBsm"  ADAS
 SG_ DET_VALID_FLAG_197 : 119|1@1+ (1,0) [0|1] ""  ADAS
 SG_ DET_BI_STATIC_FLAG_197 : 504|1@1+ (1,0) [0|1] ""  ADAS
 SG_ DET_SUPER_RES_TARGET_197 : 104|1@1+ (1,0) [0|1] ""  ADAS
 SG_ DET_SNR_197 : 128|8@1+ (0.35156,0) [0|89.6478] "dB"  ADAS
 SG_ DET_POINT_TARGET_PROB_197 : 114|4@1+ (6.67,0) [0|100] "%"  ADAS
 SG_ DET_EXISTENCE_PROB_197 : 120|6@1+ (1.588,0) [0|100] "%"  ADAS
 SG_ DET_OUTSIDE_SECTOR_197 : 159|1@1+ (1,0) [0|1] ""  ADAS
 SG_ DET_HVC_FLAG_197 : 118|1@1+ (1,0) [0|1] ""  ADAS
 SG_ DET_CONFD_AZIMUTH_197 : 126|2@1+ (1,0) [0|3] ""  ADAS
 SG_ DET_CONFD_ELEVATION_197 : 112|2@1+ (1,0) [0|3] ""  ADAS
 SG_ DET_RANGE_198 : 144|15@1+ (0.015625,0) [0|500] "m"  ADAS
 SG_ DET_RANGE_ERR_198 : 160|7@1+ (0.0075,0) [0|0.9525] "m"  ADAS
 SG_ DET_RANGE_VELOCITY_198 : 168|15@1+ (0.0078125,-128) [-128|127.9921875] "m/s"  ADAS
 SG_ DET_RANGE_VELOCITY_ERR_198 : 184|8@1+ (0.003,0) [0|0.765] "m/s"  ADAS
 SG_ DET_AZIMUTH_198 : 208|13@1+ (0.0004,-1.5708) [-1.5708|1.5708] "rad"  ADAS
 SG_ DET_AZIMUTH_ERR_198 : 224|7@1+ (0.00087267,0) [0|0.11082909] "rad"  ADAS
 SG_ DET_ELEVATION_198 : 192|8@1+ (0.00275,-0.34925) [-0.34925|0.34925] "rad"  ADAS
 SG_ DET_ELEVATION_ERR_198 : 200|6@1+ (0.00174533,0) [0|0.10995579] "rad"  ADAS
 SG_ DET_RCS_198 : 256|8@1+ (0.5,-64) [-64|63.5] "dBsm"  ADAS
 SG_ DET_VALID_FLAG_198 : 167|1@1+ (1,0) [0|1] ""  ADAS
 SG_ DET_BI_STATIC_FLAG_198 : 505|1@1+ (1,0) [0|1] ""  ADAS
 SG_ DET_SUPER_RES_TARGET_198 : 247|1@1+ (1,0) [0|1] ""  ADAS
 SG_ DET_SNR_198 : 248|8@1+ (0.35156,0) [0|89.6478] "dB"  ADAS
 SG_ DET_POINT_TARGET_PROB_198 : 240|4@1+ (6.67,0) [0|100] "%"  ADAS
 SG_ DET_EXISTENCE_PROB_198 : 232|6@1+ (1.588,0) [0|100] "%"  ADAS
 SG_ DET_OUTSIDE_SECTOR_198 : 183|1@1+ (1,0) [0|1] ""  ADAS
 SG_ DET_HVC_FLAG_198 : 246|1@1+ (1,0) [0|1] ""  ADAS
 SG_ DET_CONFD_AZIMUTH_198 : 206|2@1+ (1,0) [0|3] ""  ADAS
 SG_ DET_CONFD_ELEVATION_198 : 244|2@1+ (1,0) [0|3] ""  ADAS
 SG_ DET_RANGE_199 : 264|15@1+ (0.015625,0) [0|500] "m"  ADAS
 SG_ DET_RANGE_ERR_199 : 280|7@1+ (0.0075,0) [0|0.9525] "m"  ADAS
 SG_ DET_RANGE_VELOCITY_199 : 288|15@1+ (0.0078125,-128) [-128|127.9921875] "m/s"  ADAS
 SG_ DET_RANGE_VELOCITY_ERR_199 : 304|8@1+ (0.003,0) [0|0.765] "m/s"  ADAS
 SG_ DET_AZIMUTH_199 : 328|13@1+ (0.0004,-1.5708) [-1.5708|1.5708] "rad"  ADAS
 SG_ DET_AZIMUTH_ERR_199 : 345|7@1+ (0.00087267,0) [0|0.11082909] "rad"  ADAS
 SG_ DET_ELEVATION_199 : 312|8@1+ (0.00275,-0.34925) [-0.34925|0.34925] "rad"  ADAS
 SG_ DET_ELEVATION_ERR_199 : 320|6@1+ (0.00174533,0) [0|0.10995579] "rad"  ADAS
 SG_ DET_RCS_199 : 376|8@1+ (0.5,-64) [-64|63.5] "dBsm"  ADAS
 SG_ DET_VALID_FLAG_199 : 399|1@1+ (1,0) [0|1] ""  ADAS
 SG_ DET_BI_STATIC_FLAG_199 : 482|1@1+ (1,0) [0|1] ""  ADAS
 SG_ DET_SUPER_RES_TARGET_199 : 344|1@1+ (1,0) [0|1] ""  ADAS
 SG_ DET_SNR_199 : 368|8@1+ (0.35156,0) [0|89.6478] "dB"  ADAS
 SG_ DET_POINT_TARGET_PROB_199 : 360|4@1+ (6.67,0) [0|100] "%"  ADAS
 SG_ DET_EXISTENCE_PROB_199 : 352|6@1+ (1.588,0) [0|100] "%"  ADAS
 SG_ DET_OUTSIDE_SECTOR_199 : 407|1@1+ (1,0) [0|1] ""  ADAS
 SG_ DET_HVC_FLAG_199 : 364|1@1+ (1,0) [0|1] ""  ADAS
 SG_ DET_CONFD_AZIMUTH_199 : 365|2@1+ (1,0) [0|3] ""  ADAS
 SG_ DET_CONFD_ELEVATION_199 : 358|2@1+ (1,0) [0|3] ""  ADAS
 SG_ DET_RANGE_200 : 384|15@1+ (0.015625,0) [0|500] "m"  ADAS
 SG_ DET_RANGE_ERR_200 : 400|7@1+ (0.0075,0) [0|0.9525] "m"  ADAS
 SG_ DET_RANGE_VELOCITY_200 : 408|15@1+ (0.0078125,-128) [-128|127.9921875] "m/s"  ADAS
 SG_ DET_RANGE_VELOCITY_ERR_200 : 424|8@1+ (0.003,0) [0|0.765] "m/s"  ADAS
 SG_ DET_AZIMUTH_200 : 448|13@1+ (0.0004,-1.5708) [-1.5708|1.5708] "rad"  ADAS
 SG_ DET_AZIMUTH_ERR_200 : 465|7@1+ (0.00087267,0) [0|0.11082909] "rad"  ADAS
 SG_ DET_ELEVATION_200 : 432|8@1+ (0.00275,-0.34925) [-0.34925|0.34925] "rad"  ADAS
 SG_ DET_ELEVATION_ERR_200 : 440|6@1+ (0.00174533,0) [0|0.10995579] "rad"  ADAS
 SG_ DET_RCS_200 : 496|8@1+ (0.5,-64) [-64|63.5] "dBsm"  ADAS
 SG_ DET_VALID_FLAG_200 : 485|1@1+ (1,0) [0|1] ""  ADAS
 SG_ DET_BI_STATIC_FLAG_200 : 483|1@1+ (1,0) [0|1] ""  ADAS
 SG_ DET_SUPER_RES_TARGET_200 : 446|1@1+ (1,0) [0|1] ""  ADAS
 SG_ DET_SNR_200 : 488|8@1+ (0.35156,0) [0|89.6478] "dB"  ADAS
 SG_ DET_POINT_TARGET_PROB_200 : 472|4@1+ (6.67,0) [0|100] "%"  ADAS
 SG_ DET_EXISTENCE_PROB_200 : 506|6@1+ (1.588,0) [0|100] "%"  ADAS
 SG_ DET_OUTSIDE_SECTOR_200 : 481|1@1+ (1,0) [0|1] ""  ADAS
 SG_ DET_HVC_FLAG_200 : 464|1@1+ (1,0) [0|1] ""  ADAS
 SG_ DET_CONFD_AZIMUTH_200 : 486|2@1+ (1,0) [0|3] ""  ADAS
 SG_ DET_CONFD_ELEVATION_200 : 461|2@1+ (1,0) [0|3] ""  ADAS
 SG_ DET_MH_SCAN_INDEX_4LSB_197_200 : 476|4@1+ (1,0) [0|15] ""  ADAS
 SG_ DET_MH_CYCLE_COUNTER_197_200 : 16|8@1+ (1,0) [0|255] ""  ADAS
 SG_ DET_MH_CRC16_197_200 : 0|16@1+ (1,0) [0|65535] ""  ADAS

BO_ 1074 RDR_DETECTION_201_204: 64 RDR07
 SG_ DET_RANGE_201 : 24|15@1+ (0.015625,0) [0|500] "m"  ADAS
 SG_ DET_RANGE_ERR_201 : 40|7@1+ (0.0075,0) [0|0.9525] "m"  ADAS
 SG_ DET_RANGE_VELOCITY_201 : 48|15@1+ (0.0078125,-128) [-128|127.9921875] "m/s"  ADAS
 SG_ DET_RANGE_VELOCITY_ERR_201 : 64|8@1+ (0.003,0) [0|0.765] "m/s"  ADAS
 SG_ DET_AZIMUTH_201 : 88|13@1+ (0.0004,-1.5708) [-1.5708|1.5708] "rad"  ADAS
 SG_ DET_AZIMUTH_ERR_201 : 105|7@1+ (0.00087267,0) [0|0.11082909] "rad"  ADAS
 SG_ DET_ELEVATION_201 : 72|8@1+ (0.00275,-0.34925) [-0.34925|0.34925] "rad"  ADAS
 SG_ DET_ELEVATION_ERR_201 : 80|6@1+ (0.00174533,0) [0|0.10995579] "rad"  ADAS
 SG_ DET_RCS_201 : 136|8@1+ (0.5,-64) [-64|63.5] "dBsm"  ADAS
 SG_ DET_VALID_FLAG_201 : 119|1@1+ (1,0) [0|1] ""  ADAS
 SG_ DET_BI_STATIC_FLAG_201 : 504|1@1+ (1,0) [0|1] ""  ADAS
 SG_ DET_SUPER_RES_TARGET_201 : 104|1@1+ (1,0) [0|1] ""  ADAS
 SG_ DET_SNR_201 : 128|8@1+ (0.35156,0) [0|89.6478] "dB"  ADAS
 SG_ DET_POINT_TARGET_PROB_201 : 114|4@1+ (6.67,0) [0|100] "%"  ADAS
 SG_ DET_EXISTENCE_PROB_201 : 120|6@1+ (1.588,0) [0|100] "%"  ADAS
 SG_ DET_OUTSIDE_SECTOR_201 : 159|1@1+ (1,0) [0|1] ""  ADAS
 SG_ DET_HVC_FLAG_201 : 118|1@1+ (1,0) [0|1] ""  ADAS
 SG_ DET_CONFD_AZIMUTH_201 : 126|2@1+ (1,0) [0|3] ""  ADAS
 SG_ DET_CONFD_ELEVATION_201 : 112|2@1+ (1,0) [0|3] ""  ADAS
 SG_ DET_RANGE_202 : 144|15@1+ (0.015625,0) [0|500] "m"  ADAS
 SG_ DET_RANGE_ERR_202 : 160|7@1+ (0.0075,0) [0|0.9525] "m"  ADAS
 SG_ DET_RANGE_VELOCITY_202 : 168|15@1+ (0.0078125,-128) [-128|127.9921875] "m/s"  ADAS
 SG_ DET_RANGE_VELOCITY_ERR_202 : 184|8@1+ (0.003,0) [0|0.765] "m/s"  ADAS
 SG_ DET_AZIMUTH_202 : 208|13@1+ (0.0004,-1.5708) [-1.5708|1.5708] "rad"  ADAS
 SG_ DET_AZIMUTH_ERR_202 : 224|7@1+ (0.00087267,0) [0|0.11082909] "rad"  ADAS
 SG_ DET_ELEVATION_202 : 192|8@1+ (0.00275,-0.34925) [-0.34925|0.34925] "rad"  ADAS
 SG_ DET_ELEVATION_ERR_202 : 200|6@1+ (0.00174533,0) [0|0.10995579] "rad"  ADAS
 SG_ DET_RCS_202 : 256|8@1+ (0.5,-64) [-64|63.5] "dBsm"  ADAS
 SG_ DET_VALID_FLAG_202 : 167|1@1+ (1,0) [0|1] ""  ADAS
 SG_ DET_BI_STATIC_FLAG_202 : 505|1@1+ (1,0) [0|1] ""  ADAS
 SG_ DET_SUPER_RES_TARGET_202 : 247|1@1+ (1,0) [0|1] ""  ADAS
 SG_ DET_SNR_202 : 248|8@1+ (0.35156,0) [0|89.6478] "dB"  ADAS
 SG_ DET_POINT_TARGET_PROB_202 : 240|4@1+ (6.67,0) [0|100] "%"  ADAS
 SG_ DET_EXISTENCE_PROB_202 : 232|6@1+ (1.588,0) [0|100] "%"  ADAS
 SG_ DET_OUTSIDE_SECTOR_202 : 183|1@1+ (1,0) [0|1] ""  ADAS
 SG_ DET_HVC_FLAG_202 : 246|1@1+ (1,0) [0|1] ""  ADAS
 SG_ DET_CONFD_AZIMUTH_202 : 206|2@1+ (1,0) [0|3] ""  ADAS
 SG_ DET_CONFD_ELEVATION_202 : 244|2@1+ (1,0) [0|3] ""  ADAS
 SG_ DET_RANGE_203 : 264|15@1+ (0.015625,0) [0|500] "m"  ADAS
 SG_ DET_RANGE_ERR_203 : 280|7@1+ (0.0075,0) [0|0.9525] "m"  ADAS
 SG_ DET_RANGE_VELOCITY_203 : 288|15@1+ (0.0078125,-128) [-128|127.9921875] "m/s"  ADAS
 SG_ DET_RANGE_VELOCITY_ERR_203 : 304|8@1+ (0.003,0) [0|0.765] "m/s"  ADAS
 SG_ DET_AZIMUTH_203 : 328|13@1+ (0.0004,-1.5708) [-1.5708|1.5708] "rad"  ADAS
 SG_ DET_AZIMUTH_ERR_203 : 345|7@1+ (0.00087267,0) [0|0.11082909] "rad"  ADAS
 SG_ DET_ELEVATION_203 : 312|8@1+ (0.00275,-0.34925) [-0.34925|0.34925] "rad"  ADAS
 SG_ DET_ELEVATION_ERR_203 : 320|6@1+ (0.00174533,0) [0|0.10995579] "rad"  ADAS
 SG_ DET_RCS_203 : 376|8@1+ (0.5,-64) [-64|63.5] "dBsm"  ADAS
 SG_ DET_VALID_FLAG_203 : 399|1@1+ (1,0) [0|1] ""  ADAS
 SG_ DET_BI_STATIC_FLAG_203 : 482|1@1+ (1,0) [0|1] ""  ADAS
 SG_ DET_SUPER_RES_TARGET_203 : 344|1@1+ (1,0) [0|1] ""  ADAS
 SG_ DET_SNR_203 : 368|8@1+ (0.35156,0) [0|89.6478] "dB"  ADAS
 SG_ DET_POINT_TARGET_PROB_203 : 360|4@1+ (6.67,0) [0|100] "%"  ADAS
 SG_ DET_EXISTENCE_PROB_203 : 352|6@1+ (1.588,0) [0|100] "%"  ADAS
 SG_ DET_OUTSIDE_SECTOR_203 : 407|1@1+ (1,0) [0|1] ""  ADAS
 SG_ DET_HVC_FLAG_203 : 364|1@1+ (1,0) [0|1] ""  ADAS
 SG_ DET_CONFD_AZIMUTH_203 : 365|2@1+ (1,0) [0|3] ""  ADAS
 SG_ DET_CONFD_ELEVATION_203 : 358|2@1+ (1,0) [0|3] ""  ADAS
 SG_ DET_RANGE_204 : 384|15@1+ (0.015625,0) [0|500] "m"  ADAS
 SG_ DET_RANGE_ERR_204 : 400|7@1+ (0.0075,0) [0|0.9525] "m"  ADAS
 SG_ DET_RANGE_VELOCITY_204 : 408|15@1+ (0.0078125,-128) [-128|127.9921875] "m/s"  ADAS
 SG_ DET_RANGE_VELOCITY_ERR_204 : 424|8@1+ (0.003,0) [0|0.765] "m/s"  ADAS
 SG_ DET_AZIMUTH_204 : 448|13@1+ (0.0004,-1.5708) [-1.5708|1.5708] "rad"  ADAS
 SG_ DET_AZIMUTH_ERR_204 : 465|7@1+ (0.00087267,0) [0|0.11082909] "rad"  ADAS
 SG_ DET_ELEVATION_204 : 432|8@1+ (0.00275,-0.34925) [-0.34925|0.34925] "rad"  ADAS
 SG_ DET_ELEVATION_ERR_204 : 440|6@1+ (0.00174533,0) [0|0.10995579] "rad"  ADAS
 SG_ DET_RCS_204 : 496|8@1+ (0.5,-64) [-64|63.5] "dBsm"  ADAS
 SG_ DET_VALID_FLAG_204 : 485|1@1+ (1,0) [0|1] ""  ADAS
 SG_ DET_BI_STATIC_FLAG_204 : 483|1@1+ (1,0) [0|1] ""  ADAS
 SG_ DET_SUPER_RES_TARGET_204 : 446|1@1+ (1,0) [0|1] ""  ADAS
 SG_ DET_SNR_204 : 488|8@1+ (0.35156,0) [0|89.6478] "dB"  ADAS
 SG_ DET_POINT_TARGET_PROB_204 : 472|4@1+ (6.67,0) [0|100] "%"  ADAS
 SG_ DET_EXISTENCE_PROB_204 : 506|6@1+ (1.588,0) [0|100] "%"  ADAS
 SG_ DET_OUTSIDE_SECTOR_204 : 481|1@1+ (1,0) [0|1] ""  ADAS
 SG_ DET_HVC_FLAG_204 : 464|1@1+ (1,0) [0|1] ""  ADAS
 SG_ DET_CONFD_AZIMUTH_204 : 486|2@1+ (1,0) [0|3] ""  ADAS
 SG_ DET_CONFD_ELEVATION_204 : 461|2@1+ (1,0) [0|3] ""  ADAS
 SG_ DET_MH_SCAN_INDEX_4LSB_201_204 : 476|4@1+ (1,0) [0|15] ""  ADAS
 SG_ DET_MH_CYCLE_COUNTER_201_204 : 16|8@1+ (1,0) [0|255] ""  ADAS
 SG_ DET_MH_CRC16_201_204 : 0|16@1+ (1,0) [0|65535] ""  ADAS

BO_ 1075 RDR_DETECTION_205_208: 64 RDR07
 SG_ DET_RANGE_205 : 24|15@1+ (0.015625,0) [0|500] "m"  ADAS
 SG_ DET_RANGE_ERR_205 : 40|7@1+ (0.0075,0) [0|0.9525] "m"  ADAS
 SG_ DET_RANGE_VELOCITY_205 : 48|15@1+ (0.0078125,-128) [-128|127.9921875] "m/s"  ADAS
 SG_ DET_RANGE_VELOCITY_ERR_205 : 64|8@1+ (0.003,0) [0|0.765] "m/s"  ADAS
 SG_ DET_AZIMUTH_205 : 88|13@1+ (0.0004,-1.5708) [-1.5708|1.5708] "rad"  ADAS
 SG_ DET_AZIMUTH_ERR_205 : 105|7@1+ (0.00087267,0) [0|0.11082909] "rad"  ADAS
 SG_ DET_ELEVATION_205 : 72|8@1+ (0.00275,-0.34925) [-0.34925|0.34925] "rad"  ADAS
 SG_ DET_ELEVATION_ERR_205 : 80|6@1+ (0.00174533,0) [0|0.10995579] "rad"  ADAS
 SG_ DET_RCS_205 : 136|8@1+ (0.5,-64) [-64|63.5] "dBsm"  ADAS
 SG_ DET_VALID_FLAG_205 : 119|1@1+ (1,0) [0|1] ""  ADAS
 SG_ DET_BI_STATIC_FLAG_205 : 504|1@1+ (1,0) [0|1] ""  ADAS
 SG_ DET_SUPER_RES_TARGET_205 : 104|1@1+ (1,0) [0|1] ""  ADAS
 SG_ DET_SNR_205 : 128|8@1+ (0.35156,0) [0|89.6478] "dB"  ADAS
 SG_ DET_POINT_TARGET_PROB_205 : 114|4@1+ (6.67,0) [0|100] "%"  ADAS
 SG_ DET_EXISTENCE_PROB_205 : 120|6@1+ (1.588,0) [0|100] "%"  ADAS
 SG_ DET_OUTSIDE_SECTOR_205 : 159|1@1+ (1,0) [0|1] ""  ADAS
 SG_ DET_HVC_FLAG_205 : 118|1@1+ (1,0) [0|1] ""  ADAS
 SG_ DET_CONFD_AZIMUTH_205 : 126|2@1+ (1,0) [0|3] ""  ADAS
 SG_ DET_CONFD_ELEVATION_205 : 112|2@1+ (1,0) [0|3] ""  ADAS
 SG_ DET_RANGE_206 : 144|15@1+ (0.015625,0) [0|500] "m"  ADAS
 SG_ DET_RANGE_ERR_206 : 160|7@1+ (0.0075,0) [0|0.9525] "m"  ADAS
 SG_ DET_RANGE_VELOCITY_206 : 168|15@1+ (0.0078125,-128) [-128|127.9921875] "m/s"  ADAS
 SG_ DET_RANGE_VELOCITY_ERR_206 : 184|8@1+ (0.003,0) [0|0.765] "m/s"  ADAS
 SG_ DET_AZIMUTH_206 : 208|13@1+ (0.0004,-1.5708) [-1.5708|1.5708] "rad"  ADAS
 SG_ DET_AZIMUTH_ERR_206 : 224|7@1+ (0.00087267,0) [0|0.11082909] "rad"  ADAS
 SG_ DET_ELEVATION_206 : 192|8@1+ (0.00275,-0.34925) [-0.34925|0.34925] "rad"  ADAS
 SG_ DET_ELEVATION_ERR_206 : 200|6@1+ (0.00174533,0) [0|0.10995579] "rad"  ADAS
 SG_ DET_RCS_206 : 256|8@1+ (0.5,-64) [-64|63.5] "dBsm"  ADAS
 SG_ DET_VALID_FLAG_206 : 167|1@1+ (1,0) [0|1] ""  ADAS
 SG_ DET_BI_STATIC_FLAG_206 : 505|1@1+ (1,0) [0|1] ""  ADAS
 SG_ DET_SUPER_RES_TARGET_206 : 247|1@1+ (1,0) [0|1] ""  ADAS
 SG_ DET_SNR_206 : 248|8@1+ (0.35156,0) [0|89.6478] "dB"  ADAS
 SG_ DET_POINT_TARGET_PROB_206 : 240|4@1+ (6.67,0) [0|100] "%"  ADAS
 SG_ DET_EXISTENCE_PROB_206 : 232|6@1+ (1.588,0) [0|100] "%"  ADAS
 SG_ DET_OUTSIDE_SECTOR_206 : 183|1@1+ (1,0) [0|1] ""  ADAS
 SG_ DET_HVC_FLAG_206 : 246|1@1+ (1,0) [0|1] ""  ADAS
 SG_ DET_CONFD_AZIMUTH_206 : 206|2@1+ (1,0) [0|3] ""  ADAS
 SG_ DET_CONFD_ELEVATION_206 : 244|2@1+ (1,0) [0|3] ""  ADAS
 SG_ DET_RANGE_207 : 264|15@1+ (0.015625,0) [0|500] "m"  ADAS
 SG_ DET_RANGE_ERR_207 : 280|7@1+ (0.0075,0) [0|0.9525] "m"  ADAS
 SG_ DET_RANGE_VELOCITY_207 : 288|15@1+ (0.0078125,-128) [-128|127.9921875] "m/s"  ADAS
 SG_ DET_RANGE_VELOCITY_ERR_207 : 304|8@1+ (0.003,0) [0|0.765] "m/s"  ADAS
 SG_ DET_AZIMUTH_207 : 328|13@1+ (0.0004,-1.5708) [-1.5708|1.5708] "rad"  ADAS
 SG_ DET_AZIMUTH_ERR_207 : 345|7@1+ (0.00087267,0) [0|0.11082909] "rad"  ADAS
 SG_ DET_ELEVATION_207 : 312|8@1+ (0.00275,-0.34925) [-0.34925|0.34925] "rad"  ADAS
 SG_ DET_ELEVATION_ERR_207 : 320|6@1+ (0.00174533,0) [0|0.10995579] "rad"  ADAS
 SG_ DET_RCS_207 : 376|8@1+ (0.5,-64) [-64|63.5] "dBsm"  ADAS
 SG_ DET_VALID_FLAG_207 : 399|1@1+ (1,0) [0|1] ""  ADAS
 SG_ DET_BI_STATIC_FLAG_207 : 482|1@1+ (1,0) [0|1] ""  ADAS
 SG_ DET_SUPER_RES_TARGET_207 : 344|1@1+ (1,0) [0|1] ""  ADAS
 SG_ DET_SNR_207 : 368|8@1+ (0.35156,0) [0|89.6478] "dB"  ADAS
 SG_ DET_POINT_TARGET_PROB_207 : 360|4@1+ (6.67,0) [0|100] "%"  ADAS
 SG_ DET_EXISTENCE_PROB_207 : 352|6@1+ (1.588,0) [0|100] "%"  ADAS
 SG_ DET_OUTSIDE_SECTOR_207 : 407|1@1+ (1,0) [0|1] ""  ADAS
 SG_ DET_HVC_FLAG_207 : 364|1@1+ (1,0) [0|1] ""  ADAS
 SG_ DET_CONFD_AZIMUTH_207 : 365|2@1+ (1,0) [0|3] ""  ADAS
 SG_ DET_CONFD_ELEVATION_207 : 358|2@1+ (1,0) [0|3] ""  ADAS
 SG_ DET_RANGE_208 : 384|15@1+ (0.015625,0) [0|500] "m"  ADAS
 SG_ DET_RANGE_ERR_208 : 400|7@1+ (0.0075,0) [0|0.9525] "m"  ADAS
 SG_ DET_RANGE_VELOCITY_208 : 408|15@1+ (0.0078125,-128) [-128|127.9921875] "m/s"  ADAS
 SG_ DET_RANGE_VELOCITY_ERR_208 : 424|8@1+ (0.003,0) [0|0.765] "m/s"  ADAS
 SG_ DET_AZIMUTH_208 : 448|13@1+ (0.0004,-1.5708) [-1.5708|1.5708] "rad"  ADAS
 SG_ DET_AZIMUTH_ERR_208 : 465|7@1+ (0.00087267,0) [0|0.11082909] "rad"  ADAS
 SG_ DET_ELEVATION_208 : 432|8@1+ (0.00275,-0.34925) [-0.34925|0.34925] "rad"  ADAS
 SG_ DET_ELEVATION_ERR_208 : 440|6@1+ (0.00174533,0) [0|0.10995579] "rad"  ADAS
 SG_ DET_RCS_208 : 496|8@1+ (0.5,-64) [-64|63.5] "dBsm"  ADAS
 SG_ DET_VALID_FLAG_208 : 485|1@1+ (1,0) [0|1] ""  ADAS
 SG_ DET_BI_STATIC_FLAG_208 : 483|1@1+ (1,0) [0|1] ""  ADAS
 SG_ DET_SUPER_RES_TARGET_208 : 446|1@1+ (1,0) [0|1] ""  ADAS
 SG_ DET_SNR_208 : 488|8@1+ (0.35156,0) [0|89.6478] "dB"  ADAS
 SG_ DET_POINT_TARGET_PROB_208 : 472|4@1+ (6.67,0) [0|100] "%"  ADAS
 SG_ DET_EXISTENCE_PROB_208 : 506|6@1+ (1.588,0) [0|100] "%"  ADAS
 SG_ DET_OUTSIDE_SECTOR_208 : 481|1@1+ (1,0) [0|1] ""  ADAS
 SG_ DET_HVC_FLAG_208 : 464|1@1+ (1,0) [0|1] ""  ADAS
 SG_ DET_CONFD_AZIMUTH_208 : 486|2@1+ (1,0) [0|3] ""  ADAS
 SG_ DET_CONFD_ELEVATION_208 : 461|2@1+ (1,0) [0|3] ""  ADAS
 SG_ DET_MH_SCAN_INDEX_4LSB_205_208 : 476|4@1+ (1,0) [0|15] ""  ADAS
 SG_ DET_MH_CYCLE_COUNTER_205_208 : 16|8@1+ (1,0) [0|255] ""  ADAS
 SG_ DET_MH_CRC16_205_208 : 0|16@1+ (1,0) [0|65535] ""  ADAS

BO_ 1076 RDR_DETECTION_209_212: 64 RDR07
 SG_ DET_RANGE_209 : 24|15@1+ (0.015625,0) [0|500] "m"  ADAS
 SG_ DET_RANGE_ERR_209 : 40|7@1+ (0.0075,0) [0|0.9525] "m"  ADAS
 SG_ DET_RANGE_VELOCITY_209 : 48|15@1+ (0.0078125,-128) [-128|127.9921875] "m/s"  ADAS
 SG_ DET_RANGE_VELOCITY_ERR_209 : 64|8@1+ (0.003,0) [0|0.765] "m/s"  ADAS
 SG_ DET_AZIMUTH_209 : 88|13@1+ (0.0004,-1.5708) [-1.5708|1.5708] "rad"  ADAS
 SG_ DET_AZIMUTH_ERR_209 : 105|7@1+ (0.00087267,0) [0|0.11082909] "rad"  ADAS
 SG_ DET_ELEVATION_209 : 72|8@1+ (0.00275,-0.34925) [-0.34925|0.34925] "rad"  ADAS
 SG_ DET_ELEVATION_ERR_209 : 80|6@1+ (0.00174533,0) [0|0.10995579] "rad"  ADAS
 SG_ DET_RCS_209 : 136|8@1+ (0.5,-64) [-64|63.5] "dBsm"  ADAS
 SG_ DET_VALID_FLAG_209 : 119|1@1+ (1,0) [0|1] ""  ADAS
 SG_ DET_BI_STATIC_FLAG_209 : 504|1@1+ (1,0) [0|1] ""  ADAS
 SG_ DET_SUPER_RES_TARGET_209 : 104|1@1+ (1,0) [0|1] ""  ADAS
 SG_ DET_SNR_209 : 128|8@1+ (0.35156,0) [0|89.6478] "dB"  ADAS
 SG_ DET_POINT_TARGET_PROB_209 : 114|4@1+ (6.67,0) [0|100] "%"  ADAS
 SG_ DET_EXISTENCE_PROB_209 : 120|6@1+ (1.588,0) [0|100] "%"  ADAS
 SG_ DET_OUTSIDE_SECTOR_209 : 159|1@1+ (1,0) [0|1] ""  ADAS
 SG_ DET_HVC_FLAG_209 : 118|1@1+ (1,0) [0|1] ""  ADAS
 SG_ DET_CONFD_AZIMUTH_209 : 126|2@1+ (1,0) [0|3] ""  ADAS
 SG_ DET_CONFD_ELEVATION_209 : 112|2@1+ (1,0) [0|3] ""  ADAS
 SG_ DET_RANGE_210 : 144|15@1+ (0.015625,0) [0|500] "m"  ADAS
 SG_ DET_RANGE_ERR_210 : 160|7@1+ (0.0075,0) [0|0.9525] "m"  ADAS
 SG_ DET_RANGE_VELOCITY_210 : 168|15@1+ (0.0078125,-128) [-128|127.9921875] "m/s"  ADAS
 SG_ DET_RANGE_VELOCITY_ERR_210 : 184|8@1+ (0.003,0) [0|0.765] "m/s"  ADAS
 SG_ DET_AZIMUTH_210 : 208|13@1+ (0.0004,-1.5708) [-1.5708|1.5708] "rad"  ADAS
 SG_ DET_AZIMUTH_ERR_210 : 224|7@1+ (0.00087267,0) [0|0.11082909] "rad"  ADAS
 SG_ DET_ELEVATION_210 : 192|8@1+ (0.00275,-0.34925) [-0.34925|0.34925] "rad"  ADAS
 SG_ DET_ELEVATION_ERR_210 : 200|6@1+ (0.00174533,0) [0|0.10995579] "rad"  ADAS
 SG_ DET_RCS_210 : 256|8@1+ (0.5,-64) [-64|63.5] "dBsm"  ADAS
 SG_ DET_VALID_FLAG_210 : 167|1@1+ (1,0) [0|1] ""  ADAS
 SG_ DET_BI_STATIC_FLAG_210 : 505|1@1+ (1,0) [0|1] ""  ADAS
 SG_ DET_SUPER_RES_TARGET_210 : 247|1@1+ (1,0) [0|1] ""  ADAS
 SG_ DET_SNR_210 : 248|8@1+ (0.35156,0) [0|89.6478] "dB"  ADAS
 SG_ DET_POINT_TARGET_PROB_210 : 240|4@1+ (6.67,0) [0|100] "%"  ADAS
 SG_ DET_EXISTENCE_PROB_210 : 232|6@1+ (1.588,0) [0|100] "%"  ADAS
 SG_ DET_OUTSIDE_SECTOR_210 : 183|1@1+ (1,0) [0|1] ""  ADAS
 SG_ DET_HVC_FLAG_210 : 246|1@1+ (1,0) [0|1] ""  ADAS
 SG_ DET_CONFD_AZIMUTH_210 : 206|2@1+ (1,0) [0|3] ""  ADAS
 SG_ DET_CONFD_ELEVATION_210 : 244|2@1+ (1,0) [0|3] ""  ADAS
 SG_ DET_RANGE_211 : 264|15@1+ (0.015625,0) [0|500] "m"  ADAS
 SG_ DET_RANGE_ERR_211 : 280|7@1+ (0.0075,0) [0|0.9525] "m"  ADAS
 SG_ DET_RANGE_VELOCITY_211 : 288|15@1+ (0.0078125,-128) [-128|127.9921875] "m/s"  ADAS
 SG_ DET_RANGE_VELOCITY_ERR_211 : 304|8@1+ (0.003,0) [0|0.765] "m/s"  ADAS
 SG_ DET_AZIMUTH_211 : 328|13@1+ (0.0004,-1.5708) [-1.5708|1.5708] "rad"  ADAS
 SG_ DET_AZIMUTH_ERR_211 : 345|7@1+ (0.00087267,0) [0|0.11082909] "rad"  ADAS
 SG_ DET_ELEVATION_211 : 312|8@1+ (0.00275,-0.34925) [-0.34925|0.34925] "rad"  ADAS
 SG_ DET_ELEVATION_ERR_211 : 320|6@1+ (0.00174533,0) [0|0.10995579] "rad"  ADAS
 SG_ DET_RCS_211 : 376|8@1+ (0.5,-64) [-64|63.5] "dBsm"  ADAS
 SG_ DET_VALID_FLAG_211 : 399|1@1+ (1,0) [0|1] ""  ADAS
 SG_ DET_BI_STATIC_FLAG_211 : 482|1@1+ (1,0) [0|1] ""  ADAS
 SG_ DET_SUPER_RES_TARGET_211 : 344|1@1+ (1,0) [0|1] ""  ADAS
 SG_ DET_SNR_211 : 368|8@1+ (0.35156,0) [0|89.6478] "dB"  ADAS
 SG_ DET_POINT_TARGET_PROB_211 : 360|4@1+ (6.67,0) [0|100] "%"  ADAS
 SG_ DET_EXISTENCE_PROB_211 : 352|6@1+ (1.588,0) [0|100] "%"  ADAS
 SG_ DET_OUTSIDE_SECTOR_211 : 407|1@1+ (1,0) [0|1] ""  ADAS
 SG_ DET_HVC_FLAG_211 : 364|1@1+ (1,0) [0|1] ""  ADAS
 SG_ DET_CONFD_AZIMUTH_211 : 365|2@1+ (1,0) [0|3] ""  ADAS
 SG_ DET_CONFD_ELEVATION_211 : 358|2@1+ (1,0) [0|3] ""  ADAS
 SG_ DET_RANGE_212 : 384|15@1+ (0.015625,0) [0|500] "m"  ADAS
 SG_ DET_RANGE_ERR_212 : 400|7@1+ (0.0075,0) [0|0.9525] "m"  ADAS
 SG_ DET_RANGE_VELOCITY_212 : 408|15@1+ (0.0078125,-128) [-128|127.9921875] "m/s"  ADAS
 SG_ DET_RANGE_VELOCITY_ERR_212 : 424|8@1+ (0.003,0) [0|0.765] "m/s"  ADAS
 SG_ DET_AZIMUTH_212 : 448|13@1+ (0.0004,-1.5708) [-1.5708|1.5708] "rad"  ADAS
 SG_ DET_AZIMUTH_ERR_212 : 465|7@1+ (0.00087267,0) [0|0.11082909] "rad"  ADAS
 SG_ DET_ELEVATION_212 : 432|8@1+ (0.00275,-0.34925) [-0.34925|0.34925] "rad"  ADAS
 SG_ DET_ELEVATION_ERR_212 : 440|6@1+ (0.00174533,0) [0|0.10995579] "rad"  ADAS
 SG_ DET_RCS_212 : 496|8@1+ (0.5,-64) [-64|63.5] "dBsm"  ADAS
 SG_ DET_VALID_FLAG_212 : 485|1@1+ (1,0) [0|1] ""  ADAS
 SG_ DET_BI_STATIC_FLAG_212 : 483|1@1+ (1,0) [0|1] ""  ADAS
 SG_ DET_SUPER_RES_TARGET_212 : 446|1@1+ (1,0) [0|1] ""  ADAS
 SG_ DET_SNR_212 : 488|8@1+ (0.35156,0) [0|89.6478] "dB"  ADAS
 SG_ DET_POINT_TARGET_PROB_212 : 472|4@1+ (6.67,0) [0|100] "%"  ADAS
 SG_ DET_EXISTENCE_PROB_212 : 506|6@1+ (1.588,0) [0|100] "%"  ADAS
 SG_ DET_OUTSIDE_SECTOR_212 : 481|1@1+ (1,0) [0|1] ""  ADAS
 SG_ DET_HVC_FLAG_212 : 464|1@1+ (1,0) [0|1] ""  ADAS
 SG_ DET_CONFD_AZIMUTH_212 : 486|2@1+ (1,0) [0|3] ""  ADAS
 SG_ DET_CONFD_ELEVATION_212 : 461|2@1+ (1,0) [0|3] ""  ADAS
 SG_ DET_MH_SCAN_INDEX_4LSB_209_212 : 476|4@1+ (1,0) [0|15] ""  ADAS
 SG_ DET_MH_CYCLE_COUNTER_209_212 : 16|8@1+ (1,0) [0|255] ""  ADAS
 SG_ DET_MH_CRC16_209_212 : 0|16@1+ (1,0) [0|65535] ""  ADAS

BO_ 1077 RDR_DETECTION_213_216: 64 RDR07
 SG_ DET_RANGE_213 : 24|15@1+ (0.015625,0) [0|500] "m"  ADAS
 SG_ DET_RANGE_ERR_213 : 40|7@1+ (0.0075,0) [0|0.9525] "m"  ADAS
 SG_ DET_RANGE_VELOCITY_213 : 48|15@1+ (0.0078125,-128) [-128|127.9921875] "m/s"  ADAS
 SG_ DET_RANGE_VELOCITY_ERR_213 : 64|8@1+ (0.003,0) [0|0.765] "m/s"  ADAS
 SG_ DET_AZIMUTH_213 : 88|13@1+ (0.0004,-1.5708) [-1.5708|1.5708] "rad"  ADAS
 SG_ DET_AZIMUTH_ERR_213 : 105|7@1+ (0.00087267,0) [0|0.11082909] "rad"  ADAS
 SG_ DET_ELEVATION_213 : 72|8@1+ (0.00275,-0.34925) [-0.34925|0.34925] "rad"  ADAS
 SG_ DET_ELEVATION_ERR_213 : 80|6@1+ (0.00174533,0) [0|0.10995579] "rad"  ADAS
 SG_ DET_RCS_213 : 136|8@1+ (0.5,-64) [-64|63.5] "dBsm"  ADAS
 SG_ DET_VALID_FLAG_213 : 119|1@1+ (1,0) [0|1] ""  ADAS
 SG_ DET_BI_STATIC_FLAG_213 : 504|1@1+ (1,0) [0|1] ""  ADAS
 SG_ DET_SUPER_RES_TARGET_213 : 104|1@1+ (1,0) [0|1] ""  ADAS
 SG_ DET_SNR_213 : 128|8@1+ (0.35156,0) [0|89.6478] "dB"  ADAS
 SG_ DET_POINT_TARGET_PROB_213 : 114|4@1+ (6.67,0) [0|100] "%"  ADAS
 SG_ DET_EXISTENCE_PROB_213 : 120|6@1+ (1.588,0) [0|100] "%"  ADAS
 SG_ DET_OUTSIDE_SECTOR_213 : 159|1@1+ (1,0) [0|1] ""  ADAS
 SG_ DET_HVC_FLAG_213 : 118|1@1+ (1,0) [0|1] ""  ADAS
 SG_ DET_CONFD_AZIMUTH_213 : 126|2@1+ (1,0) [0|3] ""  ADAS
 SG_ DET_CONFD_ELEVATION_213 : 112|2@1+ (1,0) [0|3] ""  ADAS
 SG_ DET_RANGE_214 : 144|15@1+ (0.015625,0) [0|500] "m"  ADAS
 SG_ DET_RANGE_ERR_214 : 160|7@1+ (0.0075,0) [0|0.9525] "m"  ADAS
 SG_ DET_RANGE_VELOCITY_214 : 168|15@1+ (0.0078125,-128) [-128|127.9921875] "m/s"  ADAS
 SG_ DET_RANGE_VELOCITY_ERR_214 : 184|8@1+ (0.003,0) [0|0.765] "m/s"  ADAS
 SG_ DET_AZIMUTH_214 : 208|13@1+ (0.0004,-1.5708) [-1.5708|1.5708] "rad"  ADAS
 SG_ DET_AZIMUTH_ERR_214 : 224|7@1+ (0.00087267,0) [0|0.11082909] "rad"  ADAS
 SG_ DET_ELEVATION_214 : 192|8@1+ (0.00275,-0.34925) [-0.34925|0.34925] "rad"  ADAS
 SG_ DET_ELEVATION_ERR_214 : 200|6@1+ (0.00174533,0) [0|0.10995579] "rad"  ADAS
 SG_ DET_RCS_214 : 256|8@1+ (0.5,-64) [-64|63.5] "dBsm"  ADAS
 SG_ DET_VALID_FLAG_214 : 167|1@1+ (1,0) [0|1] ""  ADAS
 SG_ DET_BI_STATIC_FLAG_214 : 505|1@1+ (1,0) [0|1] ""  ADAS
 SG_ DET_SUPER_RES_TARGET_214 : 247|1@1+ (1,0) [0|1] ""  ADAS
 SG_ DET_SNR_214 : 248|8@1+ (0.35156,0) [0|89.6478] "dB"  ADAS
 SG_ DET_POINT_TARGET_PROB_214 : 240|4@1+ (6.67,0) [0|100] "%"  ADAS
 SG_ DET_EXISTENCE_PROB_214 : 232|6@1+ (1.588,0) [0|100] "%"  ADAS
 SG_ DET_OUTSIDE_SECTOR_214 : 183|1@1+ (1,0) [0|1] ""  ADAS
 SG_ DET_HVC_FLAG_214 : 246|1@1+ (1,0) [0|1] ""  ADAS
 SG_ DET_CONFD_AZIMUTH_214 : 206|2@1+ (1,0) [0|3] ""  ADAS
 SG_ DET_CONFD_ELEVATION_214 : 244|2@1+ (1,0) [0|3] ""  ADAS
 SG_ DET_RANGE_215 : 264|15@1+ (0.015625,0) [0|500] "m"  ADAS
 SG_ DET_RANGE_ERR_215 : 280|7@1+ (0.0075,0) [0|0.9525] "m"  ADAS
 SG_ DET_RANGE_VELOCITY_215 : 288|15@1+ (0.0078125,-128) [-128|127.9921875] "m/s"  ADAS
 SG_ DET_RANGE_VELOCITY_ERR_215 : 304|8@1+ (0.003,0) [0|0.765] "m/s"  ADAS
 SG_ DET_AZIMUTH_215 : 328|13@1+ (0.0004,-1.5708) [-1.5708|1.5708] "rad"  ADAS
 SG_ DET_AZIMUTH_ERR_215 : 345|7@1+ (0.00087267,0) [0|0.11082909] "rad"  ADAS
 SG_ DET_ELEVATION_215 : 312|8@1+ (0.00275,-0.34925) [-0.34925|0.34925] "rad"  ADAS
 SG_ DET_ELEVATION_ERR_215 : 320|6@1+ (0.00174533,0) [0|0.10995579] "rad"  ADAS
 SG_ DET_RCS_215 : 376|8@1+ (0.5,-64) [-64|63.5] "dBsm"  ADAS
 SG_ DET_VALID_FLAG_215 : 399|1@1+ (1,0) [0|1] ""  ADAS
 SG_ DET_BI_STATIC_FLAG_215 : 482|1@1+ (1,0) [0|1] ""  ADAS
 SG_ DET_SUPER_RES_TARGET_215 : 344|1@1+ (1,0) [0|1] ""  ADAS
 SG_ DET_SNR_215 : 368|8@1+ (0.35156,0) [0|89.6478] "dB"  ADAS
 SG_ DET_POINT_TARGET_PROB_215 : 360|4@1+ (6.67,0) [0|100] "%"  ADAS
 SG_ DET_EXISTENCE_PROB_215 : 352|6@1+ (1.588,0) [0|100] "%"  ADAS
 SG_ DET_OUTSIDE_SECTOR_215 : 407|1@1+ (1,0) [0|1] ""  ADAS
 SG_ DET_HVC_FLAG_215 : 364|1@1+ (1,0) [0|1] ""  ADAS
 SG_ DET_CONFD_AZIMUTH_215 : 365|2@1+ (1,0) [0|3] ""  ADAS
 SG_ DET_CONFD_ELEVATION_215 : 358|2@1+ (1,0) [0|3] ""  ADAS
 SG_ DET_RANGE_216 : 384|15@1+ (0.015625,0) [0|500] "m"  ADAS
 SG_ DET_RANGE_ERR_216 : 400|7@1+ (0.0075,0) [0|0.9525] "m"  ADAS
 SG_ DET_RANGE_VELOCITY_216 : 408|15@1+ (0.0078125,-128) [-128|127.9921875] "m/s"  ADAS
 SG_ DET_RANGE_VELOCITY_ERR_216 : 424|8@1+ (0.003,0) [0|0.765] "m/s"  ADAS
 SG_ DET_AZIMUTH_216 : 448|13@1+ (0.0004,-1.5708) [-1.5708|1.5708] "rad"  ADAS
 SG_ DET_AZIMUTH_ERR_216 : 465|7@1+ (0.00087267,0) [0|0.11082909] "rad"  ADAS
 SG_ DET_ELEVATION_216 : 432|8@1+ (0.00275,-0.34925) [-0.34925|0.34925] "rad"  ADAS
 SG_ DET_ELEVATION_ERR_216 : 440|6@1+ (0.00174533,0) [0|0.10995579] "rad"  ADAS
 SG_ DET_RCS_216 : 496|8@1+ (0.5,-64) [-64|63.5] "dBsm"  ADAS
 SG_ DET_VALID_FLAG_216 : 485|1@1+ (1,0) [0|1] ""  ADAS
 SG_ DET_BI_STATIC_FLAG_216 : 483|1@1+ (1,0) [0|1] ""  ADAS
 SG_ DET_SUPER_RES_TARGET_216 : 446|1@1+ (1,0) [0|1] ""  ADAS
 SG_ DET_SNR_216 : 488|8@1+ (0.35156,0) [0|89.6478] "dB"  ADAS
 SG_ DET_POINT_TARGET_PROB_216 : 472|4@1+ (6.67,0) [0|100] "%"  ADAS
 SG_ DET_EXISTENCE_PROB_216 : 506|6@1+ (1.588,0) [0|100] "%"  ADAS
 SG_ DET_OUTSIDE_SECTOR_216 : 481|1@1+ (1,0) [0|1] ""  ADAS
 SG_ DET_HVC_FLAG_216 : 464|1@1+ (1,0) [0|1] ""  ADAS
 SG_ DET_CONFD_AZIMUTH_216 : 486|2@1+ (1,0) [0|3] ""  ADAS
 SG_ DET_CONFD_ELEVATION_216 : 461|2@1+ (1,0) [0|3] ""  ADAS
 SG_ DET_MH_SCAN_INDEX_4LSB_213_216 : 476|4@1+ (1,0) [0|15] ""  ADAS
 SG_ DET_MH_CYCLE_COUNTER_213_216 : 16|8@1+ (1,0) [0|255] ""  ADAS
 SG_ DET_MH_CRC16_213_216 : 0|16@1+ (1,0) [0|65535] ""  ADAS

BO_ 1078 RDR_DETECTION_217_220: 64 RDR07
 SG_ DET_RANGE_217 : 24|15@1+ (0.015625,0) [0|500] "m"  ADAS
 SG_ DET_RANGE_ERR_217 : 40|7@1+ (0.0075,0) [0|0.9525] "m"  ADAS
 SG_ DET_RANGE_VELOCITY_217 : 48|15@1+ (0.0078125,-128) [-128|127.9921875] "m/s"  ADAS
 SG_ DET_RANGE_VELOCITY_ERR_217 : 64|8@1+ (0.003,0) [0|0.765] "m/s"  ADAS
 SG_ DET_AZIMUTH_217 : 88|13@1+ (0.0004,-1.5708) [-1.5708|1.5708] "rad"  ADAS
 SG_ DET_AZIMUTH_ERR_217 : 105|7@1+ (0.00087267,0) [0|0.11082909] "rad"  ADAS
 SG_ DET_ELEVATION_217 : 72|8@1+ (0.00275,-0.34925) [-0.34925|0.34925] "rad"  ADAS
 SG_ DET_ELEVATION_ERR_217 : 80|6@1+ (0.00174533,0) [0|0.10995579] "rad"  ADAS
 SG_ DET_RCS_217 : 136|8@1+ (0.5,-64) [-64|63.5] "dBsm"  ADAS
 SG_ DET_VALID_FLAG_217 : 119|1@1+ (1,0) [0|1] ""  ADAS
 SG_ DET_BI_STATIC_FLAG_217 : 504|1@1+ (1,0) [0|1] ""  ADAS
 SG_ DET_SUPER_RES_TARGET_217 : 104|1@1+ (1,0) [0|1] ""  ADAS
 SG_ DET_SNR_217 : 128|8@1+ (0.35156,0) [0|89.6478] "dB"  ADAS
 SG_ DET_POINT_TARGET_PROB_217 : 114|4@1+ (6.67,0) [0|100] "%"  ADAS
 SG_ DET_EXISTENCE_PROB_217 : 120|6@1+ (1.588,0) [0|100] "%"  ADAS
 SG_ DET_OUTSIDE_SECTOR_217 : 159|1@1+ (1,0) [0|1] ""  ADAS
 SG_ DET_HVC_FLAG_217 : 118|1@1+ (1,0) [0|1] ""  ADAS
 SG_ DET_CONFD_AZIMUTH_217 : 126|2@1+ (1,0) [0|3] ""  ADAS
 SG_ DET_CONFD_ELEVATION_217 : 112|2@1+ (1,0) [0|3] ""  ADAS
 SG_ DET_RANGE_218 : 144|15@1+ (0.015625,0) [0|500] "m"  ADAS
 SG_ DET_RANGE_ERR_218 : 160|7@1+ (0.0075,0) [0|0.9525] "m"  ADAS
 SG_ DET_RANGE_VELOCITY_218 : 168|15@1+ (0.0078125,-128) [-128|127.9921875] "m/s"  ADAS
 SG_ DET_RANGE_VELOCITY_ERR_218 : 184|8@1+ (0.003,0) [0|0.765] "m/s"  ADAS
 SG_ DET_AZIMUTH_218 : 208|13@1+ (0.0004,-1.5708) [-1.5708|1.5708] "rad"  ADAS
 SG_ DET_AZIMUTH_ERR_218 : 224|7@1+ (0.00087267,0) [0|0.11082909] "rad"  ADAS
 SG_ DET_ELEVATION_218 : 192|8@1+ (0.00275,-0.34925) [-0.34925|0.34925] "rad"  ADAS
 SG_ DET_ELEVATION_ERR_218 : 200|6@1+ (0.00174533,0) [0|0.10995579] "rad"  ADAS
 SG_ DET_RCS_218 : 256|8@1+ (0.5,-64) [-64|63.5] "dBsm"  ADAS
 SG_ DET_VALID_FLAG_218 : 167|1@1+ (1,0) [0|1] ""  ADAS
 SG_ DET_BI_STATIC_FLAG_218 : 505|1@1+ (1,0) [0|1] ""  ADAS
 SG_ DET_SUPER_RES_TARGET_218 : 247|1@1+ (1,0) [0|1] ""  ADAS
 SG_ DET_SNR_218 : 248|8@1+ (0.35156,0) [0|89.6478] "dB"  ADAS
 SG_ DET_POINT_TARGET_PROB_218 : 240|4@1+ (6.67,0) [0|100] "%"  ADAS
 SG_ DET_EXISTENCE_PROB_218 : 232|6@1+ (1.588,0) [0|100] "%"  ADAS
 SG_ DET_OUTSIDE_SECTOR_218 : 183|1@1+ (1,0) [0|1] ""  ADAS
 SG_ DET_HVC_FLAG_218 : 246|1@1+ (1,0) [0|1] ""  ADAS
 SG_ DET_CONFD_AZIMUTH_218 : 206|2@1+ (1,0) [0|3] ""  ADAS
 SG_ DET_CONFD_ELEVATION_218 : 244|2@1+ (1,0) [0|3] ""  ADAS
 SG_ DET_RANGE_219 : 264|15@1+ (0.015625,0) [0|500] "m"  ADAS
 SG_ DET_RANGE_ERR_219 : 280|7@1+ (0.0075,0) [0|0.9525] "m"  ADAS
 SG_ DET_RANGE_VELOCITY_219 : 288|15@1+ (0.0078125,-128) [-128|127.9921875] "m/s"  ADAS
 SG_ DET_RANGE_VELOCITY_ERR_219 : 304|8@1+ (0.003,0) [0|0.765] "m/s"  ADAS
 SG_ DET_AZIMUTH_219 : 328|13@1+ (0.0004,-1.5708) [-1.5708|1.5708] "rad"  ADAS
 SG_ DET_AZIMUTH_ERR_219 : 345|7@1+ (0.00087267,0) [0|0.11082909] "rad"  ADAS
 SG_ DET_ELEVATION_219 : 312|8@1+ (0.00275,-0.34925) [-0.34925|0.34925] "rad"  ADAS
 SG_ DET_ELEVATION_ERR_219 : 320|6@1+ (0.00174533,0) [0|0.10995579] "rad"  ADAS
 SG_ DET_RCS_219 : 376|8@1+ (0.5,-64) [-64|63.5] "dBsm"  ADAS
 SG_ DET_VALID_FLAG_219 : 399|1@1+ (1,0) [0|1] ""  ADAS
 SG_ DET_BI_STATIC_FLAG_219 : 482|1@1+ (1,0) [0|1] ""  ADAS
 SG_ DET_SUPER_RES_TARGET_219 : 344|1@1+ (1,0) [0|1] ""  ADAS
 SG_ DET_SNR_219 : 368|8@1+ (0.35156,0) [0|89.6478] "dB"  ADAS
 SG_ DET_POINT_TARGET_PROB_219 : 360|4@1+ (6.67,0) [0|100] "%"  ADAS
 SG_ DET_EXISTENCE_PROB_219 : 352|6@1+ (1.588,0) [0|100] "%"  ADAS
 SG_ DET_OUTSIDE_SECTOR_219 : 407|1@1+ (1,0) [0|1] ""  ADAS
 SG_ DET_HVC_FLAG_219 : 364|1@1+ (1,0) [0|1] ""  ADAS
 SG_ DET_CONFD_AZIMUTH_219 : 365|2@1+ (1,0) [0|3] ""  ADAS
 SG_ DET_CONFD_ELEVATION_219 : 358|2@1+ (1,0) [0|3] ""  ADAS
 SG_ DET_RANGE_220 : 384|15@1+ (0.015625,0) [0|500] "m"  ADAS
 SG_ DET_RANGE_ERR_220 : 400|7@1+ (0.0075,0) [0|0.9525] "m"  ADAS
 SG_ DET_RANGE_VELOCITY_220 : 408|15@1+ (0.0078125,-128) [-128|127.9921875] "m/s"  ADAS
 SG_ DET_RANGE_VELOCITY_ERR_220 : 424|8@1+ (0.003,0) [0|0.765] "m/s"  ADAS
 SG_ DET_AZIMUTH_220 : 448|13@1+ (0.0004,-1.5708) [-1.5708|1.5708] "rad"  ADAS
 SG_ DET_AZIMUTH_ERR_220 : 465|7@1+ (0.00087267,0) [0|0.11082909] "rad"  ADAS
 SG_ DET_ELEVATION_220 : 432|8@1+ (0.00275,-0.34925) [-0.34925|0.34925] "rad"  ADAS
 SG_ DET_ELEVATION_ERR_220 : 440|6@1+ (0.00174533,0) [0|0.10995579] "rad"  ADAS
 SG_ DET_RCS_220 : 496|8@1+ (0.5,-64) [-64|63.5] "dBsm"  ADAS
 SG_ DET_VALID_FLAG_220 : 485|1@1+ (1,0) [0|1] ""  ADAS
 SG_ DET_BI_STATIC_FLAG_220 : 483|1@1+ (1,0) [0|1] ""  ADAS
 SG_ DET_SUPER_RES_TARGET_220 : 446|1@1+ (1,0) [0|1] ""  ADAS
 SG_ DET_SNR_220 : 488|8@1+ (0.35156,0) [0|89.6478] "dB"  ADAS
 SG_ DET_POINT_TARGET_PROB_220 : 472|4@1+ (6.67,0) [0|100] "%"  ADAS
 SG_ DET_EXISTENCE_PROB_220 : 506|6@1+ (1.588,0) [0|100] "%"  ADAS
 SG_ DET_OUTSIDE_SECTOR_220 : 481|1@1+ (1,0) [0|1] ""  ADAS
 SG_ DET_HVC_FLAG_220 : 464|1@1+ (1,0) [0|1] ""  ADAS
 SG_ DET_CONFD_AZIMUTH_220 : 486|2@1+ (1,0) [0|3] ""  ADAS
 SG_ DET_CONFD_ELEVATION_220 : 461|2@1+ (1,0) [0|3] ""  ADAS
 SG_ DET_MH_SCAN_INDEX_4LSB_217_220 : 476|4@1+ (1,0) [0|15] ""  ADAS
 SG_ DET_MH_CYCLE_COUNTER_217_220 : 16|8@1+ (1,0) [0|255] ""  ADAS
 SG_ DET_MH_CRC16_217_220 : 0|16@1+ (1,0) [0|65535] ""  ADAS

BO_ 1079 RDR_DETECTION_221_224: 64 RDR07
 SG_ DET_RANGE_221 : 24|15@1+ (0.015625,0) [0|500] "m"  ADAS
 SG_ DET_RANGE_ERR_221 : 40|7@1+ (0.0075,0) [0|0.9525] "m"  ADAS
 SG_ DET_RANGE_VELOCITY_221 : 48|15@1+ (0.0078125,-128) [-128|127.9921875] "m/s"  ADAS
 SG_ DET_RANGE_VELOCITY_ERR_221 : 64|8@1+ (0.003,0) [0|0.765] "m/s"  ADAS
 SG_ DET_AZIMUTH_221 : 88|13@1+ (0.0004,-1.5708) [-1.5708|1.5708] "rad"  ADAS
 SG_ DET_AZIMUTH_ERR_221 : 105|7@1+ (0.00087267,0) [0|0.11082909] "rad"  ADAS
 SG_ DET_ELEVATION_221 : 72|8@1+ (0.00275,-0.34925) [-0.34925|0.34925] "rad"  ADAS
 SG_ DET_ELEVATION_ERR_221 : 80|6@1+ (0.00174533,0) [0|0.10995579] "rad"  ADAS
 SG_ DET_RCS_221 : 136|8@1+ (0.5,-64) [-64|63.5] "dBsm"  ADAS
 SG_ DET_VALID_FLAG_221 : 119|1@1+ (1,0) [0|1] ""  ADAS
 SG_ DET_BI_STATIC_FLAG_221 : 504|1@1+ (1,0) [0|1] ""  ADAS
 SG_ DET_SUPER_RES_TARGET_221 : 104|1@1+ (1,0) [0|1] ""  ADAS
 SG_ DET_SNR_221 : 128|8@1+ (0.35156,0) [0|89.6478] "dB"  ADAS
 SG_ DET_POINT_TARGET_PROB_221 : 114|4@1+ (6.67,0) [0|100] "%"  ADAS
 SG_ DET_EXISTENCE_PROB_221 : 120|6@1+ (1.588,0) [0|100] "%"  ADAS
 SG_ DET_OUTSIDE_SECTOR_221 : 159|1@1+ (1,0) [0|1] ""  ADAS
 SG_ DET_HVC_FLAG_221 : 118|1@1+ (1,0) [0|1] ""  ADAS
 SG_ DET_CONFD_AZIMUTH_221 : 126|2@1+ (1,0) [0|3] ""  ADAS
 SG_ DET_CONFD_ELEVATION_221 : 112|2@1+ (1,0) [0|3] ""  ADAS
 SG_ DET_RANGE_222 : 144|15@1+ (0.015625,0) [0|500] "m"  ADAS
 SG_ DET_RANGE_ERR_222 : 160|7@1+ (0.0075,0) [0|0.9525] "m"  ADAS
 SG_ DET_RANGE_VELOCITY_222 : 168|15@1+ (0.0078125,-128) [-128|127.9921875] "m/s"  ADAS
 SG_ DET_RANGE_VELOCITY_ERR_222 : 184|8@1+ (0.003,0) [0|0.765] "m/s"  ADAS
 SG_ DET_AZIMUTH_222 : 208|13@1+ (0.0004,-1.5708) [-1.5708|1.5708] "rad"  ADAS
 SG_ DET_AZIMUTH_ERR_222 : 224|7@1+ (0.00087267,0) [0|0.11082909] "rad"  ADAS
 SG_ DET_ELEVATION_222 : 192|8@1+ (0.00275,-0.34925) [-0.34925|0.34925] "rad"  ADAS
 SG_ DET_ELEVATION_ERR_222 : 200|6@1+ (0.00174533,0) [0|0.10995579] "rad"  ADAS
 SG_ DET_RCS_222 : 256|8@1+ (0.5,-64) [-64|63.5] "dBsm"  ADAS
 SG_ DET_VALID_FLAG_222 : 167|1@1+ (1,0) [0|1] ""  ADAS
 SG_ DET_BI_STATIC_FLAG_222 : 505|1@1+ (1,0) [0|1] ""  ADAS
 SG_ DET_SUPER_RES_TARGET_222 : 247|1@1+ (1,0) [0|1] ""  ADAS
 SG_ DET_SNR_222 : 248|8@1+ (0.35156,0) [0|89.6478] "dB"  ADAS
 SG_ DET_POINT_TARGET_PROB_222 : 240|4@1+ (6.67,0) [0|100] "%"  ADAS
 SG_ DET_EXISTENCE_PROB_222 : 232|6@1+ (1.588,0) [0|100] "%"  ADAS
 SG_ DET_OUTSIDE_SECTOR_222 : 183|1@1+ (1,0) [0|1] ""  ADAS
 SG_ DET_HVC_FLAG_222 : 246|1@1+ (1,0) [0|1] ""  ADAS
 SG_ DET_CONFD_AZIMUTH_222 : 206|2@1+ (1,0) [0|3] ""  ADAS
 SG_ DET_CONFD_ELEVATION_222 : 244|2@1+ (1,0) [0|3] ""  ADAS
 SG_ DET_RANGE_223 : 264|15@1+ (0.015625,0) [0|500] "m"  ADAS
 SG_ DET_RANGE_ERR_223 : 280|7@1+ (0.0075,0) [0|0.9525] "m"  ADAS
 SG_ DET_RANGE_VELOCITY_223 : 288|15@1+ (0.0078125,-128) [-128|127.9921875] "m/s"  ADAS
 SG_ DET_RANGE_VELOCITY_ERR_223 : 304|8@1+ (0.003,0) [0|0.765] "m/s"  ADAS
 SG_ DET_AZIMUTH_223 : 328|13@1+ (0.0004,-1.5708) [-1.5708|1.5708] "rad"  ADAS
 SG_ DET_AZIMUTH_ERR_223 : 345|7@1+ (0.00087267,0) [0|0.11082909] "rad"  ADAS
 SG_ DET_ELEVATION_223 : 312|8@1+ (0.00275,-0.34925) [-0.34925|0.34925] "rad"  ADAS
 SG_ DET_ELEVATION_ERR_223 : 320|6@1+ (0.00174533,0) [0|0.10995579] "rad"  ADAS
 SG_ DET_RCS_223 : 376|8@1+ (0.5,-64) [-64|63.5] "dBsm"  ADAS
 SG_ DET_VALID_FLAG_223 : 399|1@1+ (1,0) [0|1] ""  ADAS
 SG_ DET_BI_STATIC_FLAG_223 : 482|1@1+ (1,0) [0|1] ""  ADAS
 SG_ DET_SUPER_RES_TARGET_223 : 344|1@1+ (1,0) [0|1] ""  ADAS
 SG_ DET_SNR_223 : 368|8@1+ (0.35156,0) [0|89.6478] "dB"  ADAS
 SG_ DET_POINT_TARGET_PROB_223 : 360|4@1+ (6.67,0) [0|100] "%"  ADAS
 SG_ DET_EXISTENCE_PROB_223 : 352|6@1+ (1.588,0) [0|100] "%"  ADAS
 SG_ DET_OUTSIDE_SECTOR_223 : 407|1@1+ (1,0) [0|1] ""  ADAS
 SG_ DET_HVC_FLAG_223 : 364|1@1+ (1,0) [0|1] ""  ADAS
 SG_ DET_CONFD_AZIMUTH_223 : 365|2@1+ (1,0) [0|3] ""  ADAS
 SG_ DET_CONFD_ELEVATION_223 : 358|2@1+ (1,0) [0|3] ""  ADAS
 SG_ DET_RANGE_224 : 384|15@1+ (0.015625,0) [0|500] "m"  ADAS
 SG_ DET_RANGE_ERR_224 : 400|7@1+ (0.0075,0) [0|0.9525] "m"  ADAS
 SG_ DET_RANGE_VELOCITY_224 : 408|15@1+ (0.0078125,-128) [-128|127.9921875] "m/s"  ADAS
 SG_ DET_RANGE_VELOCITY_ERR_224 : 424|8@1+ (0.003,0) [0|0.765] "m/s"  ADAS
 SG_ DET_AZIMUTH_224 : 448|13@1+ (0.0004,-1.5708) [-1.5708|1.5708] "rad"  ADAS
 SG_ DET_AZIMUTH_ERR_224 : 465|7@1+ (0.00087267,0) [0|0.11082909] "rad"  ADAS
 SG_ DET_ELEVATION_224 : 432|8@1+ (0.00275,-0.34925) [-0.34925|0.34925] "rad"  ADAS
 SG_ DET_ELEVATION_ERR_224 : 440|6@1+ (0.00174533,0) [0|0.10995579] "rad"  ADAS
 SG_ DET_RCS_224 : 496|8@1+ (0.5,-64) [-64|63.5] "dBsm"  ADAS
 SG_ DET_VALID_FLAG_224 : 485|1@1+ (1,0) [0|1] ""  ADAS
 SG_ DET_BI_STATIC_FLAG_224 : 483|1@1+ (1,0) [0|1] ""  ADAS
 SG_ DET_SUPER_RES_TARGET_224 : 446|1@1+ (1,0) [0|1] ""  ADAS
 SG_ DET_SNR_224 : 488|8@1+ (0.35156,0) [0|89.6478] "dB"  ADAS
 SG_ DET_POINT_TARGET_PROB_224 : 472|4@1+ (6.67,0) [0|100] "%"  ADAS
 SG_ DET_EXISTENCE_PROB_224 : 506|6@1+ (1.588,0) [0|100] "%"  ADAS
 SG_ DET_OUTSIDE_SECTOR_224 : 481|1@1+ (1,0) [0|1] ""  ADAS
 SG_ DET_HVC_FLAG_224 : 464|1@1+ (1,0) [0|1] ""  ADAS
 SG_ DET_CONFD_AZIMUTH_224 : 486|2@1+ (1,0) [0|3] ""  ADAS
 SG_ DET_CONFD_ELEVATION_224 : 461|2@1+ (1,0) [0|3] ""  ADAS
 SG_ DET_MH_SCAN_INDEX_4LSB_221_224 : 476|4@1+ (1,0) [0|15] ""  ADAS
 SG_ DET_MH_CYCLE_COUNTER_221_224 : 16|8@1+ (1,0) [0|255] ""  ADAS
 SG_ DET_MH_CRC16_221_224 : 0|16@1+ (1,0) [0|65535] ""  ADAS

BO_ 1080 RDR_DETECTION_225_228: 64 RDR07
 SG_ DET_RANGE_225 : 24|15@1+ (0.015625,0) [0|500] "m"  ADAS
 SG_ DET_RANGE_ERR_225 : 40|7@1+ (0.0075,0) [0|0.9525] "m"  ADAS
 SG_ DET_RANGE_VELOCITY_225 : 48|15@1+ (0.0078125,-128) [-128|127.9921875] "m/s"  ADAS
 SG_ DET_RANGE_VELOCITY_ERR_225 : 64|8@1+ (0.003,0) [0|0.765] "m/s"  ADAS
 SG_ DET_AZIMUTH_225 : 88|13@1+ (0.0004,-1.5708) [-1.5708|1.5708] "rad"  ADAS
 SG_ DET_AZIMUTH_ERR_225 : 105|7@1+ (0.00087267,0) [0|0.11082909] "rad"  ADAS
 SG_ DET_ELEVATION_225 : 72|8@1+ (0.00275,-0.34925) [-0.34925|0.34925] "rad"  ADAS
 SG_ DET_ELEVATION_ERR_225 : 80|6@1+ (0.00174533,0) [0|0.10995579] "rad"  ADAS
 SG_ DET_RCS_225 : 136|8@1+ (0.5,-64) [-64|63.5] "dBsm"  ADAS
 SG_ DET_VALID_FLAG_225 : 119|1@1+ (1,0) [0|1] ""  ADAS
 SG_ DET_BI_STATIC_FLAG_225 : 504|1@1+ (1,0) [0|1] ""  ADAS
 SG_ DET_SUPER_RES_TARGET_225 : 104|1@1+ (1,0) [0|1] ""  ADAS
 SG_ DET_SNR_225 : 128|8@1+ (0.35156,0) [0|89.6478] "dB"  ADAS
 SG_ DET_POINT_TARGET_PROB_225 : 114|4@1+ (6.67,0) [0|100] "%"  ADAS
 SG_ DET_EXISTENCE_PROB_225 : 120|6@1+ (1.588,0) [0|100] "%"  ADAS
 SG_ DET_OUTSIDE_SECTOR_225 : 159|1@1+ (1,0) [0|1] ""  ADAS
 SG_ DET_HVC_FLAG_225 : 118|1@1+ (1,0) [0|1] ""  ADAS
 SG_ DET_CONFD_AZIMUTH_225 : 126|2@1+ (1,0) [0|3] ""  ADAS
 SG_ DET_CONFD_ELEVATION_225 : 112|2@1+ (1,0) [0|3] ""  ADAS
 SG_ DET_RANGE_226 : 144|15@1+ (0.015625,0) [0|500] "m"  ADAS
 SG_ DET_RANGE_ERR_226 : 160|7@1+ (0.0075,0) [0|0.9525] "m"  ADAS
 SG_ DET_RANGE_VELOCITY_226 : 168|15@1+ (0.0078125,-128) [-128|127.9921875] "m/s"  ADAS
 SG_ DET_RANGE_VELOCITY_ERR_226 : 184|8@1+ (0.003,0) [0|0.765] "m/s"  ADAS
 SG_ DET_AZIMUTH_226 : 208|13@1+ (0.0004,-1.5708) [-1.5708|1.5708] "rad"  ADAS
 SG_ DET_AZIMUTH_ERR_226 : 224|7@1+ (0.00087267,0) [0|0.11082909] "rad"  ADAS
 SG_ DET_ELEVATION_226 : 192|8@1+ (0.00275,-0.34925) [-0.34925|0.34925] "rad"  ADAS
 SG_ DET_ELEVATION_ERR_226 : 200|6@1+ (0.00174533,0) [0|0.10995579] "rad"  ADAS
 SG_ DET_RCS_226 : 256|8@1+ (0.5,-64) [-64|63.5] "dBsm"  ADAS
 SG_ DET_VALID_FLAG_226 : 167|1@1+ (1,0) [0|1] ""  ADAS
 SG_ DET_BI_STATIC_FLAG_226 : 505|1@1+ (1,0) [0|1] ""  ADAS
 SG_ DET_SUPER_RES_TARGET_226 : 247|1@1+ (1,0) [0|1] ""  ADAS
 SG_ DET_SNR_226 : 248|8@1+ (0.35156,0) [0|89.6478] "dB"  ADAS
 SG_ DET_POINT_TARGET_PROB_226 : 240|4@1+ (6.67,0) [0|100] "%"  ADAS
 SG_ DET_EXISTENCE_PROB_226 : 232|6@1+ (1.588,0) [0|100] "%"  ADAS
 SG_ DET_OUTSIDE_SECTOR_226 : 183|1@1+ (1,0) [0|1] ""  ADAS
 SG_ DET_HVC_FLAG_226 : 246|1@1+ (1,0) [0|1] ""  ADAS
 SG_ DET_CONFD_AZIMUTH_226 : 206|2@1+ (1,0) [0|3] ""  ADAS
 SG_ DET_CONFD_ELEVATION_226 : 244|2@1+ (1,0) [0|3] ""  ADAS
 SG_ DET_RANGE_227 : 264|15@1+ (0.015625,0) [0|500] "m"  ADAS
 SG_ DET_RANGE_ERR_227 : 280|7@1+ (0.0075,0) [0|0.9525] "m"  ADAS
 SG_ DET_RANGE_VELOCITY_227 : 288|15@1+ (0.0078125,-128) [-128|127.9921875] "m/s"  ADAS
 SG_ DET_RANGE_VELOCITY_ERR_227 : 304|8@1+ (0.003,0) [0|0.765] "m/s"  ADAS
 SG_ DET_AZIMUTH_227 : 328|13@1+ (0.0004,-1.5708) [-1.5708|1.5708] "rad"  ADAS
 SG_ DET_AZIMUTH_ERR_227 : 345|7@1+ (0.00087267,0) [0|0.11082909] "rad"  ADAS
 SG_ DET_ELEVATION_227 : 312|8@1+ (0.00275,-0.34925) [-0.34925|0.34925] "rad"  ADAS
 SG_ DET_ELEVATION_ERR_227 : 320|6@1+ (0.00174533,0) [0|0.10995579] "rad"  ADAS
 SG_ DET_RCS_227 : 376|8@1+ (0.5,-64) [-64|63.5] "dBsm"  ADAS
 SG_ DET_VALID_FLAG_227 : 399|1@1+ (1,0) [0|1] ""  ADAS
 SG_ DET_BI_STATIC_FLAG_227 : 482|1@1+ (1,0) [0|1] ""  ADAS
 SG_ DET_SUPER_RES_TARGET_227 : 344|1@1+ (1,0) [0|1] ""  ADAS
 SG_ DET_SNR_227 : 368|8@1+ (0.35156,0) [0|89.6478] "dB"  ADAS
 SG_ DET_POINT_TARGET_PROB_227 : 360|4@1+ (6.67,0) [0|100] "%"  ADAS
 SG_ DET_EXISTENCE_PROB_227 : 352|6@1+ (1.588,0) [0|100] "%"  ADAS
 SG_ DET_OUTSIDE_SECTOR_227 : 407|1@1+ (1,0) [0|1] ""  ADAS
 SG_ DET_HVC_FLAG_227 : 364|1@1+ (1,0) [0|1] ""  ADAS
 SG_ DET_CONFD_AZIMUTH_227 : 365|2@1+ (1,0) [0|3] ""  ADAS
 SG_ DET_CONFD_ELEVATION_227 : 358|2@1+ (1,0) [0|3] ""  ADAS
 SG_ DET_RANGE_228 : 384|15@1+ (0.015625,0) [0|500] "m"  ADAS
 SG_ DET_RANGE_ERR_228 : 400|7@1+ (0.0075,0) [0|0.9525] "m"  ADAS
 SG_ DET_RANGE_VELOCITY_228 : 408|15@1+ (0.0078125,-128) [-128|127.9921875] "m/s"  ADAS
 SG_ DET_RANGE_VELOCITY_ERR_228 : 424|8@1+ (0.003,0) [0|0.765] "m/s"  ADAS
 SG_ DET_AZIMUTH_228 : 448|13@1+ (0.0004,-1.5708) [-1.5708|1.5708] "rad"  ADAS
 SG_ DET_AZIMUTH_ERR_228 : 465|7@1+ (0.00087267,0) [0|0.11082909] "rad"  ADAS
 SG_ DET_ELEVATION_228 : 432|8@1+ (0.00275,-0.34925) [-0.34925|0.34925] "rad"  ADAS
 SG_ DET_ELEVATION_ERR_228 : 440|6@1+ (0.00174533,0) [0|0.10995579] "rad"  ADAS
 SG_ DET_RCS_228 : 496|8@1+ (0.5,-64) [-64|63.5] "dBsm"  ADAS
 SG_ DET_VALID_FLAG_228 : 485|1@1+ (1,0) [0|1] ""  ADAS
 SG_ DET_BI_STATIC_FLAG_228 : 483|1@1+ (1,0) [0|1] ""  ADAS
 SG_ DET_SUPER_RES_TARGET_228 : 446|1@1+ (1,0) [0|1] ""  ADAS
 SG_ DET_SNR_228 : 488|8@1+ (0.35156,0) [0|89.6478] "dB"  ADAS
 SG_ DET_POINT_TARGET_PROB_228 : 472|4@1+ (6.67,0) [0|100] "%"  ADAS
 SG_ DET_EXISTENCE_PROB_228 : 506|6@1+ (1.588,0) [0|100] "%"  ADAS
 SG_ DET_OUTSIDE_SECTOR_228 : 481|1@1+ (1,0) [0|1] ""  ADAS
 SG_ DET_HVC_FLAG_228 : 464|1@1+ (1,0) [0|1] ""  ADAS
 SG_ DET_CONFD_AZIMUTH_228 : 486|2@1+ (1,0) [0|3] ""  ADAS
 SG_ DET_CONFD_ELEVATION_228 : 461|2@1+ (1,0) [0|3] ""  ADAS
 SG_ DET_MH_SCAN_INDEX_4LSB_225_228 : 476|4@1+ (1,0) [0|15] ""  ADAS
 SG_ DET_MH_CYCLE_COUNTER_225_228 : 16|8@1+ (1,0) [0|255] ""  ADAS
 SG_ DET_MH_CRC16_225_228 : 0|16@1+ (1,0) [0|65535] ""  ADAS

BO_ 1081 RDR_DETECTION_229_232: 64 RDR07
 SG_ DET_RANGE_229 : 24|15@1+ (0.015625,0) [0|500] "m"  ADAS
 SG_ DET_RANGE_ERR_229 : 40|7@1+ (0.0075,0) [0|0.9525] "m"  ADAS
 SG_ DET_RANGE_VELOCITY_229 : 48|15@1+ (0.0078125,-128) [-128|127.9921875] "m/s"  ADAS
 SG_ DET_RANGE_VELOCITY_ERR_229 : 64|8@1+ (0.003,0) [0|0.765] "m/s"  ADAS
 SG_ DET_AZIMUTH_229 : 88|13@1+ (0.0004,-1.5708) [-1.5708|1.5708] "rad"  ADAS
 SG_ DET_AZIMUTH_ERR_229 : 105|7@1+ (0.00087267,0) [0|0.11082909] "rad"  ADAS
 SG_ DET_ELEVATION_229 : 72|8@1+ (0.00275,-0.34925) [-0.34925|0.34925] "rad"  ADAS
 SG_ DET_ELEVATION_ERR_229 : 80|6@1+ (0.00174533,0) [0|0.10995579] "rad"  ADAS
 SG_ DET_RCS_229 : 136|8@1+ (0.5,-64) [-64|63.5] "dBsm"  ADAS
 SG_ DET_VALID_FLAG_229 : 119|1@1+ (1,0) [0|1] ""  ADAS
 SG_ DET_BI_STATIC_FLAG_229 : 504|1@1+ (1,0) [0|1] ""  ADAS
 SG_ DET_SUPER_RES_TARGET_229 : 104|1@1+ (1,0) [0|1] ""  ADAS
 SG_ DET_SNR_229 : 128|8@1+ (0.35156,0) [0|89.6478] "dB"  ADAS
 SG_ DET_POINT_TARGET_PROB_229 : 114|4@1+ (6.67,0) [0|100] "%"  ADAS
 SG_ DET_EXISTENCE_PROB_229 : 120|6@1+ (1.588,0) [0|100] "%"  ADAS
 SG_ DET_OUTSIDE_SECTOR_229 : 159|1@1+ (1,0) [0|1] ""  ADAS
 SG_ DET_HVC_FLAG_229 : 118|1@1+ (1,0) [0|1] ""  ADAS
 SG_ DET_CONFD_AZIMUTH_229 : 126|2@1+ (1,0) [0|3] ""  ADAS
 SG_ DET_CONFD_ELEVATION_229 : 112|2@1+ (1,0) [0|3] ""  ADAS
 SG_ DET_RANGE_230 : 144|15@1+ (0.015625,0) [0|500] "m"  ADAS
 SG_ DET_RANGE_ERR_230 : 160|7@1+ (0.0075,0) [0|0.9525] "m"  ADAS
 SG_ DET_RANGE_VELOCITY_230 : 168|15@1+ (0.0078125,-128) [-128|127.9921875] "m/s"  ADAS
 SG_ DET_RANGE_VELOCITY_ERR_230 : 184|8@1+ (0.003,0) [0|0.765] "m/s"  ADAS
 SG_ DET_AZIMUTH_230 : 208|13@1+ (0.0004,-1.5708) [-1.5708|1.5708] "rad"  ADAS
 SG_ DET_AZIMUTH_ERR_230 : 224|7@1+ (0.00087267,0) [0|0.11082909] "rad"  ADAS
 SG_ DET_ELEVATION_230 : 192|8@1+ (0.00275,-0.34925) [-0.34925|0.34925] "rad"  ADAS
 SG_ DET_ELEVATION_ERR_230 : 200|6@1+ (0.00174533,0) [0|0.10995579] "rad"  ADAS
 SG_ DET_RCS_230 : 256|8@1+ (0.5,-64) [-64|63.5] "dBsm"  ADAS
 SG_ DET_VALID_FLAG_230 : 167|1@1+ (1,0) [0|1] ""  ADAS
 SG_ DET_BI_STATIC_FLAG_230 : 505|1@1+ (1,0) [0|1] ""  ADAS
 SG_ DET_SUPER_RES_TARGET_230 : 247|1@1+ (1,0) [0|1] ""  ADAS
 SG_ DET_SNR_230 : 248|8@1+ (0.35156,0) [0|89.6478] "dB"  ADAS
 SG_ DET_POINT_TARGET_PROB_230 : 240|4@1+ (6.67,0) [0|100] "%"  ADAS
 SG_ DET_EXISTENCE_PROB_230 : 232|6@1+ (1.588,0) [0|100] "%"  ADAS
 SG_ DET_OUTSIDE_SECTOR_230 : 183|1@1+ (1,0) [0|1] ""  ADAS
 SG_ DET_HVC_FLAG_230 : 246|1@1+ (1,0) [0|1] ""  ADAS
 SG_ DET_CONFD_AZIMUTH_230 : 206|2@1+ (1,0) [0|3] ""  ADAS
 SG_ DET_CONFD_ELEVATION_230 : 244|2@1+ (1,0) [0|3] ""  ADAS
 SG_ DET_RANGE_231 : 264|15@1+ (0.015625,0) [0|500] "m"  ADAS
 SG_ DET_RANGE_ERR_231 : 280|7@1+ (0.0075,0) [0|0.9525] "m"  ADAS
 SG_ DET_RANGE_VELOCITY_231 : 288|15@1+ (0.0078125,-128) [-128|127.9921875] "m/s"  ADAS
 SG_ DET_RANGE_VELOCITY_ERR_231 : 304|8@1+ (0.003,0) [0|0.765] "m/s"  ADAS
 SG_ DET_AZIMUTH_231 : 328|13@1+ (0.0004,-1.5708) [-1.5708|1.5708] "rad"  ADAS
 SG_ DET_AZIMUTH_ERR_231 : 345|7@1+ (0.00087267,0) [0|0.11082909] "rad"  ADAS
 SG_ DET_ELEVATION_231 : 312|8@1+ (0.00275,-0.34925) [-0.34925|0.34925] "rad"  ADAS
 SG_ DET_ELEVATION_ERR_231 : 320|6@1+ (0.00174533,0) [0|0.10995579] "rad"  ADAS
 SG_ DET_RCS_231 : 376|8@1+ (0.5,-64) [-64|63.5] "dBsm"  ADAS
 SG_ DET_VALID_FLAG_231 : 399|1@1+ (1,0) [0|1] ""  ADAS
 SG_ DET_BI_STATIC_FLAG_231 : 482|1@1+ (1,0) [0|1] ""  ADAS
 SG_ DET_SUPER_RES_TARGET_231 : 344|1@1+ (1,0) [0|1] ""  ADAS
 SG_ DET_SNR_231 : 368|8@1+ (0.35156,0) [0|89.6478] "dB"  ADAS
 SG_ DET_POINT_TARGET_PROB_231 : 360|4@1+ (6.67,0) [0|100] "%"  ADAS
 SG_ DET_EXISTENCE_PROB_231 : 352|6@1+ (1.588,0) [0|100] "%"  ADAS
 SG_ DET_OUTSIDE_SECTOR_231 : 407|1@1+ (1,0) [0|1] ""  ADAS
 SG_ DET_HVC_FLAG_231 : 364|1@1+ (1,0) [0|1] ""  ADAS
 SG_ DET_CONFD_AZIMUTH_231 : 365|2@1+ (1,0) [0|3] ""  ADAS
 SG_ DET_CONFD_ELEVATION_231 : 358|2@1+ (1,0) [0|3] ""  ADAS
 SG_ DET_RANGE_232 : 384|15@1+ (0.015625,0) [0|500] "m"  ADAS
 SG_ DET_RANGE_ERR_232 : 400|7@1+ (0.0075,0) [0|0.9525] "m"  ADAS
 SG_ DET_RANGE_VELOCITY_232 : 408|15@1+ (0.0078125,-128) [-128|127.9921875] "m/s"  ADAS
 SG_ DET_RANGE_VELOCITY_ERR_232 : 424|8@1+ (0.003,0) [0|0.765] "m/s"  ADAS
 SG_ DET_AZIMUTH_232 : 448|13@1+ (0.0004,-1.5708) [-1.5708|1.5708] "rad"  ADAS
 SG_ DET_AZIMUTH_ERR_232 : 465|7@1+ (0.00087267,0) [0|0.11082909] "rad"  ADAS
 SG_ DET_ELEVATION_232 : 432|8@1+ (0.00275,-0.34925) [-0.34925|0.34925] "rad"  ADAS
 SG_ DET_ELEVATION_ERR_232 : 440|6@1+ (0.00174533,0) [0|0.10995579] "rad"  ADAS
 SG_ DET_RCS_232 : 496|8@1+ (0.5,-64) [-64|63.5] "dBsm"  ADAS
 SG_ DET_VALID_FLAG_232 : 485|1@1+ (1,0) [0|1] ""  ADAS
 SG_ DET_BI_STATIC_FLAG_232 : 483|1@1+ (1,0) [0|1] ""  ADAS
 SG_ DET_SUPER_RES_TARGET_232 : 446|1@1+ (1,0) [0|1] ""  ADAS
 SG_ DET_SNR_232 : 488|8@1+ (0.35156,0) [0|89.6478] "dB"  ADAS
 SG_ DET_POINT_TARGET_PROB_232 : 472|4@1+ (6.67,0) [0|100] "%"  ADAS
 SG_ DET_EXISTENCE_PROB_232 : 506|6@1+ (1.588,0) [0|100] "%"  ADAS
 SG_ DET_OUTSIDE_SECTOR_232 : 481|1@1+ (1,0) [0|1] ""  ADAS
 SG_ DET_HVC_FLAG_232 : 464|1@1+ (1,0) [0|1] ""  ADAS
 SG_ DET_CONFD_AZIMUTH_232 : 486|2@1+ (1,0) [0|3] ""  ADAS
 SG_ DET_CONFD_ELEVATION_232 : 461|2@1+ (1,0) [0|3] ""  ADAS
 SG_ DET_MH_SCAN_INDEX_4LSB_229_232 : 476|4@1+ (1,0) [0|15] ""  ADAS
 SG_ DET_MH_CYCLE_COUNTER_229_232 : 16|8@1+ (1,0) [0|255] ""  ADAS
 SG_ DET_MH_CRC16_229_232 : 0|16@1+ (1,0) [0|65535] ""  ADAS

BO_ 1082 RDR_DETECTION_233_236: 64 RDR07
 SG_ DET_RANGE_233 : 24|15@1+ (0.015625,0) [0|500] "m"  ADAS
 SG_ DET_RANGE_ERR_233 : 40|7@1+ (0.0075,0) [0|0.9525] "m"  ADAS
 SG_ DET_RANGE_VELOCITY_233 : 48|15@1+ (0.0078125,-128) [-128|127.9921875] "m/s"  ADAS
 SG_ DET_RANGE_VELOCITY_ERR_233 : 64|8@1+ (0.003,0) [0|0.765] "m/s"  ADAS
 SG_ DET_AZIMUTH_233 : 88|13@1+ (0.0004,-1.5708) [-1.5708|1.5708] "rad"  ADAS
 SG_ DET_AZIMUTH_ERR_233 : 105|7@1+ (0.00087267,0) [0|0.11082909] "rad"  ADAS
 SG_ DET_ELEVATION_233 : 72|8@1+ (0.00275,-0.34925) [-0.34925|0.34925] "rad"  ADAS
 SG_ DET_ELEVATION_ERR_233 : 80|6@1+ (0.00174533,0) [0|0.10995579] "rad"  ADAS
 SG_ DET_RCS_233 : 136|8@1+ (0.5,-64) [-64|63.5] "dBsm"  ADAS
 SG_ DET_VALID_FLAG_233 : 119|1@1+ (1,0) [0|1] ""  ADAS
 SG_ DET_BI_STATIC_FLAG_233 : 504|1@1+ (1,0) [0|1] ""  ADAS
 SG_ DET_SUPER_RES_TARGET_233 : 104|1@1+ (1,0) [0|1] ""  ADAS
 SG_ DET_SNR_233 : 128|8@1+ (0.35156,0) [0|89.6478] "dB"  ADAS
 SG_ DET_POINT_TARGET_PROB_233 : 114|4@1+ (6.67,0) [0|100] "%"  ADAS
 SG_ DET_EXISTENCE_PROB_233 : 120|6@1+ (1.588,0) [0|100] "%"  ADAS
 SG_ DET_OUTSIDE_SECTOR_233 : 159|1@1+ (1,0) [0|1] ""  ADAS
 SG_ DET_HVC_FLAG_233 : 118|1@1+ (1,0) [0|1] ""  ADAS
 SG_ DET_CONFD_AZIMUTH_233 : 126|2@1+ (1,0) [0|3] ""  ADAS
 SG_ DET_CONFD_ELEVATION_233 : 112|2@1+ (1,0) [0|3] ""  ADAS
 SG_ DET_RANGE_234 : 144|15@1+ (0.015625,0) [0|500] "m"  ADAS
 SG_ DET_RANGE_ERR_234 : 160|7@1+ (0.0075,0) [0|0.9525] "m"  ADAS
 SG_ DET_RANGE_VELOCITY_234 : 168|15@1+ (0.0078125,-128) [-128|127.9921875] "m/s"  ADAS
 SG_ DET_RANGE_VELOCITY_ERR_234 : 184|8@1+ (0.003,0) [0|0.765] "m/s"  ADAS
 SG_ DET_AZIMUTH_234 : 208|13@1+ (0.0004,-1.5708) [-1.5708|1.5708] "rad"  ADAS
 SG_ DET_AZIMUTH_ERR_234 : 224|7@1+ (0.00087267,0) [0|0.11082909] "rad"  ADAS
 SG_ DET_ELEVATION_234 : 192|8@1+ (0.00275,-0.34925) [-0.34925|0.34925] "rad"  ADAS
 SG_ DET_ELEVATION_ERR_234 : 200|6@1+ (0.00174533,0) [0|0.10995579] "rad"  ADAS
 SG_ DET_RCS_234 : 256|8@1+ (0.5,-64) [-64|63.5] "dBsm"  ADAS
 SG_ DET_VALID_FLAG_234 : 167|1@1+ (1,0) [0|1] ""  ADAS
 SG_ DET_BI_STATIC_FLAG_234 : 505|1@1+ (1,0) [0|1] ""  ADAS
 SG_ DET_SUPER_RES_TARGET_234 : 247|1@1+ (1,0) [0|1] ""  ADAS
 SG_ DET_SNR_234 : 248|8@1+ (0.35156,0) [0|89.6478] "dB"  ADAS
 SG_ DET_POINT_TARGET_PROB_234 : 240|4@1+ (6.67,0) [0|100] "%"  ADAS
 SG_ DET_EXISTENCE_PROB_234 : 232|6@1+ (1.588,0) [0|100] "%"  ADAS
 SG_ DET_OUTSIDE_SECTOR_234 : 183|1@1+ (1,0) [0|1] ""  ADAS
 SG_ DET_HVC_FLAG_234 : 246|1@1+ (1,0) [0|1] ""  ADAS
 SG_ DET_CONFD_AZIMUTH_234 : 206|2@1+ (1,0) [0|3] ""  ADAS
 SG_ DET_CONFD_ELEVATION_234 : 244|2@1+ (1,0) [0|3] ""  ADAS
 SG_ DET_RANGE_235 : 264|15@1+ (0.015625,0) [0|500] "m"  ADAS
 SG_ DET_RANGE_ERR_235 : 280|7@1+ (0.0075,0) [0|0.9525] "m"  ADAS
 SG_ DET_RANGE_VELOCITY_235 : 288|15@1+ (0.0078125,-128) [-128|127.9921875] "m/s"  ADAS
 SG_ DET_RANGE_VELOCITY_ERR_235 : 304|8@1+ (0.003,0) [0|0.765] "m/s"  ADAS
 SG_ DET_AZIMUTH_235 : 328|13@1+ (0.0004,-1.5708) [-1.5708|1.5708] "rad"  ADAS
 SG_ DET_AZIMUTH_ERR_235 : 345|7@1+ (0.00087267,0) [0|0.11082909] "rad"  ADAS
 SG_ DET_ELEVATION_235 : 312|8@1+ (0.00275,-0.34925) [-0.34925|0.34925] "rad"  ADAS
 SG_ DET_ELEVATION_ERR_235 : 320|6@1+ (0.00174533,0) [0|0.10995579] "rad"  ADAS
 SG_ DET_RCS_235 : 376|8@1+ (0.5,-64) [-64|63.5] "dBsm"  ADAS
 SG_ DET_VALID_FLAG_235 : 399|1@1+ (1,0) [0|1] ""  ADAS
 SG_ DET_BI_STATIC_FLAG_235 : 482|1@1+ (1,0) [0|1] ""  ADAS
 SG_ DET_SUPER_RES_TARGET_235 : 344|1@1+ (1,0) [0|1] ""  ADAS
 SG_ DET_SNR_235 : 368|8@1+ (0.35156,0) [0|89.6478] "dB"  ADAS
 SG_ DET_POINT_TARGET_PROB_235 : 360|4@1+ (6.67,0) [0|100] "%"  ADAS
 SG_ DET_EXISTENCE_PROB_235 : 352|6@1+ (1.588,0) [0|100] "%"  ADAS
 SG_ DET_OUTSIDE_SECTOR_235 : 407|1@1+ (1,0) [0|1] ""  ADAS
 SG_ DET_HVC_FLAG_235 : 364|1@1+ (1,0) [0|1] ""  ADAS
 SG_ DET_CONFD_AZIMUTH_235 : 365|2@1+ (1,0) [0|3] ""  ADAS
 SG_ DET_CONFD_ELEVATION_235 : 358|2@1+ (1,0) [0|3] ""  ADAS
 SG_ DET_RANGE_236 : 384|15@1+ (0.015625,0) [0|500] "m"  ADAS
 SG_ DET_RANGE_ERR_236 : 400|7@1+ (0.0075,0) [0|0.9525] "m"  ADAS
 SG_ DET_RANGE_VELOCITY_236 : 408|15@1+ (0.0078125,-128) [-128|127.9921875] "m/s"  ADAS
 SG_ DET_RANGE_VELOCITY_ERR_236 : 424|8@1+ (0.003,0) [0|0.765] "m/s"  ADAS
 SG_ DET_AZIMUTH_236 : 448|13@1+ (0.0004,-1.5708) [-1.5708|1.5708] "rad"  ADAS
 SG_ DET_AZIMUTH_ERR_236 : 465|7@1+ (0.00087267,0) [0|0.11082909] "rad"  ADAS
 SG_ DET_ELEVATION_236 : 432|8@1+ (0.00275,-0.34925) [-0.34925|0.34925] "rad"  ADAS
 SG_ DET_ELEVATION_ERR_236 : 440|6@1+ (0.00174533,0) [0|0.10995579] "rad"  ADAS
 SG_ DET_RCS_236 : 496|8@1+ (0.5,-64) [-64|63.5] "dBsm"  ADAS
 SG_ DET_VALID_FLAG_236 : 485|1@1+ (1,0) [0|1] ""  ADAS
 SG_ DET_BI_STATIC_FLAG_236 : 483|1@1+ (1,0) [0|1] ""  ADAS
 SG_ DET_SUPER_RES_TARGET_236 : 446|1@1+ (1,0) [0|1] ""  ADAS
 SG_ DET_SNR_236 : 488|8@1+ (0.35156,0) [0|89.6478] "dB"  ADAS
 SG_ DET_POINT_TARGET_PROB_236 : 472|4@1+ (6.67,0) [0|100] "%"  ADAS
 SG_ DET_EXISTENCE_PROB_236 : 506|6@1+ (1.588,0) [0|100] "%"  ADAS
 SG_ DET_OUTSIDE_SECTOR_236 : 481|1@1+ (1,0) [0|1] ""  ADAS
 SG_ DET_HVC_FLAG_236 : 464|1@1+ (1,0) [0|1] ""  ADAS
 SG_ DET_CONFD_AZIMUTH_236 : 486|2@1+ (1,0) [0|3] ""  ADAS
 SG_ DET_CONFD_ELEVATION_236 : 461|2@1+ (1,0) [0|3] ""  ADAS
 SG_ DET_MH_SCAN_INDEX_4LSB_233_236 : 476|4@1+ (1,0) [0|15] ""  ADAS
 SG_ DET_MH_CYCLE_COUNTER_233_236 : 16|8@1+ (1,0) [0|255] ""  ADAS
 SG_ DET_MH_CRC16_233_236 : 0|16@1+ (1,0) [0|65535] ""  ADAS

BO_ 1083 RDR_DETECTION_237_240: 64 RDR07
 SG_ DET_RANGE_237 : 24|15@1+ (0.015625,0) [0|500] "m"  ADAS
 SG_ DET_RANGE_ERR_237 : 40|7@1+ (0.0075,0) [0|0.9525] "m"  ADAS
 SG_ DET_RANGE_VELOCITY_237 : 48|15@1+ (0.0078125,-128) [-128|127.9921875] "m/s"  ADAS
 SG_ DET_RANGE_VELOCITY_ERR_237 : 64|8@1+ (0.003,0) [0|0.765] "m/s"  ADAS
 SG_ DET_AZIMUTH_237 : 88|13@1+ (0.0004,-1.5708) [-1.5708|1.5708] "rad"  ADAS
 SG_ DET_AZIMUTH_ERR_237 : 105|7@1+ (0.00087267,0) [0|0.11082909] "rad"  ADAS
 SG_ DET_ELEVATION_237 : 72|8@1+ (0.00275,-0.34925) [-0.34925|0.34925] "rad"  ADAS
 SG_ DET_ELEVATION_ERR_237 : 80|6@1+ (0.00174533,0) [0|0.10995579] "rad"  ADAS
 SG_ DET_RCS_237 : 136|8@1+ (0.5,-64) [-64|63.5] "dBsm"  ADAS
 SG_ DET_VALID_FLAG_237 : 119|1@1+ (1,0) [0|1] ""  ADAS
 SG_ DET_BI_STATIC_FLAG_237 : 504|1@1+ (1,0) [0|1] ""  ADAS
 SG_ DET_SUPER_RES_TARGET_237 : 104|1@1+ (1,0) [0|1] ""  ADAS
 SG_ DET_SNR_237 : 128|8@1+ (0.35156,0) [0|89.6478] "dB"  ADAS
 SG_ DET_POINT_TARGET_PROB_237 : 114|4@1+ (6.67,0) [0|100] "%"  ADAS
 SG_ DET_EXISTENCE_PROB_237 : 120|6@1+ (1.588,0) [0|100] "%"  ADAS
 SG_ DET_OUTSIDE_SECTOR_237 : 159|1@1+ (1,0) [0|1] ""  ADAS
 SG_ DET_HVC_FLAG_237 : 118|1@1+ (1,0) [0|1] ""  ADAS
 SG_ DET_CONFD_AZIMUTH_237 : 126|2@1+ (1,0) [0|3] ""  ADAS
 SG_ DET_CONFD_ELEVATION_237 : 112|2@1+ (1,0) [0|3] ""  ADAS
 SG_ DET_RANGE_238 : 144|15@1+ (0.015625,0) [0|500] "m"  ADAS
 SG_ DET_RANGE_ERR_238 : 160|7@1+ (0.0075,0) [0|0.9525] "m"  ADAS
 SG_ DET_RANGE_VELOCITY_238 : 168|15@1+ (0.0078125,-128) [-128|127.9921875] "m/s"  ADAS
 SG_ DET_RANGE_VELOCITY_ERR_238 : 184|8@1+ (0.003,0) [0|0.765] "m/s"  ADAS
 SG_ DET_AZIMUTH_238 : 208|13@1+ (0.0004,-1.5708) [-1.5708|1.5708] "rad"  ADAS
 SG_ DET_AZIMUTH_ERR_238 : 224|7@1+ (0.00087267,0) [0|0.11082909] "rad"  ADAS
 SG_ DET_ELEVATION_238 : 192|8@1+ (0.00275,-0.34925) [-0.34925|0.34925] "rad"  ADAS
 SG_ DET_ELEVATION_ERR_238 : 200|6@1+ (0.00174533,0) [0|0.10995579] "rad"  ADAS
 SG_ DET_RCS_238 : 256|8@1+ (0.5,-64) [-64|63.5] "dBsm"  ADAS
 SG_ DET_VALID_FLAG_238 : 167|1@1+ (1,0) [0|1] ""  ADAS
 SG_ DET_BI_STATIC_FLAG_238 : 505|1@1+ (1,0) [0|1] ""  ADAS
 SG_ DET_SUPER_RES_TARGET_238 : 247|1@1+ (1,0) [0|1] ""  ADAS
 SG_ DET_SNR_238 : 248|8@1+ (0.35156,0) [0|89.6478] "dB"  ADAS
 SG_ DET_POINT_TARGET_PROB_238 : 240|4@1+ (6.67,0) [0|100] "%"  ADAS
 SG_ DET_EXISTENCE_PROB_238 : 232|6@1+ (1.588,0) [0|100] "%"  ADAS
 SG_ DET_OUTSIDE_SECTOR_238 : 183|1@1+ (1,0) [0|1] ""  ADAS
 SG_ DET_HVC_FLAG_238 : 246|1@1+ (1,0) [0|1] ""  ADAS
 SG_ DET_CONFD_AZIMUTH_238 : 206|2@1+ (1,0) [0|3] ""  ADAS
 SG_ DET_CONFD_ELEVATION_238 : 244|2@1+ (1,0) [0|3] ""  ADAS
 SG_ DET_RANGE_239 : 264|15@1+ (0.015625,0) [0|500] "m"  ADAS
 SG_ DET_RANGE_ERR_239 : 280|7@1+ (0.0075,0) [0|0.9525] "m"  ADAS
 SG_ DET_RANGE_VELOCITY_239 : 288|15@1+ (0.0078125,-128) [-128|127.9921875] "m/s"  ADAS
 SG_ DET_RANGE_VELOCITY_ERR_239 : 304|8@1+ (0.003,0) [0|0.765] "m/s"  ADAS
 SG_ DET_AZIMUTH_239 : 328|13@1+ (0.0004,-1.5708) [-1.5708|1.5708] "rad"  ADAS
 SG_ DET_AZIMUTH_ERR_239 : 345|7@1+ (0.00087267,0) [0|0.11082909] "rad"  ADAS
 SG_ DET_ELEVATION_239 : 312|8@1+ (0.00275,-0.34925) [-0.34925|0.34925] "rad"  ADAS
 SG_ DET_ELEVATION_ERR_239 : 320|6@1+ (0.00174533,0) [0|0.10995579] "rad"  ADAS
 SG_ DET_RCS_239 : 376|8@1+ (0.5,-64) [-64|63.5] "dBsm"  ADAS
 SG_ DET_VALID_FLAG_239 : 399|1@1+ (1,0) [0|1] ""  ADAS
 SG_ DET_BI_STATIC_FLAG_239 : 482|1@1+ (1,0) [0|1] ""  ADAS
 SG_ DET_SUPER_RES_TARGET_239 : 344|1@1+ (1,0) [0|1] ""  ADAS
 SG_ DET_SNR_239 : 368|8@1+ (0.35156,0) [0|89.6478] "dB"  ADAS
 SG_ DET_POINT_TARGET_PROB_239 : 360|4@1+ (6.67,0) [0|100] "%"  ADAS
 SG_ DET_EXISTENCE_PROB_239 : 352|6@1+ (1.588,0) [0|100] "%"  ADAS
 SG_ DET_OUTSIDE_SECTOR_239 : 407|1@1+ (1,0) [0|1] ""  ADAS
 SG_ DET_HVC_FLAG_239 : 364|1@1+ (1,0) [0|1] ""  ADAS
 SG_ DET_CONFD_AZIMUTH_239 : 365|2@1+ (1,0) [0|3] ""  ADAS
 SG_ DET_CONFD_ELEVATION_239 : 358|2@1+ (1,0) [0|3] ""  ADAS
 SG_ DET_RANGE_240 : 384|15@1+ (0.015625,0) [0|500] "m"  ADAS
 SG_ DET_RANGE_ERR_240 : 400|7@1+ (0.0075,0) [0|0.9525] "m"  ADAS
 SG_ DET_RANGE_VELOCITY_240 : 408|15@1+ (0.0078125,-128) [-128|127.9921875] "m/s"  ADAS
 SG_ DET_RANGE_VELOCITY_ERR_240 : 424|8@1+ (0.003,0) [0|0.765] "m/s"  ADAS
 SG_ DET_AZIMUTH_240 : 448|13@1+ (0.0004,-1.5708) [-1.5708|1.5708] "rad"  ADAS
 SG_ DET_AZIMUTH_ERR_240 : 465|7@1+ (0.00087267,0) [0|0.11082909] "rad"  ADAS
 SG_ DET_ELEVATION_240 : 432|8@1+ (0.00275,-0.34925) [-0.34925|0.34925] "rad"  ADAS
 SG_ DET_ELEVATION_ERR_240 : 440|6@1+ (0.00174533,0) [0|0.10995579] "rad"  ADAS
 SG_ DET_RCS_240 : 496|8@1+ (0.5,-64) [-64|63.5] "dBsm"  ADAS
 SG_ DET_VALID_FLAG_240 : 485|1@1+ (1,0) [0|1] ""  ADAS
 SG_ DET_BI_STATIC_FLAG_240 : 483|1@1+ (1,0) [0|1] ""  ADAS
 SG_ DET_SUPER_RES_TARGET_240 : 446|1@1+ (1,0) [0|1] ""  ADAS
 SG_ DET_SNR_240 : 488|8@1+ (0.35156,0) [0|89.6478] "dB"  ADAS
 SG_ DET_POINT_TARGET_PROB_240 : 472|4@1+ (6.67,0) [0|100] "%"  ADAS
 SG_ DET_EXISTENCE_PROB_240 : 506|6@1+ (1.588,0) [0|100] "%"  ADAS
 SG_ DET_OUTSIDE_SECTOR_240 : 481|1@1+ (1,0) [0|1] ""  ADAS
 SG_ DET_HVC_FLAG_240 : 464|1@1+ (1,0) [0|1] ""  ADAS
 SG_ DET_CONFD_AZIMUTH_240 : 486|2@1+ (1,0) [0|3] ""  ADAS
 SG_ DET_CONFD_ELEVATION_240 : 461|2@1+ (1,0) [0|3] ""  ADAS
 SG_ DET_MH_SCAN_INDEX_4LSB_237_240 : 476|4@1+ (1,0) [0|15] ""  ADAS
 SG_ DET_MH_CYCLE_COUNTER_237_240 : 16|8@1+ (1,0) [0|255] ""  ADAS
 SG_ DET_MH_CRC16_237_240 : 0|16@1+ (1,0) [0|65535] ""  ADAS

BO_ 1084 RDR_DETECTION_241_244: 64 RDR07
 SG_ DET_RANGE_241 : 24|15@1+ (0.015625,0) [0|500] "m"  ADAS
 SG_ DET_RANGE_ERR_241 : 40|7@1+ (0.0075,0) [0|0.9525] "m"  ADAS
 SG_ DET_RANGE_VELOCITY_241 : 48|15@1+ (0.0078125,-128) [-128|127.9921875] "m/s"  ADAS
 SG_ DET_RANGE_VELOCITY_ERR_241 : 64|8@1+ (0.003,0) [0|0.765] "m/s"  ADAS
 SG_ DET_AZIMUTH_241 : 88|13@1+ (0.0004,-1.5708) [-1.5708|1.5708] "rad"  ADAS
 SG_ DET_AZIMUTH_ERR_241 : 105|7@1+ (0.00087267,0) [0|0.11082909] "rad"  ADAS
 SG_ DET_ELEVATION_241 : 72|8@1+ (0.00275,-0.34925) [-0.34925|0.34925] "rad"  ADAS
 SG_ DET_ELEVATION_ERR_241 : 80|6@1+ (0.00174533,0) [0|0.10995579] "rad"  ADAS
 SG_ DET_RCS_241 : 136|8@1+ (0.5,-64) [-64|63.5] "dBsm"  ADAS
 SG_ DET_VALID_FLAG_241 : 119|1@1+ (1,0) [0|1] ""  ADAS
 SG_ DET_BI_STATIC_FLAG_241 : 504|1@1+ (1,0) [0|1] ""  ADAS
 SG_ DET_SUPER_RES_TARGET_241 : 104|1@1+ (1,0) [0|1] ""  ADAS
 SG_ DET_SNR_241 : 128|8@1+ (0.35156,0) [0|89.6478] "dB"  ADAS
 SG_ DET_POINT_TARGET_PROB_241 : 114|4@1+ (6.67,0) [0|100] "%"  ADAS
 SG_ DET_EXISTENCE_PROB_241 : 120|6@1+ (1.588,0) [0|100] "%"  ADAS
 SG_ DET_OUTSIDE_SECTOR_241 : 159|1@1+ (1,0) [0|1] ""  ADAS
 SG_ DET_HVC_FLAG_241 : 118|1@1+ (1,0) [0|1] ""  ADAS
 SG_ DET_CONFD_AZIMUTH_241 : 126|2@1+ (1,0) [0|3] ""  ADAS
 SG_ DET_CONFD_ELEVATION_241 : 112|2@1+ (1,0) [0|3] ""  ADAS
 SG_ DET_RANGE_242 : 144|15@1+ (0.015625,0) [0|500] "m"  ADAS
 SG_ DET_RANGE_ERR_242 : 160|7@1+ (0.0075,0) [0|0.9525] "m"  ADAS
 SG_ DET_RANGE_VELOCITY_242 : 168|15@1+ (0.0078125,-128) [-128|127.9921875] "m/s"  ADAS
 SG_ DET_RANGE_VELOCITY_ERR_242 : 184|8@1+ (0.003,0) [0|0.765] "m/s"  ADAS
 SG_ DET_AZIMUTH_242 : 208|13@1+ (0.0004,-1.5708) [-1.5708|1.5708] "rad"  ADAS
 SG_ DET_AZIMUTH_ERR_242 : 224|7@1+ (0.00087267,0) [0|0.11082909] "rad"  ADAS
 SG_ DET_ELEVATION_242 : 192|8@1+ (0.00275,-0.34925) [-0.34925|0.34925] "rad"  ADAS
 SG_ DET_ELEVATION_ERR_242 : 200|6@1+ (0.00174533,0) [0|0.10995579] "rad"  ADAS
 SG_ DET_RCS_242 : 256|8@1+ (0.5,-64) [-64|63.5] "dBsm"  ADAS
 SG_ DET_VALID_FLAG_242 : 167|1@1+ (1,0) [0|1] ""  ADAS
 SG_ DET_BI_STATIC_FLAG_242 : 505|1@1+ (1,0) [0|1] ""  ADAS
 SG_ DET_SUPER_RES_TARGET_242 : 247|1@1+ (1,0) [0|1] ""  ADAS
 SG_ DET_SNR_242 : 248|8@1+ (0.35156,0) [0|89.6478] "dB"  ADAS
 SG_ DET_POINT_TARGET_PROB_242 : 240|4@1+ (6.67,0) [0|100] "%"  ADAS
 SG_ DET_EXISTENCE_PROB_242 : 232|6@1+ (1.588,0) [0|100] "%"  ADAS
 SG_ DET_OUTSIDE_SECTOR_242 : 183|1@1+ (1,0) [0|1] ""  ADAS
 SG_ DET_HVC_FLAG_242 : 246|1@1+ (1,0) [0|1] ""  ADAS
 SG_ DET_CONFD_AZIMUTH_242 : 206|2@1+ (1,0) [0|3] ""  ADAS
 SG_ DET_CONFD_ELEVATION_242 : 244|2@1+ (1,0) [0|3] ""  ADAS
 SG_ DET_RANGE_243 : 264|15@1+ (0.015625,0) [0|500] "m"  ADAS
 SG_ DET_RANGE_ERR_243 : 280|7@1+ (0.0075,0) [0|0.9525] "m"  ADAS
 SG_ DET_RANGE_VELOCITY_243 : 288|15@1+ (0.0078125,-128) [-128|127.9921875] "m/s"  ADAS
 SG_ DET_RANGE_VELOCITY_ERR_243 : 304|8@1+ (0.003,0) [0|0.765] "m/s"  ADAS
 SG_ DET_AZIMUTH_243 : 328|13@1+ (0.0004,-1.5708) [-1.5708|1.5708] "rad"  ADAS
 SG_ DET_AZIMUTH_ERR_243 : 345|7@1+ (0.00087267,0) [0|0.11082909] "rad"  ADAS
 SG_ DET_ELEVATION_243 : 312|8@1+ (0.00275,-0.34925) [-0.34925|0.34925] "rad"  ADAS
 SG_ DET_ELEVATION_ERR_243 : 320|6@1+ (0.00174533,0) [0|0.10995579] "rad"  ADAS
 SG_ DET_RCS_243 : 376|8@1+ (0.5,-64) [-64|63.5] "dBsm"  ADAS
 SG_ DET_VALID_FLAG_243 : 399|1@1+ (1,0) [0|1] ""  ADAS
 SG_ DET_BI_STATIC_FLAG_243 : 482|1@1+ (1,0) [0|1] ""  ADAS
 SG_ DET_SUPER_RES_TARGET_243 : 344|1@1+ (1,0) [0|1] ""  ADAS
 SG_ DET_SNR_243 : 368|8@1+ (0.35156,0) [0|89.6478] "dB"  ADAS
 SG_ DET_POINT_TARGET_PROB_243 : 360|4@1+ (6.67,0) [0|100] "%"  ADAS
 SG_ DET_EXISTENCE_PROB_243 : 352|6@1+ (1.588,0) [0|100] "%"  ADAS
 SG_ DET_OUTSIDE_SECTOR_243 : 407|1@1+ (1,0) [0|1] ""  ADAS
 SG_ DET_HVC_FLAG_243 : 364|1@1+ (1,0) [0|1] ""  ADAS
 SG_ DET_CONFD_AZIMUTH_243 : 365|2@1+ (1,0) [0|3] ""  ADAS
 SG_ DET_CONFD_ELEVATION_243 : 358|2@1+ (1,0) [0|3] ""  ADAS
 SG_ DET_RANGE_244 : 384|15@1+ (0.015625,0) [0|500] "m"  ADAS
 SG_ DET_RANGE_ERR_244 : 400|7@1+ (0.0075,0) [0|0.9525] "m"  ADAS
 SG_ DET_RANGE_VELOCITY_244 : 408|15@1+ (0.0078125,-128) [-128|127.9921875] "m/s"  ADAS
 SG_ DET_RANGE_VELOCITY_ERR_244 : 424|8@1+ (0.003,0) [0|0.765] "m/s"  ADAS
 SG_ DET_AZIMUTH_244 : 448|13@1+ (0.0004,-1.5708) [-1.5708|1.5708] "rad"  ADAS
 SG_ DET_AZIMUTH_ERR_244 : 465|7@1+ (0.00087267,0) [0|0.11082909] "rad"  ADAS
 SG_ DET_ELEVATION_244 : 432|8@1+ (0.00275,-0.34925) [-0.34925|0.34925] "rad"  ADAS
 SG_ DET_ELEVATION_ERR_244 : 440|6@1+ (0.00174533,0) [0|0.10995579] "rad"  ADAS
 SG_ DET_RCS_244 : 496|8@1+ (0.5,-64) [-64|63.5] "dBsm"  ADAS
 SG_ DET_VALID_FLAG_244 : 485|1@1+ (1,0) [0|1] ""  ADAS
 SG_ DET_BI_STATIC_FLAG_244 : 483|1@1+ (1,0) [0|1] ""  ADAS
 SG_ DET_SUPER_RES_TARGET_244 : 446|1@1+ (1,0) [0|1] ""  ADAS
 SG_ DET_SNR_244 : 488|8@1+ (0.35156,0) [0|89.6478] "dB"  ADAS
 SG_ DET_POINT_TARGET_PROB_244 : 472|4@1+ (6.67,0) [0|100] "%"  ADAS
 SG_ DET_EXISTENCE_PROB_244 : 506|6@1+ (1.588,0) [0|100] "%"  ADAS
 SG_ DET_OUTSIDE_SECTOR_244 : 481|1@1+ (1,0) [0|1] ""  ADAS
 SG_ DET_HVC_FLAG_244 : 464|1@1+ (1,0) [0|1] ""  ADAS
 SG_ DET_CONFD_AZIMUTH_244 : 486|2@1+ (1,0) [0|3] ""  ADAS
 SG_ DET_CONFD_ELEVATION_244 : 461|2@1+ (1,0) [0|3] ""  ADAS
 SG_ DET_MH_SCAN_INDEX_4LSB_241_244 : 476|4@1+ (1,0) [0|15] ""  ADAS
 SG_ DET_MH_CYCLE_COUNTER_241_244 : 16|8@1+ (1,0) [0|255] ""  ADAS
 SG_ DET_MH_CRC16_241_244 : 0|16@1+ (1,0) [0|65535] ""  ADAS

BO_ 1085 RDR_DETECTION_245_248: 64 RDR07
 SG_ DET_RANGE_245 : 24|15@1+ (0.015625,0) [0|500] "m"  ADAS
 SG_ DET_RANGE_ERR_245 : 40|7@1+ (0.0075,0) [0|0.9525] "m"  ADAS
 SG_ DET_RANGE_VELOCITY_245 : 48|15@1+ (0.0078125,-128) [-128|127.9921875] "m/s"  ADAS
 SG_ DET_RANGE_VELOCITY_ERR_245 : 64|8@1+ (0.003,0) [0|0.765] "m/s"  ADAS
 SG_ DET_AZIMUTH_245 : 88|13@1+ (0.0004,-1.5708) [-1.5708|1.5708] "rad"  ADAS
 SG_ DET_AZIMUTH_ERR_245 : 105|7@1+ (0.00087267,0) [0|0.11082909] "rad"  ADAS
 SG_ DET_ELEVATION_245 : 72|8@1+ (0.00275,-0.34925) [-0.34925|0.34925] "rad"  ADAS
 SG_ DET_ELEVATION_ERR_245 : 80|6@1+ (0.00174533,0) [0|0.10995579] "rad"  ADAS
 SG_ DET_RCS_245 : 136|8@1+ (0.5,-64) [-64|63.5] "dBsm"  ADAS
 SG_ DET_VALID_FLAG_245 : 119|1@1+ (1,0) [0|1] ""  ADAS
 SG_ DET_BI_STATIC_FLAG_245 : 504|1@1+ (1,0) [0|1] ""  ADAS
 SG_ DET_SUPER_RES_TARGET_245 : 104|1@1+ (1,0) [0|1] ""  ADAS
 SG_ DET_SNR_245 : 128|8@1+ (0.35156,0) [0|89.6478] "dB"  ADAS
 SG_ DET_POINT_TARGET_PROB_245 : 114|4@1+ (6.67,0) [0|100] "%"  ADAS
 SG_ DET_EXISTENCE_PROB_245 : 120|6@1+ (1.588,0) [0|100] "%"  ADAS
 SG_ DET_OUTSIDE_SECTOR_245 : 159|1@1+ (1,0) [0|1] ""  ADAS
 SG_ DET_HVC_FLAG_245 : 118|1@1+ (1,0) [0|1] ""  ADAS
 SG_ DET_CONFD_AZIMUTH_245 : 126|2@1+ (1,0) [0|3] ""  ADAS
 SG_ DET_CONFD_ELEVATION_245 : 112|2@1+ (1,0) [0|3] ""  ADAS
 SG_ DET_RANGE_246 : 144|15@1+ (0.015625,0) [0|500] "m"  ADAS
 SG_ DET_RANGE_ERR_246 : 160|7@1+ (0.0075,0) [0|0.9525] "m"  ADAS
 SG_ DET_RANGE_VELOCITY_246 : 168|15@1+ (0.0078125,-128) [-128|127.9921875] "m/s"  ADAS
 SG_ DET_RANGE_VELOCITY_ERR_246 : 184|8@1+ (0.003,0) [0|0.765] "m/s"  ADAS
 SG_ DET_AZIMUTH_246 : 208|13@1+ (0.0004,-1.5708) [-1.5708|1.5708] "rad"  ADAS
 SG_ DET_AZIMUTH_ERR_246 : 224|7@1+ (0.00087267,0) [0|0.11082909] "rad"  ADAS
 SG_ DET_ELEVATION_246 : 192|8@1+ (0.00275,-0.34925) [-0.34925|0.34925] "rad"  ADAS
 SG_ DET_ELEVATION_ERR_246 : 200|6@1+ (0.00174533,0) [0|0.10995579] "rad"  ADAS
 SG_ DET_RCS_246 : 256|8@1+ (0.5,-64) [-64|63.5] "dBsm"  ADAS
 SG_ DET_VALID_FLAG_246 : 167|1@1+ (1,0) [0|1] ""  ADAS
 SG_ DET_BI_STATIC_FLAG_246 : 505|1@1+ (1,0) [0|1] ""  ADAS
 SG_ DET_SUPER_RES_TARGET_246 : 247|1@1+ (1,0) [0|1] ""  ADAS
 SG_ DET_SNR_246 : 248|8@1+ (0.35156,0) [0|89.6478] "dB"  ADAS
 SG_ DET_POINT_TARGET_PROB_246 : 240|4@1+ (6.67,0) [0|100] "%"  ADAS
 SG_ DET_EXISTENCE_PROB_246 : 232|6@1+ (1.588,0) [0|100] "%"  ADAS
 SG_ DET_OUTSIDE_SECTOR_246 : 183|1@1+ (1,0) [0|1] ""  ADAS
 SG_ DET_HVC_FLAG_246 : 246|1@1+ (1,0) [0|1] ""  ADAS
 SG_ DET_CONFD_AZIMUTH_246 : 206|2@1+ (1,0) [0|3] ""  ADAS
 SG_ DET_CONFD_ELEVATION_246 : 244|2@1+ (1,0) [0|3] ""  ADAS
 SG_ DET_RANGE_247 : 264|15@1+ (0.015625,0) [0|500] "m"  ADAS
 SG_ DET_RANGE_ERR_247 : 280|7@1+ (0.0075,0) [0|0.9525] "m"  ADAS
 SG_ DET_RANGE_VELOCITY_247 : 288|15@1+ (0.0078125,-128) [-128|127.9921875] "m/s"  ADAS
 SG_ DET_RANGE_VELOCITY_ERR_247 : 304|8@1+ (0.003,0) [0|0.765] "m/s"  ADAS
 SG_ DET_AZIMUTH_247 : 328|13@1+ (0.0004,-1.5708) [-1.5708|1.5708] "rad"  ADAS
 SG_ DET_AZIMUTH_ERR_247 : 345|7@1+ (0.00087267,0) [0|0.11082909] "rad"  ADAS
 SG_ DET_ELEVATION_247 : 312|8@1+ (0.00275,-0.34925) [-0.34925|0.34925] "rad"  ADAS
 SG_ DET_ELEVATION_ERR_247 : 320|6@1+ (0.00174533,0) [0|0.10995579] "rad"  ADAS
 SG_ DET_RCS_247 : 376|8@1+ (0.5,-64) [-64|63.5] "dBsm"  ADAS
 SG_ DET_VALID_FLAG_247 : 399|1@1+ (1,0) [0|1] ""  ADAS
 SG_ DET_BI_STATIC_FLAG_247 : 482|1@1+ (1,0) [0|1] ""  ADAS
 SG_ DET_SUPER_RES_TARGET_247 : 344|1@1+ (1,0) [0|1] ""  ADAS
 SG_ DET_SNR_247 : 368|8@1+ (0.35156,0) [0|89.6478] "dB"  ADAS
 SG_ DET_POINT_TARGET_PROB_247 : 360|4@1+ (6.67,0) [0|100] "%"  ADAS
 SG_ DET_EXISTENCE_PROB_247 : 352|6@1+ (1.588,0) [0|100] "%"  ADAS
 SG_ DET_OUTSIDE_SECTOR_247 : 407|1@1+ (1,0) [0|1] ""  ADAS
 SG_ DET_HVC_FLAG_247 : 364|1@1+ (1,0) [0|1] ""  ADAS
 SG_ DET_CONFD_AZIMUTH_247 : 365|2@1+ (1,0) [0|3] ""  ADAS
 SG_ DET_CONFD_ELEVATION_247 : 358|2@1+ (1,0) [0|3] ""  ADAS
 SG_ DET_RANGE_248 : 384|15@1+ (0.015625,0) [0|500] "m"  ADAS
 SG_ DET_RANGE_ERR_248 : 400|7@1+ (0.0075,0) [0|0.9525] "m"  ADAS
 SG_ DET_RANGE_VELOCITY_248 : 408|15@1+ (0.0078125,-128) [-128|127.9921875] "m/s"  ADAS
 SG_ DET_RANGE_VELOCITY_ERR_248 : 424|8@1+ (0.003,0) [0|0.765] "m/s"  ADAS
 SG_ DET_AZIMUTH_248 : 448|13@1+ (0.0004,-1.5708) [-1.5708|1.5708] "rad"  ADAS
 SG_ DET_AZIMUTH_ERR_248 : 465|7@1+ (0.00087267,0) [0|0.11082909] "rad"  ADAS
 SG_ DET_ELEVATION_248 : 432|8@1+ (0.00275,-0.34925) [-0.34925|0.34925] "rad"  ADAS
 SG_ DET_ELEVATION_ERR_248 : 440|6@1+ (0.00174533,0) [0|0.10995579] "rad"  ADAS
 SG_ DET_RCS_248 : 496|8@1+ (0.5,-64) [-64|63.5] "dBsm"  ADAS
 SG_ DET_VALID_FLAG_248 : 485|1@1+ (1,0) [0|1] ""  ADAS
 SG_ DET_BI_STATIC_FLAG_248 : 483|1@1+ (1,0) [0|1] ""  ADAS
 SG_ DET_SUPER_RES_TARGET_248 : 446|1@1+ (1,0) [0|1] ""  ADAS
 SG_ DET_SNR_248 : 488|8@1+ (0.35156,0) [0|89.6478] "dB"  ADAS
 SG_ DET_POINT_TARGET_PROB_248 : 472|4@1+ (6.67,0) [0|100] "%"  ADAS
 SG_ DET_EXISTENCE_PROB_248 : 506|6@1+ (1.588,0) [0|100] "%"  ADAS
 SG_ DET_OUTSIDE_SECTOR_248 : 481|1@1+ (1,0) [0|1] ""  ADAS
 SG_ DET_HVC_FLAG_248 : 464|1@1+ (1,0) [0|1] ""  ADAS
 SG_ DET_CONFD_AZIMUTH_248 : 486|2@1+ (1,0) [0|3] ""  ADAS
 SG_ DET_CONFD_ELEVATION_248 : 461|2@1+ (1,0) [0|3] ""  ADAS
 SG_ DET_MH_SCAN_INDEX_4LSB_245_248 : 476|4@1+ (1,0) [0|15] ""  ADAS
 SG_ DET_MH_CYCLE_COUNTER_245_248 : 16|8@1+ (1,0) [0|255] ""  ADAS
 SG_ DET_MH_CRC16_245_248 : 0|16@1+ (1,0) [0|65535] ""  ADAS

BO_ 1086 RDR_DETECTION_249_252: 64 RDR07
 SG_ DET_RANGE_249 : 24|15@1+ (0.015625,0) [0|500] "m"  ADAS
 SG_ DET_RANGE_ERR_249 : 40|7@1+ (0.0075,0) [0|0.9525] "m"  ADAS
 SG_ DET_RANGE_VELOCITY_249 : 48|15@1+ (0.0078125,-128) [-128|127.9921875] "m/s"  ADAS
 SG_ DET_RANGE_VELOCITY_ERR_249 : 64|8@1+ (0.003,0) [0|0.765] "m/s"  ADAS
 SG_ DET_AZIMUTH_249 : 88|13@1+ (0.0004,-1.5708) [-1.5708|1.5708] "rad"  ADAS
 SG_ DET_AZIMUTH_ERR_249 : 105|7@1+ (0.00087267,0) [0|0.11082909] "rad"  ADAS
 SG_ DET_ELEVATION_249 : 72|8@1+ (0.00275,-0.34925) [-0.34925|0.34925] "rad"  ADAS
 SG_ DET_ELEVATION_ERR_249 : 80|6@1+ (0.00174533,0) [0|0.10995579] "rad"  ADAS
 SG_ DET_RCS_249 : 136|8@1+ (0.5,-64) [-64|63.5] "dBsm"  ADAS
 SG_ DET_VALID_FLAG_249 : 119|1@1+ (1,0) [0|1] ""  ADAS
 SG_ DET_BI_STATIC_FLAG_249 : 504|1@1+ (1,0) [0|1] ""  ADAS
 SG_ DET_SUPER_RES_TARGET_249 : 104|1@1+ (1,0) [0|1] ""  ADAS
 SG_ DET_SNR_249 : 128|8@1+ (0.35156,0) [0|89.6478] "dB"  ADAS
 SG_ DET_POINT_TARGET_PROB_249 : 114|4@1+ (6.67,0) [0|100] "%"  ADAS
 SG_ DET_EXISTENCE_PROB_249 : 120|6@1+ (1.588,0) [0|100] "%"  ADAS
 SG_ DET_OUTSIDE_SECTOR_249 : 159|1@1+ (1,0) [0|1] ""  ADAS
 SG_ DET_HVC_FLAG_249 : 118|1@1+ (1,0) [0|1] ""  ADAS
 SG_ DET_CONFD_AZIMUTH_249 : 126|2@1+ (1,0) [0|3] ""  ADAS
 SG_ DET_CONFD_ELEVATION_249 : 112|2@1+ (1,0) [0|3] ""  ADAS
 SG_ DET_RANGE_250 : 144|15@1+ (0.015625,0) [0|500] "m"  ADAS
 SG_ DET_RANGE_ERR_250 : 160|7@1+ (0.0075,0) [0|0.9525] "m"  ADAS
 SG_ DET_RANGE_VELOCITY_250 : 168|15@1+ (0.0078125,-128) [-128|127.9921875] "m/s"  ADAS
 SG_ DET_RANGE_VELOCITY_ERR_250 : 184|8@1+ (0.003,0) [0|0.765] "m/s"  ADAS
 SG_ DET_AZIMUTH_250 : 208|13@1+ (0.0004,-1.5708) [-1.5708|1.5708] "rad"  ADAS
 SG_ DET_AZIMUTH_ERR_250 : 224|7@1+ (0.00087267,0) [0|0.11082909] "rad"  ADAS
 SG_ DET_ELEVATION_250 : 192|8@1+ (0.00275,-0.34925) [-0.34925|0.34925] "rad"  ADAS
 SG_ DET_ELEVATION_ERR_250 : 200|6@1+ (0.00174533,0) [0|0.10995579] "rad"  ADAS
 SG_ DET_RCS_250 : 256|8@1+ (0.5,-64) [-64|63.5] "dBsm"  ADAS
 SG_ DET_VALID_FLAG_250 : 167|1@1+ (1,0) [0|1] ""  ADAS
 SG_ DET_BI_STATIC_FLAG_250 : 505|1@1+ (1,0) [0|1] ""  ADAS
 SG_ DET_SUPER_RES_TARGET_250 : 247|1@1+ (1,0) [0|1] ""  ADAS
 SG_ DET_SNR_250 : 248|8@1+ (0.35156,0) [0|89.6478] "dB"  ADAS
 SG_ DET_POINT_TARGET_PROB_250 : 240|4@1+ (6.67,0) [0|100] "%"  ADAS
 SG_ DET_EXISTENCE_PROB_250 : 232|6@1+ (1.588,0) [0|100] "%"  ADAS
 SG_ DET_OUTSIDE_SECTOR_250 : 183|1@1+ (1,0) [0|1] ""  ADAS
 SG_ DET_HVC_FLAG_250 : 246|1@1+ (1,0) [0|1] ""  ADAS
 SG_ DET_CONFD_AZIMUTH_250 : 206|2@1+ (1,0) [0|3] ""  ADAS
 SG_ DET_CONFD_ELEVATION_250 : 244|2@1+ (1,0) [0|3] ""  ADAS
 SG_ DET_RANGE_251 : 264|15@1+ (0.015625,0) [0|500] "m"  ADAS
 SG_ DET_RANGE_ERR_251 : 280|7@1+ (0.0075,0) [0|0.9525] "m"  ADAS
 SG_ DET_RANGE_VELOCITY_251 : 288|15@1+ (0.0078125,-128) [-128|127.9921875] "m/s"  ADAS
 SG_ DET_RANGE_VELOCITY_ERR_251 : 304|8@1+ (0.003,0) [0|0.765] "m/s"  ADAS
 SG_ DET_AZIMUTH_251 : 328|13@1+ (0.0004,-1.5708) [-1.5708|1.5708] "rad"  ADAS
 SG_ DET_AZIMUTH_ERR_251 : 345|7@1+ (0.00087267,0) [0|0.11082909] "rad"  ADAS
 SG_ DET_ELEVATION_251 : 312|8@1+ (0.00275,-0.34925) [-0.34925|0.34925] "rad"  ADAS
 SG_ DET_ELEVATION_ERR_251 : 320|6@1+ (0.00174533,0) [0|0.10995579] "rad"  ADAS
 SG_ DET_RCS_251 : 376|8@1+ (0.5,-64) [-64|63.5] "dBsm"  ADAS
 SG_ DET_VALID_FLAG_251 : 399|1@1+ (1,0) [0|1] ""  ADAS
 SG_ DET_BI_STATIC_FLAG_251 : 482|1@1+ (1,0) [0|1] ""  ADAS
 SG_ DET_SUPER_RES_TARGET_251 : 344|1@1+ (1,0) [0|1] ""  ADAS
 SG_ DET_SNR_251 : 368|8@1+ (0.35156,0) [0|89.6478] "dB"  ADAS
 SG_ DET_POINT_TARGET_PROB_251 : 360|4@1+ (6.67,0) [0|100] "%"  ADAS
 SG_ DET_EXISTENCE_PROB_251 : 352|6@1+ (1.588,0) [0|100] "%"  ADAS
 SG_ DET_OUTSIDE_SECTOR_251 : 407|1@1+ (1,0) [0|1] ""  ADAS
 SG_ DET_HVC_FLAG_251 : 364|1@1+ (1,0) [0|1] ""  ADAS
 SG_ DET_CONFD_AZIMUTH_251 : 365|2@1+ (1,0) [0|3] ""  ADAS
 SG_ DET_CONFD_ELEVATION_251 : 358|2@1+ (1,0) [0|3] ""  ADAS
 SG_ DET_RANGE_252 : 384|15@1+ (0.015625,0) [0|500] "m"  ADAS
 SG_ DET_RANGE_ERR_252 : 400|7@1+ (0.0075,0) [0|0.9525] "m"  ADAS
 SG_ DET_RANGE_VELOCITY_252 : 408|15@1+ (0.0078125,-128) [-128|127.9921875] "m/s"  ADAS
 SG_ DET_RANGE_VELOCITY_ERR_252 : 424|8@1+ (0.003,0) [0|0.765] "m/s"  ADAS
 SG_ DET_AZIMUTH_252 : 448|13@1+ (0.0004,-1.5708) [-1.5708|1.5708] "rad"  ADAS
 SG_ DET_AZIMUTH_ERR_252 : 465|7@1+ (0.00087267,0) [0|0.11082909] "rad"  ADAS
 SG_ DET_ELEVATION_252 : 432|8@1+ (0.00275,-0.34925) [-0.34925|0.34925] "rad"  ADAS
 SG_ DET_ELEVATION_ERR_252 : 440|6@1+ (0.00174533,0) [0|0.10995579] "rad"  ADAS
 SG_ DET_RCS_252 : 496|8@1+ (0.5,-64) [-64|63.5] "dBsm"  ADAS
 SG_ DET_VALID_FLAG_252 : 485|1@1+ (1,0) [0|1] ""  ADAS
 SG_ DET_BI_STATIC_FLAG_252 : 483|1@1+ (1,0) [0|1] ""  ADAS
 SG_ DET_SUPER_RES_TARGET_252 : 446|1@1+ (1,0) [0|1] ""  ADAS
 SG_ DET_SNR_252 : 488|8@1+ (0.35156,0) [0|89.6478] "dB"  ADAS
 SG_ DET_POINT_TARGET_PROB_252 : 472|4@1+ (6.67,0) [0|100] "%"  ADAS
 SG_ DET_EXISTENCE_PROB_252 : 506|6@1+ (1.588,0) [0|100] "%"  ADAS
 SG_ DET_OUTSIDE_SECTOR_252 : 481|1@1+ (1,0) [0|1] ""  ADAS
 SG_ DET_HVC_FLAG_252 : 464|1@1+ (1,0) [0|1] ""  ADAS
 SG_ DET_CONFD_AZIMUTH_252 : 486|2@1+ (1,0) [0|3] ""  ADAS
 SG_ DET_CONFD_ELEVATION_252 : 461|2@1+ (1,0) [0|3] ""  ADAS
 SG_ DET_MH_SCAN_INDEX_4LSB_249_252 : 476|4@1+ (1,0) [0|15] ""  ADAS
 SG_ DET_MH_CYCLE_COUNTER_249_252 : 16|8@1+ (1,0) [0|255] ""  ADAS
 SG_ DET_MH_CRC16_249_252 : 0|16@1+ (1,0) [0|65535] ""  ADAS

BO_ 1087 RDR_DETECTION_253_256: 64 RDR07
 SG_ DET_RANGE_253 : 24|15@1+ (0.015625,0) [0|500] "m"  ADAS
 SG_ DET_RANGE_ERR_253 : 40|7@1+ (0.0075,0) [0|0.9525] "m"  ADAS
 SG_ DET_RANGE_VELOCITY_253 : 48|15@1+ (0.0078125,-128) [-128|127.9921875] "m/s"  ADAS
 SG_ DET_RANGE_VELOCITY_ERR_253 : 64|8@1+ (0.003,0) [0|0.765] "m/s"  ADAS
 SG_ DET_AZIMUTH_253 : 88|13@1+ (0.0004,-1.5708) [-1.5708|1.5708] "rad"  ADAS
 SG_ DET_AZIMUTH_ERR_253 : 105|7@1+ (0.00087267,0) [0|0.11082909] "rad"  ADAS
 SG_ DET_ELEVATION_253 : 72|8@1+ (0.00275,-0.34925) [-0.34925|0.34925] "rad"  ADAS
 SG_ DET_ELEVATION_ERR_253 : 80|6@1+ (0.00174533,0) [0|0.10995579] "rad"  ADAS
 SG_ DET_RCS_253 : 136|8@1+ (0.5,-64) [-64|63.5] "dBsm"  ADAS
 SG_ DET_VALID_FLAG_253 : 119|1@1+ (1,0) [0|1] ""  ADAS
 SG_ DET_BI_STATIC_FLAG_253 : 504|1@1+ (1,0) [0|1] ""  ADAS
 SG_ DET_SUPER_RES_TARGET_253 : 104|1@1+ (1,0) [0|1] ""  ADAS
 SG_ DET_SNR_253 : 128|8@1+ (0.35156,0) [0|89.6478] "dB"  ADAS
 SG_ DET_POINT_TARGET_PROB_253 : 114|4@1+ (6.67,0) [0|100] "%"  ADAS
 SG_ DET_EXISTENCE_PROB_253 : 120|6@1+ (1.588,0) [0|100] "%"  ADAS
 SG_ DET_OUTSIDE_SECTOR_253 : 159|1@1+ (1,0) [0|1] ""  ADAS
 SG_ DET_HVC_FLAG_253 : 118|1@1+ (1,0) [0|1] ""  ADAS
 SG_ DET_CONFD_AZIMUTH_253 : 126|2@1+ (1,0) [0|3] ""  ADAS
 SG_ DET_CONFD_ELEVATION_253 : 112|2@1+ (1,0) [0|3] ""  ADAS
 SG_ DET_RANGE_254 : 144|15@1+ (0.015625,0) [0|500] "m"  ADAS
 SG_ DET_RANGE_ERR_254 : 160|7@1+ (0.0075,0) [0|0.9525] "m"  ADAS
 SG_ DET_RANGE_VELOCITY_254 : 168|15@1+ (0.0078125,-128) [-128|127.9921875] "m/s"  ADAS
 SG_ DET_RANGE_VELOCITY_ERR_254 : 184|8@1+ (0.003,0) [0|0.765] "m/s"  ADAS
 SG_ DET_AZIMUTH_254 : 208|13@1+ (0.0004,-1.5708) [-1.5708|1.5708] "rad"  ADAS
 SG_ DET_AZIMUTH_ERR_254 : 224|7@1+ (0.00087267,0) [0|0.11082909] "rad"  ADAS
 SG_ DET_ELEVATION_254 : 192|8@1+ (0.00275,-0.34925) [-0.34925|0.34925] "rad"  ADAS
 SG_ DET_ELEVATION_ERR_254 : 200|6@1+ (0.00174533,0) [0|0.10995579] "rad"  ADAS
 SG_ DET_RCS_254 : 256|8@1+ (0.5,-64) [-64|63.5] "dBsm"  ADAS
 SG_ DET_VALID_FLAG_254 : 167|1@1+ (1,0) [0|1] ""  ADAS
 SG_ DET_BI_STATIC_FLAG_254 : 505|1@1+ (1,0) [0|1] ""  ADAS
 SG_ DET_SUPER_RES_TARGET_254 : 247|1@1+ (1,0) [0|1] ""  ADAS
 SG_ DET_SNR_254 : 248|8@1+ (0.35156,0) [0|89.6478] "dB"  ADAS
 SG_ DET_POINT_TARGET_PROB_254 : 240|4@1+ (6.67,0) [0|100] "%"  ADAS
 SG_ DET_EXISTENCE_PROB_254 : 232|6@1+ (1.588,0) [0|100] "%"  ADAS
 SG_ DET_OUTSIDE_SECTOR_254 : 183|1@1+ (1,0) [0|1] ""  ADAS
 SG_ DET_HVC_FLAG_254 : 246|1@1+ (1,0) [0|1] ""  ADAS
 SG_ DET_CONFD_AZIMUTH_254 : 206|2@1+ (1,0) [0|3] ""  ADAS
 SG_ DET_CONFD_ELEVATION_254 : 244|2@1+ (1,0) [0|3] ""  ADAS
 SG_ DET_RANGE_255 : 264|15@1+ (0.015625,0) [0|500] "m"  ADAS
 SG_ DET_RANGE_ERR_255 : 280|7@1+ (0.0075,0) [0|0.9525] "m"  ADAS
 SG_ DET_RANGE_VELOCITY_255 : 288|15@1+ (0.0078125,-128) [-128|127.9921875] "m/s"  ADAS
 SG_ DET_RANGE_VELOCITY_ERR_255 : 304|8@1+ (0.003,0) [0|0.765] "m/s"  ADAS
 SG_ DET_AZIMUTH_255 : 328|13@1+ (0.0004,-1.5708) [-1.5708|1.5708] "rad"  ADAS
 SG_ DET_AZIMUTH_ERR_255 : 345|7@1+ (0.00087267,0) [0|0.11082909] "rad"  ADAS
 SG_ DET_ELEVATION_255 : 312|8@1+ (0.00275,-0.34925) [-0.34925|0.34925] "rad"  ADAS
 SG_ DET_ELEVATION_ERR_255 : 320|6@1+ (0.00174533,0) [0|0.10995579] "rad"  ADAS
 SG_ DET_RCS_255 : 376|8@1+ (0.5,-64) [-64|63.5] "dBsm"  ADAS
 SG_ DET_VALID_FLAG_255 : 399|1@1+ (1,0) [0|1] ""  ADAS
 SG_ DET_BI_STATIC_FLAG_255 : 482|1@1+ (1,0) [0|1] ""  ADAS
 SG_ DET_SUPER_RES_TARGET_255 : 344|1@1+ (1,0) [0|1] ""  ADAS
 SG_ DET_SNR_255 : 368|8@1+ (0.35156,0) [0|89.6478] "dB"  ADAS
 SG_ DET_POINT_TARGET_PROB_255 : 360|4@1+ (6.67,0) [0|100] "%"  ADAS
 SG_ DET_EXISTENCE_PROB_255 : 352|6@1+ (1.588,0) [0|100] "%"  ADAS
 SG_ DET_OUTSIDE_SECTOR_255 : 407|1@1+ (1,0) [0|1] ""  ADAS
 SG_ DET_HVC_FLAG_255 : 364|1@1+ (1,0) [0|1] ""  ADAS
 SG_ DET_CONFD_AZIMUTH_255 : 365|2@1+ (1,0) [0|3] ""  ADAS
 SG_ DET_CONFD_ELEVATION_255 : 358|2@1+ (1,0) [0|3] ""  ADAS
 SG_ DET_RANGE_256 : 384|15@1+ (0.015625,0) [0|500] "m"  ADAS
 SG_ DET_RANGE_ERR_256 : 400|7@1+ (0.0075,0) [0|0.9525] "m"  ADAS
 SG_ DET_RANGE_VELOCITY_256 : 408|15@1+ (0.0078125,-128) [-128|127.9921875] "m/s"  ADAS
 SG_ DET_RANGE_VELOCITY_ERR_256 : 424|8@1+ (0.003,0) [0|0.765] "m/s"  ADAS
 SG_ DET_AZIMUTH_256 : 448|13@1+ (0.0004,-1.5708) [-1.5708|1.5708] "rad"  ADAS
 SG_ DET_AZIMUTH_ERR_256 : 465|7@1+ (0.00087267,0) [0|0.11082909] "rad"  ADAS
 SG_ DET_ELEVATION_256 : 432|8@1+ (0.00275,-0.34925) [-0.34925|0.34925] "rad"  ADAS
 SG_ DET_ELEVATION_ERR_256 : 440|6@1+ (0.00174533,0) [0|0.10995579] "rad"  ADAS
 SG_ DET_RCS_256 : 496|8@1+ (0.5,-64) [-64|63.5] "dBsm"  ADAS
 SG_ DET_VALID_FLAG_256 : 485|1@1+ (1,0) [0|1] ""  ADAS
 SG_ DET_BI_STATIC_FLAG_256 : 483|1@1+ (1,0) [0|1] ""  ADAS
 SG_ DET_SUPER_RES_TARGET_256 : 446|1@1+ (1,0) [0|1] ""  ADAS
 SG_ DET_SNR_256 : 488|8@1+ (0.35156,0) [0|89.6478] "dB"  ADAS
 SG_ DET_POINT_TARGET_PROB_256 : 472|4@1+ (6.67,0) [0|100] "%"  ADAS
 SG_ DET_EXISTENCE_PROB_256 : 506|6@1+ (1.588,0) [0|100] "%"  ADAS
 SG_ DET_OUTSIDE_SECTOR_256 : 481|1@1+ (1,0) [0|1] ""  ADAS
 SG_ DET_HVC_FLAG_256 : 464|1@1+ (1,0) [0|1] ""  ADAS
 SG_ DET_CONFD_AZIMUTH_256 : 486|2@1+ (1,0) [0|3] ""  ADAS
 SG_ DET_CONFD_ELEVATION_256 : 461|2@1+ (1,0) [0|3] ""  ADAS
 SG_ DET_MH_SCAN_INDEX_4LSB_253_256 : 476|4@1+ (1,0) [0|15] ""  ADAS
 SG_ DET_MH_CYCLE_COUNTER_253_256 : 16|8@1+ (1,0) [0|255] ""  ADAS
 SG_ DET_MH_CRC16_253_256 : 0|16@1+ (1,0) [0|65535] ""  ADAS

BO_ 1088 RDR_DETECTION_257_260: 64 RDR07
 SG_ DET_RANGE_257 : 24|15@1+ (0.015625,0) [0|500] "m"  ADAS
 SG_ DET_RANGE_ERR_257 : 40|7@1+ (0.0075,0) [0|0.9525] "m"  ADAS
 SG_ DET_RANGE_VELOCITY_257 : 48|15@1+ (0.0078125,-128) [-128|127.9921875] "m/s"  ADAS
 SG_ DET_RANGE_VELOCITY_ERR_257 : 64|8@1+ (0.003,0) [0|0.765] "m/s"  ADAS
 SG_ DET_AZIMUTH_257 : 88|13@1+ (0.0004,-1.5708) [-1.5708|1.5708] "rad"  ADAS
 SG_ DET_AZIMUTH_ERR_257 : 105|7@1+ (0.00087267,0) [0|0.11082909] "rad"  ADAS
 SG_ DET_ELEVATION_257 : 72|8@1+ (0.00275,-0.34925) [-0.34925|0.34925] "rad"  ADAS
 SG_ DET_ELEVATION_ERR_257 : 80|6@1+ (0.00174533,0) [0|0.10995579] "rad"  ADAS
 SG_ DET_RCS_257 : 136|8@1+ (0.5,-64) [-64|63.5] "dBsm"  ADAS
 SG_ DET_VALID_FLAG_257 : 119|1@1+ (1,0) [0|1] ""  ADAS
 SG_ DET_BI_STATIC_FLAG_257 : 504|1@1+ (1,0) [0|1] ""  ADAS
 SG_ DET_SUPER_RES_TARGET_257 : 104|1@1+ (1,0) [0|1] ""  ADAS
 SG_ DET_SNR_257 : 128|8@1+ (0.35156,0) [0|89.6478] "dB"  ADAS
 SG_ DET_POINT_TARGET_PROB_257 : 114|4@1+ (6.67,0) [0|100] "%"  ADAS
 SG_ DET_EXISTENCE_PROB_257 : 120|6@1+ (1.588,0) [0|100] "%"  ADAS
 SG_ DET_OUTSIDE_SECTOR_257 : 159|1@1+ (1,0) [0|1] ""  ADAS
 SG_ DET_HVC_FLAG_257 : 118|1@1+ (1,0) [0|1] ""  ADAS
 SG_ DET_CONFD_AZIMUTH_257 : 126|2@1+ (1,0) [0|3] ""  ADAS
 SG_ DET_CONFD_ELEVATION_257 : 112|2@1+ (1,0) [0|3] ""  ADAS
 SG_ DET_RANGE_258 : 144|15@1+ (0.015625,0) [0|500] "m"  ADAS
 SG_ DET_RANGE_ERR_258 : 160|7@1+ (0.0075,0) [0|0.9525] "m"  ADAS
 SG_ DET_RANGE_VELOCITY_258 : 168|15@1+ (0.0078125,-128) [-128|127.9921875] "m/s"  ADAS
 SG_ DET_RANGE_VELOCITY_ERR_258 : 184|8@1+ (0.003,0) [0|0.765] "m/s"  ADAS
 SG_ DET_AZIMUTH_258 : 208|13@1+ (0.0004,-1.5708) [-1.5708|1.5708] "rad"  ADAS
 SG_ DET_AZIMUTH_ERR_258 : 224|7@1+ (0.00087267,0) [0|0.11082909] "rad"  ADAS
 SG_ DET_ELEVATION_258 : 192|8@1+ (0.00275,-0.34925) [-0.34925|0.34925] "rad"  ADAS
 SG_ DET_ELEVATION_ERR_258 : 200|6@1+ (0.00174533,0) [0|0.10995579] "rad"  ADAS
 SG_ DET_RCS_258 : 256|8@1+ (0.5,-64) [-64|63.5] "dBsm"  ADAS
 SG_ DET_VALID_FLAG_258 : 167|1@1+ (1,0) [0|1] ""  ADAS
 SG_ DET_BI_STATIC_FLAG_258 : 505|1@1+ (1,0) [0|1] ""  ADAS
 SG_ DET_SUPER_RES_TARGET_258 : 247|1@1+ (1,0) [0|1] ""  ADAS
 SG_ DET_SNR_258 : 248|8@1+ (0.35156,0) [0|89.6478] "dB"  ADAS
 SG_ DET_POINT_TARGET_PROB_258 : 240|4@1+ (6.67,0) [0|100] "%"  ADAS
 SG_ DET_EXISTENCE_PROB_258 : 232|6@1+ (1.588,0) [0|100] "%"  ADAS
 SG_ DET_OUTSIDE_SECTOR_258 : 183|1@1+ (1,0) [0|1] ""  ADAS
 SG_ DET_HVC_FLAG_258 : 246|1@1+ (1,0) [0|1] ""  ADAS
 SG_ DET_CONFD_AZIMUTH_258 : 206|2@1+ (1,0) [0|3] ""  ADAS
 SG_ DET_CONFD_ELEVATION_258 : 244|2@1+ (1,0) [0|3] ""  ADAS
 SG_ DET_RANGE_259 : 264|15@1+ (0.015625,0) [0|500] "m"  ADAS
 SG_ DET_RANGE_ERR_259 : 280|7@1+ (0.0075,0) [0|0.9525] "m"  ADAS
 SG_ DET_RANGE_VELOCITY_259 : 288|15@1+ (0.0078125,-128) [-128|127.9921875] "m/s"  ADAS
 SG_ DET_RANGE_VELOCITY_ERR_259 : 304|8@1+ (0.003,0) [0|0.765] "m/s"  ADAS
 SG_ DET_AZIMUTH_259 : 328|13@1+ (0.0004,-1.5708) [-1.5708|1.5708] "rad"  ADAS
 SG_ DET_AZIMUTH_ERR_259 : 345|7@1+ (0.00087267,0) [0|0.11082909] "rad"  ADAS
 SG_ DET_ELEVATION_259 : 312|8@1+ (0.00275,-0.34925) [-0.34925|0.34925] "rad"  ADAS
 SG_ DET_ELEVATION_ERR_259 : 320|6@1+ (0.00174533,0) [0|0.10995579] "rad"  ADAS
 SG_ DET_RCS_259 : 376|8@1+ (0.5,-64) [-64|63.5] "dBsm"  ADAS
 SG_ DET_VALID_FLAG_259 : 399|1@1+ (1,0) [0|1] ""  ADAS
 SG_ DET_BI_STATIC_FLAG_259 : 482|1@1+ (1,0) [0|1] ""  ADAS
 SG_ DET_SUPER_RES_TARGET_259 : 344|1@1+ (1,0) [0|1] ""  ADAS
 SG_ DET_SNR_259 : 368|8@1+ (0.35156,0) [0|89.6478] "dB"  ADAS
 SG_ DET_POINT_TARGET_PROB_259 : 360|4@1+ (6.67,0) [0|100] "%"  ADAS
 SG_ DET_EXISTENCE_PROB_259 : 352|6@1+ (1.588,0) [0|100] "%"  ADAS
 SG_ DET_OUTSIDE_SECTOR_259 : 407|1@1+ (1,0) [0|1] ""  ADAS
 SG_ DET_HVC_FLAG_259 : 364|1@1+ (1,0) [0|1] ""  ADAS
 SG_ DET_CONFD_AZIMUTH_259 : 365|2@1+ (1,0) [0|3] ""  ADAS
 SG_ DET_CONFD_ELEVATION_259 : 358|2@1+ (1,0) [0|3] ""  ADAS
 SG_ DET_RANGE_260 : 384|15@1+ (0.015625,0) [0|500] "m"  ADAS
 SG_ DET_RANGE_ERR_260 : 400|7@1+ (0.0075,0) [0|0.9525] "m"  ADAS
 SG_ DET_RANGE_VELOCITY_260 : 408|15@1+ (0.0078125,-128) [-128|127.9921875] "m/s"  ADAS
 SG_ DET_RANGE_VELOCITY_ERR_260 : 424|8@1+ (0.003,0) [0|0.765] "m/s"  ADAS
 SG_ DET_AZIMUTH_260 : 448|13@1+ (0.0004,-1.5708) [-1.5708|1.5708] "rad"  ADAS
 SG_ DET_AZIMUTH_ERR_260 : 465|7@1+ (0.00087267,0) [0|0.11082909] "rad"  ADAS
 SG_ DET_ELEVATION_260 : 432|8@1+ (0.00275,-0.34925) [-0.34925|0.34925] "rad"  ADAS
 SG_ DET_ELEVATION_ERR_260 : 440|6@1+ (0.00174533,0) [0|0.10995579] "rad"  ADAS
 SG_ DET_RCS_260 : 496|8@1+ (0.5,-64) [-64|63.5] "dBsm"  ADAS
 SG_ DET_VALID_FLAG_260 : 485|1@1+ (1,0) [0|1] ""  ADAS
 SG_ DET_BI_STATIC_FLAG_260 : 483|1@1+ (1,0) [0|1] ""  ADAS
 SG_ DET_SUPER_RES_TARGET_260 : 446|1@1+ (1,0) [0|1] ""  ADAS
 SG_ DET_SNR_260 : 488|8@1+ (0.35156,0) [0|89.6478] "dB"  ADAS
 SG_ DET_POINT_TARGET_PROB_260 : 472|4@1+ (6.67,0) [0|100] "%"  ADAS
 SG_ DET_EXISTENCE_PROB_260 : 506|6@1+ (1.588,0) [0|100] "%"  ADAS
 SG_ DET_OUTSIDE_SECTOR_260 : 481|1@1+ (1,0) [0|1] ""  ADAS
 SG_ DET_HVC_FLAG_260 : 464|1@1+ (1,0) [0|1] ""  ADAS
 SG_ DET_CONFD_AZIMUTH_260 : 486|2@1+ (1,0) [0|3] ""  ADAS
 SG_ DET_CONFD_ELEVATION_260 : 461|2@1+ (1,0) [0|3] ""  ADAS
 SG_ DET_MH_SCAN_INDEX_4LSB_257_260 : 476|4@1+ (1,0) [0|15] ""  ADAS
 SG_ DET_MH_CYCLE_COUNTER_257_260 : 16|8@1+ (1,0) [0|255] ""  ADAS
 SG_ DET_MH_CRC16_257_260 : 0|16@1+ (1,0) [0|65535] ""  ADAS

CM_ SG_ 1071 DET_RANGE_189 " measured position  of the detection";
CM_ SG_ 1071 DET_RANGE_ERR_189 "RMSE or standard deviation of the measured angle  of the detection";
CM_ SG_ 1071 DET_RANGE_VELOCITY_189 "Radial velocity of the detection positive in direction to the sensor";
CM_ SG_ 1071 DET_RANGE_VELOCITY_ERR_189 "RMSE or standard deviation of the measure radial velocity of the detection";
CM_ SG_ 1071 DET_AZIMUTH_189 "Measured angle  of the detection";
CM_ SG_ 1071 DET_AZIMUTH_ERR_189 "RMSE or standard deviation of the measured angle  of the detection";
CM_ SG_ 1071 DET_ELEVATION_189 "measured elevation of the detection";
CM_ SG_ 1071 DET_ELEVATION_ERR_189 "RMSE or standard deviation of the measured elevation  of the detection";
CM_ SG_ 1071 DET_RCS_189 "Radar Cross Section or Amplitude, is a measure of how detectable an object is by radar. A larger RCS indicates that an object is more easily detected.";
CM_ SG_ 1071 DET_VALID_FLAG_189 "is set if the measured detection is valid";
CM_ SG_ 1071 DET_BI_STATIC_FLAG_189 "1 if detection is bi-static 0 otherwise";
CM_ SG_ 1071 DET_SUPER_RES_TARGET_189 "flasg is set if the detection is super resolution target";
CM_ SG_ 1071 DET_SNR_189 "The signal to noise ratio (SNR) of the radar detection";
CM_ SG_ 1071 DET_POINT_TARGET_PROB_189 "Describes the possibility if more than one real-world object has led to this detection. 0[%] := 100[%] Multi target probability";
CM_ SG_ 1071 DET_EXISTENCE_PROB_189 "Existence probability of the detection not based on history. Value does  not depend on any past experience with similar detections.
\note Use as confidence measure where a low value means less confidence
and a high value indicates strong confidence.";
CM_ SG_ 1071 DET_OUTSIDE_SECTOR_189 "Flag to indicate detections outside the sector, set if the wrong sector calibration matrix was used";
CM_ SG_ 1071 DET_HVC_FLAG_189 "Core2 Vehicle clutter flag";
CM_ SG_ 1071 DET_CONFD_AZIMUTH_189 "Define the Confidence of Azimuth for Detection ";
CM_ SG_ 1071 DET_CONFD_ELEVATION_189 "Define the Confidence of Elevation for the Detection ";
CM_ SG_ 1071 DET_BI_STATIC_FLAG_190 "1 if detection is bi-static 0 otherwise";
CM_ SG_ 1071 DET_BI_STATIC_FLAG_191 "1 if detection is bi-static 0 otherwise";
CM_ SG_ 1071 DET_BI_STATIC_FLAG_192 "1 if detection is bi-static 0 otherwise";
CM_ SG_ 1071 DET_MH_SCAN_INDEX_4LSB_189_192 "Scan index of the measured detection";
CM_ SG_ 1071 DET_MH_CYCLE_COUNTER_189_192 "Detection Alive Counter";
CM_ SG_ 1072 DET_RANGE_193 " measured position  of the detection";
CM_ SG_ 1072 DET_RANGE_ERR_193 "RMSE or standard deviation of the measured angle  of the detection";
CM_ SG_ 1072 DET_RANGE_VELOCITY_193 "Radial velocity of the detection positive in direction to the sensor";
CM_ SG_ 1072 DET_RANGE_VELOCITY_ERR_193 "RMSE or standard deviation of the measure radial velocity of the detection";
CM_ SG_ 1072 DET_AZIMUTH_193 "Measured angle  of the detection";
CM_ SG_ 1072 DET_AZIMUTH_ERR_193 "RMSE or standard deviation of the measured angle  of the detection";
CM_ SG_ 1072 DET_ELEVATION_193 "measured elevation of the detection";
CM_ SG_ 1072 DET_ELEVATION_ERR_193 "RMSE or standard deviation of the measured elevation  of the detection";
CM_ SG_ 1072 DET_RCS_193 "Radar Cross Section or Amplitude, is a measure of how detectable an object is by radar. A larger RCS indicates that an object is more easily detected.";
CM_ SG_ 1072 DET_VALID_FLAG_193 "is set if the measured detection is valid";
CM_ SG_ 1072 DET_BI_STATIC_FLAG_193 "1 if detection is bi-static 0 otherwise";
CM_ SG_ 1072 DET_SUPER_RES_TARGET_193 "flasg is set if the detection is super resolution target";
CM_ SG_ 1072 DET_SNR_193 "The signal to noise ratio (SNR) of the radar detection";
CM_ SG_ 1072 DET_POINT_TARGET_PROB_193 "Describes the possibility if more than one real-world object has led to this detection. 0[%] := 100[%] Multi target probability";
CM_ SG_ 1072 DET_EXISTENCE_PROB_193 "Existence probability of the detection not based on history. Value does  not depend on any past experience with similar detections.
\note Use as confidence measure where a low value means less confidence
and a high value indicates strong confidence.";
CM_ SG_ 1072 DET_OUTSIDE_SECTOR_193 "Flag to indicate detections outside the sector, set if the wrong sector calibration matrix was used";
CM_ SG_ 1072 DET_HVC_FLAG_193 "Core2 Vehicle clutter flag";
CM_ SG_ 1072 DET_CONFD_AZIMUTH_193 "Define the Confidence of Azimuth for Detection ";
CM_ SG_ 1072 DET_CONFD_ELEVATION_193 "Define the Confidence of Elevation for the Detection ";
CM_ SG_ 1072 DET_BI_STATIC_FLAG_194 "1 if detection is bi-static 0 otherwise";
CM_ SG_ 1072 DET_BI_STATIC_FLAG_195 "1 if detection is bi-static 0 otherwise";
CM_ SG_ 1072 DET_BI_STATIC_FLAG_196 "1 if detection is bi-static 0 otherwise";
CM_ SG_ 1072 DET_MH_SCAN_INDEX_4LSB_193_196 "Scan index of the measured detection";
CM_ SG_ 1072 DET_MH_CYCLE_COUNTER_193_196 "Detection Alive Counter";
CM_ SG_ 1073 DET_RANGE_197 " measured position  of the detection";
CM_ SG_ 1073 DET_RANGE_ERR_197 "RMSE or standard deviation of the measured angle  of the detection";
CM_ SG_ 1073 DET_RANGE_VELOCITY_197 "Radial velocity of the detection positive in direction to the sensor";
CM_ SG_ 1073 DET_RANGE_VELOCITY_ERR_197 "RMSE or standard deviation of the measure radial velocity of the detection";
CM_ SG_ 1073 DET_AZIMUTH_197 "Measured angle  of the detection";
CM_ SG_ 1073 DET_AZIMUTH_ERR_197 "RMSE or standard deviation of the measured angle  of the detection";
CM_ SG_ 1073 DET_ELEVATION_197 "measured elevation of the detection";
CM_ SG_ 1073 DET_ELEVATION_ERR_197 "RMSE or standard deviation of the measured elevation  of the detection";
CM_ SG_ 1073 DET_RCS_197 "Radar Cross Section or Amplitude, is a measure of how detectable an object is by radar. A larger RCS indicates that an object is more easily detected.";
CM_ SG_ 1073 DET_VALID_FLAG_197 "is set if the measured detection is valid";
CM_ SG_ 1073 DET_BI_STATIC_FLAG_197 "1 if detection is bi-static 0 otherwise";
CM_ SG_ 1073 DET_SUPER_RES_TARGET_197 "flasg is set if the detection is super resolution target";
CM_ SG_ 1073 DET_SNR_197 "The signal to noise ratio (SNR) of the radar detection";
CM_ SG_ 1073 DET_POINT_TARGET_PROB_197 "Describes the possibility if more than one real-world object has led to this detection. 0[%] := 100[%] Multi target probability";
CM_ SG_ 1073 DET_EXISTENCE_PROB_197 "Existence probability of the detection not based on history. Value does  not depend on any past experience with similar detections.
\note Use as confidence measure where a low value means less confidence
and a high value indicates strong confidence.";
CM_ SG_ 1073 DET_OUTSIDE_SECTOR_197 "Flag to indicate detections outside the sector, set if the wrong sector calibration matrix was used";
CM_ SG_ 1073 DET_HVC_FLAG_197 "Core2 Vehicle clutter flag";
CM_ SG_ 1073 DET_CONFD_AZIMUTH_197 "Define the Confidence of Azimuth for Detection ";
CM_ SG_ 1073 DET_CONFD_ELEVATION_197 "Define the Confidence of Elevation for the Detection ";
CM_ SG_ 1073 DET_BI_STATIC_FLAG_198 "1 if detection is bi-static 0 otherwise";
CM_ SG_ 1073 DET_BI_STATIC_FLAG_199 "1 if detection is bi-static 0 otherwise";
CM_ SG_ 1073 DET_BI_STATIC_FLAG_200 "1 if detection is bi-static 0 otherwise";
CM_ SG_ 1073 DET_MH_SCAN_INDEX_4LSB_197_200 "Scan index of the measured detection";
CM_ SG_ 1073 DET_MH_CYCLE_COUNTER_197_200 "Detection Alive Counter";
CM_ SG_ 1074 DET_RANGE_201 " measured position  of the detection";
CM_ SG_ 1074 DET_RANGE_ERR_201 "RMSE or standard deviation of the measured angle  of the detection";
CM_ SG_ 1074 DET_RANGE_VELOCITY_201 "Radial velocity of the detection positive in direction to the sensor";
CM_ SG_ 1074 DET_RANGE_VELOCITY_ERR_201 "RMSE or standard deviation of the measure radial velocity of the detection";
CM_ SG_ 1074 DET_AZIMUTH_201 "Measured angle  of the detection";
CM_ SG_ 1074 DET_AZIMUTH_ERR_201 "RMSE or standard deviation of the measured angle  of the detection";
CM_ SG_ 1074 DET_ELEVATION_201 "measured elevation of the detection";
CM_ SG_ 1074 DET_ELEVATION_ERR_201 "RMSE or standard deviation of the measured elevation  of the detection";
CM_ SG_ 1074 DET_RCS_201 "Radar Cross Section or Amplitude, is a measure of how detectable an object is by radar. A larger RCS indicates that an object is more easily detected.";
CM_ SG_ 1074 DET_VALID_FLAG_201 "is set if the measured detection is valid";
CM_ SG_ 1074 DET_BI_STATIC_FLAG_201 "1 if detection is bi-static 0 otherwise";
CM_ SG_ 1074 DET_SUPER_RES_TARGET_201 "flasg is set if the detection is super resolution target";
CM_ SG_ 1074 DET_SNR_201 "The signal to noise ratio (SNR) of the radar detection";
CM_ SG_ 1074 DET_POINT_TARGET_PROB_201 "Describes the possibility if more than one real-world object has led to this detection. 0[%] := 100[%] Multi target probability";
CM_ SG_ 1074 DET_EXISTENCE_PROB_201 "Existence probability of the detection not based on history. Value does  not depend on any past experience with similar detections.
\note Use as confidence measure where a low value means less confidence
and a high value indicates strong confidence.";
CM_ SG_ 1074 DET_OUTSIDE_SECTOR_201 "Flag to indicate detections outside the sector, set if the wrong sector calibration matrix was used";
CM_ SG_ 1074 DET_HVC_FLAG_201 "Core2 Vehicle clutter flag";
CM_ SG_ 1074 DET_CONFD_AZIMUTH_201 "Define the Confidence of Azimuth for Detection ";
CM_ SG_ 1074 DET_CONFD_ELEVATION_201 "Define the Confidence of Elevation for the Detection ";
CM_ SG_ 1074 DET_BI_STATIC_FLAG_202 "1 if detection is bi-static 0 otherwise";
CM_ SG_ 1074 DET_BI_STATIC_FLAG_203 "1 if detection is bi-static 0 otherwise";
CM_ SG_ 1074 DET_BI_STATIC_FLAG_204 "1 if detection is bi-static 0 otherwise";
CM_ SG_ 1074 DET_MH_SCAN_INDEX_4LSB_201_204 "Scan index of the measured detection";
CM_ SG_ 1074 DET_MH_CYCLE_COUNTER_201_204 "Detection Alive Counter";
CM_ SG_ 1075 DET_RANGE_205 " measured position  of the detection";
CM_ SG_ 1075 DET_RANGE_ERR_205 "RMSE or standard deviation of the measured angle  of the detection";
CM_ SG_ 1075 DET_RANGE_VELOCITY_205 "Radial velocity of the detection positive in direction to the sensor";
CM_ SG_ 1075 DET_RANGE_VELOCITY_ERR_205 "RMSE or standard deviation of the measure radial velocity of the detection";
CM_ SG_ 1075 DET_AZIMUTH_205 "Measured angle  of the detection";
CM_ SG_ 1075 DET_AZIMUTH_ERR_205 "RMSE or standard deviation of the measured angle  of the detection";
CM_ SG_ 1075 DET_ELEVATION_205 "measured elevation of the detection";
CM_ SG_ 1075 DET_ELEVATION_ERR_205 "RMSE or standard deviation of the measured elevation  of the detection";
CM_ SG_ 1075 DET_RCS_205 "Radar Cross Section or Amplitude, is a measure of how detectable an object is by radar. A larger RCS indicates that an object is more easily detected.";
CM_ SG_ 1075 DET_VALID_FLAG_205 "is set if the measured detection is valid";
CM_ SG_ 1075 DET_BI_STATIC_FLAG_205 "1 if detection is bi-static 0 otherwise";
CM_ SG_ 1075 DET_SUPER_RES_TARGET_205 "flasg is set if the detection is super resolution target";
CM_ SG_ 1075 DET_SNR_205 "The signal to noise ratio (SNR) of the radar detection";
CM_ SG_ 1075 DET_POINT_TARGET_PROB_205 "Describes the possibility if more than one real-world object has led to this detection. 0[%] := 100[%] Multi target probability";
CM_ SG_ 1075 DET_EXISTENCE_PROB_205 "Existence probability of the detection not based on history. Value does  not depend on any past experience with similar detections.
\note Use as confidence measure where a low value means less confidence
and a high value indicates strong confidence.";
CM_ SG_ 1075 DET_OUTSIDE_SECTOR_205 "Flag to indicate detections outside the sector, set if the wrong sector calibration matrix was used";
CM_ SG_ 1075 DET_HVC_FLAG_205 "Core2 Vehicle clutter flag";
CM_ SG_ 1075 DET_CONFD_AZIMUTH_205 "Define the Confidence of Azimuth for Detection ";
CM_ SG_ 1075 DET_CONFD_ELEVATION_205 "Define the Confidence of Elevation for the Detection ";
CM_ SG_ 1075 DET_BI_STATIC_FLAG_206 "1 if detection is bi-static 0 otherwise";
CM_ SG_ 1075 DET_BI_STATIC_FLAG_207 "1 if detection is bi-static 0 otherwise";
CM_ SG_ 1075 DET_BI_STATIC_FLAG_208 "1 if detection is bi-static 0 otherwise";
CM_ SG_ 1075 DET_MH_SCAN_INDEX_4LSB_205_208 "Scan index of the measured detection";
CM_ SG_ 1075 DET_MH_CYCLE_COUNTER_205_208 "Detection Alive Counter";
CM_ SG_ 1076 DET_RANGE_209 " measured position  of the detection";
CM_ SG_ 1076 DET_RANGE_ERR_209 "RMSE or standard deviation of the measured angle  of the detection";
CM_ SG_ 1076 DET_RANGE_VELOCITY_209 "Radial velocity of the detection positive in direction to the sensor";
CM_ SG_ 1076 DET_RANGE_VELOCITY_ERR_209 "RMSE or standard deviation of the measure radial velocity of the detection";
CM_ SG_ 1076 DET_AZIMUTH_209 "Measured angle  of the detection";
CM_ SG_ 1076 DET_AZIMUTH_ERR_209 "RMSE or standard deviation of the measured angle  of the detection";
CM_ SG_ 1076 DET_ELEVATION_209 "measured elevation of the detection";
CM_ SG_ 1076 DET_ELEVATION_ERR_209 "RMSE or standard deviation of the measured elevation  of the detection";
CM_ SG_ 1076 DET_RCS_209 "Radar Cross Section or Amplitude, is a measure of how detectable an object is by radar. A larger RCS indicates that an object is more easily detected.";
CM_ SG_ 1076 DET_VALID_FLAG_209 "is set if the measured detection is valid";
CM_ SG_ 1076 DET_BI_STATIC_FLAG_209 "1 if detection is bi-static 0 otherwise";
CM_ SG_ 1076 DET_SUPER_RES_TARGET_209 "flasg is set if the detection is super resolution target";
CM_ SG_ 1076 DET_SNR_209 "The signal to noise ratio (SNR) of the radar detection";
CM_ SG_ 1076 DET_POINT_TARGET_PROB_209 "Describes the possibility if more than one real-world object has led to this detection. 0[%] := 100[%] Multi target probability";
CM_ SG_ 1076 DET_EXISTENCE_PROB_209 "Existence probability of the detection not based on history. Value does  not depend on any past experience with similar detections.
\note Use as confidence measure where a low value means less confidence
and a high value indicates strong confidence.";
CM_ SG_ 1076 DET_OUTSIDE_SECTOR_209 "Flag to indicate detections outside the sector, set if the wrong sector calibration matrix was used";
CM_ SG_ 1076 DET_HVC_FLAG_209 "Core2 Vehicle clutter flag";
CM_ SG_ 1076 DET_CONFD_AZIMUTH_209 "Define the Confidence of Azimuth for Detection ";
CM_ SG_ 1076 DET_CONFD_ELEVATION_209 "Define the Confidence of Elevation for the Detection ";
CM_ SG_ 1076 DET_BI_STATIC_FLAG_210 "1 if detection is bi-static 0 otherwise";
CM_ SG_ 1076 DET_BI_STATIC_FLAG_211 "1 if detection is bi-static 0 otherwise";
CM_ SG_ 1076 DET_BI_STATIC_FLAG_212 "1 if detection is bi-static 0 otherwise";
CM_ SG_ 1076 DET_MH_SCAN_INDEX_4LSB_209_212 "Scan index of the measured detection";
CM_ SG_ 1076 DET_MH_CYCLE_COUNTER_209_212 "Detection Alive Counter";
CM_ SG_ 1077 DET_RANGE_213 " measured position  of the detection";
CM_ SG_ 1077 DET_RANGE_ERR_213 "RMSE or standard deviation of the measured angle  of the detection";
CM_ SG_ 1077 DET_RANGE_VELOCITY_213 "Radial velocity of the detection positive in direction to the sensor";
CM_ SG_ 1077 DET_RANGE_VELOCITY_ERR_213 "RMSE or standard deviation of the measure radial velocity of the detection";
CM_ SG_ 1077 DET_AZIMUTH_213 "Measured angle  of the detection";
CM_ SG_ 1077 DET_AZIMUTH_ERR_213 "RMSE or standard deviation of the measured angle  of the detection";
CM_ SG_ 1077 DET_ELEVATION_213 "measured elevation of the detection";
CM_ SG_ 1077 DET_ELEVATION_ERR_213 "RMSE or standard deviation of the measured elevation  of the detection";
CM_ SG_ 1077 DET_RCS_213 "Radar Cross Section or Amplitude, is a measure of how detectable an object is by radar. A larger RCS indicates that an object is more easily detected.";
CM_ SG_ 1077 DET_VALID_FLAG_213 "is set if the measured detection is valid";
CM_ SG_ 1077 DET_BI_STATIC_FLAG_213 "1 if detection is bi-static 0 otherwise";
CM_ SG_ 1077 DET_SUPER_RES_TARGET_213 "flasg is set if the detection is super resolution target";
CM_ SG_ 1077 DET_SNR_213 "The signal to noise ratio (SNR) of the radar detection";
CM_ SG_ 1077 DET_POINT_TARGET_PROB_213 "Describes the possibility if more than one real-world object has led to this detection. 0[%] := 100[%] Multi target probability";
CM_ SG_ 1077 DET_EXISTENCE_PROB_213 "Existence probability of the detection not based on history. Value does  not depend on any past experience with similar detections.
\note Use as confidence measure where a low value means less confidence
and a high value indicates strong confidence.";
CM_ SG_ 1077 DET_OUTSIDE_SECTOR_213 "Flag to indicate detections outside the sector, set if the wrong sector calibration matrix was used";
CM_ SG_ 1077 DET_HVC_FLAG_213 "Core2 Vehicle clutter flag";
CM_ SG_ 1077 DET_CONFD_AZIMUTH_213 "Define the Confidence of Azimuth for Detection ";
CM_ SG_ 1077 DET_CONFD_ELEVATION_213 "Define the Confidence of Elevation for the Detection ";
CM_ SG_ 1077 DET_BI_STATIC_FLAG_214 "1 if detection is bi-static 0 otherwise";
CM_ SG_ 1077 DET_BI_STATIC_FLAG_215 "1 if detection is bi-static 0 otherwise";
CM_ SG_ 1077 DET_BI_STATIC_FLAG_216 "1 if detection is bi-static 0 otherwise";
CM_ SG_ 1077 DET_MH_SCAN_INDEX_4LSB_213_216 "Scan index of the measured detection";
CM_ SG_ 1077 DET_MH_CYCLE_COUNTER_213_216 "Detection Alive Counter";
CM_ SG_ 1078 DET_RANGE_217 " measured position  of the detection";
CM_ SG_ 1078 DET_RANGE_ERR_217 "RMSE or standard deviation of the measured angle  of the detection";
CM_ SG_ 1078 DET_RANGE_VELOCITY_217 "Radial velocity of the detection positive in direction to the sensor";
CM_ SG_ 1078 DET_RANGE_VELOCITY_ERR_217 "RMSE or standard deviation of the measure radial velocity of the detection";
CM_ SG_ 1078 DET_AZIMUTH_217 "Measured angle  of the detection";
CM_ SG_ 1078 DET_AZIMUTH_ERR_217 "RMSE or standard deviation of the measured angle  of the detection";
CM_ SG_ 1078 DET_ELEVATION_217 "measured elevation of the detection";
CM_ SG_ 1078 DET_ELEVATION_ERR_217 "RMSE or standard deviation of the measured elevation  of the detection";
CM_ SG_ 1078 DET_RCS_217 "Radar Cross Section or Amplitude, is a measure of how detectable an object is by radar. A larger RCS indicates that an object is more easily detected.";
CM_ SG_ 1078 DET_VALID_FLAG_217 "is set if the measured detection is valid";
CM_ SG_ 1078 DET_BI_STATIC_FLAG_217 "1 if detection is bi-static 0 otherwise";
CM_ SG_ 1078 DET_SUPER_RES_TARGET_217 "flasg is set if the detection is super resolution target";
CM_ SG_ 1078 DET_SNR_217 "The signal to noise ratio (SNR) of the radar detection";
CM_ SG_ 1078 DET_POINT_TARGET_PROB_217 "Describes the possibility if more than one real-world object has led to this detection. 0[%] := 100[%] Multi target probability";
CM_ SG_ 1078 DET_EXISTENCE_PROB_217 "Existence probability of the detection not based on history. Value does  not depend on any past experience with similar detections.
\note Use as confidence measure where a low value means less confidence
and a high value indicates strong confidence.";
CM_ SG_ 1078 DET_OUTSIDE_SECTOR_217 "Flag to indicate detections outside the sector, set if the wrong sector calibration matrix was used";
CM_ SG_ 1078 DET_HVC_FLAG_217 "Core2 Vehicle clutter flag";
CM_ SG_ 1078 DET_CONFD_AZIMUTH_217 "Define the Confidence of Azimuth for Detection ";
CM_ SG_ 1078 DET_CONFD_ELEVATION_217 "Define the Confidence of Elevation for the Detection ";
CM_ SG_ 1078 DET_BI_STATIC_FLAG_218 "1 if detection is bi-static 0 otherwise";
CM_ SG_ 1078 DET_BI_STATIC_FLAG_219 "1 if detection is bi-static 0 otherwise";
CM_ SG_ 1078 DET_BI_STATIC_FLAG_220 "1 if detection is bi-static 0 otherwise";
CM_ SG_ 1078 DET_MH_SCAN_INDEX_4LSB_217_220 "Scan index of the measured detection";
CM_ SG_ 1078 DET_MH_CYCLE_COUNTER_217_220 "Detection Alive Counter";
CM_ SG_ 1079 DET_RANGE_221 " measured position  of the detection";
CM_ SG_ 1079 DET_RANGE_ERR_221 "RMSE or standard deviation of the measured angle  of the detection";
CM_ SG_ 1079 DET_RANGE_VELOCITY_221 "Radial velocity of the detection positive in direction to the sensor";
CM_ SG_ 1079 DET_RANGE_VELOCITY_ERR_221 "RMSE or standard deviation of the measure radial velocity of the detection";
CM_ SG_ 1079 DET_AZIMUTH_221 "Measured angle  of the detection";
CM_ SG_ 1079 DET_AZIMUTH_ERR_221 "RMSE or standard deviation of the measured angle  of the detection";
CM_ SG_ 1079 DET_ELEVATION_221 "measured elevation of the detection";
CM_ SG_ 1079 DET_ELEVATION_ERR_221 "RMSE or standard deviation of the measured elevation  of the detection";
CM_ SG_ 1079 DET_RCS_221 "Radar Cross Section or Amplitude, is a measure of how detectable an object is by radar. A larger RCS indicates that an object is more easily detected.";
CM_ SG_ 1079 DET_VALID_FLAG_221 "is set if the measured detection is valid";
CM_ SG_ 1079 DET_BI_STATIC_FLAG_221 "1 if detection is bi-static 0 otherwise";
CM_ SG_ 1079 DET_SUPER_RES_TARGET_221 "flasg is set if the detection is super resolution target";
CM_ SG_ 1079 DET_SNR_221 "The signal to noise ratio (SNR) of the radar detection";
CM_ SG_ 1079 DET_POINT_TARGET_PROB_221 "Describes the possibility if more than one real-world object has led to this detection. 0[%] := 100[%] Multi target probability";
CM_ SG_ 1079 DET_EXISTENCE_PROB_221 "Existence probability of the detection not based on history. Value does  not depend on any past experience with similar detections.
\note Use as confidence measure where a low value means less confidence
and a high value indicates strong confidence.";
CM_ SG_ 1079 DET_OUTSIDE_SECTOR_221 "Flag to indicate detections outside the sector, set if the wrong sector calibration matrix was used";
CM_ SG_ 1079 DET_HVC_FLAG_221 "Core2 Vehicle clutter flag";
CM_ SG_ 1079 DET_CONFD_AZIMUTH_221 "Define the Confidence of Azimuth for Detection ";
CM_ SG_ 1079 DET_CONFD_ELEVATION_221 "Define the Confidence of Elevation for the Detection ";
CM_ SG_ 1079 DET_BI_STATIC_FLAG_222 "1 if detection is bi-static 0 otherwise";
CM_ SG_ 1079 DET_BI_STATIC_FLAG_223 "1 if detection is bi-static 0 otherwise";
CM_ SG_ 1079 DET_BI_STATIC_FLAG_224 "1 if detection is bi-static 0 otherwise";
CM_ SG_ 1079 DET_MH_SCAN_INDEX_4LSB_221_224 "Scan index of the measured detection";
CM_ SG_ 1079 DET_MH_CYCLE_COUNTER_221_224 "Detection Alive Counter";
CM_ SG_ 1080 DET_RANGE_225 " measured position  of the detection";
CM_ SG_ 1080 DET_RANGE_ERR_225 "RMSE or standard deviation of the measured angle  of the detection";
CM_ SG_ 1080 DET_RANGE_VELOCITY_225 "Radial velocity of the detection positive in direction to the sensor";
CM_ SG_ 1080 DET_RANGE_VELOCITY_ERR_225 "RMSE or standard deviation of the measure radial velocity of the detection";
CM_ SG_ 1080 DET_AZIMUTH_225 "Measured angle  of the detection";
CM_ SG_ 1080 DET_AZIMUTH_ERR_225 "RMSE or standard deviation of the measured angle  of the detection";
CM_ SG_ 1080 DET_ELEVATION_225 "measured elevation of the detection";
CM_ SG_ 1080 DET_ELEVATION_ERR_225 "RMSE or standard deviation of the measured elevation  of the detection";
CM_ SG_ 1080 DET_RCS_225 "Radar Cross Section or Amplitude, is a measure of how detectable an object is by radar. A larger RCS indicates that an object is more easily detected.";
CM_ SG_ 1080 DET_VALID_FLAG_225 "is set if the measured detection is valid";
CM_ SG_ 1080 DET_BI_STATIC_FLAG_225 "1 if detection is bi-static 0 otherwise";
CM_ SG_ 1080 DET_SUPER_RES_TARGET_225 "flasg is set if the detection is super resolution target";
CM_ SG_ 1080 DET_SNR_225 "The signal to noise ratio (SNR) of the radar detection";
CM_ SG_ 1080 DET_POINT_TARGET_PROB_225 "Describes the possibility if more than one real-world object has led to this detection. 0[%] := 100[%] Multi target probability";
CM_ SG_ 1080 DET_EXISTENCE_PROB_225 "Existence probability of the detection not based on history. Value does  not depend on any past experience with similar detections.
\note Use as confidence measure where a low value means less confidence
and a high value indicates strong confidence.";
CM_ SG_ 1080 DET_OUTSIDE_SECTOR_225 "Flag to indicate detections outside the sector, set if the wrong sector calibration matrix was used";
CM_ SG_ 1080 DET_HVC_FLAG_225 "Core2 Vehicle clutter flag";
CM_ SG_ 1080 DET_CONFD_AZIMUTH_225 "Define the Confidence of Azimuth for Detection ";
CM_ SG_ 1080 DET_CONFD_ELEVATION_225 "Define the Confidence of Elevation for the Detection ";
CM_ SG_ 1080 DET_BI_STATIC_FLAG_226 "1 if detection is bi-static 0 otherwise";
CM_ SG_ 1080 DET_BI_STATIC_FLAG_227 "1 if detection is bi-static 0 otherwise";
CM_ SG_ 1080 DET_BI_STATIC_FLAG_228 "1 if detection is bi-static 0 otherwise";
CM_ SG_ 1080 DET_MH_SCAN_INDEX_4LSB_225_228 "Scan index of the measured detection";
CM_ SG_ 1080 DET_MH_CYCLE_COUNTER_225_228 "Detection Alive Counter";
CM_ SG_ 1081 DET_RANGE_229 " measured position  of the detection";
CM_ SG_ 1081 DET_RANGE_ERR_229 "RMSE or standard deviation of the measured angle  of the detection";
CM_ SG_ 1081 DET_RANGE_VELOCITY_229 "Radial velocity of the detection positive in direction to the sensor";
CM_ SG_ 1081 DET_RANGE_VELOCITY_ERR_229 "RMSE or standard deviation of the measure radial velocity of the detection";
CM_ SG_ 1081 DET_AZIMUTH_229 "Measured angle  of the detection";
CM_ SG_ 1081 DET_AZIMUTH_ERR_229 "RMSE or standard deviation of the measured angle  of the detection";
CM_ SG_ 1081 DET_ELEVATION_229 "measured elevation of the detection";
CM_ SG_ 1081 DET_ELEVATION_ERR_229 "RMSE or standard deviation of the measured elevation  of the detection";
CM_ SG_ 1081 DET_RCS_229 "Radar Cross Section or Amplitude, is a measure of how detectable an object is by radar. A larger RCS indicates that an object is more easily detected.";
CM_ SG_ 1081 DET_VALID_FLAG_229 "is set if the measured detection is valid";
CM_ SG_ 1081 DET_BI_STATIC_FLAG_229 "1 if detection is bi-static 0 otherwise";
CM_ SG_ 1081 DET_SUPER_RES_TARGET_229 "flasg is set if the detection is super resolution target";
CM_ SG_ 1081 DET_SNR_229 "The signal to noise ratio (SNR) of the radar detection";
CM_ SG_ 1081 DET_POINT_TARGET_PROB_229 "Describes the possibility if more than one real-world object has led to this detection. 0[%] := 100[%] Multi target probability";
CM_ SG_ 1081 DET_EXISTENCE_PROB_229 "Existence probability of the detection not based on history. Value does  not depend on any past experience with similar detections.
\note Use as confidence measure where a low value means less confidence
and a high value indicates strong confidence.";
CM_ SG_ 1081 DET_OUTSIDE_SECTOR_229 "Flag to indicate detections outside the sector, set if the wrong sector calibration matrix was used";
CM_ SG_ 1081 DET_HVC_FLAG_229 "Core2 Vehicle clutter flag";
CM_ SG_ 1081 DET_CONFD_AZIMUTH_229 "Define the Confidence of Azimuth for Detection ";
CM_ SG_ 1081 DET_CONFD_ELEVATION_229 "Define the Confidence of Elevation for the Detection ";
CM_ SG_ 1081 DET_BI_STATIC_FLAG_230 "1 if detection is bi-static 0 otherwise";
CM_ SG_ 1081 DET_BI_STATIC_FLAG_231 "1 if detection is bi-static 0 otherwise";
CM_ SG_ 1081 DET_BI_STATIC_FLAG_232 "1 if detection is bi-static 0 otherwise";
CM_ SG_ 1081 DET_MH_SCAN_INDEX_4LSB_229_232 "Scan index of the measured detection";
CM_ SG_ 1081 DET_MH_CYCLE_COUNTER_229_232 "Detection Alive Counter";
CM_ SG_ 1082 DET_RANGE_233 " measured position  of the detection";
CM_ SG_ 1082 DET_RANGE_ERR_233 "RMSE or standard deviation of the measured angle  of the detection";
CM_ SG_ 1082 DET_RANGE_VELOCITY_233 "Radial velocity of the detection positive in direction to the sensor";
CM_ SG_ 1082 DET_RANGE_VELOCITY_ERR_233 "RMSE or standard deviation of the measure radial velocity of the detection";
CM_ SG_ 1082 DET_AZIMUTH_233 "Measured angle  of the detection";
CM_ SG_ 1082 DET_AZIMUTH_ERR_233 "RMSE or standard deviation of the measured angle  of the detection";
CM_ SG_ 1082 DET_ELEVATION_233 "measured elevation of the detection";
CM_ SG_ 1082 DET_ELEVATION_ERR_233 "RMSE or standard deviation of the measured elevation  of the detection";
CM_ SG_ 1082 DET_RCS_233 "Radar Cross Section or Amplitude, is a measure of how detectable an object is by radar. A larger RCS indicates that an object is more easily detected.";
CM_ SG_ 1082 DET_VALID_FLAG_233 "is set if the measured detection is valid";
CM_ SG_ 1082 DET_BI_STATIC_FLAG_233 "1 if detection is bi-static 0 otherwise";
CM_ SG_ 1082 DET_SUPER_RES_TARGET_233 "flasg is set if the detection is super resolution target";
CM_ SG_ 1082 DET_SNR_233 "The signal to noise ratio (SNR) of the radar detection";
CM_ SG_ 1082 DET_POINT_TARGET_PROB_233 "Describes the possibility if more than one real-world object has led to this detection. 0[%] := 100[%] Multi target probability";
CM_ SG_ 1082 DET_EXISTENCE_PROB_233 "Existence probability of the detection not based on history. Value does  not depend on any past experience with similar detections.
\note Use as confidence measure where a low value means less confidence
and a high value indicates strong confidence.";
CM_ SG_ 1082 DET_OUTSIDE_SECTOR_233 "Flag to indicate detections outside the sector, set if the wrong sector calibration matrix was used";
CM_ SG_ 1082 DET_HVC_FLAG_233 "Core2 Vehicle clutter flag";
CM_ SG_ 1082 DET_CONFD_AZIMUTH_233 "Define the Confidence of Azimuth for Detection ";
CM_ SG_ 1082 DET_CONFD_ELEVATION_233 "Define the Confidence of Elevation for the Detection ";
CM_ SG_ 1082 DET_BI_STATIC_FLAG_234 "1 if detection is bi-static 0 otherwise";
CM_ SG_ 1082 DET_BI_STATIC_FLAG_235 "1 if detection is bi-static 0 otherwise";
CM_ SG_ 1082 DET_BI_STATIC_FLAG_236 "1 if detection is bi-static 0 otherwise";
CM_ SG_ 1082 DET_MH_SCAN_INDEX_4LSB_233_236 "Scan index of the measured detection";
CM_ SG_ 1082 DET_MH_CYCLE_COUNTER_233_236 "Detection Alive Counter";
CM_ SG_ 1083 DET_RANGE_237 " measured position  of the detection";
CM_ SG_ 1083 DET_RANGE_ERR_237 "RMSE or standard deviation of the measured angle  of the detection";
CM_ SG_ 1083 DET_RANGE_VELOCITY_237 "Radial velocity of the detection positive in direction to the sensor";
CM_ SG_ 1083 DET_RANGE_VELOCITY_ERR_237 "RMSE or standard deviation of the measure radial velocity of the detection";
CM_ SG_ 1083 DET_AZIMUTH_237 "Measured angle  of the detection";
CM_ SG_ 1083 DET_AZIMUTH_ERR_237 "RMSE or standard deviation of the measured angle  of the detection";
CM_ SG_ 1083 DET_ELEVATION_237 "measured elevation of the detection";
CM_ SG_ 1083 DET_ELEVATION_ERR_237 "RMSE or standard deviation of the measured elevation  of the detection";
CM_ SG_ 1083 DET_RCS_237 "Radar Cross Section or Amplitude, is a measure of how detectable an object is by radar. A larger RCS indicates that an object is more easily detected.";
CM_ SG_ 1083 DET_VALID_FLAG_237 "is set if the measured detection is valid";
CM_ SG_ 1083 DET_BI_STATIC_FLAG_237 "1 if detection is bi-static 0 otherwise";
CM_ SG_ 1083 DET_SUPER_RES_TARGET_237 "flasg is set if the detection is super resolution target";
CM_ SG_ 1083 DET_SNR_237 "The signal to noise ratio (SNR) of the radar detection";
CM_ SG_ 1083 DET_POINT_TARGET_PROB_237 "Describes the possibility if more than one real-world object has led to this detection. 0[%] := 100[%] Multi target probability";
CM_ SG_ 1083 DET_EXISTENCE_PROB_237 "Existence probability of the detection not based on history. Value does  not depend on any past experience with similar detections.
\note Use as confidence measure where a low value means less confidence
and a high value indicates strong confidence.";
CM_ SG_ 1083 DET_OUTSIDE_SECTOR_237 "Flag to indicate detections outside the sector, set if the wrong sector calibration matrix was used";
CM_ SG_ 1083 DET_HVC_FLAG_237 "Core2 Vehicle clutter flag";
CM_ SG_ 1083 DET_CONFD_AZIMUTH_237 "Define the Confidence of Azimuth for Detection ";
CM_ SG_ 1083 DET_CONFD_ELEVATION_237 "Define the Confidence of Elevation for the Detection ";
CM_ SG_ 1083 DET_BI_STATIC_FLAG_238 "1 if detection is bi-static 0 otherwise";
CM_ SG_ 1083 DET_BI_STATIC_FLAG_239 "1 if detection is bi-static 0 otherwise";
CM_ SG_ 1083 DET_BI_STATIC_FLAG_240 "1 if detection is bi-static 0 otherwise";
CM_ SG_ 1083 DET_MH_SCAN_INDEX_4LSB_237_240 "Scan index of the measured detection";
CM_ SG_ 1083 DET_MH_CYCLE_COUNTER_237_240 "Detection Alive Counter";
CM_ SG_ 1084 DET_RANGE_241 " measured position  of the detection";
CM_ SG_ 1084 DET_RANGE_ERR_241 "RMSE or standard deviation of the measured angle  of the detection";
CM_ SG_ 1084 DET_RANGE_VELOCITY_241 "Radial velocity of the detection positive in direction to the sensor";
CM_ SG_ 1084 DET_RANGE_VELOCITY_ERR_241 "RMSE or standard deviation of the measure radial velocity of the detection";
CM_ SG_ 1084 DET_AZIMUTH_241 "Measured angle  of the detection";
CM_ SG_ 1084 DET_AZIMUTH_ERR_241 "RMSE or standard deviation of the measured angle  of the detection";
CM_ SG_ 1084 DET_ELEVATION_241 "measured elevation of the detection";
CM_ SG_ 1084 DET_ELEVATION_ERR_241 "RMSE or standard deviation of the measured elevation  of the detection";
CM_ SG_ 1084 DET_RCS_241 "Radar Cross Section or Amplitude, is a measure of how detectable an object is by radar. A larger RCS indicates that an object is more easily detected.";
CM_ SG_ 1084 DET_VALID_FLAG_241 "is set if the measured detection is valid";
CM_ SG_ 1084 DET_BI_STATIC_FLAG_241 "1 if detection is bi-static 0 otherwise";
CM_ SG_ 1084 DET_SUPER_RES_TARGET_241 "flasg is set if the detection is super resolution target";
CM_ SG_ 1084 DET_SNR_241 "The signal to noise ratio (SNR) of the radar detection";
CM_ SG_ 1084 DET_POINT_TARGET_PROB_241 "Describes the possibility if more than one real-world object has led to this detection. 0[%] := 100[%] Multi target probability";
CM_ SG_ 1084 DET_EXISTENCE_PROB_241 "Existence probability of the detection not based on history. Value does  not depend on any past experience with similar detections.
\note Use as confidence measure where a low value means less confidence
and a high value indicates strong confidence.";
CM_ SG_ 1084 DET_OUTSIDE_SECTOR_241 "Flag to indicate detections outside the sector, set if the wrong sector calibration matrix was used";
CM_ SG_ 1084 DET_HVC_FLAG_241 "Core2 Vehicle clutter flag";
CM_ SG_ 1084 DET_CONFD_AZIMUTH_241 "Define the Confidence of Azimuth for Detection ";
CM_ SG_ 1084 DET_CONFD_ELEVATION_241 "Define the Confidence of Elevation for the Detection ";
CM_ SG_ 1084 DET_BI_STATIC_FLAG_242 "1 if detection is bi-static 0 otherwise";
CM_ SG_ 1084 DET_BI_STATIC_FLAG_243 "1 if detection is bi-static 0 otherwise";
CM_ SG_ 1084 DET_BI_STATIC_FLAG_244 "1 if detection is bi-static 0 otherwise";
CM_ SG_ 1084 DET_MH_SCAN_INDEX_4LSB_241_244 "Scan index of the measured detection";
CM_ SG_ 1084 DET_MH_CYCLE_COUNTER_241_244 "Detection Alive Counter";
CM_ SG_ 1085 DET_RANGE_245 " measured position  of the detection";
CM_ SG_ 1085 DET_RANGE_ERR_245 "RMSE or standard deviation of the measured angle  of the detection";
CM_ SG_ 1085 DET_RANGE_VELOCITY_245 "Radial velocity of the detection positive in direction to the sensor";
CM_ SG_ 1085 DET_RANGE_VELOCITY_ERR_245 "RMSE or standard deviation of the measure radial velocity of the detection";
CM_ SG_ 1085 DET_AZIMUTH_245 "Measured angle  of the detection";
CM_ SG_ 1085 DET_AZIMUTH_ERR_245 "RMSE or standard deviation of the measured angle  of the detection";
CM_ SG_ 1085 DET_ELEVATION_245 "measured elevation of the detection";
CM_ SG_ 1085 DET_ELEVATION_ERR_245 "RMSE or standard deviation of the measured elevation  of the detection";
CM_ SG_ 1085 DET_RCS_245 "Radar Cross Section or Amplitude, is a measure of how detectable an object is by radar. A larger RCS indicates that an object is more easily detected.";
CM_ SG_ 1085 DET_VALID_FLAG_245 "is set if the measured detection is valid";
CM_ SG_ 1085 DET_BI_STATIC_FLAG_245 "1 if detection is bi-static 0 otherwise";
CM_ SG_ 1085 DET_SUPER_RES_TARGET_245 "flasg is set if the detection is super resolution target";
CM_ SG_ 1085 DET_SNR_245 "The signal to noise ratio (SNR) of the radar detection";
CM_ SG_ 1085 DET_POINT_TARGET_PROB_245 "Describes the possibility if more than one real-world object has led to this detection. 0[%] := 100[%] Multi target probability";
CM_ SG_ 1085 DET_EXISTENCE_PROB_245 "Existence probability of the detection not based on history. Value does  not depend on any past experience with similar detections.
\note Use as confidence measure where a low value means less confidence
and a high value indicates strong confidence.";
CM_ SG_ 1085 DET_OUTSIDE_SECTOR_245 "Flag to indicate detections outside the sector, set if the wrong sector calibration matrix was used";
CM_ SG_ 1085 DET_HVC_FLAG_245 "Core2 Vehicle clutter flag";
CM_ SG_ 1085 DET_CONFD_AZIMUTH_245 "Define the Confidence of Azimuth for Detection ";
CM_ SG_ 1085 DET_CONFD_ELEVATION_245 "Define the Confidence of Elevation for the Detection ";
CM_ SG_ 1085 DET_BI_STATIC_FLAG_246 "1 if detection is bi-static 0 otherwise";
CM_ SG_ 1085 DET_BI_STATIC_FLAG_247 "1 if detection is bi-static 0 otherwise";
CM_ SG_ 1085 DET_BI_STATIC_FLAG_248 "1 if detection is bi-static 0 otherwise";
CM_ SG_ 1085 DET_MH_SCAN_INDEX_4LSB_245_248 "Scan index of the measured detection";
CM_ SG_ 1085 DET_MH_CYCLE_COUNTER_245_248 "Detection Alive Counter";
CM_ SG_ 1086 DET_RANGE_249 " measured position  of the detection";
CM_ SG_ 1086 DET_RANGE_ERR_249 "RMSE or standard deviation of the measured angle  of the detection";
CM_ SG_ 1086 DET_RANGE_VELOCITY_249 "Radial velocity of the detection positive in direction to the sensor";
CM_ SG_ 1086 DET_RANGE_VELOCITY_ERR_249 "RMSE or standard deviation of the measure radial velocity of the detection";
CM_ SG_ 1086 DET_AZIMUTH_249 "Measured angle  of the detection";
CM_ SG_ 1086 DET_AZIMUTH_ERR_249 "RMSE or standard deviation of the measured angle  of the detection";
CM_ SG_ 1086 DET_ELEVATION_249 "measured elevation of the detection";
CM_ SG_ 1086 DET_ELEVATION_ERR_249 "RMSE or standard deviation of the measured elevation  of the detection";
CM_ SG_ 1086 DET_RCS_249 "Radar Cross Section or Amplitude, is a measure of how detectable an object is by radar. A larger RCS indicates that an object is more easily detected.";
CM_ SG_ 1086 DET_VALID_FLAG_249 "is set if the measured detection is valid";
CM_ SG_ 1086 DET_BI_STATIC_FLAG_249 "1 if detection is bi-static 0 otherwise";
CM_ SG_ 1086 DET_SUPER_RES_TARGET_249 "flasg is set if the detection is super resolution target";
CM_ SG_ 1086 DET_SNR_249 "The signal to noise ratio (SNR) of the radar detection";
CM_ SG_ 1086 DET_POINT_TARGET_PROB_249 "Describes the possibility if more than one real-world object has led to this detection. 0[%] := 100[%] Multi target probability";
CM_ SG_ 1086 DET_EXISTENCE_PROB_249 "Existence probability of the detection not based on history. Value does  not depend on any past experience with similar detections.
\note Use as confidence measure where a low value means less confidence
and a high value indicates strong confidence.";
CM_ SG_ 1086 DET_OUTSIDE_SECTOR_249 "Flag to indicate detections outside the sector, set if the wrong sector calibration matrix was used";
CM_ SG_ 1086 DET_HVC_FLAG_249 "Core2 Vehicle clutter flag";
CM_ SG_ 1086 DET_CONFD_AZIMUTH_249 "Define the Confidence of Azimuth for Detection ";
CM_ SG_ 1086 DET_CONFD_ELEVATION_249 "Define the Confidence of Elevation for the Detection ";
CM_ SG_ 1086 DET_BI_STATIC_FLAG_250 "1 if detection is bi-static 0 otherwise";
CM_ SG_ 1086 DET_BI_STATIC_FLAG_251 "1 if detection is bi-static 0 otherwise";
CM_ SG_ 1086 DET_BI_STATIC_FLAG_252 "1 if detection is bi-static 0 otherwise";
CM_ SG_ 1086 DET_MH_SCAN_INDEX_4LSB_249_252 "Scan index of the measured detection";
CM_ SG_ 1086 DET_MH_CYCLE_COUNTER_249_252 "Detection Alive Counter";
CM_ SG_ 1087 DET_RANGE_253 " measured position  of the detection";
CM_ SG_ 1087 DET_RANGE_ERR_253 "RMSE or standard deviation of the measured angle  of the detection";
CM_ SG_ 1087 DET_RANGE_VELOCITY_253 "Radial velocity of the detection positive in direction to the sensor";
CM_ SG_ 1087 DET_RANGE_VELOCITY_ERR_253 "RMSE or standard deviation of the measure radial velocity of the detection";
CM_ SG_ 1087 DET_AZIMUTH_253 "Measured angle  of the detection";
CM_ SG_ 1087 DET_AZIMUTH_ERR_253 "RMSE or standard deviation of the measured angle  of the detection";
CM_ SG_ 1087 DET_ELEVATION_253 "measured elevation of the detection";
CM_ SG_ 1087 DET_ELEVATION_ERR_253 "RMSE or standard deviation of the measured elevation  of the detection";
CM_ SG_ 1087 DET_RCS_253 "Radar Cross Section or Amplitude, is a measure of how detectable an object is by radar. A larger RCS indicates that an object is more easily detected.";
CM_ SG_ 1087 DET_VALID_FLAG_253 "is set if the measured detection is valid";
CM_ SG_ 1087 DET_BI_STATIC_FLAG_253 "1 if detection is bi-static 0 otherwise";
CM_ SG_ 1087 DET_SUPER_RES_TARGET_253 "flasg is set if the detection is super resolution target";
CM_ SG_ 1087 DET_SNR_253 "The signal to noise ratio (SNR) of the radar detection";
CM_ SG_ 1087 DET_POINT_TARGET_PROB_253 "Describes the possibility if more than one real-world object has led to this detection. 0[%] := 100[%] Multi target probability";
CM_ SG_ 1087 DET_EXISTENCE_PROB_253 "Existence probability of the detection not based on history. Value does  not depend on any past experience with similar detections.
\note Use as confidence measure where a low value means less confidence
and a high value indicates strong confidence.";
CM_ SG_ 1087 DET_OUTSIDE_SECTOR_253 "Flag to indicate detections outside the sector, set if the wrong sector calibration matrix was used";
CM_ SG_ 1087 DET_HVC_FLAG_253 "Core2 Vehicle clutter flag";
CM_ SG_ 1087 DET_CONFD_AZIMUTH_253 "Define the Confidence of Azimuth for Detection ";
CM_ SG_ 1087 DET_CONFD_ELEVATION_253 "Define the Confidence of Elevation for the Detection ";
CM_ SG_ 1087 DET_BI_STATIC_FLAG_254 "1 if detection is bi-static 0 otherwise";
CM_ SG_ 1087 DET_BI_STATIC_FLAG_255 "1 if detection is bi-static 0 otherwise";
CM_ SG_ 1087 DET_BI_STATIC_FLAG_256 "1 if detection is bi-static 0 otherwise";
CM_ SG_ 1087 DET_MH_SCAN_INDEX_4LSB_253_256 "Scan index of the measured detection";
CM_ SG_ 1087 DET_MH_CYCLE_COUNTER_253_256 "Detection Alive Counter";
CM_ SG_ 1088 DET_RANGE_257 " measured position  of the detection";
CM_ SG_ 1088 DET_RANGE_ERR_257 "RMSE or standard deviation of the measured angle  of the detection";
CM_ SG_ 1088 DET_RANGE_VELOCITY_257 "Radial velocity of the detection positive in direction to the sensor";
CM_ SG_ 1088 DET_RANGE_VELOCITY_ERR_257 "RMSE or standard deviation of the measure radial velocity of the detection";
CM_ SG_ 1088 DET_AZIMUTH_257 "Measured angle  of the detection";
CM_ SG_ 1088 DET_AZIMUTH_ERR_257 "RMSE or standard deviation of the measured angle  of the detection";
CM_ SG_ 1088 DET_ELEVATION_257 "measured elevation of the detection";
CM_ SG_ 1088 DET_ELEVATION_ERR_257 "RMSE or standard deviation of the measured elevation  of the detection";
CM_ SG_ 1088 DET_RCS_257 "Radar Cross Section or Amplitude, is a measure of how detectable an object is by radar. A larger RCS indicates that an object is more easily detected.";
CM_ SG_ 1088 DET_VALID_FLAG_257 "is set if the measured detection is valid";
CM_ SG_ 1088 DET_BI_STATIC_FLAG_257 "1 if detection is bi-static 0 otherwise";
CM_ SG_ 1088 DET_SUPER_RES_TARGET_257 "flasg is set if the detection is super resolution target";
CM_ SG_ 1088 DET_SNR_257 "The signal to noise ratio (SNR) of the radar detection";
CM_ SG_ 1088 DET_POINT_TARGET_PROB_257 "Describes the possibility if more than one real-world object has led to this detection. 0[%] := 100[%] Multi target probability";
CM_ SG_ 1088 DET_EXISTENCE_PROB_257 "Existence probability of the detection not based on history. Value does  not depend on any past experience with similar detections.
\note Use as confidence measure where a low value means less confidence
and a high value indicates strong confidence.";
CM_ SG_ 1088 DET_OUTSIDE_SECTOR_257 "Flag to indicate detections outside the sector, set if the wrong sector calibration matrix was used";
CM_ SG_ 1088 DET_HVC_FLAG_257 "Core2 Vehicle clutter flag";
CM_ SG_ 1088 DET_CONFD_AZIMUTH_257 "Define the Confidence of Azimuth for Detection ";
CM_ SG_ 1088 DET_CONFD_ELEVATION_257 "Define the Confidence of Elevation for the Detection ";
CM_ SG_ 1088 DET_BI_STATIC_FLAG_258 "1 if detection is bi-static 0 otherwise";
CM_ SG_ 1088 DET_BI_STATIC_FLAG_259 "1 if detection is bi-static 0 otherwise";
CM_ SG_ 1088 DET_BI_STATIC_FLAG_260 "1 if detection is bi-static 0 otherwise";
CM_ SG_ 1088 DET_MH_SCAN_INDEX_4LSB_257_260 "Scan index of the measured detection";
CM_ SG_ 1088 DET_MH_CYCLE_COUNTER_257_260 "Detection Alive Counter";
BA_DEF_ BO_  "CanTpBs" INT 0 255;
BA_DEF_ BO_  "DiagRequest" ENUM  "No","Yes";
BA_DEF_ BO_  "DiagResponse" ENUM  "No","Yes";
BA_DEF_ BO_  "E2EDataId" INT 0 65535;
BA_DEF_ BO_  "E2EDataLength" INT 0 65535;
BA_DEF_ BO_  "E2EProfile" STRING ;
BA_DEF_ BO_  "EventRateOfChange" INT 10 10000;
BA_DEF_ BO_  "GenMsgCycleTime" INT 0 100000;
BA_DEF_ BO_  "GenMsgILSupport" ENUM  "No","Yes";
BA_DEF_ BO_  "GenMsgNrOfRepetition" INT 0 100;
BA_DEF_ BO_  "GenMsgSendType" ENUM  "FixedPeriodic","Event","EnabledPeriodic","NotUsed","NotUsed","EventPeriodic","NotUsed","NotUsed","NoMsgSendType";
BA_DEF_ BO_  "NetworkInitialization" ENUM  "No","Yes";
BA_DEF_ BO_  "NmAsrMessage" ENUM  "No","Yes";
BA_DEF_ BO_  "NmMessage" ENUM  "No","Yes";
BA_DEF_ BO_  "SCP_AuthInfoTxLength" INT 0 512;
BA_DEF_ BO_  "SCP_DataId" INT 0 65535;
BA_DEF_ BO_  "SCP_FreshnessValueId" INT 0 65535;
BA_DEF_ BO_  "SCP_FreshnessValueLength" INT 0 512;
BA_DEF_ BO_  "SCP_FreshnessValueTxLength" INT 0 512;
BA_DEF_ BO_  "SC_Message" ENUM  "No","Yes","Yes, split message";
BA_DEF_ BO_  "TpTxIndex" INT 0 255;
BA_DEF_ BO_  "VFrameFormat" ENUM  "StandardCAN","ExtendedCAN","reserved","reserved","reserved","reserved","reserved","reserved","reserved","reserved","reserved","reserved","reserved","reserved","StandardCAN_FD","ExtendedCAN_FD";
BA_DEF_ SG_  "GenSigCmt" STRING ;
BA_DEF_ SG_  "GenSigCycleTime" INT 0 0;
BA_DEF_ SG_  "GenSigSendType" ENUM  "Cyclic","OnWrite","vector_leerstring","OnChange","vector_leerstring","IfActive","vector_leerstring","NoSigSendType";
BA_DEF_ SG_  "GenSigStartValue" INT 0 1000000000;
BA_DEF_ SG_  "GenSigTimeoutTime" INT 0 0;
BA_DEF_ SG_  "GenSigVtEn" STRING ;
BA_DEF_ SG_  "GenSigVtName" STRING ;
BA_DEF_ SG_  "InvalidValue" STRING ;
BA_DEF_DEF_  "CanTpBs" 255;
BA_DEF_DEF_  "DiagRequest" "No";
BA_DEF_DEF_  "DiagResponse" "No";
BA_DEF_DEF_  "E2EDataId" 0;
BA_DEF_DEF_  "E2EDataLength" 0;
BA_DEF_DEF_  "E2EProfile" "";
BA_DEF_DEF_  "EventRateOfChange" 10000;
BA_DEF_DEF_  "GenMsgCycleTime" 0;
BA_DEF_DEF_  "GenMsgILSupport" "Yes";
BA_DEF_DEF_  "GenMsgNrOfRepetition" 0;
BA_DEF_DEF_  "GenMsgSendType" "NoMsgSendType";
BA_DEF_DEF_  "NetworkInitialization" "Yes";
BA_DEF_DEF_  "NmAsrMessage" "No";
BA_DEF_DEF_  "NmMessage" "No";
BA_DEF_DEF_  "SCP_AuthInfoTxLength" 28;
BA_DEF_DEF_  "SCP_DataId" 0;
BA_DEF_DEF_  "SCP_FreshnessValueId" 0;
BA_DEF_DEF_  "SCP_FreshnessValueLength" 48;
BA_DEF_DEF_  "SCP_FreshnessValueTxLength" 4;
BA_DEF_DEF_  "SC_Message" "No";
BA_DEF_DEF_  "TpTxIndex" 0;
BA_DEF_DEF_  "VFrameFormat" "StandardCAN_FD";
BA_DEF_DEF_  "GenSigCmt" "";
BA_DEF_DEF_  "GenSigCycleTime" 0;
BA_DEF_DEF_  "GenSigSendType" "NoSigSendType";
BA_DEF_DEF_  "GenSigStartValue" 0;
BA_DEF_DEF_  "GenSigTimeoutTime" 0;
BA_DEF_DEF_  "GenSigVtEn" "";
BA_DEF_DEF_  "GenSigVtName" "";
BA_DEF_DEF_  "InvalidValue" "";
BA_ "GenMsgSendType" BO_ 1071 1;
BA_ "GenMsgSendType" BO_ 1072 1;
BA_ "GenMsgSendType" BO_ 1073 1;
BA_ "GenMsgSendType" BO_ 1074 1;
BA_ "GenMsgSendType" BO_ 1075 1;
BA_ "GenMsgSendType" BO_ 1076 1;
BA_ "GenMsgSendType" BO_ 1077 1;
BA_ "GenMsgSendType" BO_ 1078 1;
BA_ "GenMsgSendType" BO_ 1079 1;
BA_ "GenMsgSendType" BO_ 1080 1;
BA_ "GenMsgSendType" BO_ 1081 1;
BA_ "GenMsgSendType" BO_ 1082 1;
BA_ "GenMsgSendType" BO_ 1083 1;
BA_ "GenMsgSendType" BO_ 1084 1;
BA_ "GenMsgSendType" BO_ 1085 1;
BA_ "GenMsgSendType" BO_ 1086 1;
BA_ "GenMsgSendType" BO_ 1087 1;
BA_ "GenMsgSendType" BO_ 1088 1;
BA_ "GenSigStartValue" SG_ 1071 DET_RANGE_VELOCITY_189 16384;
BA_ "GenSigStartValue" SG_ 1071 DET_RCS_189 128;
BA_ "GenSigStartValue" SG_ 1071 DET_RANGE_VELOCITY_190 16384;
BA_ "GenSigStartValue" SG_ 1071 DET_RCS_190 128;
BA_ "GenSigStartValue" SG_ 1071 DET_RANGE_VELOCITY_191 16384;
BA_ "GenSigStartValue" SG_ 1071 DET_RCS_191 128;
BA_ "GenSigStartValue" SG_ 1071 DET_RANGE_VELOCITY_192 16384;
BA_ "GenSigStartValue" SG_ 1071 DET_RCS_192 128;
BA_ "GenSigStartValue" SG_ 1072 DET_RANGE_VELOCITY_193 16384;
BA_ "GenSigStartValue" SG_ 1072 DET_RCS_193 128;
BA_ "GenSigStartValue" SG_ 1072 DET_RANGE_VELOCITY_194 16384;
BA_ "GenSigStartValue" SG_ 1072 DET_RCS_194 128;
BA_ "GenSigStartValue" SG_ 1072 DET_RANGE_VELOCITY_195 16384;
BA_ "GenSigStartValue" SG_ 1072 DET_RCS_195 128;
BA_ "GenSigStartValue" SG_ 1072 DET_RANGE_VELOCITY_196 16384;
BA_ "GenSigStartValue" SG_ 1072 DET_RCS_196 128;
BA_ "GenSigStartValue" SG_ 1073 DET_RANGE_VELOCITY_197 16384;
BA_ "GenSigStartValue" SG_ 1073 DET_RCS_197 128;
BA_ "GenSigStartValue" SG_ 1073 DET_RANGE_VELOCITY_198 16384;
BA_ "GenSigStartValue" SG_ 1073 DET_RCS_198 128;
BA_ "GenSigStartValue" SG_ 1073 DET_RANGE_VELOCITY_199 16384;
BA_ "GenSigStartValue" SG_ 1073 DET_RCS_199 128;
BA_ "GenSigStartValue" SG_ 1073 DET_RANGE_VELOCITY_200 16384;
BA_ "GenSigStartValue" SG_ 1073 DET_RCS_200 128;
BA_ "GenSigStartValue" SG_ 1074 DET_RANGE_VELOCITY_201 16384;
BA_ "GenSigStartValue" SG_ 1074 DET_RCS_201 128;
BA_ "GenSigStartValue" SG_ 1074 DET_RANGE_VELOCITY_202 16384;
BA_ "GenSigStartValue" SG_ 1074 DET_RCS_202 128;
BA_ "GenSigStartValue" SG_ 1074 DET_RANGE_VELOCITY_203 16384;
BA_ "GenSigStartValue" SG_ 1074 DET_RCS_203 128;
BA_ "GenSigStartValue" SG_ 1074 DET_RANGE_VELOCITY_204 16384;
BA_ "GenSigStartValue" SG_ 1074 DET_RCS_204 128;
BA_ "GenSigStartValue" SG_ 1075 DET_RANGE_VELOCITY_205 16384;
BA_ "GenSigStartValue" SG_ 1075 DET_RCS_205 128;
BA_ "GenSigStartValue" SG_ 1075 DET_RANGE_VELOCITY_206 16384;
BA_ "GenSigStartValue" SG_ 1075 DET_RCS_206 128;
BA_ "GenSigStartValue" SG_ 1075 DET_RANGE_VELOCITY_207 16384;
BA_ "GenSigStartValue" SG_ 1075 DET_RCS_207 128;
BA_ "GenSigStartValue" SG_ 1075 DET_RANGE_VELOCITY_208 16384;
BA_ "GenSigStartValue" SG_ 1075 DET_RCS_208 128;
BA_ "GenSigStartValue" SG_ 1076 DET_RANGE_VELOCITY_209 16384;
BA_ "GenSigStartValue" SG_ 1076 DET_RCS_209 128;
BA_ "GenSigStartValue" SG_ 1076 DET_RANGE_VELOCITY_210 16384;
BA_ "GenSigStartValue" SG_ 1076 DET_RCS_210 128;
BA_ "GenSigStartValue" SG_ 1076 DET_RANGE_VELOCITY_211 16384;
BA_ "GenSigStartValue" SG_ 1076 DET_RCS_211 128;
BA_ "GenSigStartValue" SG_ 1076 DET_RANGE_VELOCITY_212 16384;
BA_ "GenSigStartValue" SG_ 1076 DET_RCS_212 128;
BA_ "GenSigStartValue" SG_ 1077 DET_RANGE_VELOCITY_213 16384;
BA_ "GenSigStartValue" SG_ 1077 DET_RCS_213 128;
BA_ "GenSigStartValue" SG_ 1077 DET_RANGE_VELOCITY_214 16384;
BA_ "GenSigStartValue" SG_ 1077 DET_RCS_214 128;
BA_ "GenSigStartValue" SG_ 1077 DET_RANGE_VELOCITY_215 16384;
BA_ "GenSigStartValue" SG_ 1077 DET_RCS_215 128;
BA_ "GenSigStartValue" SG_ 1077 DET_RANGE_VELOCITY_216 16384;
BA_ "GenSigStartValue" SG_ 1077 DET_RCS_216 128;
BA_ "GenSigStartValue" SG_ 1078 DET_RANGE_VELOCITY_217 16384;
BA_ "GenSigStartValue" SG_ 1078 DET_RCS_217 128;
BA_ "GenSigStartValue" SG_ 1078 DET_RANGE_VELOCITY_218 16384;
BA_ "GenSigStartValue" SG_ 1078 DET_RCS_218 128;
BA_ "GenSigStartValue" SG_ 1078 DET_RANGE_VELOCITY_219 16384;
BA_ "GenSigStartValue" SG_ 1078 DET_RCS_219 128;
BA_ "GenSigStartValue" SG_ 1078 DET_RANGE_VELOCITY_220 16384;
BA_ "GenSigStartValue" SG_ 1078 DET_RCS_220 128;
BA_ "GenSigStartValue" SG_ 1079 DET_RANGE_VELOCITY_221 16384;
BA_ "GenSigStartValue" SG_ 1079 DET_RCS_221 128;
BA_ "GenSigStartValue" SG_ 1079 DET_RANGE_VELOCITY_222 16384;
BA_ "GenSigStartValue" SG_ 1079 DET_RCS_222 128;
BA_ "GenSigStartValue" SG_ 1079 DET_RANGE_VELOCITY_223 16384;
BA_ "GenSigStartValue" SG_ 1079 DET_RCS_223 128;
BA_ "GenSigStartValue" SG_ 1079 DET_RANGE_VELOCITY_224 16384;
BA_ "GenSigStartValue" SG_ 1079 DET_RCS_224 128;
BA_ "GenSigStartValue" SG_ 1080 DET_RANGE_VELOCITY_225 16384;
BA_ "GenSigStartValue" SG_ 1080 DET_RCS_225 128;
BA_ "GenSigStartValue" SG_ 1080 DET_RANGE_VELOCITY_226 16384;
BA_ "GenSigStartValue" SG_ 1080 DET_RCS_226 128;
BA_ "GenSigStartValue" SG_ 1080 DET_RANGE_VELOCITY_227 16384;
BA_ "GenSigStartValue" SG_ 1080 DET_RCS_227 128;
BA_ "GenSigStartValue" SG_ 1080 DET_RANGE_VELOCITY_228 16384;
BA_ "GenSigStartValue" SG_ 1080 DET_RCS_228 128;
BA_ "GenSigStartValue" SG_ 1081 DET_RANGE_VELOCITY_229 16384;
BA_ "GenSigStartValue" SG_ 1081 DET_RCS_229 128;
BA_ "GenSigStartValue" SG_ 1081 DET_RANGE_VELOCITY_230 16384;
BA_ "GenSigStartValue" SG_ 1081 DET_RCS_230 128;
BA_ "GenSigStartValue" SG_ 1081 DET_RANGE_VELOCITY_231 16384;
BA_ "GenSigStartValue" SG_ 1081 DET_RCS_231 128;
BA_ "GenSigStartValue" SG_ 1081 DET_RANGE_VELOCITY_232 16384;
BA_ "GenSigStartValue" SG_ 1081 DET_RCS_232 128;
BA_ "GenSigStartValue" SG_ 1082 DET_RANGE_VELOCITY_233 16384;
BA_ "GenSigStartValue" SG_ 1082 DET_RCS_233 128;
BA_ "GenSigStartValue" SG_ 1082 DET_RANGE_VELOCITY_234 16384;
BA_ "GenSigStartValue" SG_ 1082 DET_RCS_234 128;
BA_ "GenSigStartValue" SG_ 1082 DET_RANGE_VELOCITY_235 16384;
BA_ "GenSigStartValue" SG_ 1082 DET_RCS_235 128;
BA_ "GenSigStartValue" SG_ 1082 DET_RANGE_VELOCITY_236 16384;
BA_ "GenSigStartValue" SG_ 1082 DET_RCS_236 128;
BA_ "GenSigStartValue" SG_ 1083 DET_RANGE_VELOCITY_237 16384;
BA_ "GenSigStartValue" SG_ 1083 DET_RCS_237 128;
BA_ "GenSigStartValue" SG_ 1083 DET_RANGE_VELOCITY_238 16384;
BA_ "GenSigStartValue" SG_ 1083 DET_RCS_238 128;
BA_ "GenSigStartValue" SG_ 1083 DET_RANGE_VELOCITY_239 16384;
BA_ "GenSigStartValue" SG_ 1083 DET_RCS_239 128;
BA_ "GenSigStartValue" SG_ 1083 DET_RANGE_VELOCITY_240 16384;
BA_ "GenSigStartValue" SG_ 1083 DET_RCS_240 128;
BA_ "GenSigStartValue" SG_ 1084 DET_RANGE_VELOCITY_241 16384;
BA_ "GenSigStartValue" SG_ 1084 DET_RCS_241 128;
BA_ "GenSigStartValue" SG_ 1084 DET_RANGE_VELOCITY_242 16384;
BA_ "GenSigStartValue" SG_ 1084 DET_RCS_242 128;
BA_ "GenSigStartValue" SG_ 1084 DET_RANGE_VELOCITY_243 16384;
BA_ "GenSigStartValue" SG_ 1084 DET_RCS_243 128;
BA_ "GenSigStartValue" SG_ 1084 DET_RANGE_VELOCITY_244 16384;
BA_ "GenSigStartValue" SG_ 1084 DET_RCS_244 128;
BA_ "GenSigStartValue" SG_ 1085 DET_RANGE_VELOCITY_245 16384;
BA_ "GenSigStartValue" SG_ 1085 DET_RCS_245 128;
BA_ "GenSigStartValue" SG_ 1085 DET_RANGE_VELOCITY_246 16384;
BA_ "GenSigStartValue" SG_ 1085 DET_RCS_246 128;
BA_ "GenSigStartValue" SG_ 1085 DET_RANGE_VELOCITY_247 16384;
BA_ "GenSigStartValue" SG_ 1085 DET_RCS_247 128;
BA_ "GenSigStartValue" SG_ 1085 DET_RANGE_VELOCITY_248 16384;
BA_ "GenSigStartValue" SG_ 1085 DET_RCS_248 128;
BA_ "GenSigStartValue" SG_ 1086 DET_RANGE_VELOCITY_249 16384;
BA_ "GenSigStartValue" SG_ 1086 DET_RCS_249 128;
BA_ "GenSigStartValue" SG_ 1086 DET_RANGE_VELOCITY_250 16384;
BA_ "GenSigStartValue" SG_ 1086 DET_RCS_250 128;
BA_ "GenSigStartValue" SG_ 1086 DET_RANGE_VELOCITY_251 16384;
BA_ "GenSigStartValue" SG_ 1086 DET_RCS_251 128;
BA_ "GenSigStartValue" SG_ 1086 DET_RANGE_VELOCITY_252 16384;
BA_ "GenSigStartValue" SG_ 1086 DET_RCS_252 128;
BA_ "GenSigStartValue" SG_ 1087 DET_RANGE_VELOCITY_253 16384;
BA_ "GenSigStartValue" SG_ 1087 DET_RCS_253 128;
BA_ "GenSigStartValue" SG_ 1087 DET_RANGE_VELOCITY_254 16384;
BA_ "GenSigStartValue" SG_ 1087 DET_RCS_254 128;
BA_ "GenSigStartValue" SG_ 1087 DET_RANGE_VELOCITY_255 16384;
BA_ "GenSigStartValue" SG_ 1087 DET_RCS_255 128;
BA_ "GenSigStartValue" SG_ 1087 DET_RANGE_VELOCITY_256 16384;
BA_ "GenSigStartValue" SG_ 1087 DET_RCS_256 128;
BA_ "GenSigStartValue" SG_ 1088 DET_RANGE_VELOCITY_257 16384;
BA_ "GenSigStartValue" SG_ 1088 DET_RCS_257 128;
BA_ "GenSigStartValue" SG_ 1088 DET_RANGE_VELOCITY_258 16384;
BA_ "GenSigStartValue" SG_ 1088 DET_RCS_258 128;
BA_ "GenSigStartValue" SG_ 1088 DET_RANGE_VELOCITY_259 16384;
BA_ "GenSigStartValue" SG_ 1088 DET_RCS_259 128;
BA_ "GenSigStartValue" SG_ 1088 DET_RANGE_VELOCITY_260 16384;
BA_ "GenSigStartValue" SG_ 1088 DET_RCS_260 128;
VAL_ 1071 DET_CONFD_AZIMUTH_189 0 "High" 1 "MidHigh" 2 "MidLow" 3 "Low" ;
VAL_ 1071 DET_CONFD_ELEVATION_189 0 "High" 1 "MidHigh" 2 "MidLow" 3 "Low" ;
VAL_ 1071 DET_CONFD_AZIMUTH_190 0 "High" 1 "MidHigh" 2 "MidLow" 3 "Low" ;
VAL_ 1071 DET_CONFD_ELEVATION_190 0 "High" 1 "MidHigh" 2 "MidLow" 3 "Low" ;
VAL_ 1071 DET_CONFD_AZIMUTH_191 0 "High" 1 "MidHigh" 2 "MidLow" 3 "Low" ;
VAL_ 1071 DET_CONFD_ELEVATION_191 0 "High" 1 "MidHigh" 2 "MidLow" 3 "Low" ;
VAL_ 1072 DET_CONFD_AZIMUTH_193 0 "High" 1 "MidHigh" 2 "MidLow" 3 "Low" ;
VAL_ 1072 DET_CONFD_ELEVATION_193 0 "High" 1 "MidHigh" 2 "MidLow" 3 "Low" ;
VAL_ 1072 DET_CONFD_AZIMUTH_194 0 "High" 1 "MidHigh" 2 "MidLow" 3 "Low" ;
VAL_ 1072 DET_CONFD_ELEVATION_194 0 "High" 1 "MidHigh" 2 "MidLow" 3 "Low" ;
VAL_ 1072 DET_CONFD_AZIMUTH_195 0 "High" 1 "MidHigh" 2 "MidLow" 3 "Low" ;
VAL_ 1072 DET_CONFD_ELEVATION_195 0 "High" 1 "MidHigh" 2 "MidLow" 3 "Low" ;
VAL_ 1073 DET_CONFD_AZIMUTH_197 0 "High" 1 "MidHigh" 2 "MidLow" 3 "Low" ;
VAL_ 1073 DET_CONFD_ELEVATION_197 0 "High" 1 "MidHigh" 2 "MidLow" 3 "Low" ;
VAL_ 1073 DET_CONFD_AZIMUTH_198 0 "High" 1 "MidHigh" 2 "MidLow" 3 "Low" ;
VAL_ 1073 DET_CONFD_ELEVATION_198 0 "High" 1 "MidHigh" 2 "MidLow" 3 "Low" ;
VAL_ 1073 DET_CONFD_AZIMUTH_199 0 "High" 1 "MidHigh" 2 "MidLow" 3 "Low" ;
VAL_ 1073 DET_CONFD_ELEVATION_199 0 "High" 1 "MidHigh" 2 "MidLow" 3 "Low" ;
VAL_ 1074 DET_CONFD_AZIMUTH_201 0 "High" 1 "MidHigh" 2 "MidLow" 3 "Low" ;
VAL_ 1074 DET_CONFD_ELEVATION_201 0 "High" 1 "MidHigh" 2 "MidLow" 3 "Low" ;
VAL_ 1074 DET_CONFD_AZIMUTH_202 0 "High" 1 "MidHigh" 2 "MidLow" 3 "Low" ;
VAL_ 1074 DET_CONFD_ELEVATION_202 0 "High" 1 "MidHigh" 2 "MidLow" 3 "Low" ;
VAL_ 1074 DET_CONFD_AZIMUTH_203 0 "High" 1 "MidHigh" 2 "MidLow" 3 "Low" ;
VAL_ 1074 DET_CONFD_ELEVATION_203 0 "High" 1 "MidHigh" 2 "MidLow" 3 "Low" ;
VAL_ 1075 DET_CONFD_AZIMUTH_205 0 "High" 1 "MidHigh" 2 "MidLow" 3 "Low" ;
VAL_ 1075 DET_CONFD_ELEVATION_205 0 "High" 1 "MidHigh" 2 "MidLow" 3 "Low" ;
VAL_ 1075 DET_CONFD_AZIMUTH_206 0 "High" 1 "MidHigh" 2 "MidLow" 3 "Low" ;
VAL_ 1075 DET_CONFD_ELEVATION_206 0 "High" 1 "MidHigh" 2 "MidLow" 3 "Low" ;
VAL_ 1075 DET_CONFD_AZIMUTH_207 0 "High" 1 "MidHigh" 2 "MidLow" 3 "Low" ;
VAL_ 1075 DET_CONFD_ELEVATION_207 0 "High" 1 "MidHigh" 2 "MidLow" 3 "Low" ;
VAL_ 1076 DET_CONFD_AZIMUTH_209 0 "High" 1 "MidHigh" 2 "MidLow" 3 "Low" ;
VAL_ 1076 DET_CONFD_ELEVATION_209 0 "High" 1 "MidHigh" 2 "MidLow" 3 "Low" ;
VAL_ 1076 DET_CONFD_AZIMUTH_210 0 "High" 1 "MidHigh" 2 "MidLow" 3 "Low" ;
VAL_ 1076 DET_CONFD_ELEVATION_210 0 "High" 1 "MidHigh" 2 "MidLow" 3 "Low" ;
VAL_ 1076 DET_CONFD_AZIMUTH_211 0 "High" 1 "MidHigh" 2 "MidLow" 3 "Low" ;
VAL_ 1076 DET_CONFD_ELEVATION_211 0 "High" 1 "MidHigh" 2 "MidLow" 3 "Low" ;
VAL_ 1077 DET_CONFD_AZIMUTH_213 0 "High" 1 "MidHigh" 2 "MidLow" 3 "Low" ;
VAL_ 1077 DET_CONFD_ELEVATION_213 0 "High" 1 "MidHigh" 2 "MidLow" 3 "Low" ;
VAL_ 1077 DET_CONFD_AZIMUTH_214 0 "High" 1 "MidHigh" 2 "MidLow" 3 "Low" ;
VAL_ 1077 DET_CONFD_ELEVATION_214 0 "High" 1 "MidHigh" 2 "MidLow" 3 "Low" ;
VAL_ 1077 DET_CONFD_AZIMUTH_215 0 "High" 1 "MidHigh" 2 "MidLow" 3 "Low" ;
VAL_ 1077 DET_CONFD_ELEVATION_215 0 "High" 1 "MidHigh" 2 "MidLow" 3 "Low" ;
VAL_ 1078 DET_CONFD_AZIMUTH_217 0 "High" 1 "MidHigh" 2 "MidLow" 3 "Low" ;
VAL_ 1078 DET_CONFD_ELEVATION_217 0 "High" 1 "MidHigh" 2 "MidLow" 3 "Low" ;
VAL_ 1078 DET_CONFD_AZIMUTH_218 0 "High" 1 "MidHigh" 2 "MidLow" 3 "Low" ;
VAL_ 1078 DET_CONFD_ELEVATION_218 0 "High" 1 "MidHigh" 2 "MidLow" 3 "Low" ;
VAL_ 1078 DET_CONFD_AZIMUTH_219 0 "High" 1 "MidHigh" 2 "MidLow" 3 "Low" ;
VAL_ 1078 DET_CONFD_ELEVATION_219 0 "High" 1 "MidHigh" 2 "MidLow" 3 "Low" ;
VAL_ 1079 DET_CONFD_AZIMUTH_221 0 "High" 1 "MidHigh" 2 "MidLow" 3 "Low" ;
VAL_ 1079 DET_CONFD_ELEVATION_221 0 "High" 1 "MidHigh" 2 "MidLow" 3 "Low" ;
VAL_ 1079 DET_CONFD_AZIMUTH_222 0 "High" 1 "MidHigh" 2 "MidLow" 3 "Low" ;
VAL_ 1079 DET_CONFD_ELEVATION_222 0 "High" 1 "MidHigh" 2 "MidLow" 3 "Low" ;
VAL_ 1079 DET_CONFD_AZIMUTH_223 0 "High" 1 "MidHigh" 2 "MidLow" 3 "Low" ;
VAL_ 1079 DET_CONFD_ELEVATION_223 0 "High" 1 "MidHigh" 2 "MidLow" 3 "Low" ;
VAL_ 1080 DET_CONFD_AZIMUTH_225 0 "High" 1 "MidHigh" 2 "MidLow" 3 "Low" ;
VAL_ 1080 DET_CONFD_ELEVATION_225 0 "High" 1 "MidHigh" 2 "MidLow" 3 "Low" ;
VAL_ 1080 DET_CONFD_AZIMUTH_226 0 "High" 1 "MidHigh" 2 "MidLow" 3 "Low" ;
VAL_ 1080 DET_CONFD_ELEVATION_226 0 "High" 1 "MidHigh" 2 "MidLow" 3 "Low" ;
VAL_ 1080 DET_CONFD_AZIMUTH_227 0 "High" 1 "MidHigh" 2 "MidLow" 3 "Low" ;
VAL_ 1080 DET_CONFD_ELEVATION_227 0 "High" 1 "MidHigh" 2 "MidLow" 3 "Low" ;
VAL_ 1081 DET_CONFD_AZIMUTH_229 0 "High" 1 "MidHigh" 2 "MidLow" 3 "Low" ;
VAL_ 1081 DET_CONFD_ELEVATION_229 0 "High" 1 "MidHigh" 2 "MidLow" 3 "Low" ;
VAL_ 1081 DET_CONFD_AZIMUTH_230 0 "High" 1 "MidHigh" 2 "MidLow" 3 "Low" ;
VAL_ 1081 DET_CONFD_ELEVATION_230 0 "High" 1 "MidHigh" 2 "MidLow" 3 "Low" ;
VAL_ 1081 DET_CONFD_AZIMUTH_231 0 "High" 1 "MidHigh" 2 "MidLow" 3 "Low" ;
VAL_ 1081 DET_CONFD_ELEVATION_231 0 "High" 1 "MidHigh" 2 "MidLow" 3 "Low" ;
VAL_ 1082 DET_CONFD_AZIMUTH_233 0 "High" 1 "MidHigh" 2 "MidLow" 3 "Low" ;
VAL_ 1082 DET_CONFD_ELEVATION_233 0 "High" 1 "MidHigh" 2 "MidLow" 3 "Low" ;
VAL_ 1082 DET_CONFD_AZIMUTH_234 0 "High" 1 "MidHigh" 2 "MidLow" 3 "Low" ;
VAL_ 1082 DET_CONFD_ELEVATION_234 0 "High" 1 "MidHigh" 2 "MidLow" 3 "Low" ;
VAL_ 1082 DET_CONFD_AZIMUTH_235 0 "High" 1 "MidHigh" 2 "MidLow" 3 "Low" ;
VAL_ 1082 DET_CONFD_ELEVATION_235 0 "High" 1 "MidHigh" 2 "MidLow" 3 "Low" ;
VAL_ 1083 DET_CONFD_AZIMUTH_237 0 "High" 1 "MidHigh" 2 "MidLow" 3 "Low" ;
VAL_ 1083 DET_CONFD_ELEVATION_237 0 "High" 1 "MidHigh" 2 "MidLow" 3 "Low" ;
VAL_ 1083 DET_CONFD_AZIMUTH_238 0 "High" 1 "MidHigh" 2 "MidLow" 3 "Low" ;
VAL_ 1083 DET_CONFD_ELEVATION_238 0 "High" 1 "MidHigh" 2 "MidLow" 3 "Low" ;
VAL_ 1083 DET_CONFD_AZIMUTH_239 0 "High" 1 "MidHigh" 2 "MidLow" 3 "Low" ;
VAL_ 1083 DET_CONFD_ELEVATION_239 0 "High" 1 "MidHigh" 2 "MidLow" 3 "Low" ;
VAL_ 1084 DET_CONFD_AZIMUTH_241 0 "High" 1 "MidHigh" 2 "MidLow" 3 "Low" ;
VAL_ 1084 DET_CONFD_ELEVATION_241 0 "High" 1 "MidHigh" 2 "MidLow" 3 "Low" ;
VAL_ 1084 DET_CONFD_AZIMUTH_242 0 "High" 1 "MidHigh" 2 "MidLow" 3 "Low" ;
VAL_ 1084 DET_CONFD_ELEVATION_242 0 "High" 1 "MidHigh" 2 "MidLow" 3 "Low" ;
VAL_ 1084 DET_CONFD_AZIMUTH_243 0 "High" 1 "MidHigh" 2 "MidLow" 3 "Low" ;
VAL_ 1084 DET_CONFD_ELEVATION_243 0 "High" 1 "MidHigh" 2 "MidLow" 3 "Low" ;
VAL_ 1085 DET_CONFD_AZIMUTH_245 0 "High" 1 "MidHigh" 2 "MidLow" 3 "Low" ;
VAL_ 1085 DET_CONFD_ELEVATION_245 0 "High" 1 "MidHigh" 2 "MidLow" 3 "Low" ;
VAL_ 1085 DET_CONFD_AZIMUTH_246 0 "High" 1 "MidHigh" 2 "MidLow" 3 "Low" ;
VAL_ 1085 DET_CONFD_ELEVATION_246 0 "High" 1 "MidHigh" 2 "MidLow" 3 "Low" ;
VAL_ 1085 DET_CONFD_AZIMUTH_247 0 "High" 1 "MidHigh" 2 "MidLow" 3 "Low" ;
VAL_ 1085 DET_CONFD_ELEVATION_247 0 "High" 1 "MidHigh" 2 "MidLow" 3 "Low" ;
VAL_ 1086 DET_CONFD_AZIMUTH_249 0 "High" 1 "MidHigh" 2 "MidLow" 3 "Low" ;
VAL_ 1086 DET_CONFD_ELEVATION_249 0 "High" 1 "MidHigh" 2 "MidLow" 3 "Low" ;
VAL_ 1086 DET_CONFD_AZIMUTH_250 0 "High" 1 "MidHigh" 2 "MidLow" 3 "Low" ;
VAL_ 1086 DET_CONFD_ELEVATION_250 0 "High" 1 "MidHigh" 2 "MidLow" 3 "Low" ;
VAL_ 1086 DET_CONFD_AZIMUTH_251 0 "High" 1 "MidHigh" 2 "MidLow" 3 "Low" ;
VAL_ 1086 DET_CONFD_ELEVATION_251 0 "High" 1 "MidHigh" 2 "MidLow" 3 "Low" ;
VAL_ 1087 DET_CONFD_AZIMUTH_253 0 "High" 1 "MidHigh" 2 "MidLow" 3 "Low" ;
VAL_ 1087 DET_CONFD_ELEVATION_253 0 "High" 1 "MidHigh" 2 "MidLow" 3 "Low" ;
VAL_ 1087 DET_CONFD_AZIMUTH_254 0 "High" 1 "MidHigh" 2 "MidLow" 3 "Low" ;
VAL_ 1087 DET_CONFD_ELEVATION_254 0 "High" 1 "MidHigh" 2 "MidLow" 3 "Low" ;
VAL_ 1087 DET_CONFD_AZIMUTH_255 0 "High" 1 "MidHigh" 2 "MidLow" 3 "Low" ;
VAL_ 1087 DET_CONFD_ELEVATION_255 0 "High" 1 "MidHigh" 2 "MidLow" 3 "Low" ;
VAL_ 1088 DET_CONFD_AZIMUTH_257 0 "High" 1 "MidHigh" 2 "MidLow" 3 "Low" ;
VAL_ 1088 DET_CONFD_ELEVATION_257 0 "High" 1 "MidHigh" 2 "MidLow" 3 "Low" ;
VAL_ 1088 DET_CONFD_AZIMUTH_258 0 "High" 1 "MidHigh" 2 "MidLow" 3 "Low" ;
VAL_ 1088 DET_CONFD_ELEVATION_258 0 "High" 1 "MidHigh" 2 "MidLow" 3 "Low" ;
VAL_ 1088 DET_CONFD_AZIMUTH_259 0 "High" 1 "MidHigh" 2 "MidLow" 3 "Low" ;
VAL_ 1088 DET_CONFD_ELEVATION_259 0 "High" 1 "MidHigh" 2 "MidLow" 3 "Low" ;
SIG_GROUP_ 1071 Detections_189_192 1 : DET_MH_CRC16_189_192 DET_MH_CYCLE_COUNTER_189_192 DET_MH_SCAN_INDEX_4LSB_189_192 DET_CONFD_ELEVATION_189 DET_CONFD_AZIMUTH_189 DET_HVC_FLAG_189 DET_OUTSIDE_SECTOR_189 DET_EXISTENCE_PROB_189 DET_POINT_TARGET_PROB_189 DET_SNR_189 DET_SUPER_RES_TARGET_189 DET_BI_STATIC_FLAG_189 DET_VALID_FLAG_189 DET_RCS_189 DET_ELEVATION_ERR_189 DET_ELEVATION_189 DET_AZIMUTH_ERR_189 DET_AZIMUTH_189 DET_RANGE_VELOCITY_ERR_189 DET_RANGE_VELOCITY_189 DET_RANGE_ERR_189 DET_RANGE_189 DET_CONFD_ELEVATION_190 DET_CONFD_AZIMUTH_190 DET_HVC_FLAG_190 DET_OUTSIDE_SECTOR_190 DET_EXISTENCE_PROB_190 DET_POINT_TARGET_PROB_190 DET_SNR_190 DET_SUPER_RES_TARGET_190 DET_BI_STATIC_FLAG_190 DET_VALID_FLAG_190 DET_RCS_190 DET_ELEVATION_ERR_190 DET_ELEVATION_190 DET_AZIMUTH_ERR_190 DET_AZIMUTH_190 DET_RANGE_VELOCITY_ERR_190 DET_RANGE_VELOCITY_190 DET_RANGE_ERR_190 DET_RANGE_190 DET_CONFD_ELEVATION_191 DET_CONFD_AZIMUTH_191 DET_HVC_FLAG_191 DET_OUTSIDE_SECTOR_191 DET_EXISTENCE_PROB_191 DET_POINT_TARGET_PROB_191 DET_SNR_191 DET_SUPER_RES_TARGET_191 DET_BI_STATIC_FLAG_191 DET_VALID_FLAG_191 DET_RCS_191 DET_ELEVATION_ERR_191 DET_ELEVATION_191 DET_AZIMUTH_ERR_191 DET_AZIMUTH_191 DET_RANGE_VELOCITY_ERR_191 DET_RANGE_VELOCITY_191 DET_RANGE_ERR_191 DET_RANGE_191 DET_CONFD_ELEVATION_192 DET_CONFD_AZIMUTH_192 DET_HVC_FLAG_192 DET_OUTSIDE_SECTOR_192 DET_EXISTENCE_PROB_192 DET_POINT_TARGET_PROB_192 DET_SNR_192 DET_SUPER_RES_TARGET_192 DET_BI_STATIC_FLAG_192 DET_VALID_FLAG_192 DET_RCS_192 DET_ELEVATION_ERR_192 DET_ELEVATION_192 DET_AZIMUTH_ERR_192 DET_AZIMUTH_192 DET_RANGE_VELOCITY_ERR_192 DET_RANGE_VELOCITY_192 DET_RANGE_ERR_192 DET_RANGE_192;
SIG_GROUP_ 1072 Detections_193_196 1 : DET_MH_CRC16_193_196 DET_MH_CYCLE_COUNTER_193_196 DET_MH_SCAN_INDEX_4LSB_193_196 DET_CONFD_ELEVATION_193 DET_CONFD_AZIMUTH_193 DET_HVC_FLAG_193 DET_OUTSIDE_SECTOR_193 DET_EXISTENCE_PROB_193 DET_POINT_TARGET_PROB_193 DET_SNR_193 DET_SUPER_RES_TARGET_193 DET_BI_STATIC_FLAG_193 DET_VALID_FLAG_193 DET_RCS_193 DET_ELEVATION_ERR_193 DET_ELEVATION_193 DET_AZIMUTH_ERR_193 DET_AZIMUTH_193 DET_RANGE_VELOCITY_ERR_193 DET_RANGE_VELOCITY_193 DET_RANGE_ERR_193 DET_RANGE_193 DET_CONFD_ELEVATION_194 DET_CONFD_AZIMUTH_194 DET_HVC_FLAG_194 DET_OUTSIDE_SECTOR_194 DET_EXISTENCE_PROB_194 DET_POINT_TARGET_PROB_194 DET_SNR_194 DET_SUPER_RES_TARGET_194 DET_BI_STATIC_FLAG_194 DET_VALID_FLAG_194 DET_RCS_194 DET_ELEVATION_ERR_194 DET_ELEVATION_194 DET_AZIMUTH_ERR_194 DET_AZIMUTH_194 DET_RANGE_VELOCITY_ERR_194 DET_RANGE_VELOCITY_194 DET_RANGE_ERR_194 DET_RANGE_194 DET_CONFD_ELEVATION_195 DET_CONFD_AZIMUTH_195 DET_HVC_FLAG_195 DET_OUTSIDE_SECTOR_195 DET_EXISTENCE_PROB_195 DET_POINT_TARGET_PROB_195 DET_SNR_195 DET_SUPER_RES_TARGET_195 DET_BI_STATIC_FLAG_195 DET_VALID_FLAG_195 DET_RCS_195 DET_ELEVATION_ERR_195 DET_ELEVATION_195 DET_AZIMUTH_ERR_195 DET_AZIMUTH_195 DET_RANGE_VELOCITY_ERR_195 DET_RANGE_VELOCITY_195 DET_RANGE_ERR_195 DET_RANGE_195 DET_CONFD_ELEVATION_196 DET_CONFD_AZIMUTH_196 DET_HVC_FLAG_196 DET_OUTSIDE_SECTOR_196 DET_EXISTENCE_PROB_196 DET_POINT_TARGET_PROB_196 DET_SNR_196 DET_SUPER_RES_TARGET_196 DET_BI_STATIC_FLAG_196 DET_VALID_FLAG_196 DET_RCS_196 DET_ELEVATION_ERR_196 DET_ELEVATION_196 DET_AZIMUTH_ERR_196 DET_AZIMUTH_196 DET_RANGE_VELOCITY_ERR_196 DET_RANGE_VELOCITY_196 DET_RANGE_ERR_196 DET_RANGE_196;
SIG_GROUP_ 1073 Detections_197_200 1 : DET_MH_CRC16_197_200 DET_MH_CYCLE_COUNTER_197_200 DET_MH_SCAN_INDEX_4LSB_197_200 DET_CONFD_ELEVATION_197 DET_CONFD_AZIMUTH_197 DET_HVC_FLAG_197 DET_OUTSIDE_SECTOR_197 DET_EXISTENCE_PROB_197 DET_POINT_TARGET_PROB_197 DET_SNR_197 DET_SUPER_RES_TARGET_197 DET_BI_STATIC_FLAG_197 DET_VALID_FLAG_197 DET_RCS_197 DET_ELEVATION_ERR_197 DET_ELEVATION_197 DET_AZIMUTH_ERR_197 DET_AZIMUTH_197 DET_RANGE_VELOCITY_ERR_197 DET_RANGE_VELOCITY_197 DET_RANGE_ERR_197 DET_RANGE_197 DET_CONFD_ELEVATION_198 DET_CONFD_AZIMUTH_198 DET_HVC_FLAG_198 DET_OUTSIDE_SECTOR_198 DET_EXISTENCE_PROB_198 DET_POINT_TARGET_PROB_198 DET_SNR_198 DET_SUPER_RES_TARGET_198 DET_BI_STATIC_FLAG_198 DET_VALID_FLAG_198 DET_RCS_198 DET_ELEVATION_ERR_198 DET_ELEVATION_198 DET_AZIMUTH_ERR_198 DET_AZIMUTH_198 DET_RANGE_VELOCITY_ERR_198 DET_RANGE_VELOCITY_198 DET_RANGE_ERR_198 DET_RANGE_198 DET_CONFD_ELEVATION_199 DET_CONFD_AZIMUTH_199 DET_HVC_FLAG_199 DET_OUTSIDE_SECTOR_199 DET_EXISTENCE_PROB_199 DET_POINT_TARGET_PROB_199 DET_SNR_199 DET_SUPER_RES_TARGET_199 DET_BI_STATIC_FLAG_199 DET_VALID_FLAG_199 DET_RCS_199 DET_ELEVATION_ERR_199 DET_ELEVATION_199 DET_AZIMUTH_ERR_199 DET_AZIMUTH_199 DET_RANGE_VELOCITY_ERR_199 DET_RANGE_VELOCITY_199 DET_RANGE_ERR_199 DET_RANGE_199 DET_CONFD_ELEVATION_200 DET_CONFD_AZIMUTH_200 DET_HVC_FLAG_200 DET_OUTSIDE_SECTOR_200 DET_EXISTENCE_PROB_200 DET_POINT_TARGET_PROB_200 DET_SNR_200 DET_SUPER_RES_TARGET_200 DET_BI_STATIC_FLAG_200 DET_VALID_FLAG_200 DET_RCS_200 DET_ELEVATION_ERR_200 DET_ELEVATION_200 DET_AZIMUTH_ERR_200 DET_AZIMUTH_200 DET_RANGE_VELOCITY_ERR_200 DET_RANGE_VELOCITY_200 DET_RANGE_ERR_200 DET_RANGE_200;
SIG_GROUP_ 1074 Detections_201_204 1 : DET_MH_CRC16_201_204 DET_MH_CYCLE_COUNTER_201_204 DET_MH_SCAN_INDEX_4LSB_201_204 DET_CONFD_ELEVATION_201 DET_CONFD_AZIMUTH_201 DET_HVC_FLAG_201 DET_OUTSIDE_SECTOR_201 DET_EXISTENCE_PROB_201 DET_POINT_TARGET_PROB_201 DET_SNR_201 DET_SUPER_RES_TARGET_201 DET_BI_STATIC_FLAG_201 DET_VALID_FLAG_201 DET_RCS_201 DET_ELEVATION_ERR_201 DET_ELEVATION_201 DET_AZIMUTH_ERR_201 DET_AZIMUTH_201 DET_RANGE_VELOCITY_ERR_201 DET_RANGE_VELOCITY_201 DET_RANGE_ERR_201 DET_RANGE_201 DET_CONFD_ELEVATION_202 DET_CONFD_AZIMUTH_202 DET_HVC_FLAG_202 DET_OUTSIDE_SECTOR_202 DET_EXISTENCE_PROB_202 DET_POINT_TARGET_PROB_202 DET_SNR_202 DET_SUPER_RES_TARGET_202 DET_BI_STATIC_FLAG_202 DET_VALID_FLAG_202 DET_RCS_202 DET_ELEVATION_ERR_202 DET_ELEVATION_202 DET_AZIMUTH_ERR_202 DET_AZIMUTH_202 DET_RANGE_VELOCITY_ERR_202 DET_RANGE_VELOCITY_202 DET_RANGE_ERR_202 DET_RANGE_202 DET_CONFD_ELEVATION_203 DET_CONFD_AZIMUTH_203 DET_HVC_FLAG_203 DET_OUTSIDE_SECTOR_203 DET_EXISTENCE_PROB_203 DET_POINT_TARGET_PROB_203 DET_SNR_203 DET_SUPER_RES_TARGET_203 DET_BI_STATIC_FLAG_203 DET_VALID_FLAG_203 DET_RCS_203 DET_ELEVATION_ERR_203 DET_ELEVATION_203 DET_AZIMUTH_ERR_203 DET_AZIMUTH_203 DET_RANGE_VELOCITY_ERR_203 DET_RANGE_VELOCITY_203 DET_RANGE_ERR_203 DET_RANGE_203 DET_CONFD_ELEVATION_204 DET_CONFD_AZIMUTH_204 DET_HVC_FLAG_204 DET_OUTSIDE_SECTOR_204 DET_EXISTENCE_PROB_204 DET_POINT_TARGET_PROB_204 DET_SNR_204 DET_SUPER_RES_TARGET_204 DET_BI_STATIC_FLAG_204 DET_VALID_FLAG_204 DET_RCS_204 DET_ELEVATION_ERR_204 DET_ELEVATION_204 DET_AZIMUTH_ERR_204 DET_AZIMUTH_204 DET_RANGE_VELOCITY_ERR_204 DET_RANGE_VELOCITY_204 DET_RANGE_ERR_204 DET_RANGE_204;
SIG_GROUP_ 1075 Detections_205_208 1 : DET_MH_CRC16_205_208 DET_MH_CYCLE_COUNTER_205_208 DET_MH_SCAN_INDEX_4LSB_205_208 DET_CONFD_ELEVATION_205 DET_CONFD_AZIMUTH_205 DET_HVC_FLAG_205 DET_OUTSIDE_SECTOR_205 DET_EXISTENCE_PROB_205 DET_POINT_TARGET_PROB_205 DET_SNR_205 DET_SUPER_RES_TARGET_205 DET_BI_STATIC_FLAG_205 DET_VALID_FLAG_205 DET_RCS_205 DET_ELEVATION_ERR_205 DET_ELEVATION_205 DET_AZIMUTH_ERR_205 DET_AZIMUTH_205 DET_RANGE_VELOCITY_ERR_205 DET_RANGE_VELOCITY_205 DET_RANGE_ERR_205 DET_RANGE_205 DET_CONFD_ELEVATION_206 DET_CONFD_AZIMUTH_206 DET_HVC_FLAG_206 DET_OUTSIDE_SECTOR_206 DET_EXISTENCE_PROB_206 DET_POINT_TARGET_PROB_206 DET_SNR_206 DET_SUPER_RES_TARGET_206 DET_BI_STATIC_FLAG_206 DET_VALID_FLAG_206 DET_RCS_206 DET_ELEVATION_ERR_206 DET_ELEVATION_206 DET_AZIMUTH_ERR_206 DET_AZIMUTH_206 DET_RANGE_VELOCITY_ERR_206 DET_RANGE_VELOCITY_206 DET_RANGE_ERR_206 DET_RANGE_206 DET_CONFD_ELEVATION_207 DET_CONFD_AZIMUTH_207 DET_HVC_FLAG_207 DET_OUTSIDE_SECTOR_207 DET_EXISTENCE_PROB_207 DET_POINT_TARGET_PROB_207 DET_SNR_207 DET_SUPER_RES_TARGET_207 DET_BI_STATIC_FLAG_207 DET_VALID_FLAG_207 DET_RCS_207 DET_ELEVATION_ERR_207 DET_ELEVATION_207 DET_AZIMUTH_ERR_207 DET_AZIMUTH_207 DET_RANGE_VELOCITY_ERR_207 DET_RANGE_VELOCITY_207 DET_RANGE_ERR_207 DET_RANGE_207 DET_CONFD_ELEVATION_208 DET_CONFD_AZIMUTH_208 DET_HVC_FLAG_208 DET_OUTSIDE_SECTOR_208 DET_EXISTENCE_PROB_208 DET_POINT_TARGET_PROB_208 DET_SNR_208 DET_SUPER_RES_TARGET_208 DET_BI_STATIC_FLAG_208 DET_VALID_FLAG_208 DET_RCS_208 DET_ELEVATION_ERR_208 DET_ELEVATION_208 DET_AZIMUTH_ERR_208 DET_AZIMUTH_208 DET_RANGE_VELOCITY_ERR_208 DET_RANGE_VELOCITY_208 DET_RANGE_ERR_208 DET_RANGE_208;
SIG_GROUP_ 1076 Detections_209_212 1 : DET_MH_CRC16_209_212 DET_MH_CYCLE_COUNTER_209_212 DET_MH_SCAN_INDEX_4LSB_209_212 DET_CONFD_ELEVATION_209 DET_CONFD_AZIMUTH_209 DET_HVC_FLAG_209 DET_OUTSIDE_SECTOR_209 DET_EXISTENCE_PROB_209 DET_POINT_TARGET_PROB_209 DET_SNR_209 DET_SUPER_RES_TARGET_209 DET_BI_STATIC_FLAG_209 DET_VALID_FLAG_209 DET_RCS_209 DET_ELEVATION_ERR_209 DET_ELEVATION_209 DET_AZIMUTH_ERR_209 DET_AZIMUTH_209 DET_RANGE_VELOCITY_ERR_209 DET_RANGE_VELOCITY_209 DET_RANGE_ERR_209 DET_RANGE_209 DET_CONFD_ELEVATION_210 DET_CONFD_AZIMUTH_210 DET_HVC_FLAG_210 DET_OUTSIDE_SECTOR_210 DET_EXISTENCE_PROB_210 DET_POINT_TARGET_PROB_210 DET_SNR_210 DET_SUPER_RES_TARGET_210 DET_BI_STATIC_FLAG_210 DET_VALID_FLAG_210 DET_RCS_210 DET_ELEVATION_ERR_210 DET_ELEVATION_210 DET_AZIMUTH_ERR_210 DET_AZIMUTH_210 DET_RANGE_VELOCITY_ERR_210 DET_RANGE_VELOCITY_210 DET_RANGE_ERR_210 DET_RANGE_210 DET_CONFD_ELEVATION_211 DET_CONFD_AZIMUTH_211 DET_HVC_FLAG_211 DET_OUTSIDE_SECTOR_211 DET_EXISTENCE_PROB_211 DET_POINT_TARGET_PROB_211 DET_SNR_211 DET_SUPER_RES_TARGET_211 DET_BI_STATIC_FLAG_211 DET_VALID_FLAG_211 DET_RCS_211 DET_ELEVATION_ERR_211 DET_ELEVATION_211 DET_AZIMUTH_ERR_211 DET_AZIMUTH_211 DET_RANGE_VELOCITY_ERR_211 DET_RANGE_VELOCITY_211 DET_RANGE_ERR_211 DET_RANGE_211 DET_CONFD_ELEVATION_212 DET_CONFD_AZIMUTH_212 DET_HVC_FLAG_212 DET_OUTSIDE_SECTOR_212 DET_EXISTENCE_PROB_212 DET_POINT_TARGET_PROB_212 DET_SNR_212 DET_SUPER_RES_TARGET_212 DET_BI_STATIC_FLAG_212 DET_VALID_FLAG_212 DET_RCS_212 DET_ELEVATION_ERR_212 DET_ELEVATION_212 DET_AZIMUTH_ERR_212 DET_AZIMUTH_212 DET_RANGE_VELOCITY_ERR_212 DET_RANGE_VELOCITY_212 DET_RANGE_ERR_212 DET_RANGE_212;
SIG_GROUP_ 1077 Detections_213_216 1 : DET_MH_CRC16_213_216 DET_MH_CYCLE_COUNTER_213_216 DET_MH_SCAN_INDEX_4LSB_213_216 DET_CONFD_ELEVATION_213 DET_CONFD_AZIMUTH_213 DET_HVC_FLAG_213 DET_OUTSIDE_SECTOR_213 DET_EXISTENCE_PROB_213 DET_POINT_TARGET_PROB_213 DET_SNR_213 DET_SUPER_RES_TARGET_213 DET_BI_STATIC_FLAG_213 DET_VALID_FLAG_213 DET_RCS_213 DET_ELEVATION_ERR_213 DET_ELEVATION_213 DET_AZIMUTH_ERR_213 DET_AZIMUTH_213 DET_RANGE_VELOCITY_ERR_213 DET_RANGE_VELOCITY_213 DET_RANGE_ERR_213 DET_RANGE_213 DET_CONFD_ELEVATION_214 DET_CONFD_AZIMUTH_214 DET_HVC_FLAG_214 DET_OUTSIDE_SECTOR_214 DET_EXISTENCE_PROB_214 DET_POINT_TARGET_PROB_214 DET_SNR_214 DET_SUPER_RES_TARGET_214 DET_BI_STATIC_FLAG_214 DET_VALID_FLAG_214 DET_RCS_214 DET_ELEVATION_ERR_214 DET_ELEVATION_214 DET_AZIMUTH_ERR_214 DET_AZIMUTH_214 DET_RANGE_VELOCITY_ERR_214 DET_RANGE_VELOCITY_214 DET_RANGE_ERR_214 DET_RANGE_214 DET_CONFD_ELEVATION_215 DET_CONFD_AZIMUTH_215 DET_HVC_FLAG_215 DET_OUTSIDE_SECTOR_215 DET_EXISTENCE_PROB_215 DET_POINT_TARGET_PROB_215 DET_SNR_215 DET_SUPER_RES_TARGET_215 DET_BI_STATIC_FLAG_215 DET_VALID_FLAG_215 DET_RCS_215 DET_ELEVATION_ERR_215 DET_ELEVATION_215 DET_AZIMUTH_ERR_215 DET_AZIMUTH_215 DET_RANGE_VELOCITY_ERR_215 DET_RANGE_VELOCITY_215 DET_RANGE_ERR_215 DET_RANGE_215 DET_CONFD_ELEVATION_216 DET_CONFD_AZIMUTH_216 DET_HVC_FLAG_216 DET_OUTSIDE_SECTOR_216 DET_EXISTENCE_PROB_216 DET_POINT_TARGET_PROB_216 DET_SNR_216 DET_SUPER_RES_TARGET_216 DET_BI_STATIC_FLAG_216 DET_VALID_FLAG_216 DET_RCS_216 DET_ELEVATION_ERR_216 DET_ELEVATION_216 DET_AZIMUTH_ERR_216 DET_AZIMUTH_216 DET_RANGE_VELOCITY_ERR_216 DET_RANGE_VELOCITY_216 DET_RANGE_ERR_216 DET_RANGE_216;
SIG_GROUP_ 1078 Detections_217_220 1 : DET_MH_CRC16_217_220 DET_MH_CYCLE_COUNTER_217_220 DET_MH_SCAN_INDEX_4LSB_217_220 DET_CONFD_ELEVATION_217 DET_CONFD_AZIMUTH_217 DET_HVC_FLAG_217 DET_OUTSIDE_SECTOR_217 DET_EXISTENCE_PROB_217 DET_POINT_TARGET_PROB_217 DET_SNR_217 DET_SUPER_RES_TARGET_217 DET_BI_STATIC_FLAG_217 DET_VALID_FLAG_217 DET_RCS_217 DET_ELEVATION_ERR_217 DET_ELEVATION_217 DET_AZIMUTH_ERR_217 DET_AZIMUTH_217 DET_RANGE_VELOCITY_ERR_217 DET_RANGE_VELOCITY_217 DET_RANGE_ERR_217 DET_RANGE_217 DET_CONFD_ELEVATION_218 DET_CONFD_AZIMUTH_218 DET_HVC_FLAG_218 DET_OUTSIDE_SECTOR_218 DET_EXISTENCE_PROB_218 DET_POINT_TARGET_PROB_218 DET_SNR_218 DET_SUPER_RES_TARGET_218 DET_BI_STATIC_FLAG_218 DET_VALID_FLAG_218 DET_RCS_218 DET_ELEVATION_ERR_218 DET_ELEVATION_218 DET_AZIMUTH_ERR_218 DET_AZIMUTH_218 DET_RANGE_VELOCITY_ERR_218 DET_RANGE_VELOCITY_218 DET_RANGE_ERR_218 DET_RANGE_218 DET_CONFD_ELEVATION_219 DET_CONFD_AZIMUTH_219 DET_HVC_FLAG_219 DET_OUTSIDE_SECTOR_219 DET_EXISTENCE_PROB_219 DET_POINT_TARGET_PROB_219 DET_SNR_219 DET_SUPER_RES_TARGET_219 DET_BI_STATIC_FLAG_219 DET_VALID_FLAG_219 DET_RCS_219 DET_ELEVATION_ERR_219 DET_ELEVATION_219 DET_AZIMUTH_ERR_219 DET_AZIMUTH_219 DET_RANGE_VELOCITY_ERR_219 DET_RANGE_VELOCITY_219 DET_RANGE_ERR_219 DET_RANGE_219 DET_CONFD_ELEVATION_220 DET_CONFD_AZIMUTH_220 DET_HVC_FLAG_220 DET_OUTSIDE_SECTOR_220 DET_EXISTENCE_PROB_220 DET_POINT_TARGET_PROB_220 DET_SNR_220 DET_SUPER_RES_TARGET_220 DET_BI_STATIC_FLAG_220 DET_VALID_FLAG_220 DET_RCS_220 DET_ELEVATION_ERR_220 DET_ELEVATION_220 DET_AZIMUTH_ERR_220 DET_AZIMUTH_220 DET_RANGE_VELOCITY_ERR_220 DET_RANGE_VELOCITY_220 DET_RANGE_ERR_220 DET_RANGE_220;
SIG_GROUP_ 1079 Detections_221_224 1 : DET_MH_CRC16_221_224 DET_MH_CYCLE_COUNTER_221_224 DET_MH_SCAN_INDEX_4LSB_221_224 DET_CONFD_ELEVATION_221 DET_CONFD_AZIMUTH_221 DET_HVC_FLAG_221 DET_OUTSIDE_SECTOR_221 DET_EXISTENCE_PROB_221 DET_POINT_TARGET_PROB_221 DET_SNR_221 DET_SUPER_RES_TARGET_221 DET_BI_STATIC_FLAG_221 DET_VALID_FLAG_221 DET_RCS_221 DET_ELEVATION_ERR_221 DET_ELEVATION_221 DET_AZIMUTH_ERR_221 DET_AZIMUTH_221 DET_RANGE_VELOCITY_ERR_221 DET_RANGE_VELOCITY_221 DET_RANGE_ERR_221 DET_RANGE_221 DET_CONFD_ELEVATION_222 DET_CONFD_AZIMUTH_222 DET_HVC_FLAG_222 DET_OUTSIDE_SECTOR_222 DET_EXISTENCE_PROB_222 DET_POINT_TARGET_PROB_222 DET_SNR_222 DET_SUPER_RES_TARGET_222 DET_BI_STATIC_FLAG_222 DET_VALID_FLAG_222 DET_RCS_222 DET_ELEVATION_ERR_222 DET_ELEVATION_222 DET_AZIMUTH_ERR_222 DET_AZIMUTH_222 DET_RANGE_VELOCITY_ERR_222 DET_RANGE_VELOCITY_222 DET_RANGE_ERR_222 DET_RANGE_222 DET_CONFD_ELEVATION_223 DET_CONFD_AZIMUTH_223 DET_HVC_FLAG_223 DET_OUTSIDE_SECTOR_223 DET_EXISTENCE_PROB_223 DET_POINT_TARGET_PROB_223 DET_SNR_223 DET_SUPER_RES_TARGET_223 DET_BI_STATIC_FLAG_223 DET_VALID_FLAG_223 DET_RCS_223 DET_ELEVATION_ERR_223 DET_ELEVATION_223 DET_AZIMUTH_ERR_223 DET_AZIMUTH_223 DET_RANGE_VELOCITY_ERR_223 DET_RANGE_VELOCITY_223 DET_RANGE_ERR_223 DET_RANGE_223 DET_CONFD_ELEVATION_224 DET_CONFD_AZIMUTH_224 DET_HVC_FLAG_224 DET_OUTSIDE_SECTOR_224 DET_EXISTENCE_PROB_224 DET_POINT_TARGET_PROB_224 DET_SNR_224 DET_SUPER_RES_TARGET_224 DET_BI_STATIC_FLAG_224 DET_VALID_FLAG_224 DET_RCS_224 DET_ELEVATION_ERR_224 DET_ELEVATION_224 DET_AZIMUTH_ERR_224 DET_AZIMUTH_224 DET_RANGE_VELOCITY_ERR_224 DET_RANGE_VELOCITY_224 DET_RANGE_ERR_224 DET_RANGE_224;
SIG_GROUP_ 1080 Detections_225_228 1 : DET_MH_CRC16_225_228 DET_MH_CYCLE_COUNTER_225_228 DET_MH_SCAN_INDEX_4LSB_225_228 DET_CONFD_ELEVATION_225 DET_CONFD_AZIMUTH_225 DET_HVC_FLAG_225 DET_OUTSIDE_SECTOR_225 DET_EXISTENCE_PROB_225 DET_POINT_TARGET_PROB_225 DET_SNR_225 DET_SUPER_RES_TARGET_225 DET_BI_STATIC_FLAG_225 DET_VALID_FLAG_225 DET_RCS_225 DET_ELEVATION_ERR_225 DET_ELEVATION_225 DET_AZIMUTH_ERR_225 DET_AZIMUTH_225 DET_RANGE_VELOCITY_ERR_225 DET_RANGE_VELOCITY_225 DET_RANGE_ERR_225 DET_RANGE_225 DET_CONFD_ELEVATION_226 DET_CONFD_AZIMUTH_226 DET_HVC_FLAG_226 DET_OUTSIDE_SECTOR_226 DET_EXISTENCE_PROB_226 DET_POINT_TARGET_PROB_226 DET_SNR_226 DET_SUPER_RES_TARGET_226 DET_BI_STATIC_FLAG_226 DET_VALID_FLAG_226 DET_RCS_226 DET_ELEVATION_ERR_226 DET_ELEVATION_226 DET_AZIMUTH_ERR_226 DET_AZIMUTH_226 DET_RANGE_VELOCITY_ERR_226 DET_RANGE_VELOCITY_226 DET_RANGE_ERR_226 DET_RANGE_226 DET_CONFD_ELEVATION_227 DET_CONFD_AZIMUTH_227 DET_HVC_FLAG_227 DET_OUTSIDE_SECTOR_227 DET_EXISTENCE_PROB_227 DET_POINT_TARGET_PROB_227 DET_SNR_227 DET_SUPER_RES_TARGET_227 DET_BI_STATIC_FLAG_227 DET_VALID_FLAG_227 DET_RCS_227 DET_ELEVATION_ERR_227 DET_ELEVATION_227 DET_AZIMUTH_ERR_227 DET_AZIMUTH_227 DET_RANGE_VELOCITY_ERR_227 DET_RANGE_VELOCITY_227 DET_RANGE_ERR_227 DET_RANGE_227 DET_CONFD_ELEVATION_228 DET_CONFD_AZIMUTH_228 DET_HVC_FLAG_228 DET_OUTSIDE_SECTOR_228 DET_EXISTENCE_PROB_228 DET_POINT_TARGET_PROB_228 DET_SNR_228 DET_SUPER_RES_TARGET_228 DET_BI_STATIC_FLAG_228 DET_VALID_FLAG_228 DET_RCS_228 DET_ELEVATION_ERR_228 DET_ELEVATION_228 DET_AZIMUTH_ERR_228 DET_AZIMUTH_228 DET_RANGE_VELOCITY_ERR_228 DET_RANGE_VELOCITY_228 DET_RANGE_ERR_228 DET_RANGE_228;
SIG_GROUP_ 1081 Detections_229_232 1 : DET_MH_CRC16_229_232 DET_MH_CYCLE_COUNTER_229_232 DET_MH_SCAN_INDEX_4LSB_229_232 DET_CONFD_ELEVATION_229 DET_CONFD_AZIMUTH_229 DET_HVC_FLAG_229 DET_OUTSIDE_SECTOR_229 DET_EXISTENCE_PROB_229 DET_POINT_TARGET_PROB_229 DET_SNR_229 DET_SUPER_RES_TARGET_229 DET_BI_STATIC_FLAG_229 DET_VALID_FLAG_229 DET_RCS_229 DET_ELEVATION_ERR_229 DET_ELEVATION_229 DET_AZIMUTH_ERR_229 DET_AZIMUTH_229 DET_RANGE_VELOCITY_ERR_229 DET_RANGE_VELOCITY_229 DET_RANGE_ERR_229 DET_RANGE_229 DET_CONFD_ELEVATION_230 DET_CONFD_AZIMUTH_230 DET_HVC_FLAG_230 DET_OUTSIDE_SECTOR_230 DET_EXISTENCE_PROB_230 DET_POINT_TARGET_PROB_230 DET_SNR_230 DET_SUPER_RES_TARGET_230 DET_BI_STATIC_FLAG_230 DET_VALID_FLAG_230 DET_RCS_230 DET_ELEVATION_ERR_230 DET_ELEVATION_230 DET_AZIMUTH_ERR_230 DET_AZIMUTH_230 DET_RANGE_VELOCITY_ERR_230 DET_RANGE_VELOCITY_230 DET_RANGE_ERR_230 DET_RANGE_230 DET_CONFD_ELEVATION_231 DET_CONFD_AZIMUTH_231 DET_HVC_FLAG_231 DET_OUTSIDE_SECTOR_231 DET_EXISTENCE_PROB_231 DET_POINT_TARGET_PROB_231 DET_SNR_231 DET_SUPER_RES_TARGET_231 DET_BI_STATIC_FLAG_231 DET_VALID_FLAG_231 DET_RCS_231 DET_ELEVATION_ERR_231 DET_ELEVATION_231 DET_AZIMUTH_ERR_231 DET_AZIMUTH_231 DET_RANGE_VELOCITY_ERR_231 DET_RANGE_VELOCITY_231 DET_RANGE_ERR_231 DET_RANGE_231 DET_CONFD_ELEVATION_232 DET_CONFD_AZIMUTH_232 DET_HVC_FLAG_232 DET_OUTSIDE_SECTOR_232 DET_EXISTENCE_PROB_232 DET_POINT_TARGET_PROB_232 DET_SNR_232 DET_SUPER_RES_TARGET_232 DET_BI_STATIC_FLAG_232 DET_VALID_FLAG_232 DET_RCS_232 DET_ELEVATION_ERR_232 DET_ELEVATION_232 DET_AZIMUTH_ERR_232 DET_AZIMUTH_232 DET_RANGE_VELOCITY_ERR_232 DET_RANGE_VELOCITY_232 DET_RANGE_ERR_232 DET_RANGE_232;
SIG_GROUP_ 1082 Detections_233_236 1 : DET_MH_CRC16_233_236 DET_MH_CYCLE_COUNTER_233_236 DET_MH_SCAN_INDEX_4LSB_233_236 DET_CONFD_ELEVATION_233 DET_CONFD_AZIMUTH_233 DET_HVC_FLAG_233 DET_OUTSIDE_SECTOR_233 DET_EXISTENCE_PROB_233 DET_POINT_TARGET_PROB_233 DET_SNR_233 DET_SUPER_RES_TARGET_233 DET_BI_STATIC_FLAG_233 DET_VALID_FLAG_233 DET_RCS_233 DET_ELEVATION_ERR_233 DET_ELEVATION_233 DET_AZIMUTH_ERR_233 DET_AZIMUTH_233 DET_RANGE_VELOCITY_ERR_233 DET_RANGE_VELOCITY_233 DET_RANGE_ERR_233 DET_RANGE_233 DET_CONFD_ELEVATION_234 DET_CONFD_AZIMUTH_234 DET_HVC_FLAG_234 DET_OUTSIDE_SECTOR_234 DET_EXISTENCE_PROB_234 DET_POINT_TARGET_PROB_234 DET_SNR_234 DET_SUPER_RES_TARGET_234 DET_BI_STATIC_FLAG_234 DET_VALID_FLAG_234 DET_RCS_234 DET_ELEVATION_ERR_234 DET_ELEVATION_234 DET_AZIMUTH_ERR_234 DET_AZIMUTH_234 DET_RANGE_VELOCITY_ERR_234 DET_RANGE_VELOCITY_234 DET_RANGE_ERR_234 DET_RANGE_234 DET_CONFD_ELEVATION_235 DET_CONFD_AZIMUTH_235 DET_HVC_FLAG_235 DET_OUTSIDE_SECTOR_235 DET_EXISTENCE_PROB_235 DET_POINT_TARGET_PROB_235 DET_SNR_235 DET_SUPER_RES_TARGET_235 DET_BI_STATIC_FLAG_235 DET_VALID_FLAG_235 DET_RCS_235 DET_ELEVATION_ERR_235 DET_ELEVATION_235 DET_AZIMUTH_ERR_235 DET_AZIMUTH_235 DET_RANGE_VELOCITY_ERR_235 DET_RANGE_VELOCITY_235 DET_RANGE_ERR_235 DET_RANGE_235 DET_CONFD_ELEVATION_236 DET_CONFD_AZIMUTH_236 DET_HVC_FLAG_236 DET_OUTSIDE_SECTOR_236 DET_EXISTENCE_PROB_236 DET_POINT_TARGET_PROB_236 DET_SNR_236 DET_SUPER_RES_TARGET_236 DET_BI_STATIC_FLAG_236 DET_VALID_FLAG_236 DET_RCS_236 DET_ELEVATION_ERR_236 DET_ELEVATION_236 DET_AZIMUTH_ERR_236 DET_AZIMUTH_236 DET_RANGE_VELOCITY_ERR_236 DET_RANGE_VELOCITY_236 DET_RANGE_ERR_236 DET_RANGE_236;
SIG_GROUP_ 1083 Detections_237_240 1 : DET_MH_CRC16_237_240 DET_MH_CYCLE_COUNTER_237_240 DET_MH_SCAN_INDEX_4LSB_237_240 DET_CONFD_ELEVATION_237 DET_CONFD_AZIMUTH_237 DET_HVC_FLAG_237 DET_OUTSIDE_SECTOR_237 DET_EXISTENCE_PROB_237 DET_POINT_TARGET_PROB_237 DET_SNR_237 DET_SUPER_RES_TARGET_237 DET_BI_STATIC_FLAG_237 DET_VALID_FLAG_237 DET_RCS_237 DET_ELEVATION_ERR_237 DET_ELEVATION_237 DET_AZIMUTH_ERR_237 DET_AZIMUTH_237 DET_RANGE_VELOCITY_ERR_237 DET_RANGE_VELOCITY_237 DET_RANGE_ERR_237 DET_RANGE_237 DET_CONFD_ELEVATION_238 DET_CONFD_AZIMUTH_238 DET_HVC_FLAG_238 DET_OUTSIDE_SECTOR_238 DET_EXISTENCE_PROB_238 DET_POINT_TARGET_PROB_238 DET_SNR_238 DET_SUPER_RES_TARGET_238 DET_BI_STATIC_FLAG_238 DET_VALID_FLAG_238 DET_RCS_238 DET_ELEVATION_ERR_238 DET_ELEVATION_238 DET_AZIMUTH_ERR_238 DET_AZIMUTH_238 DET_RANGE_VELOCITY_ERR_238 DET_RANGE_VELOCITY_238 DET_RANGE_ERR_238 DET_RANGE_238 DET_CONFD_ELEVATION_239 DET_CONFD_AZIMUTH_239 DET_HVC_FLAG_239 DET_OUTSIDE_SECTOR_239 DET_EXISTENCE_PROB_239 DET_POINT_TARGET_PROB_239 DET_SNR_239 DET_SUPER_RES_TARGET_239 DET_BI_STATIC_FLAG_239 DET_VALID_FLAG_239 DET_RCS_239 DET_ELEVATION_ERR_239 DET_ELEVATION_239 DET_AZIMUTH_ERR_239 DET_AZIMUTH_239 DET_RANGE_VELOCITY_ERR_239 DET_RANGE_VELOCITY_239 DET_RANGE_ERR_239 DET_RANGE_239 DET_CONFD_ELEVATION_240 DET_CONFD_AZIMUTH_240 DET_HVC_FLAG_240 DET_OUTSIDE_SECTOR_240 DET_EXISTENCE_PROB_240 DET_POINT_TARGET_PROB_240 DET_SNR_240 DET_SUPER_RES_TARGET_240 DET_BI_STATIC_FLAG_240 DET_VALID_FLAG_240 DET_RCS_240 DET_ELEVATION_ERR_240 DET_ELEVATION_240 DET_AZIMUTH_ERR_240 DET_AZIMUTH_240 DET_RANGE_VELOCITY_ERR_240 DET_RANGE_VELOCITY_240 DET_RANGE_ERR_240 DET_RANGE_240;
SIG_GROUP_ 1084 Detections_241_244 1 : DET_MH_CRC16_241_244 DET_MH_CYCLE_COUNTER_241_244 DET_MH_SCAN_INDEX_4LSB_241_244 DET_CONFD_ELEVATION_241 DET_CONFD_AZIMUTH_241 DET_HVC_FLAG_241 DET_OUTSIDE_SECTOR_241 DET_EXISTENCE_PROB_241 DET_POINT_TARGET_PROB_241 DET_SNR_241 DET_SUPER_RES_TARGET_241 DET_BI_STATIC_FLAG_241 DET_VALID_FLAG_241 DET_RCS_241 DET_ELEVATION_ERR_241 DET_ELEVATION_241 DET_AZIMUTH_ERR_241 DET_AZIMUTH_241 DET_RANGE_VELOCITY_ERR_241 DET_RANGE_VELOCITY_241 DET_RANGE_ERR_241 DET_RANGE_241 DET_CONFD_ELEVATION_242 DET_CONFD_AZIMUTH_242 DET_HVC_FLAG_242 DET_OUTSIDE_SECTOR_242 DET_EXISTENCE_PROB_242 DET_POINT_TARGET_PROB_242 DET_SNR_242 DET_SUPER_RES_TARGET_242 DET_BI_STATIC_FLAG_242 DET_VALID_FLAG_242 DET_RCS_242 DET_ELEVATION_ERR_242 DET_ELEVATION_242 DET_AZIMUTH_ERR_242 DET_AZIMUTH_242 DET_RANGE_VELOCITY_ERR_242 DET_RANGE_VELOCITY_242 DET_RANGE_ERR_242 DET_RANGE_242 DET_CONFD_ELEVATION_243 DET_CONFD_AZIMUTH_243 DET_HVC_FLAG_243 DET_OUTSIDE_SECTOR_243 DET_EXISTENCE_PROB_243 DET_POINT_TARGET_PROB_243 DET_SNR_243 DET_SUPER_RES_TARGET_243 DET_BI_STATIC_FLAG_243 DET_VALID_FLAG_243 DET_RCS_243 DET_ELEVATION_ERR_243 DET_ELEVATION_243 DET_AZIMUTH_ERR_243 DET_AZIMUTH_243 DET_RANGE_VELOCITY_ERR_243 DET_RANGE_VELOCITY_243 DET_RANGE_ERR_243 DET_RANGE_243 DET_CONFD_ELEVATION_244 DET_CONFD_AZIMUTH_244 DET_HVC_FLAG_244 DET_OUTSIDE_SECTOR_244 DET_EXISTENCE_PROB_244 DET_POINT_TARGET_PROB_244 DET_SNR_244 DET_SUPER_RES_TARGET_244 DET_BI_STATIC_FLAG_244 DET_VALID_FLAG_244 DET_RCS_244 DET_ELEVATION_ERR_244 DET_ELEVATION_244 DET_AZIMUTH_ERR_244 DET_AZIMUTH_244 DET_RANGE_VELOCITY_ERR_244 DET_RANGE_VELOCITY_244 DET_RANGE_ERR_244 DET_RANGE_244;
SIG_GROUP_ 1085 Detections_245_248 1 : DET_MH_CRC16_245_248 DET_MH_CYCLE_COUNTER_245_248 DET_MH_SCAN_INDEX_4LSB_245_248 DET_CONFD_ELEVATION_245 DET_CONFD_AZIMUTH_245 DET_HVC_FLAG_245 DET_OUTSIDE_SECTOR_245 DET_EXISTENCE_PROB_245 DET_POINT_TARGET_PROB_245 DET_SNR_245 DET_SUPER_RES_TARGET_245 DET_BI_STATIC_FLAG_245 DET_VALID_FLAG_245 DET_RCS_245 DET_ELEVATION_ERR_245 DET_ELEVATION_245 DET_AZIMUTH_ERR_245 DET_AZIMUTH_245 DET_RANGE_VELOCITY_ERR_245 DET_RANGE_VELOCITY_245 DET_RANGE_ERR_245 DET_RANGE_245 DET_CONFD_ELEVATION_246 DET_CONFD_AZIMUTH_246 DET_HVC_FLAG_246 DET_OUTSIDE_SECTOR_246 DET_EXISTENCE_PROB_246 DET_POINT_TARGET_PROB_246 DET_SNR_246 DET_SUPER_RES_TARGET_246 DET_BI_STATIC_FLAG_246 DET_VALID_FLAG_246 DET_RCS_246 DET_ELEVATION_ERR_246 DET_ELEVATION_246 DET_AZIMUTH_ERR_246 DET_AZIMUTH_246 DET_RANGE_VELOCITY_ERR_246 DET_RANGE_VELOCITY_246 DET_RANGE_ERR_246 DET_RANGE_246 DET_CONFD_ELEVATION_247 DET_CONFD_AZIMUTH_247 DET_HVC_FLAG_247 DET_OUTSIDE_SECTOR_247 DET_EXISTENCE_PROB_247 DET_POINT_TARGET_PROB_247 DET_SNR_247 DET_SUPER_RES_TARGET_247 DET_BI_STATIC_FLAG_247 DET_VALID_FLAG_247 DET_RCS_247 DET_ELEVATION_ERR_247 DET_ELEVATION_247 DET_AZIMUTH_ERR_247 DET_AZIMUTH_247 DET_RANGE_VELOCITY_ERR_247 DET_RANGE_VELOCITY_247 DET_RANGE_ERR_247 DET_RANGE_247 DET_CONFD_ELEVATION_248 DET_CONFD_AZIMUTH_248 DET_HVC_FLAG_248 DET_OUTSIDE_SECTOR_248 DET_EXISTENCE_PROB_248 DET_POINT_TARGET_PROB_248 DET_SNR_248 DET_SUPER_RES_TARGET_248 DET_BI_STATIC_FLAG_248 DET_VALID_FLAG_248 DET_RCS_248 DET_ELEVATION_ERR_248 DET_ELEVATION_248 DET_AZIMUTH_ERR_248 DET_AZIMUTH_248 DET_RANGE_VELOCITY_ERR_248 DET_RANGE_VELOCITY_248 DET_RANGE_ERR_248 DET_RANGE_248;
SIG_GROUP_ 1086 Detections_249_252 1 : DET_MH_CRC16_249_252 DET_MH_CYCLE_COUNTER_249_252 DET_MH_SCAN_INDEX_4LSB_249_252 DET_CONFD_ELEVATION_249 DET_CONFD_AZIMUTH_249 DET_HVC_FLAG_249 DET_OUTSIDE_SECTOR_249 DET_EXISTENCE_PROB_249 DET_POINT_TARGET_PROB_249 DET_SNR_249 DET_SUPER_RES_TARGET_249 DET_BI_STATIC_FLAG_249 DET_VALID_FLAG_249 DET_RCS_249 DET_ELEVATION_ERR_249 DET_ELEVATION_249 DET_AZIMUTH_ERR_249 DET_AZIMUTH_249 DET_RANGE_VELOCITY_ERR_249 DET_RANGE_VELOCITY_249 DET_RANGE_ERR_249 DET_RANGE_249 DET_CONFD_ELEVATION_250 DET_CONFD_AZIMUTH_250 DET_HVC_FLAG_250 DET_OUTSIDE_SECTOR_250 DET_EXISTENCE_PROB_250 DET_POINT_TARGET_PROB_250 DET_SNR_250 DET_SUPER_RES_TARGET_250 DET_BI_STATIC_FLAG_250 DET_VALID_FLAG_250 DET_RCS_250 DET_ELEVATION_ERR_250 DET_ELEVATION_250 DET_AZIMUTH_ERR_250 DET_AZIMUTH_250 DET_RANGE_VELOCITY_ERR_250 DET_RANGE_VELOCITY_250 DET_RANGE_ERR_250 DET_RANGE_250 DET_CONFD_ELEVATION_251 DET_CONFD_AZIMUTH_251 DET_HVC_FLAG_251 DET_OUTSIDE_SECTOR_251 DET_EXISTENCE_PROB_251 DET_POINT_TARGET_PROB_251 DET_SNR_251 DET_SUPER_RES_TARGET_251 DET_BI_STATIC_FLAG_251 DET_VALID_FLAG_251 DET_RCS_251 DET_ELEVATION_ERR_251 DET_ELEVATION_251 DET_AZIMUTH_ERR_251 DET_AZIMUTH_251 DET_RANGE_VELOCITY_ERR_251 DET_RANGE_VELOCITY_251 DET_RANGE_ERR_251 DET_RANGE_251 DET_CONFD_ELEVATION_252 DET_CONFD_AZIMUTH_252 DET_HVC_FLAG_252 DET_OUTSIDE_SECTOR_252 DET_EXISTENCE_PROB_252 DET_POINT_TARGET_PROB_252 DET_SNR_252 DET_SUPER_RES_TARGET_252 DET_BI_STATIC_FLAG_252 DET_VALID_FLAG_252 DET_RCS_252 DET_ELEVATION_ERR_252 DET_ELEVATION_252 DET_AZIMUTH_ERR_252 DET_AZIMUTH_252 DET_RANGE_VELOCITY_ERR_252 DET_RANGE_VELOCITY_252 DET_RANGE_ERR_252 DET_RANGE_252;
SIG_GROUP_ 1087 Detections_253_256 1 : DET_MH_CRC16_253_256 DET_MH_CYCLE_COUNTER_253_256 DET_MH_SCAN_INDEX_4LSB_253_256 DET_CONFD_ELEVATION_253 DET_CONFD_AZIMUTH_253 DET_HVC_FLAG_253 DET_OUTSIDE_SECTOR_253 DET_EXISTENCE_PROB_253 DET_POINT_TARGET_PROB_253 DET_SNR_253 DET_SUPER_RES_TARGET_253 DET_BI_STATIC_FLAG_253 DET_VALID_FLAG_253 DET_RCS_253 DET_ELEVATION_ERR_253 DET_ELEVATION_253 DET_AZIMUTH_ERR_253 DET_AZIMUTH_253 DET_RANGE_VELOCITY_ERR_253 DET_RANGE_VELOCITY_253 DET_RANGE_ERR_253 DET_RANGE_253 DET_CONFD_ELEVATION_254 DET_CONFD_AZIMUTH_254 DET_HVC_FLAG_254 DET_OUTSIDE_SECTOR_254 DET_EXISTENCE_PROB_254 DET_POINT_TARGET_PROB_254 DET_SNR_254 DET_SUPER_RES_TARGET_254 DET_BI_STATIC_FLAG_254 DET_VALID_FLAG_254 DET_RCS_254 DET_ELEVATION_ERR_254 DET_ELEVATION_254 DET_AZIMUTH_ERR_254 DET_AZIMUTH_254 DET_RANGE_VELOCITY_ERR_254 DET_RANGE_VELOCITY_254 DET_RANGE_ERR_254 DET_RANGE_254 DET_CONFD_ELEVATION_255 DET_CONFD_AZIMUTH_255 DET_HVC_FLAG_255 DET_OUTSIDE_SECTOR_255 DET_EXISTENCE_PROB_255 DET_POINT_TARGET_PROB_255 DET_SNR_255 DET_SUPER_RES_TARGET_255 DET_BI_STATIC_FLAG_255 DET_VALID_FLAG_255 DET_RCS_255 DET_ELEVATION_ERR_255 DET_ELEVATION_255 DET_AZIMUTH_ERR_255 DET_AZIMUTH_255 DET_RANGE_VELOCITY_ERR_255 DET_RANGE_VELOCITY_255 DET_RANGE_ERR_255 DET_RANGE_255 DET_CONFD_ELEVATION_256 DET_CONFD_AZIMUTH_256 DET_HVC_FLAG_256 DET_OUTSIDE_SECTOR_256 DET_EXISTENCE_PROB_256 DET_POINT_TARGET_PROB_256 DET_SNR_256 DET_SUPER_RES_TARGET_256 DET_BI_STATIC_FLAG_256 DET_VALID_FLAG_256 DET_RCS_256 DET_ELEVATION_ERR_256 DET_ELEVATION_256 DET_AZIMUTH_ERR_256 DET_AZIMUTH_256 DET_RANGE_VELOCITY_ERR_256 DET_RANGE_VELOCITY_256 DET_RANGE_ERR_256 DET_RANGE_256;
SIG_GROUP_ 1088 Detections_257_260 1 : DET_MH_CRC16_257_260 DET_MH_CYCLE_COUNTER_257_260 DET_MH_SCAN_INDEX_4LSB_257_260 DET_CONFD_ELEVATION_257 DET_CONFD_AZIMUTH_257 DET_HVC_FLAG_257 DET_OUTSIDE_SECTOR_257 DET_EXISTENCE_PROB_257 DET_POINT_TARGET_PROB_257 DET_SNR_257 DET_SUPER_RES_TARGET_257 DET_BI_STATIC_FLAG_257 DET_VALID_FLAG_257 DET_RCS_257 DET_ELEVATION_ERR_257 DET_ELEVATION_257 DET_AZIMUTH_ERR_257 DET_AZIMUTH_257 DET_RANGE_VELOCITY_ERR_257 DET_RANGE_VELOCITY_257 DET_RANGE_ERR_257 DET_RANGE_257 DET_CONFD_ELEVATION_258 DET_CONFD_AZIMUTH_258 DET_HVC_FLAG_258 DET_OUTSIDE_SECTOR_258 DET_EXISTENCE_PROB_258 DET_POINT_TARGET_PROB_258 DET_SNR_258 DET_SUPER_RES_TARGET_258 DET_BI_STATIC_FLAG_258 DET_VALID_FLAG_258 DET_RCS_258 DET_ELEVATION_ERR_258 DET_ELEVATION_258 DET_AZIMUTH_ERR_258 DET_AZIMUTH_258 DET_RANGE_VELOCITY_ERR_258 DET_RANGE_VELOCITY_258 DET_RANGE_ERR_258 DET_RANGE_258 DET_CONFD_ELEVATION_259 DET_CONFD_AZIMUTH_259 DET_HVC_FLAG_259 DET_OUTSIDE_SECTOR_259 DET_EXISTENCE_PROB_259 DET_POINT_TARGET_PROB_259 DET_SNR_259 DET_SUPER_RES_TARGET_259 DET_BI_STATIC_FLAG_259 DET_VALID_FLAG_259 DET_RCS_259 DET_ELEVATION_ERR_259 DET_ELEVATION_259 DET_AZIMUTH_ERR_259 DET_AZIMUTH_259 DET_RANGE_VELOCITY_ERR_259 DET_RANGE_VELOCITY_259 DET_RANGE_ERR_259 DET_RANGE_259 DET_CONFD_ELEVATION_260 DET_CONFD_AZIMUTH_260 DET_HVC_FLAG_260 DET_OUTSIDE_SECTOR_260 DET_EXISTENCE_PROB_260 DET_POINT_TARGET_PROB_260 DET_SNR_260 DET_SUPER_RES_TARGET_260 DET_BI_STATIC_FLAG_260 DET_VALID_FLAG_260 DET_RCS_260 DET_ELEVATION_ERR_260 DET_ELEVATION_260 DET_AZIMUTH_ERR_260 DET_AZIMUTH_260 DET_RANGE_VELOCITY_ERR_260 DET_RANGE_VELOCITY_260 DET_RANGE_ERR_260 DET_RANGE_260;

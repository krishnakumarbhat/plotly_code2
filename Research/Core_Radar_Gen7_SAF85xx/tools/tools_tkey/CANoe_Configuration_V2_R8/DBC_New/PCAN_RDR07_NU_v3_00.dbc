VERSION "created by canmatrix"

NS_ :

BS_:

BU_: External_Tool ADAS RDR07

BO_ 1089 RDR_DETECTION_261_264: 64 RDR07
 SG_ DET_RANGE_261 : 24|15@1+ (0.015625,0) [0|500] "m"  ADAS
 SG_ DET_RANGE_ERR_261 : 40|7@1+ (0.0075,0) [0|0.9525] "m"  ADAS
 SG_ DET_RANGE_VELOCITY_261 : 48|15@1+ (0.0078125,-128) [-128|127.9921875] "m/s"  ADAS
 SG_ DET_RANGE_VELOCITY_ERR_261 : 64|8@1+ (0.003,0) [0|0.765] "m/s"  ADAS
 SG_ DET_AZIMUTH_261 : 88|13@1+ (0.0004,-1.5708) [-1.5708|1.5708] "rad"  ADAS
 SG_ DET_AZIMUTH_ERR_261 : 105|7@1+ (0.00087267,0) [0|0.11082909] "rad"  ADAS
 SG_ DET_ELEVATION_261 : 72|8@1+ (0.00275,-0.34925) [-0.34925|0.34925] "rad"  ADAS
 SG_ DET_ELEVATION_ERR_261 : 80|6@1+ (0.00174533,0) [0|0.10995579] "rad"  ADAS
 SG_ DET_RCS_261 : 136|8@1+ (0.5,-64) [-64|63.5] "dBsm"  ADAS
 SG_ DET_VALID_FLAG_261 : 119|1@1+ (1,0) [0|1] ""  ADAS
 SG_ DET_BI_STATIC_FLAG_261 : 504|1@1+ (1,0) [0|1] ""  ADAS
 SG_ DET_SUPER_RES_TARGET_261 : 104|1@1+ (1,0) [0|1] ""  ADAS
 SG_ DET_SNR_261 : 128|8@1+ (0.35156,0) [0|89.6478] "dB"  ADAS
 SG_ DET_POINT_TARGET_PROB_261 : 114|4@1+ (6.67,0) [0|100] "%"  ADAS
 SG_ DET_EXISTENCE_PROB_261 : 120|6@1+ (1.588,0) [0|100] "%"  ADAS
 SG_ DET_OUTSIDE_SECTOR_261 : 159|1@1+ (1,0) [0|1] ""  ADAS
 SG_ DET_HVC_FLAG_261 : 118|1@1+ (1,0) [0|1] ""  ADAS
 SG_ DET_CONFD_AZIMUTH_261 : 126|2@1+ (1,0) [0|3] ""  ADAS
 SG_ DET_CONFD_ELEVATION_261 : 112|2@1+ (1,0) [0|3] ""  ADAS
 SG_ DET_RANGE_262 : 144|15@1+ (0.015625,0) [0|500] "m"  ADAS
 SG_ DET_RANGE_ERR_262 : 160|7@1+ (0.0075,0) [0|0.9525] "m"  ADAS
 SG_ DET_RANGE_VELOCITY_262 : 168|15@1+ (0.0078125,-128) [-128|127.9921875] "m/s"  ADAS
 SG_ DET_RANGE_VELOCITY_ERR_262 : 184|8@1+ (0.003,0) [0|0.765] "m/s"  ADAS
 SG_ DET_AZIMUTH_262 : 208|13@1+ (0.0004,-1.5708) [-1.5708|1.5708] "rad"  ADAS
 SG_ DET_AZIMUTH_ERR_262 : 224|7@1+ (0.00087267,0) [0|0.11082909] "rad"  ADAS
 SG_ DET_ELEVATION_262 : 192|8@1+ (0.00275,-0.34925) [-0.34925|0.34925] "rad"  ADAS
 SG_ DET_ELEVATION_ERR_262 : 200|6@1+ (0.00174533,0) [0|0.10995579] "rad"  ADAS
 SG_ DET_RCS_262 : 256|8@1+ (0.5,-64) [-64|63.5] "dBsm"  ADAS
 SG_ DET_VALID_FLAG_262 : 167|1@1+ (1,0) [0|1] ""  ADAS
 SG_ DET_BI_STATIC_FLAG_262 : 505|1@1+ (1,0) [0|1] ""  ADAS
 SG_ DET_SUPER_RES_TARGET_262 : 247|1@1+ (1,0) [0|1] ""  ADAS
 SG_ DET_SNR_262 : 248|8@1+ (0.35156,0) [0|89.6478] "dB"  ADAS
 SG_ DET_POINT_TARGET_PROB_262 : 240|4@1+ (6.67,0) [0|100] "%"  ADAS
 SG_ DET_EXISTENCE_PROB_262 : 232|6@1+ (1.588,0) [0|100] "%"  ADAS
 SG_ DET_OUTSIDE_SECTOR_262 : 183|1@1+ (1,0) [0|1] ""  ADAS
 SG_ DET_HVC_FLAG_262 : 246|1@1+ (1,0) [0|1] ""  ADAS
 SG_ DET_CONFD_AZIMUTH_262 : 206|2@1+ (1,0) [0|3] ""  ADAS
 SG_ DET_CONFD_ELEVATION_262 : 244|2@1+ (1,0) [0|3] ""  ADAS
 SG_ DET_RANGE_263 : 264|15@1+ (0.015625,0) [0|500] "m"  ADAS
 SG_ DET_RANGE_ERR_263 : 280|7@1+ (0.0075,0) [0|0.9525] "m"  ADAS
 SG_ DET_RANGE_VELOCITY_263 : 288|15@1+ (0.0078125,-128) [-128|127.9921875] "m/s"  ADAS
 SG_ DET_RANGE_VELOCITY_ERR_263 : 304|8@1+ (0.003,0) [0|0.765] "m/s"  ADAS
 SG_ DET_AZIMUTH_263 : 328|13@1+ (0.0004,-1.5708) [-1.5708|1.5708] "rad"  ADAS
 SG_ DET_AZIMUTH_ERR_263 : 345|7@1+ (0.00087267,0) [0|0.11082909] "rad"  ADAS
 SG_ DET_ELEVATION_263 : 312|8@1+ (0.00275,-0.34925) [-0.34925|0.34925] "rad"  ADAS
 SG_ DET_ELEVATION_ERR_263 : 320|6@1+ (0.00174533,0) [0|0.10995579] "rad"  ADAS
 SG_ DET_RCS_263 : 376|8@1+ (0.5,-64) [-64|63.5] "dBsm"  ADAS
 SG_ DET_VALID_FLAG_263 : 399|1@1+ (1,0) [0|1] ""  ADAS
 SG_ DET_BI_STATIC_FLAG_263 : 482|1@1+ (1,0) [0|1] ""  ADAS
 SG_ DET_SUPER_RES_TARGET_263 : 344|1@1+ (1,0) [0|1] ""  ADAS
 SG_ DET_SNR_263 : 368|8@1+ (0.35156,0) [0|89.6478] "dB"  ADAS
 SG_ DET_POINT_TARGET_PROB_263 : 360|4@1+ (6.67,0) [0|100] "%"  ADAS
 SG_ DET_EXISTENCE_PROB_263 : 352|6@1+ (1.588,0) [0|100] "%"  ADAS
 SG_ DET_OUTSIDE_SECTOR_263 : 407|1@1+ (1,0) [0|1] ""  ADAS
 SG_ DET_HVC_FLAG_263 : 364|1@1+ (1,0) [0|1] ""  ADAS
 SG_ DET_CONFD_AZIMUTH_263 : 365|2@1+ (1,0) [0|3] ""  ADAS
 SG_ DET_CONFD_ELEVATION_263 : 358|2@1+ (1,0) [0|3] ""  ADAS
 SG_ DET_RANGE_264 : 384|15@1+ (0.015625,0) [0|500] "m"  ADAS
 SG_ DET_RANGE_ERR_264 : 400|7@1+ (0.0075,0) [0|0.9525] "m"  ADAS
 SG_ DET_RANGE_VELOCITY_264 : 408|15@1+ (0.0078125,-128) [-128|127.9921875] "m/s"  ADAS
 SG_ DET_RANGE_VELOCITY_ERR_264 : 424|8@1+ (0.003,0) [0|0.765] "m/s"  ADAS
 SG_ DET_AZIMUTH_264 : 448|13@1+ (0.0004,-1.5708) [-1.5708|1.5708] "rad"  ADAS
 SG_ DET_AZIMUTH_ERR_264 : 465|7@1+ (0.00087267,0) [0|0.11082909] "rad"  ADAS
 SG_ DET_ELEVATION_264 : 432|8@1+ (0.00275,-0.34925) [-0.34925|0.34925] "rad"  ADAS
 SG_ DET_ELEVATION_ERR_264 : 440|6@1+ (0.00174533,0) [0|0.10995579] "rad"  ADAS
 SG_ DET_RCS_264 : 496|8@1+ (0.5,-64) [-64|63.5] "dBsm"  ADAS
 SG_ DET_VALID_FLAG_264 : 485|1@1+ (1,0) [0|1] ""  ADAS
 SG_ DET_BI_STATIC_FLAG_264 : 483|1@1+ (1,0) [0|1] ""  ADAS
 SG_ DET_SUPER_RES_TARGET_264 : 446|1@1+ (1,0) [0|1] ""  ADAS
 SG_ DET_SNR_264 : 488|8@1+ (0.35156,0) [0|89.6478] "dB"  ADAS
 SG_ DET_POINT_TARGET_PROB_264 : 472|4@1+ (6.67,0) [0|100] "%"  ADAS
 SG_ DET_EXISTENCE_PROB_264 : 506|6@1+ (1.588,0) [0|100] "%"  ADAS
 SG_ DET_OUTSIDE_SECTOR_264 : 481|1@1+ (1,0) [0|1] ""  ADAS
 SG_ DET_HVC_FLAG_264 : 464|1@1+ (1,0) [0|1] ""  ADAS
 SG_ DET_CONFD_AZIMUTH_264 : 486|2@1+ (1,0) [0|3] ""  ADAS
 SG_ DET_CONFD_ELEVATION_264 : 461|2@1+ (1,0) [0|3] ""  ADAS
 SG_ DET_MH_SCAN_INDEX_4LSB_261_264 : 476|4@1+ (1,0) [0|15] ""  ADAS
 SG_ DET_MH_CYCLE_COUNTER_261_264 : 16|8@1+ (1,0) [0|255] ""  ADAS
 SG_ DET_MH_CRC16_261_264 : 0|16@1+ (1,0) [0|65535] ""  ADAS

BO_ 1090 RDR_DETECTION_265_268: 64 RDR07
 SG_ DET_RANGE_265 : 24|15@1+ (0.015625,0) [0|500] "m"  ADAS
 SG_ DET_RANGE_ERR_265 : 40|7@1+ (0.0075,0) [0|0.9525] "m"  ADAS
 SG_ DET_RANGE_VELOCITY_265 : 48|15@1+ (0.0078125,-128) [-128|127.9921875] "m/s"  ADAS
 SG_ DET_RANGE_VELOCITY_ERR_265 : 64|8@1+ (0.003,0) [0|0.765] "m/s"  ADAS
 SG_ DET_AZIMUTH_265 : 88|13@1+ (0.0004,-1.5708) [-1.5708|1.5708] "rad"  ADAS
 SG_ DET_AZIMUTH_ERR_265 : 105|7@1+ (0.00087267,0) [0|0.11082909] "rad"  ADAS
 SG_ DET_ELEVATION_265 : 72|8@1+ (0.00275,-0.34925) [-0.34925|0.34925] "rad"  ADAS
 SG_ DET_ELEVATION_ERR_265 : 80|6@1+ (0.00174533,0) [0|0.10995579] "rad"  ADAS
 SG_ DET_RCS_265 : 136|8@1+ (0.5,-64) [-64|63.5] "dBsm"  ADAS
 SG_ DET_VALID_FLAG_265 : 119|1@1+ (1,0) [0|1] ""  ADAS
 SG_ DET_BI_STATIC_FLAG_265 : 504|1@1+ (1,0) [0|1] ""  ADAS
 SG_ DET_SUPER_RES_TARGET_265 : 104|1@1+ (1,0) [0|1] ""  ADAS
 SG_ DET_SNR_265 : 128|8@1+ (0.35156,0) [0|89.6478] "dB"  ADAS
 SG_ DET_POINT_TARGET_PROB_265 : 114|4@1+ (6.67,0) [0|100] "%"  ADAS
 SG_ DET_EXISTENCE_PROB_265 : 120|6@1+ (1.588,0) [0|100] "%"  ADAS
 SG_ DET_OUTSIDE_SECTOR_265 : 159|1@1+ (1,0) [0|1] ""  ADAS
 SG_ DET_HVC_FLAG_265 : 118|1@1+ (1,0) [0|1] ""  ADAS
 SG_ DET_CONFD_AZIMUTH_265 : 126|2@1+ (1,0) [0|3] ""  ADAS
 SG_ DET_CONFD_ELEVATION_265 : 112|2@1+ (1,0) [0|3] ""  ADAS
 SG_ DET_RANGE_266 : 144|15@1+ (0.015625,0) [0|500] "m"  ADAS
 SG_ DET_RANGE_ERR_266 : 160|7@1+ (0.0075,0) [0|0.9525] "m"  ADAS
 SG_ DET_RANGE_VELOCITY_266 : 168|15@1+ (0.0078125,-128) [-128|127.9921875] "m/s"  ADAS
 SG_ DET_RANGE_VELOCITY_ERR_266 : 184|8@1+ (0.003,0) [0|0.765] "m/s"  ADAS
 SG_ DET_AZIMUTH_266 : 208|13@1+ (0.0004,-1.5708) [-1.5708|1.5708] "rad"  ADAS
 SG_ DET_AZIMUTH_ERR_266 : 224|7@1+ (0.00087267,0) [0|0.11082909] "rad"  ADAS
 SG_ DET_ELEVATION_266 : 192|8@1+ (0.00275,-0.34925) [-0.34925|0.34925] "rad"  ADAS
 SG_ DET_ELEVATION_ERR_266 : 200|6@1+ (0.00174533,0) [0|0.10995579] "rad"  ADAS
 SG_ DET_RCS_266 : 256|8@1+ (0.5,-64) [-64|63.5] "dBsm"  ADAS
 SG_ DET_VALID_FLAG_266 : 167|1@1+ (1,0) [0|1] ""  ADAS
 SG_ DET_BI_STATIC_FLAG_266 : 505|1@1+ (1,0) [0|1] ""  ADAS
 SG_ DET_SUPER_RES_TARGET_266 : 247|1@1+ (1,0) [0|1] ""  ADAS
 SG_ DET_SNR_266 : 248|8@1+ (0.35156,0) [0|89.6478] "dB"  ADAS
 SG_ DET_POINT_TARGET_PROB_266 : 240|4@1+ (6.67,0) [0|100] "%"  ADAS
 SG_ DET_EXISTENCE_PROB_266 : 232|6@1+ (1.588,0) [0|100] "%"  ADAS
 SG_ DET_OUTSIDE_SECTOR_266 : 183|1@1+ (1,0) [0|1] ""  ADAS
 SG_ DET_HVC_FLAG_266 : 246|1@1+ (1,0) [0|1] ""  ADAS
 SG_ DET_CONFD_AZIMUTH_266 : 206|2@1+ (1,0) [0|3] ""  ADAS
 SG_ DET_CONFD_ELEVATION_266 : 244|2@1+ (1,0) [0|3] ""  ADAS
 SG_ DET_RANGE_267 : 264|15@1+ (0.015625,0) [0|500] "m"  ADAS
 SG_ DET_RANGE_ERR_267 : 280|7@1+ (0.0075,0) [0|0.9525] "m"  ADAS
 SG_ DET_RANGE_VELOCITY_267 : 288|15@1+ (0.0078125,-128) [-128|127.9921875] "m/s"  ADAS
 SG_ DET_RANGE_VELOCITY_ERR_267 : 304|8@1+ (0.003,0) [0|0.765] "m/s"  ADAS
 SG_ DET_AZIMUTH_267 : 328|13@1+ (0.0004,-1.5708) [-1.5708|1.5708] "rad"  ADAS
 SG_ DET_AZIMUTH_ERR_267 : 345|7@1+ (0.00087267,0) [0|0.11082909] "rad"  ADAS
 SG_ DET_ELEVATION_267 : 312|8@1+ (0.00275,-0.34925) [-0.34925|0.34925] "rad"  ADAS
 SG_ DET_ELEVATION_ERR_267 : 320|6@1+ (0.00174533,0) [0|0.10995579] "rad"  ADAS
 SG_ DET_RCS_267 : 376|8@1+ (0.5,-64) [-64|63.5] "dBsm"  ADAS
 SG_ DET_VALID_FLAG_267 : 399|1@1+ (1,0) [0|1] ""  ADAS
 SG_ DET_BI_STATIC_FLAG_267 : 482|1@1+ (1,0) [0|1] ""  ADAS
 SG_ DET_SUPER_RES_TARGET_267 : 344|1@1+ (1,0) [0|1] ""  ADAS
 SG_ DET_SNR_267 : 368|8@1+ (0.35156,0) [0|89.6478] "dB"  ADAS
 SG_ DET_POINT_TARGET_PROB_267 : 360|4@1+ (6.67,0) [0|100] "%"  ADAS
 SG_ DET_EXISTENCE_PROB_267 : 352|6@1+ (1.588,0) [0|100] "%"  ADAS
 SG_ DET_OUTSIDE_SECTOR_267 : 407|1@1+ (1,0) [0|1] ""  ADAS
 SG_ DET_HVC_FLAG_267 : 364|1@1+ (1,0) [0|1] ""  ADAS
 SG_ DET_CONFD_AZIMUTH_267 : 365|2@1+ (1,0) [0|3] ""  ADAS
 SG_ DET_CONFD_ELEVATION_267 : 358|2@1+ (1,0) [0|3] ""  ADAS
 SG_ DET_RANGE_268 : 384|15@1+ (0.015625,0) [0|500] "m"  ADAS
 SG_ DET_RANGE_ERR_268 : 400|7@1+ (0.0075,0) [0|0.9525] "m"  ADAS
 SG_ DET_RANGE_VELOCITY_268 : 408|15@1+ (0.0078125,-128) [-128|127.9921875] "m/s"  ADAS
 SG_ DET_RANGE_VELOCITY_ERR_268 : 424|8@1+ (0.003,0) [0|0.765] "m/s"  ADAS
 SG_ DET_AZIMUTH_268 : 448|13@1+ (0.0004,-1.5708) [-1.5708|1.5708] "rad"  ADAS
 SG_ DET_AZIMUTH_ERR_268 : 465|7@1+ (0.00087267,0) [0|0.11082909] "rad"  ADAS
 SG_ DET_ELEVATION_268 : 432|8@1+ (0.00275,-0.34925) [-0.34925|0.34925] "rad"  ADAS
 SG_ DET_ELEVATION_ERR_268 : 440|6@1+ (0.00174533,0) [0|0.10995579] "rad"  ADAS
 SG_ DET_RCS_268 : 496|8@1+ (0.5,-64) [-64|63.5] "dBsm"  ADAS
 SG_ DET_VALID_FLAG_268 : 485|1@1+ (1,0) [0|1] ""  ADAS
 SG_ DET_BI_STATIC_FLAG_268 : 483|1@1+ (1,0) [0|1] ""  ADAS
 SG_ DET_SUPER_RES_TARGET_268 : 446|1@1+ (1,0) [0|1] ""  ADAS
 SG_ DET_SNR_268 : 488|8@1+ (0.35156,0) [0|89.6478] "dB"  ADAS
 SG_ DET_POINT_TARGET_PROB_268 : 472|4@1+ (6.67,0) [0|100] "%"  ADAS
 SG_ DET_EXISTENCE_PROB_268 : 506|6@1+ (1.588,0) [0|100] "%"  ADAS
 SG_ DET_OUTSIDE_SECTOR_268 : 481|1@1+ (1,0) [0|1] ""  ADAS
 SG_ DET_HVC_FLAG_268 : 464|1@1+ (1,0) [0|1] ""  ADAS
 SG_ DET_CONFD_AZIMUTH_268 : 486|2@1+ (1,0) [0|3] ""  ADAS
 SG_ DET_CONFD_ELEVATION_268 : 461|2@1+ (1,0) [0|3] ""  ADAS
 SG_ DET_MH_SCAN_INDEX_4LSB_265_268 : 476|4@1+ (1,0) [0|15] ""  ADAS
 SG_ DET_MH_CYCLE_COUNTER_265_268 : 16|8@1+ (1,0) [0|255] ""  ADAS
 SG_ DET_MH_CRC16_265_268 : 0|16@1+ (1,0) [0|65535] ""  ADAS

BO_ 1091 RDR_DETECTION_269_272: 64 RDR07
 SG_ DET_RANGE_269 : 24|15@1+ (0.015625,0) [0|500] "m"  ADAS
 SG_ DET_RANGE_ERR_269 : 40|7@1+ (0.0075,0) [0|0.9525] "m"  ADAS
 SG_ DET_RANGE_VELOCITY_269 : 48|15@1+ (0.0078125,-128) [-128|127.9921875] "m/s"  ADAS
 SG_ DET_RANGE_VELOCITY_ERR_269 : 64|8@1+ (0.003,0) [0|0.765] "m/s"  ADAS
 SG_ DET_AZIMUTH_269 : 88|13@1+ (0.0004,-1.5708) [-1.5708|1.5708] "rad"  ADAS
 SG_ DET_AZIMUTH_ERR_269 : 105|7@1+ (0.00087267,0) [0|0.11082909] "rad"  ADAS
 SG_ DET_ELEVATION_269 : 72|8@1+ (0.00275,-0.34925) [-0.34925|0.34925] "rad"  ADAS
 SG_ DET_ELEVATION_ERR_269 : 80|6@1+ (0.00174533,0) [0|0.10995579] "rad"  ADAS
 SG_ DET_RCS_269 : 136|8@1+ (0.5,-64) [-64|63.5] "dBsm"  ADAS
 SG_ DET_VALID_FLAG_269 : 119|1@1+ (1,0) [0|1] ""  ADAS
 SG_ DET_BI_STATIC_FLAG_269 : 504|1@1+ (1,0) [0|1] ""  ADAS
 SG_ DET_SUPER_RES_TARGET_269 : 104|1@1+ (1,0) [0|1] ""  ADAS
 SG_ DET_SNR_269 : 128|8@1+ (0.35156,0) [0|89.6478] "dB"  ADAS
 SG_ DET_POINT_TARGET_PROB_269 : 114|4@1+ (6.67,0) [0|100] "%"  ADAS
 SG_ DET_EXISTENCE_PROB_269 : 120|6@1+ (1.588,0) [0|100] "%"  ADAS
 SG_ DET_OUTSIDE_SECTOR_269 : 159|1@1+ (1,0) [0|1] ""  ADAS
 SG_ DET_HVC_FLAG_269 : 118|1@1+ (1,0) [0|1] ""  ADAS
 SG_ DET_CONFD_AZIMUTH_269 : 126|2@1+ (1,0) [0|3] ""  ADAS
 SG_ DET_CONFD_ELEVATION_269 : 112|2@1+ (1,0) [0|3] ""  ADAS
 SG_ DET_RANGE_270 : 144|15@1+ (0.015625,0) [0|500] "m"  ADAS
 SG_ DET_RANGE_ERR_270 : 160|7@1+ (0.0075,0) [0|0.9525] "m"  ADAS
 SG_ DET_RANGE_VELOCITY_270 : 168|15@1+ (0.0078125,-128) [-128|127.9921875] "m/s"  ADAS
 SG_ DET_RANGE_VELOCITY_ERR_270 : 184|8@1+ (0.003,0) [0|0.765] "m/s"  ADAS
 SG_ DET_AZIMUTH_270 : 208|13@1+ (0.0004,-1.5708) [-1.5708|1.5708] "rad"  ADAS
 SG_ DET_AZIMUTH_ERR_270 : 224|7@1+ (0.00087267,0) [0|0.11082909] "rad"  ADAS
 SG_ DET_ELEVATION_270 : 192|8@1+ (0.00275,-0.34925) [-0.34925|0.34925] "rad"  ADAS
 SG_ DET_ELEVATION_ERR_270 : 200|6@1+ (0.00174533,0) [0|0.10995579] "rad"  ADAS
 SG_ DET_RCS_270 : 256|8@1+ (0.5,-64) [-64|63.5] "dBsm"  ADAS
 SG_ DET_VALID_FLAG_270 : 167|1@1+ (1,0) [0|1] ""  ADAS
 SG_ DET_BI_STATIC_FLAG_270 : 505|1@1+ (1,0) [0|1] ""  ADAS
 SG_ DET_SUPER_RES_TARGET_270 : 247|1@1+ (1,0) [0|1] ""  ADAS
 SG_ DET_SNR_270 : 248|8@1+ (0.35156,0) [0|89.6478] "dB"  ADAS
 SG_ DET_POINT_TARGET_PROB_270 : 240|4@1+ (6.67,0) [0|100] "%"  ADAS
 SG_ DET_EXISTENCE_PROB_270 : 232|6@1+ (1.588,0) [0|100] "%"  ADAS
 SG_ DET_OUTSIDE_SECTOR_270 : 183|1@1+ (1,0) [0|1] ""  ADAS
 SG_ DET_HVC_FLAG_270 : 246|1@1+ (1,0) [0|1] ""  ADAS
 SG_ DET_CONFD_AZIMUTH_270 : 206|2@1+ (1,0) [0|3] ""  ADAS
 SG_ DET_CONFD_ELEVATION_270 : 244|2@1+ (1,0) [0|3] ""  ADAS
 SG_ DET_RANGE_271 : 264|15@1+ (0.015625,0) [0|500] "m"  ADAS
 SG_ DET_RANGE_ERR_271 : 280|7@1+ (0.0075,0) [0|0.9525] "m"  ADAS
 SG_ DET_RANGE_VELOCITY_271 : 288|15@1+ (0.0078125,-128) [-128|127.9921875] "m/s"  ADAS
 SG_ DET_RANGE_VELOCITY_ERR_271 : 304|8@1+ (0.003,0) [0|0.765] "m/s"  ADAS
 SG_ DET_AZIMUTH_271 : 328|13@1+ (0.0004,-1.5708) [-1.5708|1.5708] "rad"  ADAS
 SG_ DET_AZIMUTH_ERR_271 : 345|7@1+ (0.00087267,0) [0|0.11082909] "rad"  ADAS
 SG_ DET_ELEVATION_271 : 312|8@1+ (0.00275,-0.34925) [-0.34925|0.34925] "rad"  ADAS
 SG_ DET_ELEVATION_ERR_271 : 320|6@1+ (0.00174533,0) [0|0.10995579] "rad"  ADAS
 SG_ DET_RCS_271 : 376|8@1+ (0.5,-64) [-64|63.5] "dBsm"  ADAS
 SG_ DET_VALID_FLAG_271 : 399|1@1+ (1,0) [0|1] ""  ADAS
 SG_ DET_BI_STATIC_FLAG_271 : 482|1@1+ (1,0) [0|1] ""  ADAS
 SG_ DET_SUPER_RES_TARGET_271 : 344|1@1+ (1,0) [0|1] ""  ADAS
 SG_ DET_SNR_271 : 368|8@1+ (0.35156,0) [0|89.6478] "dB"  ADAS
 SG_ DET_POINT_TARGET_PROB_271 : 360|4@1+ (6.67,0) [0|100] "%"  ADAS
 SG_ DET_EXISTENCE_PROB_271 : 352|6@1+ (1.588,0) [0|100] "%"  ADAS
 SG_ DET_OUTSIDE_SECTOR_271 : 407|1@1+ (1,0) [0|1] ""  ADAS
 SG_ DET_HVC_FLAG_271 : 364|1@1+ (1,0) [0|1] ""  ADAS
 SG_ DET_CONFD_AZIMUTH_271 : 365|2@1+ (1,0) [0|3] ""  ADAS
 SG_ DET_CONFD_ELEVATION_271 : 358|2@1+ (1,0) [0|3] ""  ADAS
 SG_ DET_RANGE_272 : 384|15@1+ (0.015625,0) [0|500] "m"  ADAS
 SG_ DET_RANGE_ERR_272 : 400|7@1+ (0.0075,0) [0|0.9525] "m"  ADAS
 SG_ DET_RANGE_VELOCITY_272 : 408|15@1+ (0.0078125,-128) [-128|127.9921875] "m/s"  ADAS
 SG_ DET_RANGE_VELOCITY_ERR_272 : 424|8@1+ (0.003,0) [0|0.765] "m/s"  ADAS
 SG_ DET_AZIMUTH_272 : 448|13@1+ (0.0004,-1.5708) [-1.5708|1.5708] "rad"  ADAS
 SG_ DET_AZIMUTH_ERR_272 : 465|7@1+ (0.00087267,0) [0|0.11082909] "rad"  ADAS
 SG_ DET_ELEVATION_272 : 432|8@1+ (0.00275,-0.34925) [-0.34925|0.34925] "rad"  ADAS
 SG_ DET_ELEVATION_ERR_272 : 440|6@1+ (0.00174533,0) [0|0.10995579] "rad"  ADAS
 SG_ DET_RCS_272 : 496|8@1+ (0.5,-64) [-64|63.5] "dBsm"  ADAS
 SG_ DET_VALID_FLAG_272 : 485|1@1+ (1,0) [0|1] ""  ADAS
 SG_ DET_BI_STATIC_FLAG_272 : 483|1@1+ (1,0) [0|1] ""  ADAS
 SG_ DET_SUPER_RES_TARGET_272 : 446|1@1+ (1,0) [0|1] ""  ADAS
 SG_ DET_SNR_272 : 488|8@1+ (0.35156,0) [0|89.6478] "dB"  ADAS
 SG_ DET_POINT_TARGET_PROB_272 : 472|4@1+ (6.67,0) [0|100] "%"  ADAS
 SG_ DET_EXISTENCE_PROB_272 : 506|6@1+ (1.588,0) [0|100] "%"  ADAS
 SG_ DET_OUTSIDE_SECTOR_272 : 481|1@1+ (1,0) [0|1] ""  ADAS
 SG_ DET_HVC_FLAG_272 : 464|1@1+ (1,0) [0|1] ""  ADAS
 SG_ DET_CONFD_AZIMUTH_272 : 486|2@1+ (1,0) [0|3] ""  ADAS
 SG_ DET_CONFD_ELEVATION_272 : 461|2@1+ (1,0) [0|3] ""  ADAS
 SG_ DET_MH_SCAN_INDEX_4LSB_269_272 : 476|4@1+ (1,0) [0|15] ""  ADAS
 SG_ DET_MH_CYCLE_COUNTER_269_272 : 16|8@1+ (1,0) [0|255] ""  ADAS
 SG_ DET_MH_CRC16_269_272 : 0|16@1+ (1,0) [0|65535] ""  ADAS

BO_ 1092 RDR_DETECTION_273_276: 64 RDR07
 SG_ DET_RANGE_273 : 24|15@1+ (0.015625,0) [0|500] "m"  ADAS
 SG_ DET_RANGE_ERR_273 : 40|7@1+ (0.0075,0) [0|0.9525] "m"  ADAS
 SG_ DET_RANGE_VELOCITY_273 : 48|15@1+ (0.0078125,-128) [-128|127.9921875] "m/s"  ADAS
 SG_ DET_RANGE_VELOCITY_ERR_273 : 64|8@1+ (0.003,0) [0|0.765] "m/s"  ADAS
 SG_ DET_AZIMUTH_273 : 88|13@1+ (0.0004,-1.5708) [-1.5708|1.5708] "rad"  ADAS
 SG_ DET_AZIMUTH_ERR_273 : 105|7@1+ (0.00087267,0) [0|0.11082909] "rad"  ADAS
 SG_ DET_ELEVATION_273 : 72|8@1+ (0.00275,-0.34925) [-0.34925|0.34925] "rad"  ADAS
 SG_ DET_ELEVATION_ERR_273 : 80|6@1+ (0.00174533,0) [0|0.10995579] "rad"  ADAS
 SG_ DET_RCS_273 : 136|8@1+ (0.5,-64) [-64|63.5] "dBsm"  ADAS
 SG_ DET_VALID_FLAG_273 : 119|1@1+ (1,0) [0|1] ""  ADAS
 SG_ DET_BI_STATIC_FLAG_273 : 504|1@1+ (1,0) [0|1] ""  ADAS
 SG_ DET_SUPER_RES_TARGET_273 : 104|1@1+ (1,0) [0|1] ""  ADAS
 SG_ DET_SNR_273 : 128|8@1+ (0.35156,0) [0|89.6478] "dB"  ADAS
 SG_ DET_POINT_TARGET_PROB_273 : 114|4@1+ (6.67,0) [0|100] "%"  ADAS
 SG_ DET_EXISTENCE_PROB_273 : 120|6@1+ (1.588,0) [0|100] "%"  ADAS
 SG_ DET_OUTSIDE_SECTOR_273 : 159|1@1+ (1,0) [0|1] ""  ADAS
 SG_ DET_HVC_FLAG_273 : 118|1@1+ (1,0) [0|1] ""  ADAS
 SG_ DET_CONFD_AZIMUTH_273 : 126|2@1+ (1,0) [0|3] ""  ADAS
 SG_ DET_CONFD_ELEVATION_273 : 112|2@1+ (1,0) [0|3] ""  ADAS
 SG_ DET_RANGE_274 : 144|15@1+ (0.015625,0) [0|500] "m"  ADAS
 SG_ DET_RANGE_ERR_274 : 160|7@1+ (0.0075,0) [0|0.9525] "m"  ADAS
 SG_ DET_RANGE_VELOCITY_274 : 168|15@1+ (0.0078125,-128) [-128|127.9921875] "m/s"  ADAS
 SG_ DET_RANGE_VELOCITY_ERR_274 : 184|8@1+ (0.003,0) [0|0.765] "m/s"  ADAS
 SG_ DET_AZIMUTH_274 : 208|13@1+ (0.0004,-1.5708) [-1.5708|1.5708] "rad"  ADAS
 SG_ DET_AZIMUTH_ERR_274 : 224|7@1+ (0.00087267,0) [0|0.11082909] "rad"  ADAS
 SG_ DET_ELEVATION_274 : 192|8@1+ (0.00275,-0.34925) [-0.34925|0.34925] "rad"  ADAS
 SG_ DET_ELEVATION_ERR_274 : 200|6@1+ (0.00174533,0) [0|0.10995579] "rad"  ADAS
 SG_ DET_RCS_274 : 256|8@1+ (0.5,-64) [-64|63.5] "dBsm"  ADAS
 SG_ DET_VALID_FLAG_274 : 167|1@1+ (1,0) [0|1] ""  ADAS
 SG_ DET_BI_STATIC_FLAG_274 : 505|1@1+ (1,0) [0|1] ""  ADAS
 SG_ DET_SUPER_RES_TARGET_274 : 247|1@1+ (1,0) [0|1] ""  ADAS
 SG_ DET_SNR_274 : 248|8@1+ (0.35156,0) [0|89.6478] "dB"  ADAS
 SG_ DET_POINT_TARGET_PROB_274 : 240|4@1+ (6.67,0) [0|100] "%"  ADAS
 SG_ DET_EXISTENCE_PROB_274 : 232|6@1+ (1.588,0) [0|100] "%"  ADAS
 SG_ DET_OUTSIDE_SECTOR_274 : 183|1@1+ (1,0) [0|1] ""  ADAS
 SG_ DET_HVC_FLAG_274 : 246|1@1+ (1,0) [0|1] ""  ADAS
 SG_ DET_CONFD_AZIMUTH_274 : 206|2@1+ (1,0) [0|3] ""  ADAS
 SG_ DET_CONFD_ELEVATION_274 : 244|2@1+ (1,0) [0|3] ""  ADAS
 SG_ DET_RANGE_275 : 264|15@1+ (0.015625,0) [0|500] "m"  ADAS
 SG_ DET_RANGE_ERR_275 : 280|7@1+ (0.0075,0) [0|0.9525] "m"  ADAS
 SG_ DET_RANGE_VELOCITY_275 : 288|15@1+ (0.0078125,-128) [-128|127.9921875] "m/s"  ADAS
 SG_ DET_RANGE_VELOCITY_ERR_275 : 304|8@1+ (0.003,0) [0|0.765] "m/s"  ADAS
 SG_ DET_AZIMUTH_275 : 328|13@1+ (0.0004,-1.5708) [-1.5708|1.5708] "rad"  ADAS
 SG_ DET_AZIMUTH_ERR_275 : 345|7@1+ (0.00087267,0) [0|0.11082909] "rad"  ADAS
 SG_ DET_ELEVATION_275 : 312|8@1+ (0.00275,-0.34925) [-0.34925|0.34925] "rad"  ADAS
 SG_ DET_ELEVATION_ERR_275 : 320|6@1+ (0.00174533,0) [0|0.10995579] "rad"  ADAS
 SG_ DET_RCS_275 : 376|8@1+ (0.5,-64) [-64|63.5] "dBsm"  ADAS
 SG_ DET_VALID_FLAG_275 : 399|1@1+ (1,0) [0|1] ""  ADAS
 SG_ DET_BI_STATIC_FLAG_275 : 482|1@1+ (1,0) [0|1] ""  ADAS
 SG_ DET_SUPER_RES_TARGET_275 : 344|1@1+ (1,0) [0|1] ""  ADAS
 SG_ DET_SNR_275 : 368|8@1+ (0.35156,0) [0|89.6478] "dB"  ADAS
 SG_ DET_POINT_TARGET_PROB_275 : 360|4@1+ (6.67,0) [0|100] "%"  ADAS
 SG_ DET_EXISTENCE_PROB_275 : 352|6@1+ (1.588,0) [0|100] "%"  ADAS
 SG_ DET_OUTSIDE_SECTOR_275 : 407|1@1+ (1,0) [0|1] ""  ADAS
 SG_ DET_HVC_FLAG_275 : 364|1@1+ (1,0) [0|1] ""  ADAS
 SG_ DET_CONFD_AZIMUTH_275 : 365|2@1+ (1,0) [0|3] ""  ADAS
 SG_ DET_CONFD_ELEVATION_275 : 358|2@1+ (1,0) [0|3] ""  ADAS
 SG_ DET_RANGE_276 : 384|15@1+ (0.015625,0) [0|500] "m"  ADAS
 SG_ DET_RANGE_ERR_276 : 400|7@1+ (0.0075,0) [0|0.9525] "m"  ADAS
 SG_ DET_RANGE_VELOCITY_276 : 408|15@1+ (0.0078125,-128) [-128|127.9921875] "m/s"  ADAS
 SG_ DET_RANGE_VELOCITY_ERR_276 : 424|8@1+ (0.003,0) [0|0.765] "m/s"  ADAS
 SG_ DET_AZIMUTH_276 : 448|13@1+ (0.0004,-1.5708) [-1.5708|1.5708] "rad"  ADAS
 SG_ DET_AZIMUTH_ERR_276 : 465|7@1+ (0.00087267,0) [0|0.11082909] "rad"  ADAS
 SG_ DET_ELEVATION_276 : 432|8@1+ (0.00275,-0.34925) [-0.34925|0.34925] "rad"  ADAS
 SG_ DET_ELEVATION_ERR_276 : 440|6@1+ (0.00174533,0) [0|0.10995579] "rad"  ADAS
 SG_ DET_RCS_276 : 496|8@1+ (0.5,-64) [-64|63.5] "dBsm"  ADAS
 SG_ DET_VALID_FLAG_276 : 485|1@1+ (1,0) [0|1] ""  ADAS
 SG_ DET_BI_STATIC_FLAG_276 : 483|1@1+ (1,0) [0|1] ""  ADAS
 SG_ DET_SUPER_RES_TARGET_276 : 446|1@1+ (1,0) [0|1] ""  ADAS
 SG_ DET_SNR_276 : 488|8@1+ (0.35156,0) [0|89.6478] "dB"  ADAS
 SG_ DET_POINT_TARGET_PROB_276 : 472|4@1+ (6.67,0) [0|100] "%"  ADAS
 SG_ DET_EXISTENCE_PROB_276 : 506|6@1+ (1.588,0) [0|100] "%"  ADAS
 SG_ DET_OUTSIDE_SECTOR_276 : 481|1@1+ (1,0) [0|1] ""  ADAS
 SG_ DET_HVC_FLAG_276 : 464|1@1+ (1,0) [0|1] ""  ADAS
 SG_ DET_CONFD_AZIMUTH_276 : 486|2@1+ (1,0) [0|3] ""  ADAS
 SG_ DET_CONFD_ELEVATION_276 : 461|2@1+ (1,0) [0|3] ""  ADAS
 SG_ DET_MH_SCAN_INDEX_4LSB_273_276 : 476|4@1+ (1,0) [0|15] ""  ADAS
 SG_ DET_MH_CYCLE_COUNTER_273_276 : 16|8@1+ (1,0) [0|255] ""  ADAS
 SG_ DET_MH_CRC16_273_276 : 0|16@1+ (1,0) [0|65535] ""  ADAS

BO_ 1093 RDR_DETECTION_277_280: 64 RDR07
 SG_ DET_RANGE_277 : 24|15@1+ (0.015625,0) [0|500] "m"  ADAS
 SG_ DET_RANGE_ERR_277 : 40|7@1+ (0.0075,0) [0|0.9525] "m"  ADAS
 SG_ DET_RANGE_VELOCITY_277 : 48|15@1+ (0.0078125,-128) [-128|127.9921875] "m/s"  ADAS
 SG_ DET_RANGE_VELOCITY_ERR_277 : 64|8@1+ (0.003,0) [0|0.765] "m/s"  ADAS
 SG_ DET_AZIMUTH_277 : 88|13@1+ (0.0004,-1.5708) [-1.5708|1.5708] "rad"  ADAS
 SG_ DET_AZIMUTH_ERR_277 : 105|7@1+ (0.00087267,0) [0|0.11082909] "rad"  ADAS
 SG_ DET_ELEVATION_277 : 72|8@1+ (0.00275,-0.34925) [-0.34925|0.34925] "rad"  ADAS
 SG_ DET_ELEVATION_ERR_277 : 80|6@1+ (0.00174533,0) [0|0.10995579] "rad"  ADAS
 SG_ DET_RCS_277 : 136|8@1+ (0.5,-64) [-64|63.5] "dBsm"  ADAS
 SG_ DET_VALID_FLAG_277 : 119|1@1+ (1,0) [0|1] ""  ADAS
 SG_ DET_BI_STATIC_FLAG_277 : 504|1@1+ (1,0) [0|1] ""  ADAS
 SG_ DET_SUPER_RES_TARGET_277 : 104|1@1+ (1,0) [0|1] ""  ADAS
 SG_ DET_SNR_277 : 128|8@1+ (0.35156,0) [0|89.6478] "dB"  ADAS
 SG_ DET_POINT_TARGET_PROB_277 : 114|4@1+ (6.67,0) [0|100] "%"  ADAS
 SG_ DET_EXISTENCE_PROB_277 : 120|6@1+ (1.588,0) [0|100] "%"  ADAS
 SG_ DET_OUTSIDE_SECTOR_277 : 159|1@1+ (1,0) [0|1] ""  ADAS
 SG_ DET_HVC_FLAG_277 : 118|1@1+ (1,0) [0|1] ""  ADAS
 SG_ DET_CONFD_AZIMUTH_277 : 126|2@1+ (1,0) [0|3] ""  ADAS
 SG_ DET_CONFD_ELEVATION_277 : 112|2@1+ (1,0) [0|3] ""  ADAS
 SG_ DET_RANGE_278 : 144|15@1+ (0.015625,0) [0|500] "m"  ADAS
 SG_ DET_RANGE_ERR_278 : 160|7@1+ (0.0075,0) [0|0.9525] "m"  ADAS
 SG_ DET_RANGE_VELOCITY_278 : 168|15@1+ (0.0078125,-128) [-128|127.9921875] "m/s"  ADAS
 SG_ DET_RANGE_VELOCITY_ERR_278 : 184|8@1+ (0.003,0) [0|0.765] "m/s"  ADAS
 SG_ DET_AZIMUTH_278 : 208|13@1+ (0.0004,-1.5708) [-1.5708|1.5708] "rad"  ADAS
 SG_ DET_AZIMUTH_ERR_278 : 224|7@1+ (0.00087267,0) [0|0.11082909] "rad"  ADAS
 SG_ DET_ELEVATION_278 : 192|8@1+ (0.00275,-0.34925) [-0.34925|0.34925] "rad"  ADAS
 SG_ DET_ELEVATION_ERR_278 : 200|6@1+ (0.00174533,0) [0|0.10995579] "rad"  ADAS
 SG_ DET_RCS_278 : 256|8@1+ (0.5,-64) [-64|63.5] "dBsm"  ADAS
 SG_ DET_VALID_FLAG_278 : 167|1@1+ (1,0) [0|1] ""  ADAS
 SG_ DET_BI_STATIC_FLAG_278 : 505|1@1+ (1,0) [0|1] ""  ADAS
 SG_ DET_SUPER_RES_TARGET_278 : 247|1@1+ (1,0) [0|1] ""  ADAS
 SG_ DET_SNR_278 : 248|8@1+ (0.35156,0) [0|89.6478] "dB"  ADAS
 SG_ DET_POINT_TARGET_PROB_278 : 240|4@1+ (6.67,0) [0|100] "%"  ADAS
 SG_ DET_EXISTENCE_PROB_278 : 232|6@1+ (1.588,0) [0|100] "%"  ADAS
 SG_ DET_OUTSIDE_SECTOR_278 : 183|1@1+ (1,0) [0|1] ""  ADAS
 SG_ DET_HVC_FLAG_278 : 246|1@1+ (1,0) [0|1] ""  ADAS
 SG_ DET_CONFD_AZIMUTH_278 : 206|2@1+ (1,0) [0|3] ""  ADAS
 SG_ DET_CONFD_ELEVATION_278 : 244|2@1+ (1,0) [0|3] ""  ADAS
 SG_ DET_RANGE_279 : 264|15@1+ (0.015625,0) [0|500] "m"  ADAS
 SG_ DET_RANGE_ERR_279 : 280|7@1+ (0.0075,0) [0|0.9525] "m"  ADAS
 SG_ DET_RANGE_VELOCITY_279 : 288|15@1+ (0.0078125,-128) [-128|127.9921875] "m/s"  ADAS
 SG_ DET_RANGE_VELOCITY_ERR_279 : 304|8@1+ (0.003,0) [0|0.765] "m/s"  ADAS
 SG_ DET_AZIMUTH_279 : 328|13@1+ (0.0004,-1.5708) [-1.5708|1.5708] "rad"  ADAS
 SG_ DET_AZIMUTH_ERR_279 : 345|7@1+ (0.00087267,0) [0|0.11082909] "rad"  ADAS
 SG_ DET_ELEVATION_279 : 312|8@1+ (0.00275,-0.34925) [-0.34925|0.34925] "rad"  ADAS
 SG_ DET_ELEVATION_ERR_279 : 320|6@1+ (0.00174533,0) [0|0.10995579] "rad"  ADAS
 SG_ DET_RCS_279 : 376|8@1+ (0.5,-64) [-64|63.5] "dBsm"  ADAS
 SG_ DET_VALID_FLAG_279 : 399|1@1+ (1,0) [0|1] ""  ADAS
 SG_ DET_BI_STATIC_FLAG_279 : 482|1@1+ (1,0) [0|1] ""  ADAS
 SG_ DET_SUPER_RES_TARGET_279 : 344|1@1+ (1,0) [0|1] ""  ADAS
 SG_ DET_SNR_279 : 368|8@1+ (0.35156,0) [0|89.6478] "dB"  ADAS
 SG_ DET_POINT_TARGET_PROB_279 : 360|4@1+ (6.67,0) [0|100] "%"  ADAS
 SG_ DET_EXISTENCE_PROB_279 : 352|6@1+ (1.588,0) [0|100] "%"  ADAS
 SG_ DET_OUTSIDE_SECTOR_279 : 407|1@1+ (1,0) [0|1] ""  ADAS
 SG_ DET_HVC_FLAG_279 : 364|1@1+ (1,0) [0|1] ""  ADAS
 SG_ DET_CONFD_AZIMUTH_279 : 365|2@1+ (1,0) [0|3] ""  ADAS
 SG_ DET_CONFD_ELEVATION_279 : 358|2@1+ (1,0) [0|3] ""  ADAS
 SG_ DET_RANGE_280 : 384|15@1+ (0.015625,0) [0|500] "m"  ADAS
 SG_ DET_RANGE_ERR_280 : 400|7@1+ (0.0075,0) [0|0.9525] "m"  ADAS
 SG_ DET_RANGE_VELOCITY_280 : 408|15@1+ (0.0078125,-128) [-128|127.9921875] "m/s"  ADAS
 SG_ DET_RANGE_VELOCITY_ERR_280 : 424|8@1+ (0.003,0) [0|0.765] "m/s"  ADAS
 SG_ DET_AZIMUTH_280 : 448|13@1+ (0.0004,-1.5708) [-1.5708|1.5708] "rad"  ADAS
 SG_ DET_AZIMUTH_ERR_280 : 465|7@1+ (0.00087267,0) [0|0.11082909] "rad"  ADAS
 SG_ DET_ELEVATION_280 : 432|8@1+ (0.00275,-0.34925) [-0.34925|0.34925] "rad"  ADAS
 SG_ DET_ELEVATION_ERR_280 : 440|6@1+ (0.00174533,0) [0|0.10995579] "rad"  ADAS
 SG_ DET_RCS_280 : 496|8@1+ (0.5,-64) [-64|63.5] "dBsm"  ADAS
 SG_ DET_VALID_FLAG_280 : 485|1@1+ (1,0) [0|1] ""  ADAS
 SG_ DET_BI_STATIC_FLAG_280 : 483|1@1+ (1,0) [0|1] ""  ADAS
 SG_ DET_SUPER_RES_TARGET_280 : 446|1@1+ (1,0) [0|1] ""  ADAS
 SG_ DET_SNR_280 : 488|8@1+ (0.35156,0) [0|89.6478] "dB"  ADAS
 SG_ DET_POINT_TARGET_PROB_280 : 472|4@1+ (6.67,0) [0|100] "%"  ADAS
 SG_ DET_EXISTENCE_PROB_280 : 506|6@1+ (1.588,0) [0|100] "%"  ADAS
 SG_ DET_OUTSIDE_SECTOR_280 : 481|1@1+ (1,0) [0|1] ""  ADAS
 SG_ DET_HVC_FLAG_280 : 464|1@1+ (1,0) [0|1] ""  ADAS
 SG_ DET_CONFD_AZIMUTH_280 : 486|2@1+ (1,0) [0|3] ""  ADAS
 SG_ DET_CONFD_ELEVATION_280 : 461|2@1+ (1,0) [0|3] ""  ADAS
 SG_ DET_MH_SCAN_INDEX_4LSB_277_280 : 476|4@1+ (1,0) [0|15] ""  ADAS
 SG_ DET_MH_CYCLE_COUNTER_277_280 : 16|8@1+ (1,0) [0|255] ""  ADAS
 SG_ DET_MH_CRC16_277_280 : 0|16@1+ (1,0) [0|65535] ""  ADAS

BO_ 1094 RDR_DETECTION_281_284: 64 RDR07
 SG_ DET_RANGE_281 : 24|15@1+ (0.015625,0) [0|500] "m"  ADAS
 SG_ DET_RANGE_ERR_281 : 40|7@1+ (0.0075,0) [0|0.9525] "m"  ADAS
 SG_ DET_RANGE_VELOCITY_281 : 48|15@1+ (0.0078125,-128) [-128|127.9921875] "m/s"  ADAS
 SG_ DET_RANGE_VELOCITY_ERR_281 : 64|8@1+ (0.003,0) [0|0.765] "m/s"  ADAS
 SG_ DET_AZIMUTH_281 : 88|13@1+ (0.0004,-1.5708) [-1.5708|1.5708] "rad"  ADAS
 SG_ DET_AZIMUTH_ERR_281 : 105|7@1+ (0.00087267,0) [0|0.11082909] "rad"  ADAS
 SG_ DET_ELEVATION_281 : 72|8@1+ (0.00275,-0.34925) [-0.34925|0.34925] "rad"  ADAS
 SG_ DET_ELEVATION_ERR_281 : 80|6@1+ (0.00174533,0) [0|0.10995579] "rad"  ADAS
 SG_ DET_RCS_281 : 136|8@1+ (0.5,-64) [-64|63.5] "dBsm"  ADAS
 SG_ DET_VALID_FLAG_281 : 119|1@1+ (1,0) [0|1] ""  ADAS
 SG_ DET_BI_STATIC_FLAG_281 : 504|1@1+ (1,0) [0|1] ""  ADAS
 SG_ DET_SUPER_RES_TARGET_281 : 104|1@1+ (1,0) [0|1] ""  ADAS
 SG_ DET_SNR_281 : 128|8@1+ (0.35156,0) [0|89.6478] "dB"  ADAS
 SG_ DET_POINT_TARGET_PROB_281 : 114|4@1+ (6.67,0) [0|100] "%"  ADAS
 SG_ DET_EXISTENCE_PROB_281 : 120|6@1+ (1.588,0) [0|100] "%"  ADAS
 SG_ DET_OUTSIDE_SECTOR_281 : 159|1@1+ (1,0) [0|1] ""  ADAS
 SG_ DET_HVC_FLAG_281 : 118|1@1+ (1,0) [0|1] ""  ADAS
 SG_ DET_CONFD_AZIMUTH_281 : 126|2@1+ (1,0) [0|3] ""  ADAS
 SG_ DET_CONFD_ELEVATION_281 : 112|2@1+ (1,0) [0|3] ""  ADAS
 SG_ DET_RANGE_282 : 144|15@1+ (0.015625,0) [0|500] "m"  ADAS
 SG_ DET_RANGE_ERR_282 : 160|7@1+ (0.0075,0) [0|0.9525] "m"  ADAS
 SG_ DET_RANGE_VELOCITY_282 : 168|15@1+ (0.0078125,-128) [-128|127.9921875] "m/s"  ADAS
 SG_ DET_RANGE_VELOCITY_ERR_282 : 184|8@1+ (0.003,0) [0|0.765] "m/s"  ADAS
 SG_ DET_AZIMUTH_282 : 208|13@1+ (0.0004,-1.5708) [-1.5708|1.5708] "rad"  ADAS
 SG_ DET_AZIMUTH_ERR_282 : 224|7@1+ (0.00087267,0) [0|0.11082909] "rad"  ADAS
 SG_ DET_ELEVATION_282 : 192|8@1+ (0.00275,-0.34925) [-0.34925|0.34925] "rad"  ADAS
 SG_ DET_ELEVATION_ERR_282 : 200|6@1+ (0.00174533,0) [0|0.10995579] "rad"  ADAS
 SG_ DET_RCS_282 : 256|8@1+ (0.5,-64) [-64|63.5] "dBsm"  ADAS
 SG_ DET_VALID_FLAG_282 : 167|1@1+ (1,0) [0|1] ""  ADAS
 SG_ DET_BI_STATIC_FLAG_282 : 505|1@1+ (1,0) [0|1] ""  ADAS
 SG_ DET_SUPER_RES_TARGET_282 : 247|1@1+ (1,0) [0|1] ""  ADAS
 SG_ DET_SNR_282 : 248|8@1+ (0.35156,0) [0|89.6478] "dB"  ADAS
 SG_ DET_POINT_TARGET_PROB_282 : 240|4@1+ (6.67,0) [0|100] "%"  ADAS
 SG_ DET_EXISTENCE_PROB_282 : 232|6@1+ (1.588,0) [0|100] "%"  ADAS
 SG_ DET_OUTSIDE_SECTOR_282 : 183|1@1+ (1,0) [0|1] ""  ADAS
 SG_ DET_HVC_FLAG_282 : 246|1@1+ (1,0) [0|1] ""  ADAS
 SG_ DET_CONFD_AZIMUTH_282 : 206|2@1+ (1,0) [0|3] ""  ADAS
 SG_ DET_CONFD_ELEVATION_282 : 244|2@1+ (1,0) [0|3] ""  ADAS
 SG_ DET_RANGE_283 : 264|15@1+ (0.015625,0) [0|500] "m"  ADAS
 SG_ DET_RANGE_ERR_283 : 280|7@1+ (0.0075,0) [0|0.9525] "m"  ADAS
 SG_ DET_RANGE_VELOCITY_283 : 288|15@1+ (0.0078125,-128) [-128|127.9921875] "m/s"  ADAS
 SG_ DET_RANGE_VELOCITY_ERR_283 : 304|8@1+ (0.003,0) [0|0.765] "m/s"  ADAS
 SG_ DET_AZIMUTH_283 : 328|13@1+ (0.0004,-1.5708) [-1.5708|1.5708] "rad"  ADAS
 SG_ DET_AZIMUTH_ERR_283 : 345|7@1+ (0.00087267,0) [0|0.11082909] "rad"  ADAS
 SG_ DET_ELEVATION_283 : 312|8@1+ (0.00275,-0.34925) [-0.34925|0.34925] "rad"  ADAS
 SG_ DET_ELEVATION_ERR_283 : 320|6@1+ (0.00174533,0) [0|0.10995579] "rad"  ADAS
 SG_ DET_RCS_283 : 376|8@1+ (0.5,-64) [-64|63.5] "dBsm"  ADAS
 SG_ DET_VALID_FLAG_283 : 399|1@1+ (1,0) [0|1] ""  ADAS
 SG_ DET_BI_STATIC_FLAG_283 : 482|1@1+ (1,0) [0|1] ""  ADAS
 SG_ DET_SUPER_RES_TARGET_283 : 344|1@1+ (1,0) [0|1] ""  ADAS
 SG_ DET_SNR_283 : 368|8@1+ (0.35156,0) [0|89.6478] "dB"  ADAS
 SG_ DET_POINT_TARGET_PROB_283 : 360|4@1+ (6.67,0) [0|100] "%"  ADAS
 SG_ DET_EXISTENCE_PROB_283 : 352|6@1+ (1.588,0) [0|100] "%"  ADAS
 SG_ DET_OUTSIDE_SECTOR_283 : 407|1@1+ (1,0) [0|1] ""  ADAS
 SG_ DET_HVC_FLAG_283 : 364|1@1+ (1,0) [0|1] ""  ADAS
 SG_ DET_CONFD_AZIMUTH_283 : 365|2@1+ (1,0) [0|3] ""  ADAS
 SG_ DET_CONFD_ELEVATION_283 : 358|2@1+ (1,0) [0|3] ""  ADAS
 SG_ DET_RANGE_284 : 384|15@1+ (0.015625,0) [0|500] "m"  ADAS
 SG_ DET_RANGE_ERR_284 : 400|7@1+ (0.0075,0) [0|0.9525] "m"  ADAS
 SG_ DET_RANGE_VELOCITY_284 : 408|15@1+ (0.0078125,-128) [-128|127.9921875] "m/s"  ADAS
 SG_ DET_RANGE_VELOCITY_ERR_284 : 424|8@1+ (0.003,0) [0|0.765] "m/s"  ADAS
 SG_ DET_AZIMUTH_284 : 448|13@1+ (0.0004,-1.5708) [-1.5708|1.5708] "rad"  ADAS
 SG_ DET_AZIMUTH_ERR_284 : 465|7@1+ (0.00087267,0) [0|0.11082909] "rad"  ADAS
 SG_ DET_ELEVATION_284 : 432|8@1+ (0.00275,-0.34925) [-0.34925|0.34925] "rad"  ADAS
 SG_ DET_ELEVATION_ERR_284 : 440|6@1+ (0.00174533,0) [0|0.10995579] "rad"  ADAS
 SG_ DET_RCS_284 : 496|8@1+ (0.5,-64) [-64|63.5] "dBsm"  ADAS
 SG_ DET_VALID_FLAG_284 : 485|1@1+ (1,0) [0|1] ""  ADAS
 SG_ DET_BI_STATIC_FLAG_284 : 483|1@1+ (1,0) [0|1] ""  ADAS
 SG_ DET_SUPER_RES_TARGET_284 : 446|1@1+ (1,0) [0|1] ""  ADAS
 SG_ DET_SNR_284 : 488|8@1+ (0.35156,0) [0|89.6478] "dB"  ADAS
 SG_ DET_POINT_TARGET_PROB_284 : 472|4@1+ (6.67,0) [0|100] "%"  ADAS
 SG_ DET_EXISTENCE_PROB_284 : 506|6@1+ (1.588,0) [0|100] "%"  ADAS
 SG_ DET_OUTSIDE_SECTOR_284 : 481|1@1+ (1,0) [0|1] ""  ADAS
 SG_ DET_HVC_FLAG_284 : 464|1@1+ (1,0) [0|1] ""  ADAS
 SG_ DET_CONFD_AZIMUTH_284 : 486|2@1+ (1,0) [0|3] ""  ADAS
 SG_ DET_CONFD_ELEVATION_284 : 461|2@1+ (1,0) [0|3] ""  ADAS
 SG_ DET_MH_SCAN_INDEX_4LSB_281_284 : 476|4@1+ (1,0) [0|15] ""  ADAS
 SG_ DET_MH_CYCLE_COUNTER_281_284 : 16|8@1+ (1,0) [0|255] ""  ADAS
 SG_ DET_MH_CRC16_281_284 : 0|16@1+ (1,0) [0|65535] ""  ADAS

BO_ 1095 RDR_DETECTION_285_288: 64 RDR07
 SG_ DET_RANGE_285 : 24|15@1+ (0.015625,0) [0|500] "m"  ADAS
 SG_ DET_RANGE_ERR_285 : 40|7@1+ (0.0075,0) [0|0.9525] "m"  ADAS
 SG_ DET_RANGE_VELOCITY_285 : 48|15@1+ (0.0078125,-128) [-128|127.9921875] "m/s"  ADAS
 SG_ DET_RANGE_VELOCITY_ERR_285 : 64|8@1+ (0.003,0) [0|0.765] "m/s"  ADAS
 SG_ DET_AZIMUTH_285 : 88|13@1+ (0.0004,-1.5708) [-1.5708|1.5708] "rad"  ADAS
 SG_ DET_AZIMUTH_ERR_285 : 105|7@1+ (0.00087267,0) [0|0.11082909] "rad"  ADAS
 SG_ DET_ELEVATION_285 : 72|8@1+ (0.00275,-0.34925) [-0.34925|0.34925] "rad"  ADAS
 SG_ DET_ELEVATION_ERR_285 : 80|6@1+ (0.00174533,0) [0|0.10995579] "rad"  ADAS
 SG_ DET_RCS_285 : 136|8@1+ (0.5,-64) [-64|63.5] "dBsm"  ADAS
 SG_ DET_VALID_FLAG_285 : 119|1@1+ (1,0) [0|1] ""  ADAS
 SG_ DET_BI_STATIC_FLAG_285 : 504|1@1+ (1,0) [0|1] ""  ADAS
 SG_ DET_SUPER_RES_TARGET_285 : 104|1@1+ (1,0) [0|1] ""  ADAS
 SG_ DET_SNR_285 : 128|8@1+ (0.35156,0) [0|89.6478] "dB"  ADAS
 SG_ DET_POINT_TARGET_PROB_285 : 114|4@1+ (6.67,0) [0|100] "%"  ADAS
 SG_ DET_EXISTENCE_PROB_285 : 120|6@1+ (1.588,0) [0|100] "%"  ADAS
 SG_ DET_OUTSIDE_SECTOR_285 : 159|1@1+ (1,0) [0|1] ""  ADAS
 SG_ DET_HVC_FLAG_285 : 118|1@1+ (1,0) [0|1] ""  ADAS
 SG_ DET_CONFD_AZIMUTH_285 : 126|2@1+ (1,0) [0|3] ""  ADAS
 SG_ DET_CONFD_ELEVATION_285 : 112|2@1+ (1,0) [0|3] ""  ADAS
 SG_ DET_RANGE_286 : 144|15@1+ (0.015625,0) [0|500] "m"  ADAS
 SG_ DET_RANGE_ERR_286 : 160|7@1+ (0.0075,0) [0|0.9525] "m"  ADAS
 SG_ DET_RANGE_VELOCITY_286 : 168|15@1+ (0.0078125,-128) [-128|127.9921875] "m/s"  ADAS
 SG_ DET_RANGE_VELOCITY_ERR_286 : 184|8@1+ (0.003,0) [0|0.765] "m/s"  ADAS
 SG_ DET_AZIMUTH_286 : 208|13@1+ (0.0004,-1.5708) [-1.5708|1.5708] "rad"  ADAS
 SG_ DET_AZIMUTH_ERR_286 : 224|7@1+ (0.00087267,0) [0|0.11082909] "rad"  ADAS
 SG_ DET_ELEVATION_286 : 192|8@1+ (0.00275,-0.34925) [-0.34925|0.34925] "rad"  ADAS
 SG_ DET_ELEVATION_ERR_286 : 200|6@1+ (0.00174533,0) [0|0.10995579] "rad"  ADAS
 SG_ DET_RCS_286 : 256|8@1+ (0.5,-64) [-64|63.5] "dBsm"  ADAS
 SG_ DET_VALID_FLAG_286 : 167|1@1+ (1,0) [0|1] ""  ADAS
 SG_ DET_BI_STATIC_FLAG_286 : 505|1@1+ (1,0) [0|1] ""  ADAS
 SG_ DET_SUPER_RES_TARGET_286 : 247|1@1+ (1,0) [0|1] ""  ADAS
 SG_ DET_SNR_286 : 248|8@1+ (0.35156,0) [0|89.6478] "dB"  ADAS
 SG_ DET_POINT_TARGET_PROB_286 : 240|4@1+ (6.67,0) [0|100] "%"  ADAS
 SG_ DET_EXISTENCE_PROB_286 : 232|6@1+ (1.588,0) [0|100] "%"  ADAS
 SG_ DET_OUTSIDE_SECTOR_286 : 183|1@1+ (1,0) [0|1] ""  ADAS
 SG_ DET_HVC_FLAG_286 : 246|1@1+ (1,0) [0|1] ""  ADAS
 SG_ DET_CONFD_AZIMUTH_286 : 206|2@1+ (1,0) [0|3] ""  ADAS
 SG_ DET_CONFD_ELEVATION_286 : 244|2@1+ (1,0) [0|3] ""  ADAS
 SG_ DET_RANGE_287 : 264|15@1+ (0.015625,0) [0|500] "m"  ADAS
 SG_ DET_RANGE_ERR_287 : 280|7@1+ (0.0075,0) [0|0.9525] "m"  ADAS
 SG_ DET_RANGE_VELOCITY_287 : 288|15@1+ (0.0078125,-128) [-128|127.9921875] "m/s"  ADAS
 SG_ DET_RANGE_VELOCITY_ERR_287 : 304|8@1+ (0.003,0) [0|0.765] "m/s"  ADAS
 SG_ DET_AZIMUTH_287 : 328|13@1+ (0.0004,-1.5708) [-1.5708|1.5708] "rad"  ADAS
 SG_ DET_AZIMUTH_ERR_287 : 345|7@1+ (0.00087267,0) [0|0.11082909] "rad"  ADAS
 SG_ DET_ELEVATION_287 : 312|8@1+ (0.00275,-0.34925) [-0.34925|0.34925] "rad"  ADAS
 SG_ DET_ELEVATION_ERR_287 : 320|6@1+ (0.00174533,0) [0|0.10995579] "rad"  ADAS
 SG_ DET_RCS_287 : 376|8@1+ (0.5,-64) [-64|63.5] "dBsm"  ADAS
 SG_ DET_VALID_FLAG_287 : 399|1@1+ (1,0) [0|1] ""  ADAS
 SG_ DET_BI_STATIC_FLAG_287 : 482|1@1+ (1,0) [0|1] ""  ADAS
 SG_ DET_SUPER_RES_TARGET_287 : 344|1@1+ (1,0) [0|1] ""  ADAS
 SG_ DET_SNR_287 : 368|8@1+ (0.35156,0) [0|89.6478] "dB"  ADAS
 SG_ DET_POINT_TARGET_PROB_287 : 360|4@1+ (6.67,0) [0|100] "%"  ADAS
 SG_ DET_EXISTENCE_PROB_287 : 352|6@1+ (1.588,0) [0|100] "%"  ADAS
 SG_ DET_OUTSIDE_SECTOR_287 : 407|1@1+ (1,0) [0|1] ""  ADAS
 SG_ DET_HVC_FLAG_287 : 364|1@1+ (1,0) [0|1] ""  ADAS
 SG_ DET_CONFD_AZIMUTH_287 : 365|2@1+ (1,0) [0|3] ""  ADAS
 SG_ DET_CONFD_ELEVATION_287 : 358|2@1+ (1,0) [0|3] ""  ADAS
 SG_ DET_RANGE_288 : 384|15@1+ (0.015625,0) [0|500] "m"  ADAS
 SG_ DET_RANGE_ERR_288 : 400|7@1+ (0.0075,0) [0|0.9525] "m"  ADAS
 SG_ DET_RANGE_VELOCITY_288 : 408|15@1+ (0.0078125,-128) [-128|127.9921875] "m/s"  ADAS
 SG_ DET_RANGE_VELOCITY_ERR_288 : 424|8@1+ (0.003,0) [0|0.765] "m/s"  ADAS
 SG_ DET_AZIMUTH_288 : 448|13@1+ (0.0004,-1.5708) [-1.5708|1.5708] "rad"  ADAS
 SG_ DET_AZIMUTH_ERR_288 : 465|7@1+ (0.00087267,0) [0|0.11082909] "rad"  ADAS
 SG_ DET_ELEVATION_288 : 432|8@1+ (0.00275,-0.34925) [-0.34925|0.34925] "rad"  ADAS
 SG_ DET_ELEVATION_ERR_288 : 440|6@1+ (0.00174533,0) [0|0.10995579] "rad"  ADAS
 SG_ DET_RCS_288 : 496|8@1+ (0.5,-64) [-64|63.5] "dBsm"  ADAS
 SG_ DET_VALID_FLAG_288 : 485|1@1+ (1,0) [0|1] ""  ADAS
 SG_ DET_BI_STATIC_FLAG_288 : 483|1@1+ (1,0) [0|1] ""  ADAS
 SG_ DET_SUPER_RES_TARGET_288 : 446|1@1+ (1,0) [0|1] ""  ADAS
 SG_ DET_SNR_288 : 488|8@1+ (0.35156,0) [0|89.6478] "dB"  ADAS
 SG_ DET_POINT_TARGET_PROB_288 : 472|4@1+ (6.67,0) [0|100] "%"  ADAS
 SG_ DET_EXISTENCE_PROB_288 : 506|6@1+ (1.588,0) [0|100] "%"  ADAS
 SG_ DET_OUTSIDE_SECTOR_288 : 481|1@1+ (1,0) [0|1] ""  ADAS
 SG_ DET_HVC_FLAG_288 : 464|1@1+ (1,0) [0|1] ""  ADAS
 SG_ DET_CONFD_AZIMUTH_288 : 486|2@1+ (1,0) [0|3] ""  ADAS
 SG_ DET_CONFD_ELEVATION_288 : 461|2@1+ (1,0) [0|3] ""  ADAS
 SG_ DET_MH_SCAN_INDEX_4LSB_285_288 : 476|4@1+ (1,0) [0|15] ""  ADAS
 SG_ DET_MH_CYCLE_COUNTER_285_288 : 16|8@1+ (1,0) [0|255] ""  ADAS
 SG_ DET_MH_CRC16_285_288 : 0|16@1+ (1,0) [0|65535] ""  ADAS

BO_ 1096 RDR_DETECTION_289_292: 64 RDR07
 SG_ DET_RANGE_289 : 24|15@1+ (0.015625,0) [0|500] "m"  ADAS
 SG_ DET_RANGE_ERR_289 : 40|7@1+ (0.0075,0) [0|0.9525] "m"  ADAS
 SG_ DET_RANGE_VELOCITY_289 : 48|15@1+ (0.0078125,-128) [-128|127.9921875] "m/s"  ADAS
 SG_ DET_RANGE_VELOCITY_ERR_289 : 64|8@1+ (0.003,0) [0|0.765] "m/s"  ADAS
 SG_ DET_AZIMUTH_289 : 88|13@1+ (0.0004,-1.5708) [-1.5708|1.5708] "rad"  ADAS
 SG_ DET_AZIMUTH_ERR_289 : 105|7@1+ (0.00087267,0) [0|0.11082909] "rad"  ADAS
 SG_ DET_ELEVATION_289 : 72|8@1+ (0.00275,-0.34925) [-0.34925|0.34925] "rad"  ADAS
 SG_ DET_ELEVATION_ERR_289 : 80|6@1+ (0.00174533,0) [0|0.10995579] "rad"  ADAS
 SG_ DET_RCS_289 : 136|8@1+ (0.5,-64) [-64|63.5] "dBsm"  ADAS
 SG_ DET_VALID_FLAG_289 : 119|1@1+ (1,0) [0|1] ""  ADAS
 SG_ DET_BI_STATIC_FLAG_289 : 504|1@1+ (1,0) [0|1] ""  ADAS
 SG_ DET_SUPER_RES_TARGET_289 : 104|1@1+ (1,0) [0|1] ""  ADAS
 SG_ DET_SNR_289 : 128|8@1+ (0.35156,0) [0|89.6478] "dB"  ADAS
 SG_ DET_POINT_TARGET_PROB_289 : 114|4@1+ (6.67,0) [0|100] "%"  ADAS
 SG_ DET_EXISTENCE_PROB_289 : 120|6@1+ (1.588,0) [0|100] "%"  ADAS
 SG_ DET_OUTSIDE_SECTOR_289 : 159|1@1+ (1,0) [0|1] ""  ADAS
 SG_ DET_HVC_FLAG_289 : 118|1@1+ (1,0) [0|1] ""  ADAS
 SG_ DET_CONFD_AZIMUTH_289 : 126|2@1+ (1,0) [0|3] ""  ADAS
 SG_ DET_CONFD_ELEVATION_289 : 112|2@1+ (1,0) [0|3] ""  ADAS
 SG_ DET_RANGE_290 : 144|15@1+ (0.015625,0) [0|500] "m"  ADAS
 SG_ DET_RANGE_ERR_290 : 160|7@1+ (0.0075,0) [0|0.9525] "m"  ADAS
 SG_ DET_RANGE_VELOCITY_290 : 168|15@1+ (0.0078125,-128) [-128|127.9921875] "m/s"  ADAS
 SG_ DET_RANGE_VELOCITY_ERR_290 : 184|8@1+ (0.003,0) [0|0.765] "m/s"  ADAS
 SG_ DET_AZIMUTH_290 : 208|13@1+ (0.0004,-1.5708) [-1.5708|1.5708] "rad"  ADAS
 SG_ DET_AZIMUTH_ERR_290 : 224|7@1+ (0.00087267,0) [0|0.11082909] "rad"  ADAS
 SG_ DET_ELEVATION_290 : 192|8@1+ (0.00275,-0.34925) [-0.34925|0.34925] "rad"  ADAS
 SG_ DET_ELEVATION_ERR_290 : 200|6@1+ (0.00174533,0) [0|0.10995579] "rad"  ADAS
 SG_ DET_RCS_290 : 256|8@1+ (0.5,-64) [-64|63.5] "dBsm"  ADAS
 SG_ DET_VALID_FLAG_290 : 167|1@1+ (1,0) [0|1] ""  ADAS
 SG_ DET_BI_STATIC_FLAG_290 : 505|1@1+ (1,0) [0|1] ""  ADAS
 SG_ DET_SUPER_RES_TARGET_290 : 247|1@1+ (1,0) [0|1] ""  ADAS
 SG_ DET_SNR_290 : 248|8@1+ (0.35156,0) [0|89.6478] "dB"  ADAS
 SG_ DET_POINT_TARGET_PROB_290 : 240|4@1+ (6.67,0) [0|100] "%"  ADAS
 SG_ DET_EXISTENCE_PROB_290 : 232|6@1+ (1.588,0) [0|100] "%"  ADAS
 SG_ DET_OUTSIDE_SECTOR_290 : 183|1@1+ (1,0) [0|1] ""  ADAS
 SG_ DET_HVC_FLAG_290 : 246|1@1+ (1,0) [0|1] ""  ADAS
 SG_ DET_CONFD_AZIMUTH_290 : 206|2@1+ (1,0) [0|3] ""  ADAS
 SG_ DET_CONFD_ELEVATION_290 : 244|2@1+ (1,0) [0|3] ""  ADAS
 SG_ DET_RANGE_291 : 264|15@1+ (0.015625,0) [0|500] "m"  ADAS
 SG_ DET_RANGE_ERR_291 : 280|7@1+ (0.0075,0) [0|0.9525] "m"  ADAS
 SG_ DET_RANGE_VELOCITY_291 : 288|15@1+ (0.0078125,-128) [-128|127.9921875] "m/s"  ADAS
 SG_ DET_RANGE_VELOCITY_ERR_291 : 304|8@1+ (0.003,0) [0|0.765] "m/s"  ADAS
 SG_ DET_AZIMUTH_291 : 328|13@1+ (0.0004,-1.5708) [-1.5708|1.5708] "rad"  ADAS
 SG_ DET_AZIMUTH_ERR_291 : 345|7@1+ (0.00087267,0) [0|0.11082909] "rad"  ADAS
 SG_ DET_ELEVATION_291 : 312|8@1+ (0.00275,-0.34925) [-0.34925|0.34925] "rad"  ADAS
 SG_ DET_ELEVATION_ERR_291 : 320|6@1+ (0.00174533,0) [0|0.10995579] "rad"  ADAS
 SG_ DET_RCS_291 : 376|8@1+ (0.5,-64) [-64|63.5] "dBsm"  ADAS
 SG_ DET_VALID_FLAG_291 : 399|1@1+ (1,0) [0|1] ""  ADAS
 SG_ DET_BI_STATIC_FLAG_291 : 482|1@1+ (1,0) [0|1] ""  ADAS
 SG_ DET_SUPER_RES_TARGET_291 : 344|1@1+ (1,0) [0|1] ""  ADAS
 SG_ DET_SNR_291 : 368|8@1+ (0.35156,0) [0|89.6478] "dB"  ADAS
 SG_ DET_POINT_TARGET_PROB_291 : 360|4@1+ (6.67,0) [0|100] "%"  ADAS
 SG_ DET_EXISTENCE_PROB_291 : 352|6@1+ (1.588,0) [0|100] "%"  ADAS
 SG_ DET_OUTSIDE_SECTOR_291 : 407|1@1+ (1,0) [0|1] ""  ADAS
 SG_ DET_HVC_FLAG_291 : 364|1@1+ (1,0) [0|1] ""  ADAS
 SG_ DET_CONFD_AZIMUTH_291 : 365|2@1+ (1,0) [0|3] ""  ADAS
 SG_ DET_CONFD_ELEVATION_291 : 358|2@1+ (1,0) [0|3] ""  ADAS
 SG_ DET_RANGE_292 : 384|15@1+ (0.015625,0) [0|500] "m"  ADAS
 SG_ DET_RANGE_ERR_292 : 400|7@1+ (0.0075,0) [0|0.9525] "m"  ADAS
 SG_ DET_RANGE_VELOCITY_292 : 408|15@1+ (0.0078125,-128) [-128|127.9921875] "m/s"  ADAS
 SG_ DET_RANGE_VELOCITY_ERR_292 : 424|8@1+ (0.003,0) [0|0.765] "m/s"  ADAS
 SG_ DET_AZIMUTH_292 : 448|13@1+ (0.0004,-1.5708) [-1.5708|1.5708] "rad"  ADAS
 SG_ DET_AZIMUTH_ERR_292 : 465|7@1+ (0.00087267,0) [0|0.11082909] "rad"  ADAS
 SG_ DET_ELEVATION_292 : 432|8@1+ (0.00275,-0.34925) [-0.34925|0.34925] "rad"  ADAS
 SG_ DET_ELEVATION_ERR_292 : 440|6@1+ (0.00174533,0) [0|0.10995579] "rad"  ADAS
 SG_ DET_RCS_292 : 496|8@1+ (0.5,-64) [-64|63.5] "dBsm"  ADAS
 SG_ DET_VALID_FLAG_292 : 485|1@1+ (1,0) [0|1] ""  ADAS
 SG_ DET_BI_STATIC_FLAG_292 : 483|1@1+ (1,0) [0|1] ""  ADAS
 SG_ DET_SUPER_RES_TARGET_292 : 446|1@1+ (1,0) [0|1] ""  ADAS
 SG_ DET_SNR_292 : 488|8@1+ (0.35156,0) [0|89.6478] "dB"  ADAS
 SG_ DET_POINT_TARGET_PROB_292 : 472|4@1+ (6.67,0) [0|100] "%"  ADAS
 SG_ DET_EXISTENCE_PROB_292 : 506|6@1+ (1.588,0) [0|100] "%"  ADAS
 SG_ DET_OUTSIDE_SECTOR_292 : 481|1@1+ (1,0) [0|1] ""  ADAS
 SG_ DET_HVC_FLAG_292 : 464|1@1+ (1,0) [0|1] ""  ADAS
 SG_ DET_CONFD_AZIMUTH_292 : 486|2@1+ (1,0) [0|3] ""  ADAS
 SG_ DET_CONFD_ELEVATION_292 : 461|2@1+ (1,0) [0|3] ""  ADAS
 SG_ DET_MH_SCAN_INDEX_4LSB_289_292 : 476|4@1+ (1,0) [0|15] ""  ADAS
 SG_ DET_MH_CYCLE_COUNTER_289_292 : 16|8@1+ (1,0) [0|255] ""  ADAS
 SG_ DET_MH_CRC16_289_292 : 0|16@1+ (1,0) [0|65535] ""  ADAS

BO_ 1097 RDR_DETECTION_293_296: 64 RDR07
 SG_ DET_RANGE_293 : 24|15@1+ (0.015625,0) [0|500] "m"  ADAS
 SG_ DET_RANGE_ERR_293 : 40|7@1+ (0.0075,0) [0|0.9525] "m"  ADAS
 SG_ DET_RANGE_VELOCITY_293 : 48|15@1+ (0.0078125,-128) [-128|127.9921875] "m/s"  ADAS
 SG_ DET_RANGE_VELOCITY_ERR_293 : 64|8@1+ (0.003,0) [0|0.765] "m/s"  ADAS
 SG_ DET_AZIMUTH_293 : 88|13@1+ (0.0004,-1.5708) [-1.5708|1.5708] "rad"  ADAS
 SG_ DET_AZIMUTH_ERR_293 : 105|7@1+ (0.00087267,0) [0|0.11082909] "rad"  ADAS
 SG_ DET_ELEVATION_293 : 72|8@1+ (0.00275,-0.34925) [-0.34925|0.34925] "rad"  ADAS
 SG_ DET_ELEVATION_ERR_293 : 80|6@1+ (0.00174533,0) [0|0.10995579] "rad"  ADAS
 SG_ DET_RCS_293 : 136|8@1+ (0.5,-64) [-64|63.5] "dBsm"  ADAS
 SG_ DET_VALID_FLAG_293 : 119|1@1+ (1,0) [0|1] ""  ADAS
 SG_ DET_BI_STATIC_FLAG_293 : 504|1@1+ (1,0) [0|1] ""  ADAS
 SG_ DET_SUPER_RES_TARGET_293 : 104|1@1+ (1,0) [0|1] ""  ADAS
 SG_ DET_SNR_293 : 128|8@1+ (0.35156,0) [0|89.6478] "dB"  ADAS
 SG_ DET_POINT_TARGET_PROB_293 : 114|4@1+ (6.67,0) [0|100] "%"  ADAS
 SG_ DET_EXISTENCE_PROB_293 : 120|6@1+ (1.588,0) [0|100] "%"  ADAS
 SG_ DET_OUTSIDE_SECTOR_293 : 159|1@1+ (1,0) [0|1] ""  ADAS
 SG_ DET_HVC_FLAG_293 : 118|1@1+ (1,0) [0|1] ""  ADAS
 SG_ DET_CONFD_AZIMUTH_293 : 126|2@1+ (1,0) [0|3] ""  ADAS
 SG_ DET_CONFD_ELEVATION_293 : 112|2@1+ (1,0) [0|3] ""  ADAS
 SG_ DET_RANGE_294 : 144|15@1+ (0.015625,0) [0|500] "m"  ADAS
 SG_ DET_RANGE_ERR_294 : 160|7@1+ (0.0075,0) [0|0.9525] "m"  ADAS
 SG_ DET_RANGE_VELOCITY_294 : 168|15@1+ (0.0078125,-128) [-128|127.9921875] "m/s"  ADAS
 SG_ DET_RANGE_VELOCITY_ERR_294 : 184|8@1+ (0.003,0) [0|0.765] "m/s"  ADAS
 SG_ DET_AZIMUTH_294 : 208|13@1+ (0.0004,-1.5708) [-1.5708|1.5708] "rad"  ADAS
 SG_ DET_AZIMUTH_ERR_294 : 224|7@1+ (0.00087267,0) [0|0.11082909] "rad"  ADAS
 SG_ DET_ELEVATION_294 : 192|8@1+ (0.00275,-0.34925) [-0.34925|0.34925] "rad"  ADAS
 SG_ DET_ELEVATION_ERR_294 : 200|6@1+ (0.00174533,0) [0|0.10995579] "rad"  ADAS
 SG_ DET_RCS_294 : 256|8@1+ (0.5,-64) [-64|63.5] "dBsm"  ADAS
 SG_ DET_VALID_FLAG_294 : 167|1@1+ (1,0) [0|1] ""  ADAS
 SG_ DET_BI_STATIC_FLAG_294 : 505|1@1+ (1,0) [0|1] ""  ADAS
 SG_ DET_SUPER_RES_TARGET_294 : 247|1@1+ (1,0) [0|1] ""  ADAS
 SG_ DET_SNR_294 : 248|8@1+ (0.35156,0) [0|89.6478] "dB"  ADAS
 SG_ DET_POINT_TARGET_PROB_294 : 240|4@1+ (6.67,0) [0|100] "%"  ADAS
 SG_ DET_EXISTENCE_PROB_294 : 232|6@1+ (1.588,0) [0|100] "%"  ADAS
 SG_ DET_OUTSIDE_SECTOR_294 : 183|1@1+ (1,0) [0|1] ""  ADAS
 SG_ DET_HVC_FLAG_294 : 246|1@1+ (1,0) [0|1] ""  ADAS
 SG_ DET_CONFD_AZIMUTH_294 : 206|2@1+ (1,0) [0|3] ""  ADAS
 SG_ DET_CONFD_ELEVATION_294 : 244|2@1+ (1,0) [0|3] ""  ADAS
 SG_ DET_RANGE_295 : 264|15@1+ (0.015625,0) [0|500] "m"  ADAS
 SG_ DET_RANGE_ERR_295 : 280|7@1+ (0.0075,0) [0|0.9525] "m"  ADAS
 SG_ DET_RANGE_VELOCITY_295 : 288|15@1+ (0.0078125,-128) [-128|127.9921875] "m/s"  ADAS
 SG_ DET_RANGE_VELOCITY_ERR_295 : 304|8@1+ (0.003,0) [0|0.765] "m/s"  ADAS
 SG_ DET_AZIMUTH_295 : 328|13@1+ (0.0004,-1.5708) [-1.5708|1.5708] "rad"  ADAS
 SG_ DET_AZIMUTH_ERR_295 : 345|7@1+ (0.00087267,0) [0|0.11082909] "rad"  ADAS
 SG_ DET_ELEVATION_295 : 312|8@1+ (0.00275,-0.34925) [-0.34925|0.34925] "rad"  ADAS
 SG_ DET_ELEVATION_ERR_295 : 320|6@1+ (0.00174533,0) [0|0.10995579] "rad"  ADAS
 SG_ DET_RCS_295 : 376|8@1+ (0.5,-64) [-64|63.5] "dBsm"  ADAS
 SG_ DET_VALID_FLAG_295 : 399|1@1+ (1,0) [0|1] ""  ADAS
 SG_ DET_BI_STATIC_FLAG_295 : 482|1@1+ (1,0) [0|1] ""  ADAS
 SG_ DET_SUPER_RES_TARGET_295 : 344|1@1+ (1,0) [0|1] ""  ADAS
 SG_ DET_SNR_295 : 368|8@1+ (0.35156,0) [0|89.6478] "dB"  ADAS
 SG_ DET_POINT_TARGET_PROB_295 : 360|4@1+ (6.67,0) [0|100] "%"  ADAS
 SG_ DET_EXISTENCE_PROB_295 : 352|6@1+ (1.588,0) [0|100] "%"  ADAS
 SG_ DET_OUTSIDE_SECTOR_295 : 407|1@1+ (1,0) [0|1] ""  ADAS
 SG_ DET_HVC_FLAG_295 : 364|1@1+ (1,0) [0|1] ""  ADAS
 SG_ DET_CONFD_AZIMUTH_295 : 365|2@1+ (1,0) [0|3] ""  ADAS
 SG_ DET_CONFD_ELEVATION_295 : 358|2@1+ (1,0) [0|3] ""  ADAS
 SG_ DET_RANGE_296 : 384|15@1+ (0.015625,0) [0|500] "m"  ADAS
 SG_ DET_RANGE_ERR_296 : 400|7@1+ (0.0075,0) [0|0.9525] "m"  ADAS
 SG_ DET_RANGE_VELOCITY_296 : 408|15@1+ (0.0078125,-128) [-128|127.9921875] "m/s"  ADAS
 SG_ DET_RANGE_VELOCITY_ERR_296 : 424|8@1+ (0.003,0) [0|0.765] "m/s"  ADAS
 SG_ DET_AZIMUTH_296 : 448|13@1+ (0.0004,-1.5708) [-1.5708|1.5708] "rad"  ADAS
 SG_ DET_AZIMUTH_ERR_296 : 465|7@1+ (0.00087267,0) [0|0.11082909] "rad"  ADAS
 SG_ DET_ELEVATION_296 : 432|8@1+ (0.00275,-0.34925) [-0.34925|0.34925] "rad"  ADAS
 SG_ DET_ELEVATION_ERR_296 : 440|6@1+ (0.00174533,0) [0|0.10995579] "rad"  ADAS
 SG_ DET_RCS_296 : 496|8@1+ (0.5,-64) [-64|63.5] "dBsm"  ADAS
 SG_ DET_VALID_FLAG_296 : 485|1@1+ (1,0) [0|1] ""  ADAS
 SG_ DET_BI_STATIC_FLAG_296 : 483|1@1+ (1,0) [0|1] ""  ADAS
 SG_ DET_SUPER_RES_TARGET_296 : 446|1@1+ (1,0) [0|1] ""  ADAS
 SG_ DET_SNR_296 : 488|8@1+ (0.35156,0) [0|89.6478] "dB"  ADAS
 SG_ DET_POINT_TARGET_PROB_296 : 472|4@1+ (6.67,0) [0|100] "%"  ADAS
 SG_ DET_EXISTENCE_PROB_296 : 506|6@1+ (1.588,0) [0|100] "%"  ADAS
 SG_ DET_OUTSIDE_SECTOR_296 : 481|1@1+ (1,0) [0|1] ""  ADAS
 SG_ DET_HVC_FLAG_296 : 464|1@1+ (1,0) [0|1] ""  ADAS
 SG_ DET_CONFD_AZIMUTH_296 : 486|2@1+ (1,0) [0|3] ""  ADAS
 SG_ DET_CONFD_ELEVATION_296 : 461|2@1+ (1,0) [0|3] ""  ADAS
 SG_ DET_MH_SCAN_INDEX_4LSB_293_296 : 476|4@1+ (1,0) [0|15] ""  ADAS
 SG_ DET_MH_CYCLE_COUNTER_293_296 : 16|8@1+ (1,0) [0|255] ""  ADAS
 SG_ DET_MH_CRC16_293_296 : 0|16@1+ (1,0) [0|65535] ""  ADAS

BO_ 1098 RDR_DETECTION_297_300: 64 RDR07
 SG_ DET_RANGE_297 : 24|15@1+ (0.015625,0) [0|500] "m"  ADAS
 SG_ DET_RANGE_ERR_297 : 40|7@1+ (0.0075,0) [0|0.9525] "m"  ADAS
 SG_ DET_RANGE_VELOCITY_297 : 48|15@1+ (0.0078125,-128) [-128|127.9921875] "m/s"  ADAS
 SG_ DET_RANGE_VELOCITY_ERR_297 : 64|8@1+ (0.003,0) [0|0.765] "m/s"  ADAS
 SG_ DET_AZIMUTH_297 : 88|13@1+ (0.0004,-1.5708) [-1.5708|1.5708] "rad"  ADAS
 SG_ DET_AZIMUTH_ERR_297 : 105|7@1+ (0.00087267,0) [0|0.11082909] "rad"  ADAS
 SG_ DET_ELEVATION_297 : 72|8@1+ (0.00275,-0.34925) [-0.34925|0.34925] "rad"  ADAS
 SG_ DET_ELEVATION_ERR_297 : 80|6@1+ (0.00174533,0) [0|0.10995579] "rad"  ADAS
 SG_ DET_RCS_297 : 136|8@1+ (0.5,-64) [-64|63.5] "dBsm"  ADAS
 SG_ DET_VALID_FLAG_297 : 119|1@1+ (1,0) [0|1] ""  ADAS
 SG_ DET_BI_STATIC_FLAG_297 : 504|1@1+ (1,0) [0|1] ""  ADAS
 SG_ DET_SUPER_RES_TARGET_297 : 104|1@1+ (1,0) [0|1] ""  ADAS
 SG_ DET_SNR_297 : 128|8@1+ (0.35156,0) [0|89.6478] "dB"  ADAS
 SG_ DET_POINT_TARGET_PROB_297 : 114|4@1+ (6.67,0) [0|100] "%"  ADAS
 SG_ DET_EXISTENCE_PROB_297 : 120|6@1+ (1.588,0) [0|100] "%"  ADAS
 SG_ DET_OUTSIDE_SECTOR_297 : 159|1@1+ (1,0) [0|1] ""  ADAS
 SG_ DET_HVC_FLAG_297 : 118|1@1+ (1,0) [0|1] ""  ADAS
 SG_ DET_CONFD_AZIMUTH_297 : 126|2@1+ (1,0) [0|3] ""  ADAS
 SG_ DET_CONFD_ELEVATION_297 : 112|2@1+ (1,0) [0|3] ""  ADAS
 SG_ DET_RANGE_298 : 144|15@1+ (0.015625,0) [0|500] "m"  ADAS
 SG_ DET_RANGE_ERR_298 : 160|7@1+ (0.0075,0) [0|0.9525] "m"  ADAS
 SG_ DET_RANGE_VELOCITY_298 : 168|15@1+ (0.0078125,-128) [-128|127.9921875] "m/s"  ADAS
 SG_ DET_RANGE_VELOCITY_ERR_298 : 184|8@1+ (0.003,0) [0|0.765] "m/s"  ADAS
 SG_ DET_AZIMUTH_298 : 208|13@1+ (0.0004,-1.5708) [-1.5708|1.5708] "rad"  ADAS
 SG_ DET_AZIMUTH_ERR_298 : 224|7@1+ (0.00087267,0) [0|0.11082909] "rad"  ADAS
 SG_ DET_ELEVATION_298 : 192|8@1+ (0.00275,-0.34925) [-0.34925|0.34925] "rad"  ADAS
 SG_ DET_ELEVATION_ERR_298 : 200|6@1+ (0.00174533,0) [0|0.10995579] "rad"  ADAS
 SG_ DET_RCS_298 : 256|8@1+ (0.5,-64) [-64|63.5] "dBsm"  ADAS
 SG_ DET_VALID_FLAG_298 : 167|1@1+ (1,0) [0|1] ""  ADAS
 SG_ DET_BI_STATIC_FLAG_298 : 505|1@1+ (1,0) [0|1] ""  ADAS
 SG_ DET_SUPER_RES_TARGET_298 : 247|1@1+ (1,0) [0|1] ""  ADAS
 SG_ DET_SNR_298 : 248|8@1+ (0.35156,0) [0|89.6478] "dB"  ADAS
 SG_ DET_POINT_TARGET_PROB_298 : 240|4@1+ (6.67,0) [0|100] "%"  ADAS
 SG_ DET_EXISTENCE_PROB_298 : 232|6@1+ (1.588,0) [0|100] "%"  ADAS
 SG_ DET_OUTSIDE_SECTOR_298 : 183|1@1+ (1,0) [0|1] ""  ADAS
 SG_ DET_HVC_FLAG_298 : 246|1@1+ (1,0) [0|1] ""  ADAS
 SG_ DET_CONFD_AZIMUTH_298 : 206|2@1+ (1,0) [0|3] ""  ADAS
 SG_ DET_CONFD_ELEVATION_298 : 244|2@1+ (1,0) [0|3] ""  ADAS
 SG_ DET_RANGE_299 : 264|15@1+ (0.015625,0) [0|500] "m"  ADAS
 SG_ DET_RANGE_ERR_299 : 280|7@1+ (0.0075,0) [0|0.9525] "m"  ADAS
 SG_ DET_RANGE_VELOCITY_299 : 288|15@1+ (0.0078125,-128) [-128|127.9921875] "m/s"  ADAS
 SG_ DET_RANGE_VELOCITY_ERR_299 : 304|8@1+ (0.003,0) [0|0.765] "m/s"  ADAS
 SG_ DET_AZIMUTH_299 : 328|13@1+ (0.0004,-1.5708) [-1.5708|1.5708] "rad"  ADAS
 SG_ DET_AZIMUTH_ERR_299 : 345|7@1+ (0.00087267,0) [0|0.11082909] "rad"  ADAS
 SG_ DET_ELEVATION_299 : 312|8@1+ (0.00275,-0.34925) [-0.34925|0.34925] "rad"  ADAS
 SG_ DET_ELEVATION_ERR_299 : 320|6@1+ (0.00174533,0) [0|0.10995579] "rad"  ADAS
 SG_ DET_RCS_299 : 376|8@1+ (0.5,-64) [-64|63.5] "dBsm"  ADAS
 SG_ DET_VALID_FLAG_299 : 399|1@1+ (1,0) [0|1] ""  ADAS
 SG_ DET_BI_STATIC_FLAG_299 : 482|1@1+ (1,0) [0|1] ""  ADAS
 SG_ DET_SUPER_RES_TARGET_299 : 344|1@1+ (1,0) [0|1] ""  ADAS
 SG_ DET_SNR_299 : 368|8@1+ (0.35156,0) [0|89.6478] "dB"  ADAS
 SG_ DET_POINT_TARGET_PROB_299 : 360|4@1+ (6.67,0) [0|100] "%"  ADAS
 SG_ DET_EXISTENCE_PROB_299 : 352|6@1+ (1.588,0) [0|100] "%"  ADAS
 SG_ DET_OUTSIDE_SECTOR_299 : 407|1@1+ (1,0) [0|1] ""  ADAS
 SG_ DET_HVC_FLAG_299 : 364|1@1+ (1,0) [0|1] ""  ADAS
 SG_ DET_CONFD_AZIMUTH_299 : 365|2@1+ (1,0) [0|3] ""  ADAS
 SG_ DET_CONFD_ELEVATION_299 : 358|2@1+ (1,0) [0|3] ""  ADAS
 SG_ DET_RANGE_300 : 384|15@1+ (0.015625,0) [0|500] "m"  ADAS
 SG_ DET_RANGE_ERR_300 : 400|7@1+ (0.0075,0) [0|0.9525] "m"  ADAS
 SG_ DET_RANGE_VELOCITY_300 : 408|15@1+ (0.0078125,-128) [-128|127.9921875] "m/s"  ADAS
 SG_ DET_RANGE_VELOCITY_ERR_300 : 424|8@1+ (0.003,0) [0|0.765] "m/s"  ADAS
 SG_ DET_AZIMUTH_300 : 448|13@1+ (0.0004,-1.5708) [-1.5708|1.5708] "rad"  ADAS
 SG_ DET_AZIMUTH_ERR_300 : 465|7@1+ (0.00087267,0) [0|0.11082909] "rad"  ADAS
 SG_ DET_ELEVATION_300 : 432|8@1+ (0.00275,-0.34925) [-0.34925|0.34925] "rad"  ADAS
 SG_ DET_ELEVATION_ERR_300 : 440|6@1+ (0.00174533,0) [0|0.10995579] "rad"  ADAS
 SG_ DET_RCS_300 : 496|8@1+ (0.5,-64) [-64|63.5] "dBsm"  ADAS
 SG_ DET_VALID_FLAG_300 : 485|1@1+ (1,0) [0|1] ""  ADAS
 SG_ DET_BI_STATIC_FLAG_300 : 483|1@1+ (1,0) [0|1] ""  ADAS
 SG_ DET_SUPER_RES_TARGET_300 : 446|1@1+ (1,0) [0|1] ""  ADAS
 SG_ DET_SNR_300 : 488|8@1+ (0.35156,0) [0|89.6478] "dB"  ADAS
 SG_ DET_POINT_TARGET_PROB_300 : 472|4@1+ (6.67,0) [0|100] "%"  ADAS
 SG_ DET_EXISTENCE_PROB_300 : 506|6@1+ (1.588,0) [0|100] "%"  ADAS
 SG_ DET_OUTSIDE_SECTOR_300 : 481|1@1+ (1,0) [0|1] ""  ADAS
 SG_ DET_HVC_FLAG_300 : 464|1@1+ (1,0) [0|1] ""  ADAS
 SG_ DET_CONFD_AZIMUTH_300 : 486|2@1+ (1,0) [0|3] ""  ADAS
 SG_ DET_CONFD_ELEVATION_300 : 461|2@1+ (1,0) [0|3] ""  ADAS
 SG_ DET_MH_SCAN_INDEX_4LSB_297_300 : 476|4@1+ (1,0) [0|15] ""  ADAS
 SG_ DET_MH_CYCLE_COUNTER_297_300 : 16|8@1+ (1,0) [0|255] ""  ADAS
 SG_ DET_MH_CRC16_297_300 : 0|16@1+ (1,0) [0|65535] ""  ADAS

BO_ 1099 RDR_DETECTION_301_304: 64 RDR07
 SG_ DET_RANGE_301 : 24|15@1+ (0.015625,0) [0|500] "m"  ADAS
 SG_ DET_RANGE_ERR_301 : 40|7@1+ (0.0075,0) [0|0.9525] "m"  ADAS
 SG_ DET_RANGE_VELOCITY_301 : 48|15@1+ (0.0078125,-128) [-128|127.9921875] "m/s"  ADAS
 SG_ DET_RANGE_VELOCITY_ERR_301 : 64|8@1+ (0.003,0) [0|0.765] "m/s"  ADAS
 SG_ DET_AZIMUTH_301 : 88|13@1+ (0.0004,-1.5708) [-1.5708|1.5708] "rad"  ADAS
 SG_ DET_AZIMUTH_ERR_301 : 105|7@1+ (0.00087267,0) [0|0.11082909] "rad"  ADAS
 SG_ DET_ELEVATION_301 : 72|8@1+ (0.00275,-0.34925) [-0.34925|0.34925] "rad"  ADAS
 SG_ DET_ELEVATION_ERR_301 : 80|6@1+ (0.00174533,0) [0|0.10995579] "rad"  ADAS
 SG_ DET_RCS_301 : 136|8@1+ (0.5,-64) [-64|63.5] "dBsm"  ADAS
 SG_ DET_VALID_FLAG_301 : 119|1@1+ (1,0) [0|1] ""  ADAS
 SG_ DET_BI_STATIC_FLAG_301 : 504|1@1+ (1,0) [0|1] ""  ADAS
 SG_ DET_SUPER_RES_TARGET_301 : 104|1@1+ (1,0) [0|1] ""  ADAS
 SG_ DET_SNR_301 : 128|8@1+ (0.35156,0) [0|89.6478] "dB"  ADAS
 SG_ DET_POINT_TARGET_PROB_301 : 114|4@1+ (6.67,0) [0|100] "%"  ADAS
 SG_ DET_EXISTENCE_PROB_301 : 120|6@1+ (1.588,0) [0|100] "%"  ADAS
 SG_ DET_OUTSIDE_SECTOR_301 : 159|1@1+ (1,0) [0|1] ""  ADAS
 SG_ DET_HVC_FLAG_301 : 118|1@1+ (1,0) [0|1] ""  ADAS
 SG_ DET_CONFD_AZIMUTH_301 : 126|2@1+ (1,0) [0|3] ""  ADAS
 SG_ DET_CONFD_ELEVATION_301 : 112|2@1+ (1,0) [0|3] ""  ADAS
 SG_ DET_RANGE_302 : 144|15@1+ (0.015625,0) [0|500] "m"  ADAS
 SG_ DET_RANGE_ERR_302 : 160|7@1+ (0.0075,0) [0|0.9525] "m"  ADAS
 SG_ DET_RANGE_VELOCITY_302 : 168|15@1+ (0.0078125,-128) [-128|127.9921875] "m/s"  ADAS
 SG_ DET_RANGE_VELOCITY_ERR_302 : 184|8@1+ (0.003,0) [0|0.765] "m/s"  ADAS
 SG_ DET_AZIMUTH_302 : 208|13@1+ (0.0004,-1.5708) [-1.5708|1.5708] "rad"  ADAS
 SG_ DET_AZIMUTH_ERR_302 : 224|7@1+ (0.00087267,0) [0|0.11082909] "rad"  ADAS
 SG_ DET_ELEVATION_302 : 192|8@1+ (0.00275,-0.34925) [-0.34925|0.34925] "rad"  ADAS
 SG_ DET_ELEVATION_ERR_302 : 200|6@1+ (0.00174533,0) [0|0.10995579] "rad"  ADAS
 SG_ DET_RCS_302 : 256|8@1+ (0.5,-64) [-64|63.5] "dBsm"  ADAS
 SG_ DET_VALID_FLAG_302 : 167|1@1+ (1,0) [0|1] ""  ADAS
 SG_ DET_BI_STATIC_FLAG_302 : 505|1@1+ (1,0) [0|1] ""  ADAS
 SG_ DET_SUPER_RES_TARGET_302 : 247|1@1+ (1,0) [0|1] ""  ADAS
 SG_ DET_SNR_302 : 248|8@1+ (0.35156,0) [0|89.6478] "dB"  ADAS
 SG_ DET_POINT_TARGET_PROB_302 : 240|4@1+ (6.67,0) [0|100] "%"  ADAS
 SG_ DET_EXISTENCE_PROB_302 : 232|6@1+ (1.588,0) [0|100] "%"  ADAS
 SG_ DET_OUTSIDE_SECTOR_302 : 183|1@1+ (1,0) [0|1] ""  ADAS
 SG_ DET_HVC_FLAG_302 : 246|1@1+ (1,0) [0|1] ""  ADAS
 SG_ DET_CONFD_AZIMUTH_302 : 206|2@1+ (1,0) [0|3] ""  ADAS
 SG_ DET_CONFD_ELEVATION_302 : 244|2@1+ (1,0) [0|3] ""  ADAS
 SG_ DET_RANGE_303 : 264|15@1+ (0.015625,0) [0|500] "m"  ADAS
 SG_ DET_RANGE_ERR_303 : 280|7@1+ (0.0075,0) [0|0.9525] "m"  ADAS
 SG_ DET_RANGE_VELOCITY_303 : 288|15@1+ (0.0078125,-128) [-128|127.9921875] "m/s"  ADAS
 SG_ DET_RANGE_VELOCITY_ERR_303 : 304|8@1+ (0.003,0) [0|0.765] "m/s"  ADAS
 SG_ DET_AZIMUTH_303 : 328|13@1+ (0.0004,-1.5708) [-1.5708|1.5708] "rad"  ADAS
 SG_ DET_AZIMUTH_ERR_303 : 345|7@1+ (0.00087267,0) [0|0.11082909] "rad"  ADAS
 SG_ DET_ELEVATION_303 : 312|8@1+ (0.00275,-0.34925) [-0.34925|0.34925] "rad"  ADAS
 SG_ DET_ELEVATION_ERR_303 : 320|6@1+ (0.00174533,0) [0|0.10995579] "rad"  ADAS
 SG_ DET_RCS_303 : 376|8@1+ (0.5,-64) [-64|63.5] "dBsm"  ADAS
 SG_ DET_VALID_FLAG_303 : 399|1@1+ (1,0) [0|1] ""  ADAS
 SG_ DET_BI_STATIC_FLAG_303 : 482|1@1+ (1,0) [0|1] ""  ADAS
 SG_ DET_SUPER_RES_TARGET_303 : 344|1@1+ (1,0) [0|1] ""  ADAS
 SG_ DET_SNR_303 : 368|8@1+ (0.35156,0) [0|89.6478] "dB"  ADAS
 SG_ DET_POINT_TARGET_PROB_303 : 360|4@1+ (6.67,0) [0|100] "%"  ADAS
 SG_ DET_EXISTENCE_PROB_303 : 352|6@1+ (1.588,0) [0|100] "%"  ADAS
 SG_ DET_OUTSIDE_SECTOR_303 : 407|1@1+ (1,0) [0|1] ""  ADAS
 SG_ DET_HVC_FLAG_303 : 364|1@1+ (1,0) [0|1] ""  ADAS
 SG_ DET_CONFD_AZIMUTH_303 : 365|2@1+ (1,0) [0|3] ""  ADAS
 SG_ DET_CONFD_ELEVATION_303 : 358|2@1+ (1,0) [0|3] ""  ADAS
 SG_ DET_RANGE_304 : 384|15@1+ (0.015625,0) [0|500] "m"  ADAS
 SG_ DET_RANGE_ERR_304 : 400|7@1+ (0.0075,0) [0|0.9525] "m"  ADAS
 SG_ DET_RANGE_VELOCITY_304 : 408|15@1+ (0.0078125,-128) [-128|127.9921875] "m/s"  ADAS
 SG_ DET_RANGE_VELOCITY_ERR_304 : 424|8@1+ (0.003,0) [0|0.765] "m/s"  ADAS
 SG_ DET_AZIMUTH_304 : 448|13@1+ (0.0004,-1.5708) [-1.5708|1.5708] "rad"  ADAS
 SG_ DET_AZIMUTH_ERR_304 : 465|7@1+ (0.00087267,0) [0|0.11082909] "rad"  ADAS
 SG_ DET_ELEVATION_304 : 432|8@1+ (0.00275,-0.34925) [-0.34925|0.34925] "rad"  ADAS
 SG_ DET_ELEVATION_ERR_304 : 440|6@1+ (0.00174533,0) [0|0.10995579] "rad"  ADAS
 SG_ DET_RCS_304 : 496|8@1+ (0.5,-64) [-64|63.5] "dBsm"  ADAS
 SG_ DET_VALID_FLAG_304 : 485|1@1+ (1,0) [0|1] ""  ADAS
 SG_ DET_BI_STATIC_FLAG_304 : 483|1@1+ (1,0) [0|1] ""  ADAS
 SG_ DET_SUPER_RES_TARGET_304 : 446|1@1+ (1,0) [0|1] ""  ADAS
 SG_ DET_SNR_304 : 488|8@1+ (0.35156,0) [0|89.6478] "dB"  ADAS
 SG_ DET_POINT_TARGET_PROB_304 : 472|4@1+ (6.67,0) [0|100] "%"  ADAS
 SG_ DET_EXISTENCE_PROB_304 : 506|6@1+ (1.588,0) [0|100] "%"  ADAS
 SG_ DET_OUTSIDE_SECTOR_304 : 481|1@1+ (1,0) [0|1] ""  ADAS
 SG_ DET_HVC_FLAG_304 : 464|1@1+ (1,0) [0|1] ""  ADAS
 SG_ DET_CONFD_AZIMUTH_304 : 486|2@1+ (1,0) [0|3] ""  ADAS
 SG_ DET_CONFD_ELEVATION_304 : 461|2@1+ (1,0) [0|3] ""  ADAS
 SG_ DET_MH_SCAN_INDEX_4LSB_301_304 : 476|4@1+ (1,0) [0|15] ""  ADAS
 SG_ DET_MH_CYCLE_COUNTER_301_304 : 16|8@1+ (1,0) [0|255] ""  ADAS
 SG_ DET_MH_CRC16_301_304 : 0|16@1+ (1,0) [0|65535] ""  ADAS

BO_ 1100 RDR_DETECTION_305_308: 64 RDR07
 SG_ DET_RANGE_305 : 24|15@1+ (0.015625,0) [0|500] "m"  ADAS
 SG_ DET_RANGE_ERR_305 : 40|7@1+ (0.0075,0) [0|0.9525] "m"  ADAS
 SG_ DET_RANGE_VELOCITY_305 : 48|15@1+ (0.0078125,-128) [-128|127.9921875] "m/s"  ADAS
 SG_ DET_RANGE_VELOCITY_ERR_305 : 64|8@1+ (0.003,0) [0|0.765] "m/s"  ADAS
 SG_ DET_AZIMUTH_305 : 88|13@1+ (0.0004,-1.5708) [-1.5708|1.5708] "rad"  ADAS
 SG_ DET_AZIMUTH_ERR_305 : 105|7@1+ (0.00087267,0) [0|0.11082909] "rad"  ADAS
 SG_ DET_ELEVATION_305 : 72|8@1+ (0.00275,-0.34925) [-0.34925|0.34925] "rad"  ADAS
 SG_ DET_ELEVATION_ERR_305 : 80|6@1+ (0.00174533,0) [0|0.10995579] "rad"  ADAS
 SG_ DET_RCS_305 : 136|8@1+ (0.5,-64) [-64|63.5] "dBsm"  ADAS
 SG_ DET_VALID_FLAG_305 : 119|1@1+ (1,0) [0|1] ""  ADAS
 SG_ DET_BI_STATIC_FLAG_305 : 504|1@1+ (1,0) [0|1] ""  ADAS
 SG_ DET_SUPER_RES_TARGET_305 : 104|1@1+ (1,0) [0|1] ""  ADAS
 SG_ DET_SNR_305 : 128|8@1+ (0.35156,0) [0|89.6478] "dB"  ADAS
 SG_ DET_POINT_TARGET_PROB_305 : 114|4@1+ (6.67,0) [0|100] "%"  ADAS
 SG_ DET_EXISTENCE_PROB_305 : 120|6@1+ (1.588,0) [0|100] "%"  ADAS
 SG_ DET_OUTSIDE_SECTOR_305 : 159|1@1+ (1,0) [0|1] ""  ADAS
 SG_ DET_HVC_FLAG_305 : 118|1@1+ (1,0) [0|1] ""  ADAS
 SG_ DET_CONFD_AZIMUTH_305 : 126|2@1+ (1,0) [0|3] ""  ADAS
 SG_ DET_CONFD_ELEVATION_305 : 112|2@1+ (1,0) [0|3] ""  ADAS
 SG_ DET_RANGE_306 : 144|15@1+ (0.015625,0) [0|500] "m"  ADAS
 SG_ DET_RANGE_ERR_306 : 160|7@1+ (0.0075,0) [0|0.9525] "m"  ADAS
 SG_ DET_RANGE_VELOCITY_306 : 168|15@1+ (0.0078125,-128) [-128|127.9921875] "m/s"  ADAS
 SG_ DET_RANGE_VELOCITY_ERR_306 : 184|8@1+ (0.003,0) [0|0.765] "m/s"  ADAS
 SG_ DET_AZIMUTH_306 : 208|13@1+ (0.0004,-1.5708) [-1.5708|1.5708] "rad"  ADAS
 SG_ DET_AZIMUTH_ERR_306 : 224|7@1+ (0.00087267,0) [0|0.11082909] "rad"  ADAS
 SG_ DET_ELEVATION_306 : 192|8@1+ (0.00275,-0.34925) [-0.34925|0.34925] "rad"  ADAS
 SG_ DET_ELEVATION_ERR_306 : 200|6@1+ (0.00174533,0) [0|0.10995579] "rad"  ADAS
 SG_ DET_RCS_306 : 256|8@1+ (0.5,-64) [-64|63.5] "dBsm"  ADAS
 SG_ DET_VALID_FLAG_306 : 167|1@1+ (1,0) [0|1] ""  ADAS
 SG_ DET_BI_STATIC_FLAG_306 : 505|1@1+ (1,0) [0|1] ""  ADAS
 SG_ DET_SUPER_RES_TARGET_306 : 247|1@1+ (1,0) [0|1] ""  ADAS
 SG_ DET_SNR_306 : 248|8@1+ (0.35156,0) [0|89.6478] "dB"  ADAS
 SG_ DET_POINT_TARGET_PROB_306 : 240|4@1+ (6.67,0) [0|100] "%"  ADAS
 SG_ DET_EXISTENCE_PROB_306 : 232|6@1+ (1.588,0) [0|100] "%"  ADAS
 SG_ DET_OUTSIDE_SECTOR_306 : 183|1@1+ (1,0) [0|1] ""  ADAS
 SG_ DET_HVC_FLAG_306 : 246|1@1+ (1,0) [0|1] ""  ADAS
 SG_ DET_CONFD_AZIMUTH_306 : 206|2@1+ (1,0) [0|3] ""  ADAS
 SG_ DET_CONFD_ELEVATION_306 : 244|2@1+ (1,0) [0|3] ""  ADAS
 SG_ DET_RANGE_307 : 264|15@1+ (0.015625,0) [0|500] "m"  ADAS
 SG_ DET_RANGE_ERR_307 : 280|7@1+ (0.0075,0) [0|0.9525] "m"  ADAS
 SG_ DET_RANGE_VELOCITY_307 : 288|15@1+ (0.0078125,-128) [-128|127.9921875] "m/s"  ADAS
 SG_ DET_RANGE_VELOCITY_ERR_307 : 304|8@1+ (0.003,0) [0|0.765] "m/s"  ADAS
 SG_ DET_AZIMUTH_307 : 328|13@1+ (0.0004,-1.5708) [-1.5708|1.5708] "rad"  ADAS
 SG_ DET_AZIMUTH_ERR_307 : 345|7@1+ (0.00087267,0) [0|0.11082909] "rad"  ADAS
 SG_ DET_ELEVATION_307 : 312|8@1+ (0.00275,-0.34925) [-0.34925|0.34925] "rad"  ADAS
 SG_ DET_ELEVATION_ERR_307 : 320|6@1+ (0.00174533,0) [0|0.10995579] "rad"  ADAS
 SG_ DET_RCS_307 : 376|8@1+ (0.5,-64) [-64|63.5] "dBsm"  ADAS
 SG_ DET_VALID_FLAG_307 : 399|1@1+ (1,0) [0|1] ""  ADAS
 SG_ DET_BI_STATIC_FLAG_307 : 482|1@1+ (1,0) [0|1] ""  ADAS
 SG_ DET_SUPER_RES_TARGET_307 : 344|1@1+ (1,0) [0|1] ""  ADAS
 SG_ DET_SNR_307 : 368|8@1+ (0.35156,0) [0|89.6478] "dB"  ADAS
 SG_ DET_POINT_TARGET_PROB_307 : 360|4@1+ (6.67,0) [0|100] "%"  ADAS
 SG_ DET_EXISTENCE_PROB_307 : 352|6@1+ (1.588,0) [0|100] "%"  ADAS
 SG_ DET_OUTSIDE_SECTOR_307 : 407|1@1+ (1,0) [0|1] ""  ADAS
 SG_ DET_HVC_FLAG_307 : 364|1@1+ (1,0) [0|1] ""  ADAS
 SG_ DET_CONFD_AZIMUTH_307 : 365|2@1+ (1,0) [0|3] ""  ADAS
 SG_ DET_CONFD_ELEVATION_307 : 358|2@1+ (1,0) [0|3] ""  ADAS
 SG_ DET_RANGE_308 : 384|15@1+ (0.015625,0) [0|500] "m"  ADAS
 SG_ DET_RANGE_ERR_308 : 400|7@1+ (0.0075,0) [0|0.9525] "m"  ADAS
 SG_ DET_RANGE_VELOCITY_308 : 408|15@1+ (0.0078125,-128) [-128|127.9921875] "m/s"  ADAS
 SG_ DET_RANGE_VELOCITY_ERR_308 : 424|8@1+ (0.003,0) [0|0.765] "m/s"  ADAS
 SG_ DET_AZIMUTH_308 : 448|13@1+ (0.0004,-1.5708) [-1.5708|1.5708] "rad"  ADAS
 SG_ DET_AZIMUTH_ERR_308 : 465|7@1+ (0.00087267,0) [0|0.11082909] "rad"  ADAS
 SG_ DET_ELEVATION_308 : 432|8@1+ (0.00275,-0.34925) [-0.34925|0.34925] "rad"  ADAS
 SG_ DET_ELEVATION_ERR_308 : 440|6@1+ (0.00174533,0) [0|0.10995579] "rad"  ADAS
 SG_ DET_RCS_308 : 496|8@1+ (0.5,-64) [-64|63.5] "dBsm"  ADAS
 SG_ DET_VALID_FLAG_308 : 485|1@1+ (1,0) [0|1] ""  ADAS
 SG_ DET_BI_STATIC_FLAG_308 : 483|1@1+ (1,0) [0|1] ""  ADAS
 SG_ DET_SUPER_RES_TARGET_308 : 446|1@1+ (1,0) [0|1] ""  ADAS
 SG_ DET_SNR_308 : 488|8@1+ (0.35156,0) [0|89.6478] "dB"  ADAS
 SG_ DET_POINT_TARGET_PROB_308 : 472|4@1+ (6.67,0) [0|100] "%"  ADAS
 SG_ DET_EXISTENCE_PROB_308 : 506|6@1+ (1.588,0) [0|100] "%"  ADAS
 SG_ DET_OUTSIDE_SECTOR_308 : 481|1@1+ (1,0) [0|1] ""  ADAS
 SG_ DET_HVC_FLAG_308 : 464|1@1+ (1,0) [0|1] ""  ADAS
 SG_ DET_CONFD_AZIMUTH_308 : 486|2@1+ (1,0) [0|3] ""  ADAS
 SG_ DET_CONFD_ELEVATION_308 : 461|2@1+ (1,0) [0|3] ""  ADAS
 SG_ DET_MH_SCAN_INDEX_4LSB_305_308 : 476|4@1+ (1,0) [0|15] ""  ADAS
 SG_ DET_MH_CYCLE_COUNTER_305_308 : 16|8@1+ (1,0) [0|255] ""  ADAS
 SG_ DET_MH_CRC16_305_308 : 0|16@1+ (1,0) [0|65535] ""  ADAS

BO_ 1101 RDR_DETECTION_309_312: 64 RDR07
 SG_ DET_RANGE_309 : 24|15@1+ (0.015625,0) [0|500] "m"  ADAS
 SG_ DET_RANGE_ERR_309 : 40|7@1+ (0.0075,0) [0|0.9525] "m"  ADAS
 SG_ DET_RANGE_VELOCITY_309 : 48|15@1+ (0.0078125,-128) [-128|127.9921875] "m/s"  ADAS
 SG_ DET_RANGE_VELOCITY_ERR_309 : 64|8@1+ (0.003,0) [0|0.765] "m/s"  ADAS
 SG_ DET_AZIMUTH_309 : 88|13@1+ (0.0004,-1.5708) [-1.5708|1.5708] "rad"  ADAS
 SG_ DET_AZIMUTH_ERR_309 : 105|7@1+ (0.00087267,0) [0|0.11082909] "rad"  ADAS
 SG_ DET_ELEVATION_309 : 72|8@1+ (0.00275,-0.34925) [-0.34925|0.34925] "rad"  ADAS
 SG_ DET_ELEVATION_ERR_309 : 80|6@1+ (0.00174533,0) [0|0.10995579] "rad"  ADAS
 SG_ DET_RCS_309 : 136|8@1+ (0.5,-64) [-64|63.5] "dBsm"  ADAS
 SG_ DET_VALID_FLAG_309 : 119|1@1+ (1,0) [0|1] ""  ADAS
 SG_ DET_BI_STATIC_FLAG_309 : 504|1@1+ (1,0) [0|1] ""  ADAS
 SG_ DET_SUPER_RES_TARGET_309 : 104|1@1+ (1,0) [0|1] ""  ADAS
 SG_ DET_SNR_309 : 128|8@1+ (0.35156,0) [0|89.6478] "dB"  ADAS
 SG_ DET_POINT_TARGET_PROB_309 : 114|4@1+ (6.67,0) [0|100] "%"  ADAS
 SG_ DET_EXISTENCE_PROB_309 : 120|6@1+ (1.588,0) [0|100] "%"  ADAS
 SG_ DET_OUTSIDE_SECTOR_309 : 159|1@1+ (1,0) [0|1] ""  ADAS
 SG_ DET_HVC_FLAG_309 : 118|1@1+ (1,0) [0|1] ""  ADAS
 SG_ DET_CONFD_AZIMUTH_309 : 126|2@1+ (1,0) [0|3] ""  ADAS
 SG_ DET_CONFD_ELEVATION_309 : 112|2@1+ (1,0) [0|3] ""  ADAS
 SG_ DET_RANGE_310 : 144|15@1+ (0.015625,0) [0|500] "m"  ADAS
 SG_ DET_RANGE_ERR_310 : 160|7@1+ (0.0075,0) [0|0.9525] "m"  ADAS
 SG_ DET_RANGE_VELOCITY_310 : 168|15@1+ (0.0078125,-128) [-128|127.9921875] "m/s"  ADAS
 SG_ DET_RANGE_VELOCITY_ERR_310 : 184|8@1+ (0.003,0) [0|0.765] "m/s"  ADAS
 SG_ DET_AZIMUTH_310 : 208|13@1+ (0.0004,-1.5708) [-1.5708|1.5708] "rad"  ADAS
 SG_ DET_AZIMUTH_ERR_310 : 224|7@1+ (0.00087267,0) [0|0.11082909] "rad"  ADAS
 SG_ DET_ELEVATION_310 : 192|8@1+ (0.00275,-0.34925) [-0.34925|0.34925] "rad"  ADAS
 SG_ DET_ELEVATION_ERR_310 : 200|6@1+ (0.00174533,0) [0|0.10995579] "rad"  ADAS
 SG_ DET_RCS_310 : 256|8@1+ (0.5,-64) [-64|63.5] "dBsm"  ADAS
 SG_ DET_VALID_FLAG_310 : 167|1@1+ (1,0) [0|1] ""  ADAS
 SG_ DET_BI_STATIC_FLAG_310 : 505|1@1+ (1,0) [0|1] ""  ADAS
 SG_ DET_SUPER_RES_TARGET_310 : 247|1@1+ (1,0) [0|1] ""  ADAS
 SG_ DET_SNR_310 : 248|8@1+ (0.35156,0) [0|89.6478] "dB"  ADAS
 SG_ DET_POINT_TARGET_PROB_310 : 240|4@1+ (6.67,0) [0|100] "%"  ADAS
 SG_ DET_EXISTENCE_PROB_310 : 232|6@1+ (1.588,0) [0|100] "%"  ADAS
 SG_ DET_OUTSIDE_SECTOR_310 : 183|1@1+ (1,0) [0|1] ""  ADAS
 SG_ DET_HVC_FLAG_310 : 246|1@1+ (1,0) [0|1] ""  ADAS
 SG_ DET_CONFD_AZIMUTH_310 : 206|2@1+ (1,0) [0|3] ""  ADAS
 SG_ DET_CONFD_ELEVATION_310 : 244|2@1+ (1,0) [0|3] ""  ADAS
 SG_ DET_RANGE_311 : 264|15@1+ (0.015625,0) [0|500] "m"  ADAS
 SG_ DET_RANGE_ERR_311 : 280|7@1+ (0.0075,0) [0|0.9525] "m"  ADAS
 SG_ DET_RANGE_VELOCITY_311 : 288|15@1+ (0.0078125,-128) [-128|127.9921875] "m/s"  ADAS
 SG_ DET_RANGE_VELOCITY_ERR_311 : 304|8@1+ (0.003,0) [0|0.765] "m/s"  ADAS
 SG_ DET_AZIMUTH_311 : 328|13@1+ (0.0004,-1.5708) [-1.5708|1.5708] "rad"  ADAS
 SG_ DET_AZIMUTH_ERR_311 : 345|7@1+ (0.00087267,0) [0|0.11082909] "rad"  ADAS
 SG_ DET_ELEVATION_311 : 312|8@1+ (0.00275,-0.34925) [-0.34925|0.34925] "rad"  ADAS
 SG_ DET_ELEVATION_ERR_311 : 320|6@1+ (0.00174533,0) [0|0.10995579] "rad"  ADAS
 SG_ DET_RCS_311 : 376|8@1+ (0.5,-64) [-64|63.5] "dBsm"  ADAS
 SG_ DET_VALID_FLAG_311 : 399|1@1+ (1,0) [0|1] ""  ADAS
 SG_ DET_BI_STATIC_FLAG_311 : 482|1@1+ (1,0) [0|1] ""  ADAS
 SG_ DET_SUPER_RES_TARGET_311 : 344|1@1+ (1,0) [0|1] ""  ADAS
 SG_ DET_SNR_311 : 368|8@1+ (0.35156,0) [0|89.6478] "dB"  ADAS
 SG_ DET_POINT_TARGET_PROB_311 : 360|4@1+ (6.67,0) [0|100] "%"  ADAS
 SG_ DET_EXISTENCE_PROB_311 : 352|6@1+ (1.588,0) [0|100] "%"  ADAS
 SG_ DET_OUTSIDE_SECTOR_311 : 407|1@1+ (1,0) [0|1] ""  ADAS
 SG_ DET_HVC_FLAG_311 : 364|1@1+ (1,0) [0|1] ""  ADAS
 SG_ DET_CONFD_AZIMUTH_311 : 365|2@1+ (1,0) [0|3] ""  ADAS
 SG_ DET_CONFD_ELEVATION_311 : 358|2@1+ (1,0) [0|3] ""  ADAS
 SG_ DET_RANGE_312 : 384|15@1+ (0.015625,0) [0|500] "m"  ADAS
 SG_ DET_RANGE_ERR_312 : 400|7@1+ (0.0075,0) [0|0.9525] "m"  ADAS
 SG_ DET_RANGE_VELOCITY_312 : 408|15@1+ (0.0078125,-128) [-128|127.9921875] "m/s"  ADAS
 SG_ DET_RANGE_VELOCITY_ERR_312 : 424|8@1+ (0.003,0) [0|0.765] "m/s"  ADAS
 SG_ DET_AZIMUTH_312 : 448|13@1+ (0.0004,-1.5708) [-1.5708|1.5708] "rad"  ADAS
 SG_ DET_AZIMUTH_ERR_312 : 465|7@1+ (0.00087267,0) [0|0.11082909] "rad"  ADAS
 SG_ DET_ELEVATION_312 : 432|8@1+ (0.00275,-0.34925) [-0.34925|0.34925] "rad"  ADAS
 SG_ DET_ELEVATION_ERR_312 : 440|6@1+ (0.00174533,0) [0|0.10995579] "rad"  ADAS
 SG_ DET_RCS_312 : 496|8@1+ (0.5,-64) [-64|63.5] "dBsm"  ADAS
 SG_ DET_VALID_FLAG_312 : 485|1@1+ (1,0) [0|1] ""  ADAS
 SG_ DET_BI_STATIC_FLAG_312 : 483|1@1+ (1,0) [0|1] ""  ADAS
 SG_ DET_SUPER_RES_TARGET_312 : 446|1@1+ (1,0) [0|1] ""  ADAS
 SG_ DET_SNR_312 : 488|8@1+ (0.35156,0) [0|89.6478] "dB"  ADAS
 SG_ DET_POINT_TARGET_PROB_312 : 472|4@1+ (6.67,0) [0|100] "%"  ADAS
 SG_ DET_EXISTENCE_PROB_312 : 506|6@1+ (1.588,0) [0|100] "%"  ADAS
 SG_ DET_OUTSIDE_SECTOR_312 : 481|1@1+ (1,0) [0|1] ""  ADAS
 SG_ DET_HVC_FLAG_312 : 464|1@1+ (1,0) [0|1] ""  ADAS
 SG_ DET_CONFD_AZIMUTH_312 : 486|2@1+ (1,0) [0|3] ""  ADAS
 SG_ DET_CONFD_ELEVATION_312 : 461|2@1+ (1,0) [0|3] ""  ADAS
 SG_ DET_MH_SCAN_INDEX_4LSB_309_312 : 476|4@1+ (1,0) [0|15] ""  ADAS
 SG_ DET_MH_CYCLE_COUNTER_309_312 : 16|8@1+ (1,0) [0|255] ""  ADAS
 SG_ DET_MH_CRC16_309_312 : 0|16@1+ (1,0) [0|65535] ""  ADAS

BO_ 1102 RDR_DETECTION_313_316: 64 RDR07
 SG_ DET_RANGE_313 : 24|15@1+ (0.015625,0) [0|500] "m"  ADAS
 SG_ DET_RANGE_ERR_313 : 40|7@1+ (0.0075,0) [0|0.9525] "m"  ADAS
 SG_ DET_RANGE_VELOCITY_313 : 48|15@1+ (0.0078125,-128) [-128|127.9921875] "m/s"  ADAS
 SG_ DET_RANGE_VELOCITY_ERR_313 : 64|8@1+ (0.003,0) [0|0.765] "m/s"  ADAS
 SG_ DET_AZIMUTH_313 : 88|13@1+ (0.0004,-1.5708) [-1.5708|1.5708] "rad"  ADAS
 SG_ DET_AZIMUTH_ERR_313 : 105|7@1+ (0.00087267,0) [0|0.11082909] "rad"  ADAS
 SG_ DET_ELEVATION_313 : 72|8@1+ (0.00275,-0.34925) [-0.34925|0.34925] "rad"  ADAS
 SG_ DET_ELEVATION_ERR_313 : 80|6@1+ (0.00174533,0) [0|0.10995579] "rad"  ADAS
 SG_ DET_RCS_313 : 136|8@1+ (0.5,-64) [-64|63.5] "dBsm"  ADAS
 SG_ DET_VALID_FLAG_313 : 119|1@1+ (1,0) [0|1] ""  ADAS
 SG_ DET_BI_STATIC_FLAG_313 : 504|1@1+ (1,0) [0|1] ""  ADAS
 SG_ DET_SUPER_RES_TARGET_313 : 104|1@1+ (1,0) [0|1] ""  ADAS
 SG_ DET_SNR_313 : 128|8@1+ (0.35156,0) [0|89.6478] "dB"  ADAS
 SG_ DET_POINT_TARGET_PROB_313 : 114|4@1+ (6.67,0) [0|100] "%"  ADAS
 SG_ DET_EXISTENCE_PROB_313 : 120|6@1+ (1.588,0) [0|100] "%"  ADAS
 SG_ DET_OUTSIDE_SECTOR_313 : 159|1@1+ (1,0) [0|1] ""  ADAS
 SG_ DET_HVC_FLAG_313 : 118|1@1+ (1,0) [0|1] ""  ADAS
 SG_ DET_CONFD_AZIMUTH_313 : 126|2@1+ (1,0) [0|3] ""  ADAS
 SG_ DET_CONFD_ELEVATION_313 : 112|2@1+ (1,0) [0|3] ""  ADAS
 SG_ DET_RANGE_314 : 144|15@1+ (0.015625,0) [0|500] "m"  ADAS
 SG_ DET_RANGE_ERR_314 : 160|7@1+ (0.0075,0) [0|0.9525] "m"  ADAS
 SG_ DET_RANGE_VELOCITY_314 : 168|15@1+ (0.0078125,-128) [-128|127.9921875] "m/s"  ADAS
 SG_ DET_RANGE_VELOCITY_ERR_314 : 184|8@1+ (0.003,0) [0|0.765] "m/s"  ADAS
 SG_ DET_AZIMUTH_314 : 208|13@1+ (0.0004,-1.5708) [-1.5708|1.5708] "rad"  ADAS
 SG_ DET_AZIMUTH_ERR_314 : 224|7@1+ (0.00087267,0) [0|0.11082909] "rad"  ADAS
 SG_ DET_ELEVATION_314 : 192|8@1+ (0.00275,-0.34925) [-0.34925|0.34925] "rad"  ADAS
 SG_ DET_ELEVATION_ERR_314 : 200|6@1+ (0.00174533,0) [0|0.10995579] "rad"  ADAS
 SG_ DET_RCS_314 : 256|8@1+ (0.5,-64) [-64|63.5] "dBsm"  ADAS
 SG_ DET_VALID_FLAG_314 : 167|1@1+ (1,0) [0|1] ""  ADAS
 SG_ DET_BI_STATIC_FLAG_314 : 505|1@1+ (1,0) [0|1] ""  ADAS
 SG_ DET_SUPER_RES_TARGET_314 : 247|1@1+ (1,0) [0|1] ""  ADAS
 SG_ DET_SNR_314 : 248|8@1+ (0.35156,0) [0|89.6478] "dB"  ADAS
 SG_ DET_POINT_TARGET_PROB_314 : 240|4@1+ (6.67,0) [0|100] "%"  ADAS
 SG_ DET_EXISTENCE_PROB_314 : 232|6@1+ (1.588,0) [0|100] "%"  ADAS
 SG_ DET_OUTSIDE_SECTOR_314 : 183|1@1+ (1,0) [0|1] ""  ADAS
 SG_ DET_HVC_FLAG_314 : 246|1@1+ (1,0) [0|1] ""  ADAS
 SG_ DET_CONFD_AZIMUTH_314 : 206|2@1+ (1,0) [0|3] ""  ADAS
 SG_ DET_CONFD_ELEVATION_314 : 244|2@1+ (1,0) [0|3] ""  ADAS
 SG_ DET_RANGE_315 : 264|15@1+ (0.015625,0) [0|500] "m"  ADAS
 SG_ DET_RANGE_ERR_315 : 280|7@1+ (0.0075,0) [0|0.9525] "m"  ADAS
 SG_ DET_RANGE_VELOCITY_315 : 288|15@1+ (0.0078125,-128) [-128|127.9921875] "m/s"  ADAS
 SG_ DET_RANGE_VELOCITY_ERR_315 : 304|8@1+ (0.003,0) [0|0.765] "m/s"  ADAS
 SG_ DET_AZIMUTH_315 : 328|13@1+ (0.0004,-1.5708) [-1.5708|1.5708] "rad"  ADAS
 SG_ DET_AZIMUTH_ERR_315 : 345|7@1+ (0.00087267,0) [0|0.11082909] "rad"  ADAS
 SG_ DET_ELEVATION_315 : 312|8@1+ (0.00275,-0.34925) [-0.34925|0.34925] "rad"  ADAS
 SG_ DET_ELEVATION_ERR_315 : 320|6@1+ (0.00174533,0) [0|0.10995579] "rad"  ADAS
 SG_ DET_RCS_315 : 376|8@1+ (0.5,-64) [-64|63.5] "dBsm"  ADAS
 SG_ DET_VALID_FLAG_315 : 399|1@1+ (1,0) [0|1] ""  ADAS
 SG_ DET_BI_STATIC_FLAG_315 : 482|1@1+ (1,0) [0|1] ""  ADAS
 SG_ DET_SUPER_RES_TARGET_315 : 344|1@1+ (1,0) [0|1] ""  ADAS
 SG_ DET_SNR_315 : 368|8@1+ (0.35156,0) [0|89.6478] "dB"  ADAS
 SG_ DET_POINT_TARGET_PROB_315 : 360|4@1+ (6.67,0) [0|100] "%"  ADAS
 SG_ DET_EXISTENCE_PROB_315 : 352|6@1+ (1.588,0) [0|100] "%"  ADAS
 SG_ DET_OUTSIDE_SECTOR_315 : 407|1@1+ (1,0) [0|1] ""  ADAS
 SG_ DET_HVC_FLAG_315 : 364|1@1+ (1,0) [0|1] ""  ADAS
 SG_ DET_CONFD_AZIMUTH_315 : 365|2@1+ (1,0) [0|3] ""  ADAS
 SG_ DET_CONFD_ELEVATION_315 : 358|2@1+ (1,0) [0|3] ""  ADAS
 SG_ DET_RANGE_316 : 384|15@1+ (0.015625,0) [0|500] "m"  ADAS
 SG_ DET_RANGE_ERR_316 : 400|7@1+ (0.0075,0) [0|0.9525] "m"  ADAS
 SG_ DET_RANGE_VELOCITY_316 : 408|15@1+ (0.0078125,-128) [-128|127.9921875] "m/s"  ADAS
 SG_ DET_RANGE_VELOCITY_ERR_316 : 424|8@1+ (0.003,0) [0|0.765] "m/s"  ADAS
 SG_ DET_AZIMUTH_316 : 448|13@1+ (0.0004,-1.5708) [-1.5708|1.5708] "rad"  ADAS
 SG_ DET_AZIMUTH_ERR_316 : 465|7@1+ (0.00087267,0) [0|0.11082909] "rad"  ADAS
 SG_ DET_ELEVATION_316 : 432|8@1+ (0.00275,-0.34925) [-0.34925|0.34925] "rad"  ADAS
 SG_ DET_ELEVATION_ERR_316 : 440|6@1+ (0.00174533,0) [0|0.10995579] "rad"  ADAS
 SG_ DET_RCS_316 : 496|8@1+ (0.5,-64) [-64|63.5] "dBsm"  ADAS
 SG_ DET_VALID_FLAG_316 : 485|1@1+ (1,0) [0|1] ""  ADAS
 SG_ DET_BI_STATIC_FLAG_316 : 483|1@1+ (1,0) [0|1] ""  ADAS
 SG_ DET_SUPER_RES_TARGET_316 : 446|1@1+ (1,0) [0|1] ""  ADAS
 SG_ DET_SNR_316 : 488|8@1+ (0.35156,0) [0|89.6478] "dB"  ADAS
 SG_ DET_POINT_TARGET_PROB_316 : 472|4@1+ (6.67,0) [0|100] "%"  ADAS
 SG_ DET_EXISTENCE_PROB_316 : 506|6@1+ (1.588,0) [0|100] "%"  ADAS
 SG_ DET_OUTSIDE_SECTOR_316 : 481|1@1+ (1,0) [0|1] ""  ADAS
 SG_ DET_HVC_FLAG_316 : 464|1@1+ (1,0) [0|1] ""  ADAS
 SG_ DET_CONFD_AZIMUTH_316 : 486|2@1+ (1,0) [0|3] ""  ADAS
 SG_ DET_CONFD_ELEVATION_316 : 461|2@1+ (1,0) [0|3] ""  ADAS
 SG_ DET_MH_SCAN_INDEX_4LSB_313_316 : 476|4@1+ (1,0) [0|15] ""  ADAS
 SG_ DET_MH_CYCLE_COUNTER_313_316 : 16|8@1+ (1,0) [0|255] ""  ADAS
 SG_ DET_MH_CRC16_313_316 : 0|16@1+ (1,0) [0|65535] ""  ADAS

BO_ 1103 RDR_DETECTION_317_320: 64 RDR07
 SG_ DET_RANGE_317 : 24|15@1+ (0.015625,0) [0|500] "m"  ADAS
 SG_ DET_RANGE_ERR_317 : 40|7@1+ (0.0075,0) [0|0.9525] "m"  ADAS
 SG_ DET_RANGE_VELOCITY_317 : 48|15@1+ (0.0078125,-128) [-128|127.9921875] "m/s"  ADAS
 SG_ DET_RANGE_VELOCITY_ERR_317 : 64|8@1+ (0.003,0) [0|0.765] "m/s"  ADAS
 SG_ DET_AZIMUTH_317 : 88|13@1+ (0.0004,-1.5708) [-1.5708|1.5708] "rad"  ADAS
 SG_ DET_AZIMUTH_ERR_317 : 105|7@1+ (0.00087267,0) [0|0.11082909] "rad"  ADAS
 SG_ DET_ELEVATION_317 : 72|8@1+ (0.00275,-0.34925) [-0.34925|0.34925] "rad"  ADAS
 SG_ DET_ELEVATION_ERR_317 : 80|6@1+ (0.00174533,0) [0|0.10995579] "rad"  ADAS
 SG_ DET_RCS_317 : 136|8@1+ (0.5,-64) [-64|63.5] "dBsm"  ADAS
 SG_ DET_VALID_FLAG_317 : 119|1@1+ (1,0) [0|1] ""  ADAS
 SG_ DET_BI_STATIC_FLAG_317 : 504|1@1+ (1,0) [0|1] ""  ADAS
 SG_ DET_SUPER_RES_TARGET_317 : 104|1@1+ (1,0) [0|1] ""  ADAS
 SG_ DET_SNR_317 : 128|8@1+ (0.35156,0) [0|89.6478] "dB"  ADAS
 SG_ DET_POINT_TARGET_PROB_317 : 114|4@1+ (6.67,0) [0|100] "%"  ADAS
 SG_ DET_EXISTENCE_PROB_317 : 120|6@1+ (1.588,0) [0|100] "%"  ADAS
 SG_ DET_OUTSIDE_SECTOR_317 : 159|1@1+ (1,0) [0|1] ""  ADAS
 SG_ DET_HVC_FLAG_317 : 118|1@1+ (1,0) [0|1] ""  ADAS
 SG_ DET_CONFD_AZIMUTH_317 : 126|2@1+ (1,0) [0|3] ""  ADAS
 SG_ DET_CONFD_ELEVATION_317 : 112|2@1+ (1,0) [0|3] ""  ADAS
 SG_ DET_RANGE_318 : 144|15@1+ (0.015625,0) [0|500] "m"  ADAS
 SG_ DET_RANGE_ERR_318 : 160|7@1+ (0.0075,0) [0|0.9525] "m"  ADAS
 SG_ DET_RANGE_VELOCITY_318 : 168|15@1+ (0.0078125,-128) [-128|127.9921875] "m/s"  ADAS
 SG_ DET_RANGE_VELOCITY_ERR_318 : 184|8@1+ (0.003,0) [0|0.765] "m/s"  ADAS
 SG_ DET_AZIMUTH_318 : 208|13@1+ (0.0004,-1.5708) [-1.5708|1.5708] "rad"  ADAS
 SG_ DET_AZIMUTH_ERR_318 : 224|7@1+ (0.00087267,0) [0|0.11082909] "rad"  ADAS
 SG_ DET_ELEVATION_318 : 192|8@1+ (0.00275,-0.34925) [-0.34925|0.34925] "rad"  ADAS
 SG_ DET_ELEVATION_ERR_318 : 200|6@1+ (0.00174533,0) [0|0.10995579] "rad"  ADAS
 SG_ DET_RCS_318 : 256|8@1+ (0.5,-64) [-64|63.5] "dBsm"  ADAS
 SG_ DET_VALID_FLAG_318 : 167|1@1+ (1,0) [0|1] ""  ADAS
 SG_ DET_BI_STATIC_FLAG_318 : 505|1@1+ (1,0) [0|1] ""  ADAS
 SG_ DET_SUPER_RES_TARGET_318 : 247|1@1+ (1,0) [0|1] ""  ADAS
 SG_ DET_SNR_318 : 248|8@1+ (0.35156,0) [0|89.6478] "dB"  ADAS
 SG_ DET_POINT_TARGET_PROB_318 : 240|4@1+ (6.67,0) [0|100] "%"  ADAS
 SG_ DET_EXISTENCE_PROB_318 : 232|6@1+ (1.588,0) [0|100] "%"  ADAS
 SG_ DET_OUTSIDE_SECTOR_318 : 183|1@1+ (1,0) [0|1] ""  ADAS
 SG_ DET_HVC_FLAG_318 : 246|1@1+ (1,0) [0|1] ""  ADAS
 SG_ DET_CONFD_AZIMUTH_318 : 206|2@1+ (1,0) [0|3] ""  ADAS
 SG_ DET_CONFD_ELEVATION_318 : 244|2@1+ (1,0) [0|3] ""  ADAS
 SG_ DET_RANGE_319 : 264|15@1+ (0.015625,0) [0|500] "m"  ADAS
 SG_ DET_RANGE_ERR_319 : 280|7@1+ (0.0075,0) [0|0.9525] "m"  ADAS
 SG_ DET_RANGE_VELOCITY_319 : 288|15@1+ (0.0078125,-128) [-128|127.9921875] "m/s"  ADAS
 SG_ DET_RANGE_VELOCITY_ERR_319 : 304|8@1+ (0.003,0) [0|0.765] "m/s"  ADAS
 SG_ DET_AZIMUTH_319 : 328|13@1+ (0.0004,-1.5708) [-1.5708|1.5708] "rad"  ADAS
 SG_ DET_AZIMUTH_ERR_319 : 345|7@1+ (0.00087267,0) [0|0.11082909] "rad"  ADAS
 SG_ DET_ELEVATION_319 : 312|8@1+ (0.00275,-0.34925) [-0.34925|0.34925] "rad"  ADAS
 SG_ DET_ELEVATION_ERR_319 : 320|6@1+ (0.00174533,0) [0|0.10995579] "rad"  ADAS
 SG_ DET_RCS_319 : 376|8@1+ (0.5,-64) [-64|63.5] "dBsm"  ADAS
 SG_ DET_VALID_FLAG_319 : 399|1@1+ (1,0) [0|1] ""  ADAS
 SG_ DET_BI_STATIC_FLAG_319 : 482|1@1+ (1,0) [0|1] ""  ADAS
 SG_ DET_SUPER_RES_TARGET_319 : 344|1@1+ (1,0) [0|1] ""  ADAS
 SG_ DET_SNR_319 : 368|8@1+ (0.35156,0) [0|89.6478] "dB"  ADAS
 SG_ DET_POINT_TARGET_PROB_319 : 360|4@1+ (6.67,0) [0|100] "%"  ADAS
 SG_ DET_EXISTENCE_PROB_319 : 352|6@1+ (1.588,0) [0|100] "%"  ADAS
 SG_ DET_OUTSIDE_SECTOR_319 : 407|1@1+ (1,0) [0|1] ""  ADAS
 SG_ DET_HVC_FLAG_319 : 364|1@1+ (1,0) [0|1] ""  ADAS
 SG_ DET_CONFD_AZIMUTH_319 : 365|2@1+ (1,0) [0|3] ""  ADAS
 SG_ DET_CONFD_ELEVATION_319 : 358|2@1+ (1,0) [0|3] ""  ADAS
 SG_ DET_RANGE_320 : 384|15@1+ (0.015625,0) [0|500] "m"  ADAS
 SG_ DET_RANGE_ERR_320 : 400|7@1+ (0.0075,0) [0|0.9525] "m"  ADAS
 SG_ DET_RANGE_VELOCITY_320 : 408|15@1+ (0.0078125,-128) [-128|127.9921875] "m/s"  ADAS
 SG_ DET_RANGE_VELOCITY_ERR_320 : 424|8@1+ (0.003,0) [0|0.765] "m/s"  ADAS
 SG_ DET_AZIMUTH_320 : 448|13@1+ (0.0004,-1.5708) [-1.5708|1.5708] "rad"  ADAS
 SG_ DET_AZIMUTH_ERR_320 : 465|7@1+ (0.00087267,0) [0|0.11082909] "rad"  ADAS
 SG_ DET_ELEVATION_320 : 432|8@1+ (0.00275,-0.34925) [-0.34925|0.34925] "rad"  ADAS
 SG_ DET_ELEVATION_ERR_320 : 440|6@1+ (0.00174533,0) [0|0.10995579] "rad"  ADAS
 SG_ DET_RCS_320 : 496|8@1+ (0.5,-64) [-64|63.5] "dBsm"  ADAS
 SG_ DET_VALID_FLAG_320 : 485|1@1+ (1,0) [0|1] ""  ADAS
 SG_ DET_BI_STATIC_FLAG_320 : 483|1@1+ (1,0) [0|1] ""  ADAS
 SG_ DET_SUPER_RES_TARGET_320 : 446|1@1+ (1,0) [0|1] ""  ADAS
 SG_ DET_SNR_320 : 488|8@1+ (0.35156,0) [0|89.6478] "dB"  ADAS
 SG_ DET_POINT_TARGET_PROB_320 : 472|4@1+ (6.67,0) [0|100] "%"  ADAS
 SG_ DET_EXISTENCE_PROB_320 : 506|6@1+ (1.588,0) [0|100] "%"  ADAS
 SG_ DET_OUTSIDE_SECTOR_320 : 481|1@1+ (1,0) [0|1] ""  ADAS
 SG_ DET_HVC_FLAG_320 : 464|1@1+ (1,0) [0|1] ""  ADAS
 SG_ DET_CONFD_AZIMUTH_320 : 486|2@1+ (1,0) [0|3] ""  ADAS
 SG_ DET_CONFD_ELEVATION_320 : 461|2@1+ (1,0) [0|3] ""  ADAS
 SG_ DET_MH_SCAN_INDEX_4LSB_317_320 : 476|4@1+ (1,0) [0|15] ""  ADAS
 SG_ DET_MH_CYCLE_COUNTER_317_320 : 16|8@1+ (1,0) [0|255] ""  ADAS
 SG_ DET_MH_CRC16_317_320 : 0|16@1+ (1,0) [0|65535] ""  ADAS

BO_ 1104 RDR_DETECTION_321_324: 64 RDR07
 SG_ DET_RANGE_321 : 24|15@1+ (0.015625,0) [0|500] "m"  ADAS
 SG_ DET_RANGE_ERR_321 : 40|7@1+ (0.0075,0) [0|0.9525] "m"  ADAS
 SG_ DET_RANGE_VELOCITY_321 : 48|15@1+ (0.0078125,-128) [-128|127.9921875] "m/s"  ADAS
 SG_ DET_RANGE_VELOCITY_ERR_321 : 64|8@1+ (0.003,0) [0|0.765] "m/s"  ADAS
 SG_ DET_AZIMUTH_321 : 88|13@1+ (0.0004,-1.5708) [-1.5708|1.5708] "rad"  ADAS
 SG_ DET_AZIMUTH_ERR_321 : 105|7@1+ (0.00087267,0) [0|0.11082909] "rad"  ADAS
 SG_ DET_ELEVATION_321 : 72|8@1+ (0.00275,-0.34925) [-0.34925|0.34925] "rad"  ADAS
 SG_ DET_ELEVATION_ERR_321 : 80|6@1+ (0.00174533,0) [0|0.10995579] "rad"  ADAS
 SG_ DET_RCS_321 : 136|8@1+ (0.5,-64) [-64|63.5] "dBsm"  ADAS
 SG_ DET_VALID_FLAG_321 : 119|1@1+ (1,0) [0|1] ""  ADAS
 SG_ DET_BI_STATIC_FLAG_321 : 504|1@1+ (1,0) [0|1] ""  ADAS
 SG_ DET_SUPER_RES_TARGET_321 : 104|1@1+ (1,0) [0|1] ""  ADAS
 SG_ DET_SNR_321 : 128|8@1+ (0.35156,0) [0|89.6478] "dB"  ADAS
 SG_ DET_POINT_TARGET_PROB_321 : 114|4@1+ (6.67,0) [0|100] "%"  ADAS
 SG_ DET_EXISTENCE_PROB_321 : 120|6@1+ (1.588,0) [0|100] "%"  ADAS
 SG_ DET_OUTSIDE_SECTOR_321 : 159|1@1+ (1,0) [0|1] ""  ADAS
 SG_ DET_HVC_FLAG_321 : 118|1@1+ (1,0) [0|1] ""  ADAS
 SG_ DET_CONFD_AZIMUTH_321 : 126|2@1+ (1,0) [0|3] ""  ADAS
 SG_ DET_CONFD_ELEVATION_321 : 112|2@1+ (1,0) [0|3] ""  ADAS
 SG_ DET_RANGE_322 : 144|15@1+ (0.015625,0) [0|500] "m"  ADAS
 SG_ DET_RANGE_ERR_322 : 160|7@1+ (0.0075,0) [0|0.9525] "m"  ADAS
 SG_ DET_RANGE_VELOCITY_322 : 168|15@1+ (0.0078125,-128) [-128|127.9921875] "m/s"  ADAS
 SG_ DET_RANGE_VELOCITY_ERR_322 : 184|8@1+ (0.003,0) [0|0.765] "m/s"  ADAS
 SG_ DET_AZIMUTH_322 : 208|13@1+ (0.0004,-1.5708) [-1.5708|1.5708] "rad"  ADAS
 SG_ DET_AZIMUTH_ERR_322 : 224|7@1+ (0.00087267,0) [0|0.11082909] "rad"  ADAS
 SG_ DET_ELEVATION_322 : 192|8@1+ (0.00275,-0.34925) [-0.34925|0.34925] "rad"  ADAS
 SG_ DET_ELEVATION_ERR_322 : 200|6@1+ (0.00174533,0) [0|0.10995579] "rad"  ADAS
 SG_ DET_RCS_322 : 256|8@1+ (0.5,-64) [-64|63.5] "dBsm"  ADAS
 SG_ DET_VALID_FLAG_322 : 167|1@1+ (1,0) [0|1] ""  ADAS
 SG_ DET_BI_STATIC_FLAG_322 : 505|1@1+ (1,0) [0|1] ""  ADAS
 SG_ DET_SUPER_RES_TARGET_322 : 247|1@1+ (1,0) [0|1] ""  ADAS
 SG_ DET_SNR_322 : 248|8@1+ (0.35156,0) [0|89.6478] "dB"  ADAS
 SG_ DET_POINT_TARGET_PROB_322 : 240|4@1+ (6.67,0) [0|100] "%"  ADAS
 SG_ DET_EXISTENCE_PROB_322 : 232|6@1+ (1.588,0) [0|100] "%"  ADAS
 SG_ DET_OUTSIDE_SECTOR_322 : 183|1@1+ (1,0) [0|1] ""  ADAS
 SG_ DET_HVC_FLAG_322 : 246|1@1+ (1,0) [0|1] ""  ADAS
 SG_ DET_CONFD_AZIMUTH_322 : 206|2@1+ (1,0) [0|3] ""  ADAS
 SG_ DET_CONFD_ELEVATION_322 : 244|2@1+ (1,0) [0|3] ""  ADAS
 SG_ DET_RANGE_323 : 264|15@1+ (0.015625,0) [0|500] "m"  ADAS
 SG_ DET_RANGE_ERR_323 : 280|7@1+ (0.0075,0) [0|0.9525] "m"  ADAS
 SG_ DET_RANGE_VELOCITY_323 : 288|15@1+ (0.0078125,-128) [-128|127.9921875] "m/s"  ADAS
 SG_ DET_RANGE_VELOCITY_ERR_323 : 304|8@1+ (0.003,0) [0|0.765] "m/s"  ADAS
 SG_ DET_AZIMUTH_323 : 328|13@1+ (0.0004,-1.5708) [-1.5708|1.5708] "rad"  ADAS
 SG_ DET_AZIMUTH_ERR_323 : 345|7@1+ (0.00087267,0) [0|0.11082909] "rad"  ADAS
 SG_ DET_ELEVATION_323 : 312|8@1+ (0.00275,-0.34925) [-0.34925|0.34925] "rad"  ADAS
 SG_ DET_ELEVATION_ERR_323 : 320|6@1+ (0.00174533,0) [0|0.10995579] "rad"  ADAS
 SG_ DET_RCS_323 : 376|8@1+ (0.5,-64) [-64|63.5] "dBsm"  ADAS
 SG_ DET_VALID_FLAG_323 : 399|1@1+ (1,0) [0|1] ""  ADAS
 SG_ DET_BI_STATIC_FLAG_323 : 482|1@1+ (1,0) [0|1] ""  ADAS
 SG_ DET_SUPER_RES_TARGET_323 : 344|1@1+ (1,0) [0|1] ""  ADAS
 SG_ DET_SNR_323 : 368|8@1+ (0.35156,0) [0|89.6478] "dB"  ADAS
 SG_ DET_POINT_TARGET_PROB_323 : 360|4@1+ (6.67,0) [0|100] "%"  ADAS
 SG_ DET_EXISTENCE_PROB_323 : 352|6@1+ (1.588,0) [0|100] "%"  ADAS
 SG_ DET_OUTSIDE_SECTOR_323 : 407|1@1+ (1,0) [0|1] ""  ADAS
 SG_ DET_HVC_FLAG_323 : 364|1@1+ (1,0) [0|1] ""  ADAS
 SG_ DET_CONFD_AZIMUTH_323 : 365|2@1+ (1,0) [0|3] ""  ADAS
 SG_ DET_CONFD_ELEVATION_323 : 358|2@1+ (1,0) [0|3] ""  ADAS
 SG_ DET_RANGE_324 : 384|15@1+ (0.015625,0) [0|500] "m"  ADAS
 SG_ DET_RANGE_ERR_324 : 400|7@1+ (0.0075,0) [0|0.9525] "m"  ADAS
 SG_ DET_RANGE_VELOCITY_324 : 408|15@1+ (0.0078125,-128) [-128|127.9921875] "m/s"  ADAS
 SG_ DET_RANGE_VELOCITY_ERR_324 : 424|8@1+ (0.003,0) [0|0.765] "m/s"  ADAS
 SG_ DET_AZIMUTH_324 : 448|13@1+ (0.0004,-1.5708) [-1.5708|1.5708] "rad"  ADAS
 SG_ DET_AZIMUTH_ERR_324 : 465|7@1+ (0.00087267,0) [0|0.11082909] "rad"  ADAS
 SG_ DET_ELEVATION_324 : 432|8@1+ (0.00275,-0.34925) [-0.34925|0.34925] "rad"  ADAS
 SG_ DET_ELEVATION_ERR_324 : 440|6@1+ (0.00174533,0) [0|0.10995579] "rad"  ADAS
 SG_ DET_RCS_324 : 496|8@1+ (0.5,-64) [-64|63.5] "dBsm"  ADAS
 SG_ DET_VALID_FLAG_324 : 485|1@1+ (1,0) [0|1] ""  ADAS
 SG_ DET_BI_STATIC_FLAG_324 : 483|1@1+ (1,0) [0|1] ""  ADAS
 SG_ DET_SUPER_RES_TARGET_324 : 446|1@1+ (1,0) [0|1] ""  ADAS
 SG_ DET_SNR_324 : 488|8@1+ (0.35156,0) [0|89.6478] "dB"  ADAS
 SG_ DET_POINT_TARGET_PROB_324 : 472|4@1+ (6.67,0) [0|100] "%"  ADAS
 SG_ DET_EXISTENCE_PROB_324 : 506|6@1+ (1.588,0) [0|100] "%"  ADAS
 SG_ DET_OUTSIDE_SECTOR_324 : 481|1@1+ (1,0) [0|1] ""  ADAS
 SG_ DET_HVC_FLAG_324 : 464|1@1+ (1,0) [0|1] ""  ADAS
 SG_ DET_CONFD_AZIMUTH_324 : 486|2@1+ (1,0) [0|3] ""  ADAS
 SG_ DET_CONFD_ELEVATION_324 : 461|2@1+ (1,0) [0|3] ""  ADAS
 SG_ DET_MH_SCAN_INDEX_4LSB_321_324 : 476|4@1+ (1,0) [0|15] ""  ADAS
 SG_ DET_MH_CYCLE_COUNTER_321_324 : 16|8@1+ (1,0) [0|255] ""  ADAS
 SG_ DET_MH_CRC16_321_324 : 0|16@1+ (1,0) [0|65535] ""  ADAS

BO_ 1105 RDR_DETECTION_325_328: 64 RDR07
 SG_ DET_RANGE_325 : 24|15@1+ (0.015625,0) [0|500] "m"  ADAS
 SG_ DET_RANGE_ERR_325 : 40|7@1+ (0.0075,0) [0|0.9525] "m"  ADAS
 SG_ DET_RANGE_VELOCITY_325 : 48|15@1+ (0.0078125,-128) [-128|127.9921875] "m/s"  ADAS
 SG_ DET_RANGE_VELOCITY_ERR_325 : 64|8@1+ (0.003,0) [0|0.765] "m/s"  ADAS
 SG_ DET_AZIMUTH_325 : 88|13@1+ (0.0004,-1.5708) [-1.5708|1.5708] "rad"  ADAS
 SG_ DET_AZIMUTH_ERR_325 : 105|7@1+ (0.00087267,0) [0|0.11082909] "rad"  ADAS
 SG_ DET_ELEVATION_325 : 72|8@1+ (0.00275,-0.34925) [-0.34925|0.34925] "rad"  ADAS
 SG_ DET_ELEVATION_ERR_325 : 80|6@1+ (0.00174533,0) [0|0.10995579] "rad"  ADAS
 SG_ DET_RCS_325 : 136|8@1+ (0.5,-64) [-64|63.5] "dBsm"  ADAS
 SG_ DET_VALID_FLAG_325 : 119|1@1+ (1,0) [0|1] ""  ADAS
 SG_ DET_BI_STATIC_FLAG_325 : 504|1@1+ (1,0) [0|1] ""  ADAS
 SG_ DET_SUPER_RES_TARGET_325 : 104|1@1+ (1,0) [0|1] ""  ADAS
 SG_ DET_SNR_325 : 128|8@1+ (0.35156,0) [0|89.6478] "dB"  ADAS
 SG_ DET_POINT_TARGET_PROB_325 : 114|4@1+ (6.67,0) [0|100] "%"  ADAS
 SG_ DET_EXISTENCE_PROB_325 : 120|6@1+ (1.588,0) [0|100] "%"  ADAS
 SG_ DET_OUTSIDE_SECTOR_325 : 159|1@1+ (1,0) [0|1] ""  ADAS
 SG_ DET_HVC_FLAG_325 : 118|1@1+ (1,0) [0|1] ""  ADAS
 SG_ DET_CONFD_AZIMUTH_325 : 126|2@1+ (1,0) [0|3] ""  ADAS
 SG_ DET_CONFD_ELEVATION_325 : 112|2@1+ (1,0) [0|3] ""  ADAS
 SG_ DET_RANGE_326 : 144|15@1+ (0.015625,0) [0|500] "m"  ADAS
 SG_ DET_RANGE_ERR_326 : 160|7@1+ (0.0075,0) [0|0.9525] "m"  ADAS
 SG_ DET_RANGE_VELOCITY_326 : 168|15@1+ (0.0078125,-128) [-128|127.9921875] "m/s"  ADAS
 SG_ DET_RANGE_VELOCITY_ERR_326 : 184|8@1+ (0.003,0) [0|0.765] "m/s"  ADAS
 SG_ DET_AZIMUTH_326 : 208|13@1+ (0.0004,-1.5708) [-1.5708|1.5708] "rad"  ADAS
 SG_ DET_AZIMUTH_ERR_326 : 224|7@1+ (0.00087267,0) [0|0.11082909] "rad"  ADAS
 SG_ DET_ELEVATION_326 : 192|8@1+ (0.00275,-0.34925) [-0.34925|0.34925] "rad"  ADAS
 SG_ DET_ELEVATION_ERR_326 : 200|6@1+ (0.00174533,0) [0|0.10995579] "rad"  ADAS
 SG_ DET_RCS_326 : 256|8@1+ (0.5,-64) [-64|63.5] "dBsm"  ADAS
 SG_ DET_VALID_FLAG_326 : 167|1@1+ (1,0) [0|1] ""  ADAS
 SG_ DET_BI_STATIC_FLAG_326 : 505|1@1+ (1,0) [0|1] ""  ADAS
 SG_ DET_SUPER_RES_TARGET_326 : 247|1@1+ (1,0) [0|1] ""  ADAS
 SG_ DET_SNR_326 : 248|8@1+ (0.35156,0) [0|89.6478] "dB"  ADAS
 SG_ DET_POINT_TARGET_PROB_326 : 240|4@1+ (6.67,0) [0|100] "%"  ADAS
 SG_ DET_EXISTENCE_PROB_326 : 232|6@1+ (1.588,0) [0|100] "%"  ADAS
 SG_ DET_OUTSIDE_SECTOR_326 : 183|1@1+ (1,0) [0|1] ""  ADAS
 SG_ DET_HVC_FLAG_326 : 246|1@1+ (1,0) [0|1] ""  ADAS
 SG_ DET_CONFD_AZIMUTH_326 : 206|2@1+ (1,0) [0|3] ""  ADAS
 SG_ DET_CONFD_ELEVATION_326 : 244|2@1+ (1,0) [0|3] ""  ADAS
 SG_ DET_RANGE_327 : 264|15@1+ (0.015625,0) [0|500] "m"  ADAS
 SG_ DET_RANGE_ERR_327 : 280|7@1+ (0.0075,0) [0|0.9525] "m"  ADAS
 SG_ DET_RANGE_VELOCITY_327 : 288|15@1+ (0.0078125,-128) [-128|127.9921875] "m/s"  ADAS
 SG_ DET_RANGE_VELOCITY_ERR_327 : 304|8@1+ (0.003,0) [0|0.765] "m/s"  ADAS
 SG_ DET_AZIMUTH_327 : 328|13@1+ (0.0004,-1.5708) [-1.5708|1.5708] "rad"  ADAS
 SG_ DET_AZIMUTH_ERR_327 : 345|7@1+ (0.00087267,0) [0|0.11082909] "rad"  ADAS
 SG_ DET_ELEVATION_327 : 312|8@1+ (0.00275,-0.34925) [-0.34925|0.34925] "rad"  ADAS
 SG_ DET_ELEVATION_ERR_327 : 320|6@1+ (0.00174533,0) [0|0.10995579] "rad"  ADAS
 SG_ DET_RCS_327 : 376|8@1+ (0.5,-64) [-64|63.5] "dBsm"  ADAS
 SG_ DET_VALID_FLAG_327 : 399|1@1+ (1,0) [0|1] ""  ADAS
 SG_ DET_BI_STATIC_FLAG_327 : 482|1@1+ (1,0) [0|1] ""  ADAS
 SG_ DET_SUPER_RES_TARGET_327 : 344|1@1+ (1,0) [0|1] ""  ADAS
 SG_ DET_SNR_327 : 368|8@1+ (0.35156,0) [0|89.6478] "dB"  ADAS
 SG_ DET_POINT_TARGET_PROB_327 : 360|4@1+ (6.67,0) [0|100] "%"  ADAS
 SG_ DET_EXISTENCE_PROB_327 : 352|6@1+ (1.588,0) [0|100] "%"  ADAS
 SG_ DET_OUTSIDE_SECTOR_327 : 407|1@1+ (1,0) [0|1] ""  ADAS
 SG_ DET_HVC_FLAG_327 : 364|1@1+ (1,0) [0|1] ""  ADAS
 SG_ DET_CONFD_AZIMUTH_327 : 365|2@1+ (1,0) [0|3] ""  ADAS
 SG_ DET_CONFD_ELEVATION_327 : 358|2@1+ (1,0) [0|3] ""  ADAS
 SG_ DET_RANGE_328 : 384|15@1+ (0.015625,0) [0|500] "m"  ADAS
 SG_ DET_RANGE_ERR_328 : 400|7@1+ (0.0075,0) [0|0.9525] "m"  ADAS
 SG_ DET_RANGE_VELOCITY_328 : 408|15@1+ (0.0078125,-128) [-128|127.9921875] "m/s"  ADAS
 SG_ DET_RANGE_VELOCITY_ERR_328 : 424|8@1+ (0.003,0) [0|0.765] "m/s"  ADAS
 SG_ DET_AZIMUTH_328 : 448|13@1+ (0.0004,-1.5708) [-1.5708|1.5708] "rad"  ADAS
 SG_ DET_AZIMUTH_ERR_328 : 465|7@1+ (0.00087267,0) [0|0.11082909] "rad"  ADAS
 SG_ DET_ELEVATION_328 : 432|8@1+ (0.00275,-0.34925) [-0.34925|0.34925] "rad"  ADAS
 SG_ DET_ELEVATION_ERR_328 : 440|6@1+ (0.00174533,0) [0|0.10995579] "rad"  ADAS
 SG_ DET_RCS_328 : 496|8@1+ (0.5,-64) [-64|63.5] "dBsm"  ADAS
 SG_ DET_VALID_FLAG_328 : 485|1@1+ (1,0) [0|1] ""  ADAS
 SG_ DET_BI_STATIC_FLAG_328 : 483|1@1+ (1,0) [0|1] ""  ADAS
 SG_ DET_SUPER_RES_TARGET_328 : 446|1@1+ (1,0) [0|1] ""  ADAS
 SG_ DET_SNR_328 : 488|8@1+ (0.35156,0) [0|89.6478] "dB"  ADAS
 SG_ DET_POINT_TARGET_PROB_328 : 472|4@1+ (6.67,0) [0|100] "%"  ADAS
 SG_ DET_EXISTENCE_PROB_328 : 506|6@1+ (1.588,0) [0|100] "%"  ADAS
 SG_ DET_OUTSIDE_SECTOR_328 : 481|1@1+ (1,0) [0|1] ""  ADAS
 SG_ DET_HVC_FLAG_328 : 464|1@1+ (1,0) [0|1] ""  ADAS
 SG_ DET_CONFD_AZIMUTH_328 : 486|2@1+ (1,0) [0|3] ""  ADAS
 SG_ DET_CONFD_ELEVATION_328 : 461|2@1+ (1,0) [0|3] ""  ADAS
 SG_ DET_MH_SCAN_INDEX_4LSB_325_328 : 476|4@1+ (1,0) [0|15] ""  ADAS
 SG_ DET_MH_CYCLE_COUNTER_325_328 : 16|8@1+ (1,0) [0|255] ""  ADAS
 SG_ DET_MH_CRC16_325_328 : 0|16@1+ (1,0) [0|65535] ""  ADAS

BO_ 1106 RDR_DETECTION_329_332: 64 RDR07
 SG_ DET_RANGE_329 : 24|15@1+ (0.015625,0) [0|500] "m"  ADAS
 SG_ DET_RANGE_ERR_329 : 40|7@1+ (0.0075,0) [0|0.9525] "m"  ADAS
 SG_ DET_RANGE_VELOCITY_329 : 48|15@1+ (0.0078125,-128) [-128|127.9921875] "m/s"  ADAS
 SG_ DET_RANGE_VELOCITY_ERR_329 : 64|8@1+ (0.003,0) [0|0.765] "m/s"  ADAS
 SG_ DET_AZIMUTH_329 : 88|13@1+ (0.0004,-1.5708) [-1.5708|1.5708] "rad"  ADAS
 SG_ DET_AZIMUTH_ERR_329 : 105|7@1+ (0.00087267,0) [0|0.11082909] "rad"  ADAS
 SG_ DET_ELEVATION_329 : 72|8@1+ (0.00275,-0.34925) [-0.34925|0.34925] "rad"  ADAS
 SG_ DET_ELEVATION_ERR_329 : 80|6@1+ (0.00174533,0) [0|0.10995579] "rad"  ADAS
 SG_ DET_RCS_329 : 136|8@1+ (0.5,-64) [-64|63.5] "dBsm"  ADAS
 SG_ DET_VALID_FLAG_329 : 119|1@1+ (1,0) [0|1] ""  ADAS
 SG_ DET_BI_STATIC_FLAG_329 : 504|1@1+ (1,0) [0|1] ""  ADAS
 SG_ DET_SUPER_RES_TARGET_329 : 104|1@1+ (1,0) [0|1] ""  ADAS
 SG_ DET_SNR_329 : 128|8@1+ (0.35156,0) [0|89.6478] "dB"  ADAS
 SG_ DET_POINT_TARGET_PROB_329 : 114|4@1+ (6.67,0) [0|100] "%"  ADAS
 SG_ DET_EXISTENCE_PROB_329 : 120|6@1+ (1.588,0) [0|100] "%"  ADAS
 SG_ DET_OUTSIDE_SECTOR_329 : 159|1@1+ (1,0) [0|1] ""  ADAS
 SG_ DET_HVC_FLAG_329 : 118|1@1+ (1,0) [0|1] ""  ADAS
 SG_ DET_CONFD_AZIMUTH_329 : 126|2@1+ (1,0) [0|3] ""  ADAS
 SG_ DET_CONFD_ELEVATION_329 : 112|2@1+ (1,0) [0|3] ""  ADAS
 SG_ DET_RANGE_330 : 144|15@1+ (0.015625,0) [0|500] "m"  ADAS
 SG_ DET_RANGE_ERR_330 : 160|7@1+ (0.0075,0) [0|0.9525] "m"  ADAS
 SG_ DET_RANGE_VELOCITY_330 : 168|15@1+ (0.0078125,-128) [-128|127.9921875] "m/s"  ADAS
 SG_ DET_RANGE_VELOCITY_ERR_330 : 184|8@1+ (0.003,0) [0|0.765] "m/s"  ADAS
 SG_ DET_AZIMUTH_330 : 208|13@1+ (0.0004,-1.5708) [-1.5708|1.5708] "rad"  ADAS
 SG_ DET_AZIMUTH_ERR_330 : 224|7@1+ (0.00087267,0) [0|0.11082909] "rad"  ADAS
 SG_ DET_ELEVATION_330 : 192|8@1+ (0.00275,-0.34925) [-0.34925|0.34925] "rad"  ADAS
 SG_ DET_ELEVATION_ERR_330 : 200|6@1+ (0.00174533,0) [0|0.10995579] "rad"  ADAS
 SG_ DET_RCS_330 : 256|8@1+ (0.5,-64) [-64|63.5] "dBsm"  ADAS
 SG_ DET_VALID_FLAG_330 : 167|1@1+ (1,0) [0|1] ""  ADAS
 SG_ DET_BI_STATIC_FLAG_330 : 505|1@1+ (1,0) [0|1] ""  ADAS
 SG_ DET_SUPER_RES_TARGET_330 : 247|1@1+ (1,0) [0|1] ""  ADAS
 SG_ DET_SNR_330 : 248|8@1+ (0.35156,0) [0|89.6478] "dB"  ADAS
 SG_ DET_POINT_TARGET_PROB_330 : 240|4@1+ (6.67,0) [0|100] "%"  ADAS
 SG_ DET_EXISTENCE_PROB_330 : 232|6@1+ (1.588,0) [0|100] "%"  ADAS
 SG_ DET_OUTSIDE_SECTOR_330 : 183|1@1+ (1,0) [0|1] ""  ADAS
 SG_ DET_HVC_FLAG_330 : 246|1@1+ (1,0) [0|1] ""  ADAS
 SG_ DET_CONFD_AZIMUTH_330 : 206|2@1+ (1,0) [0|3] ""  ADAS
 SG_ DET_CONFD_ELEVATION_330 : 244|2@1+ (1,0) [0|3] ""  ADAS
 SG_ DET_RANGE_331 : 264|15@1+ (0.015625,0) [0|500] "m"  ADAS
 SG_ DET_RANGE_ERR_331 : 280|7@1+ (0.0075,0) [0|0.9525] "m"  ADAS
 SG_ DET_RANGE_VELOCITY_331 : 288|15@1+ (0.0078125,-128) [-128|127.9921875] "m/s"  ADAS
 SG_ DET_RANGE_VELOCITY_ERR_331 : 304|8@1+ (0.003,0) [0|0.765] "m/s"  ADAS
 SG_ DET_AZIMUTH_331 : 328|13@1+ (0.0004,-1.5708) [-1.5708|1.5708] "rad"  ADAS
 SG_ DET_AZIMUTH_ERR_331 : 345|7@1+ (0.00087267,0) [0|0.11082909] "rad"  ADAS
 SG_ DET_ELEVATION_331 : 312|8@1+ (0.00275,-0.34925) [-0.34925|0.34925] "rad"  ADAS
 SG_ DET_ELEVATION_ERR_331 : 320|6@1+ (0.00174533,0) [0|0.10995579] "rad"  ADAS
 SG_ DET_RCS_331 : 376|8@1+ (0.5,-64) [-64|63.5] "dBsm"  ADAS
 SG_ DET_VALID_FLAG_331 : 399|1@1+ (1,0) [0|1] ""  ADAS
 SG_ DET_BI_STATIC_FLAG_331 : 482|1@1+ (1,0) [0|1] ""  ADAS
 SG_ DET_SUPER_RES_TARGET_331 : 344|1@1+ (1,0) [0|1] ""  ADAS
 SG_ DET_SNR_331 : 368|8@1+ (0.35156,0) [0|89.6478] "dB"  ADAS
 SG_ DET_POINT_TARGET_PROB_331 : 360|4@1+ (6.67,0) [0|100] "%"  ADAS
 SG_ DET_EXISTENCE_PROB_331 : 352|6@1+ (1.588,0) [0|100] "%"  ADAS
 SG_ DET_OUTSIDE_SECTOR_331 : 407|1@1+ (1,0) [0|1] ""  ADAS
 SG_ DET_HVC_FLAG_331 : 364|1@1+ (1,0) [0|1] ""  ADAS
 SG_ DET_CONFD_AZIMUTH_331 : 365|2@1+ (1,0) [0|3] ""  ADAS
 SG_ DET_CONFD_ELEVATION_331 : 358|2@1+ (1,0) [0|3] ""  ADAS
 SG_ DET_RANGE_332 : 384|15@1+ (0.015625,0) [0|500] "m"  ADAS
 SG_ DET_RANGE_ERR_332 : 400|7@1+ (0.0075,0) [0|0.9525] "m"  ADAS
 SG_ DET_RANGE_VELOCITY_332 : 408|15@1+ (0.0078125,-128) [-128|127.9921875] "m/s"  ADAS
 SG_ DET_RANGE_VELOCITY_ERR_332 : 424|8@1+ (0.003,0) [0|0.765] "m/s"  ADAS
 SG_ DET_AZIMUTH_332 : 448|13@1+ (0.0004,-1.5708) [-1.5708|1.5708] "rad"  ADAS
 SG_ DET_AZIMUTH_ERR_332 : 465|7@1+ (0.00087267,0) [0|0.11082909] "rad"  ADAS
 SG_ DET_ELEVATION_332 : 432|8@1+ (0.00275,-0.34925) [-0.34925|0.34925] "rad"  ADAS
 SG_ DET_ELEVATION_ERR_332 : 440|6@1+ (0.00174533,0) [0|0.10995579] "rad"  ADAS
 SG_ DET_RCS_332 : 496|8@1+ (0.5,-64) [-64|63.5] "dBsm"  ADAS
 SG_ DET_VALID_FLAG_332 : 485|1@1+ (1,0) [0|1] ""  ADAS
 SG_ DET_BI_STATIC_FLAG_332 : 483|1@1+ (1,0) [0|1] ""  ADAS
 SG_ DET_SUPER_RES_TARGET_332 : 446|1@1+ (1,0) [0|1] ""  ADAS
 SG_ DET_SNR_332 : 488|8@1+ (0.35156,0) [0|89.6478] "dB"  ADAS
 SG_ DET_POINT_TARGET_PROB_332 : 472|4@1+ (6.67,0) [0|100] "%"  ADAS
 SG_ DET_EXISTENCE_PROB_332 : 506|6@1+ (1.588,0) [0|100] "%"  ADAS
 SG_ DET_OUTSIDE_SECTOR_332 : 481|1@1+ (1,0) [0|1] ""  ADAS
 SG_ DET_HVC_FLAG_332 : 464|1@1+ (1,0) [0|1] ""  ADAS
 SG_ DET_CONFD_AZIMUTH_332 : 486|2@1+ (1,0) [0|3] ""  ADAS
 SG_ DET_CONFD_ELEVATION_332 : 461|2@1+ (1,0) [0|3] ""  ADAS
 SG_ DET_MH_SCAN_INDEX_4LSB_329_332 : 476|4@1+ (1,0) [0|15] ""  ADAS
 SG_ DET_MH_CYCLE_COUNTER_329_332 : 16|8@1+ (1,0) [0|255] ""  ADAS
 SG_ DET_MH_CRC16_329_332 : 0|16@1+ (1,0) [0|65535] ""  ADAS

CM_ SG_ 1089 DET_RANGE_261 " measured position  of the detection";
CM_ SG_ 1089 DET_RANGE_ERR_261 "RMSE or standard deviation of the measured angle  of the detection";
CM_ SG_ 1089 DET_RANGE_VELOCITY_261 "Radial velocity of the detection positive in direction to the sensor";
CM_ SG_ 1089 DET_RANGE_VELOCITY_ERR_261 "RMSE or standard deviation of the measure radial velocity of the detection";
CM_ SG_ 1089 DET_AZIMUTH_261 "Measured angle  of the detection";
CM_ SG_ 1089 DET_AZIMUTH_ERR_261 "RMSE or standard deviation of the measured angle  of the detection";
CM_ SG_ 1089 DET_ELEVATION_261 "measured elevation of the detection";
CM_ SG_ 1089 DET_ELEVATION_ERR_261 "RMSE or standard deviation of the measured elevation  of the detection";
CM_ SG_ 1089 DET_RCS_261 "Radar Cross Section or Amplitude, is a measure of how detectable an object is by radar. A larger RCS indicates that an object is more easily detected.";
CM_ SG_ 1089 DET_VALID_FLAG_261 "is set if the measured detection is valid";
CM_ SG_ 1089 DET_BI_STATIC_FLAG_261 "1 if detection is bi-static 0 otherwise";
CM_ SG_ 1089 DET_SUPER_RES_TARGET_261 "flasg is set if the detection is super resolution target";
CM_ SG_ 1089 DET_SNR_261 "The signal to noise ratio (SNR) of the radar detection";
CM_ SG_ 1089 DET_POINT_TARGET_PROB_261 "Describes the possibility if more than one real-world object has led to this detection. 0[%] := 100[%] Multi target probability";
CM_ SG_ 1089 DET_EXISTENCE_PROB_261 "Existence probability of the detection not based on history. Value does  not depend on any past experience with similar detections.
\note Use as confidence measure where a low value means less confidence
and a high value indicates strong confidence.";
CM_ SG_ 1089 DET_OUTSIDE_SECTOR_261 "Flag to indicate detections outside the sector, set if the wrong sector calibration matrix was used";
CM_ SG_ 1089 DET_HVC_FLAG_261 "Core2 Vehicle clutter flag";
CM_ SG_ 1089 DET_CONFD_AZIMUTH_261 "Define the Confidence of Azimuth for Detection ";
CM_ SG_ 1089 DET_CONFD_ELEVATION_261 "Define the Confidence of Elevation for the Detection ";
CM_ SG_ 1089 DET_BI_STATIC_FLAG_262 "1 if detection is bi-static 0 otherwise";
CM_ SG_ 1089 DET_BI_STATIC_FLAG_263 "1 if detection is bi-static 0 otherwise";
CM_ SG_ 1089 DET_BI_STATIC_FLAG_264 "1 if detection is bi-static 0 otherwise";
CM_ SG_ 1089 DET_MH_SCAN_INDEX_4LSB_261_264 "Scan index of the measured detection";
CM_ SG_ 1089 DET_MH_CYCLE_COUNTER_261_264 "Detection Alive Counter";
CM_ SG_ 1090 DET_RANGE_265 " measured position  of the detection";
CM_ SG_ 1090 DET_RANGE_ERR_265 "RMSE or standard deviation of the measured angle  of the detection";
CM_ SG_ 1090 DET_RANGE_VELOCITY_265 "Radial velocity of the detection positive in direction to the sensor";
CM_ SG_ 1090 DET_RANGE_VELOCITY_ERR_265 "RMSE or standard deviation of the measure radial velocity of the detection";
CM_ SG_ 1090 DET_AZIMUTH_265 "Measured angle  of the detection";
CM_ SG_ 1090 DET_AZIMUTH_ERR_265 "RMSE or standard deviation of the measured angle  of the detection";
CM_ SG_ 1090 DET_ELEVATION_265 "measured elevation of the detection";
CM_ SG_ 1090 DET_ELEVATION_ERR_265 "RMSE or standard deviation of the measured elevation  of the detection";
CM_ SG_ 1090 DET_RCS_265 "Radar Cross Section or Amplitude, is a measure of how detectable an object is by radar. A larger RCS indicates that an object is more easily detected.";
CM_ SG_ 1090 DET_VALID_FLAG_265 "is set if the measured detection is valid";
CM_ SG_ 1090 DET_BI_STATIC_FLAG_265 "1 if detection is bi-static 0 otherwise";
CM_ SG_ 1090 DET_SUPER_RES_TARGET_265 "flasg is set if the detection is super resolution target";
CM_ SG_ 1090 DET_SNR_265 "The signal to noise ratio (SNR) of the radar detection";
CM_ SG_ 1090 DET_POINT_TARGET_PROB_265 "Describes the possibility if more than one real-world object has led to this detection. 0[%] := 100[%] Multi target probability";
CM_ SG_ 1090 DET_EXISTENCE_PROB_265 "Existence probability of the detection not based on history. Value does  not depend on any past experience with similar detections.
\note Use as confidence measure where a low value means less confidence
and a high value indicates strong confidence.";
CM_ SG_ 1090 DET_OUTSIDE_SECTOR_265 "Flag to indicate detections outside the sector, set if the wrong sector calibration matrix was used";
CM_ SG_ 1090 DET_HVC_FLAG_265 "Core2 Vehicle clutter flag";
CM_ SG_ 1090 DET_CONFD_AZIMUTH_265 "Define the Confidence of Azimuth for Detection ";
CM_ SG_ 1090 DET_CONFD_ELEVATION_265 "Define the Confidence of Elevation for the Detection ";
CM_ SG_ 1090 DET_BI_STATIC_FLAG_266 "1 if detection is bi-static 0 otherwise";
CM_ SG_ 1090 DET_BI_STATIC_FLAG_267 "1 if detection is bi-static 0 otherwise";
CM_ SG_ 1090 DET_BI_STATIC_FLAG_268 "1 if detection is bi-static 0 otherwise";
CM_ SG_ 1090 DET_MH_SCAN_INDEX_4LSB_265_268 "Scan index of the measured detection";
CM_ SG_ 1090 DET_MH_CYCLE_COUNTER_265_268 "Detection Alive Counter";
CM_ SG_ 1091 DET_RANGE_269 " measured position  of the detection";
CM_ SG_ 1091 DET_RANGE_ERR_269 "RMSE or standard deviation of the measured angle  of the detection";
CM_ SG_ 1091 DET_RANGE_VELOCITY_269 "Radial velocity of the detection positive in direction to the sensor";
CM_ SG_ 1091 DET_RANGE_VELOCITY_ERR_269 "RMSE or standard deviation of the measure radial velocity of the detection";
CM_ SG_ 1091 DET_AZIMUTH_269 "Measured angle  of the detection";
CM_ SG_ 1091 DET_AZIMUTH_ERR_269 "RMSE or standard deviation of the measured angle  of the detection";
CM_ SG_ 1091 DET_ELEVATION_269 "measured elevation of the detection";
CM_ SG_ 1091 DET_ELEVATION_ERR_269 "RMSE or standard deviation of the measured elevation  of the detection";
CM_ SG_ 1091 DET_RCS_269 "Radar Cross Section or Amplitude, is a measure of how detectable an object is by radar. A larger RCS indicates that an object is more easily detected.";
CM_ SG_ 1091 DET_VALID_FLAG_269 "is set if the measured detection is valid";
CM_ SG_ 1091 DET_BI_STATIC_FLAG_269 "1 if detection is bi-static 0 otherwise";
CM_ SG_ 1091 DET_SUPER_RES_TARGET_269 "flasg is set if the detection is super resolution target";
CM_ SG_ 1091 DET_SNR_269 "The signal to noise ratio (SNR) of the radar detection";
CM_ SG_ 1091 DET_POINT_TARGET_PROB_269 "Describes the possibility if more than one real-world object has led to this detection. 0[%] := 100[%] Multi target probability";
CM_ SG_ 1091 DET_EXISTENCE_PROB_269 "Existence probability of the detection not based on history. Value does  not depend on any past experience with similar detections.
\note Use as confidence measure where a low value means less confidence
and a high value indicates strong confidence.";
CM_ SG_ 1091 DET_OUTSIDE_SECTOR_269 "Flag to indicate detections outside the sector, set if the wrong sector calibration matrix was used";
CM_ SG_ 1091 DET_HVC_FLAG_269 "Core2 Vehicle clutter flag";
CM_ SG_ 1091 DET_CONFD_AZIMUTH_269 "Define the Confidence of Azimuth for Detection ";
CM_ SG_ 1091 DET_CONFD_ELEVATION_269 "Define the Confidence of Elevation for the Detection ";
CM_ SG_ 1091 DET_BI_STATIC_FLAG_270 "1 if detection is bi-static 0 otherwise";
CM_ SG_ 1091 DET_BI_STATIC_FLAG_271 "1 if detection is bi-static 0 otherwise";
CM_ SG_ 1091 DET_BI_STATIC_FLAG_272 "1 if detection is bi-static 0 otherwise";
CM_ SG_ 1091 DET_MH_SCAN_INDEX_4LSB_269_272 "Scan index of the measured detection";
CM_ SG_ 1091 DET_MH_CYCLE_COUNTER_269_272 "Detection Alive Counter";
CM_ SG_ 1092 DET_RANGE_273 " measured position  of the detection";
CM_ SG_ 1092 DET_RANGE_ERR_273 "RMSE or standard deviation of the measured angle  of the detection";
CM_ SG_ 1092 DET_RANGE_VELOCITY_273 "Radial velocity of the detection positive in direction to the sensor";
CM_ SG_ 1092 DET_RANGE_VELOCITY_ERR_273 "RMSE or standard deviation of the measure radial velocity of the detection";
CM_ SG_ 1092 DET_AZIMUTH_273 "Measured angle  of the detection";
CM_ SG_ 1092 DET_AZIMUTH_ERR_273 "RMSE or standard deviation of the measured angle  of the detection";
CM_ SG_ 1092 DET_ELEVATION_273 "measured elevation of the detection";
CM_ SG_ 1092 DET_ELEVATION_ERR_273 "RMSE or standard deviation of the measured elevation  of the detection";
CM_ SG_ 1092 DET_RCS_273 "Radar Cross Section or Amplitude, is a measure of how detectable an object is by radar. A larger RCS indicates that an object is more easily detected.";
CM_ SG_ 1092 DET_VALID_FLAG_273 "is set if the measured detection is valid";
CM_ SG_ 1092 DET_BI_STATIC_FLAG_273 "1 if detection is bi-static 0 otherwise";
CM_ SG_ 1092 DET_SUPER_RES_TARGET_273 "flasg is set if the detection is super resolution target";
CM_ SG_ 1092 DET_SNR_273 "The signal to noise ratio (SNR) of the radar detection";
CM_ SG_ 1092 DET_POINT_TARGET_PROB_273 "Describes the possibility if more than one real-world object has led to this detection. 0[%] := 100[%] Multi target probability";
CM_ SG_ 1092 DET_EXISTENCE_PROB_273 "Existence probability of the detection not based on history. Value does  not depend on any past experience with similar detections.
\note Use as confidence measure where a low value means less confidence
and a high value indicates strong confidence.";
CM_ SG_ 1092 DET_OUTSIDE_SECTOR_273 "Flag to indicate detections outside the sector, set if the wrong sector calibration matrix was used";
CM_ SG_ 1092 DET_HVC_FLAG_273 "Core2 Vehicle clutter flag";
CM_ SG_ 1092 DET_CONFD_AZIMUTH_273 "Define the Confidence of Azimuth for Detection ";
CM_ SG_ 1092 DET_CONFD_ELEVATION_273 "Define the Confidence of Elevation for the Detection ";
CM_ SG_ 1092 DET_BI_STATIC_FLAG_274 "1 if detection is bi-static 0 otherwise";
CM_ SG_ 1092 DET_BI_STATIC_FLAG_275 "1 if detection is bi-static 0 otherwise";
CM_ SG_ 1092 DET_BI_STATIC_FLAG_276 "1 if detection is bi-static 0 otherwise";
CM_ SG_ 1092 DET_MH_SCAN_INDEX_4LSB_273_276 "Scan index of the measured detection";
CM_ SG_ 1092 DET_MH_CYCLE_COUNTER_273_276 "Detection Alive Counter";
CM_ SG_ 1093 DET_RANGE_277 " measured position  of the detection";
CM_ SG_ 1093 DET_RANGE_ERR_277 "RMSE or standard deviation of the measured angle  of the detection";
CM_ SG_ 1093 DET_RANGE_VELOCITY_277 "Radial velocity of the detection positive in direction to the sensor";
CM_ SG_ 1093 DET_RANGE_VELOCITY_ERR_277 "RMSE or standard deviation of the measure radial velocity of the detection";
CM_ SG_ 1093 DET_AZIMUTH_277 "Measured angle  of the detection";
CM_ SG_ 1093 DET_AZIMUTH_ERR_277 "RMSE or standard deviation of the measured angle  of the detection";
CM_ SG_ 1093 DET_ELEVATION_277 "measured elevation of the detection";
CM_ SG_ 1093 DET_ELEVATION_ERR_277 "RMSE or standard deviation of the measured elevation  of the detection";
CM_ SG_ 1093 DET_RCS_277 "Radar Cross Section or Amplitude, is a measure of how detectable an object is by radar. A larger RCS indicates that an object is more easily detected.";
CM_ SG_ 1093 DET_VALID_FLAG_277 "is set if the measured detection is valid";
CM_ SG_ 1093 DET_BI_STATIC_FLAG_277 "1 if detection is bi-static 0 otherwise";
CM_ SG_ 1093 DET_SUPER_RES_TARGET_277 "flasg is set if the detection is super resolution target";
CM_ SG_ 1093 DET_SNR_277 "The signal to noise ratio (SNR) of the radar detection";
CM_ SG_ 1093 DET_POINT_TARGET_PROB_277 "Describes the possibility if more than one real-world object has led to this detection. 0[%] := 100[%] Multi target probability";
CM_ SG_ 1093 DET_EXISTENCE_PROB_277 "Existence probability of the detection not based on history. Value does  not depend on any past experience with similar detections.
\note Use as confidence measure where a low value means less confidence
and a high value indicates strong confidence.";
CM_ SG_ 1093 DET_OUTSIDE_SECTOR_277 "Flag to indicate detections outside the sector, set if the wrong sector calibration matrix was used";
CM_ SG_ 1093 DET_HVC_FLAG_277 "Core2 Vehicle clutter flag";
CM_ SG_ 1093 DET_CONFD_AZIMUTH_277 "Define the Confidence of Azimuth for Detection ";
CM_ SG_ 1093 DET_CONFD_ELEVATION_277 "Define the Confidence of Elevation for the Detection ";
CM_ SG_ 1093 DET_BI_STATIC_FLAG_278 "1 if detection is bi-static 0 otherwise";
CM_ SG_ 1093 DET_BI_STATIC_FLAG_279 "1 if detection is bi-static 0 otherwise";
CM_ SG_ 1093 DET_BI_STATIC_FLAG_280 "1 if detection is bi-static 0 otherwise";
CM_ SG_ 1093 DET_MH_SCAN_INDEX_4LSB_277_280 "Scan index of the measured detection";
CM_ SG_ 1093 DET_MH_CYCLE_COUNTER_277_280 "Detection Alive Counter";
CM_ SG_ 1094 DET_RANGE_281 " measured position  of the detection";
CM_ SG_ 1094 DET_RANGE_ERR_281 "RMSE or standard deviation of the measured angle  of the detection";
CM_ SG_ 1094 DET_RANGE_VELOCITY_281 "Radial velocity of the detection positive in direction to the sensor";
CM_ SG_ 1094 DET_RANGE_VELOCITY_ERR_281 "RMSE or standard deviation of the measure radial velocity of the detection";
CM_ SG_ 1094 DET_AZIMUTH_281 "Measured angle  of the detection";
CM_ SG_ 1094 DET_AZIMUTH_ERR_281 "RMSE or standard deviation of the measured angle  of the detection";
CM_ SG_ 1094 DET_ELEVATION_281 "measured elevation of the detection";
CM_ SG_ 1094 DET_ELEVATION_ERR_281 "RMSE or standard deviation of the measured elevation  of the detection";
CM_ SG_ 1094 DET_RCS_281 "Radar Cross Section or Amplitude, is a measure of how detectable an object is by radar. A larger RCS indicates that an object is more easily detected.";
CM_ SG_ 1094 DET_VALID_FLAG_281 "is set if the measured detection is valid";
CM_ SG_ 1094 DET_BI_STATIC_FLAG_281 "1 if detection is bi-static 0 otherwise";
CM_ SG_ 1094 DET_SUPER_RES_TARGET_281 "flasg is set if the detection is super resolution target";
CM_ SG_ 1094 DET_SNR_281 "The signal to noise ratio (SNR) of the radar detection";
CM_ SG_ 1094 DET_POINT_TARGET_PROB_281 "Describes the possibility if more than one real-world object has led to this detection. 0[%] := 100[%] Multi target probability";
CM_ SG_ 1094 DET_EXISTENCE_PROB_281 "Existence probability of the detection not based on history. Value does  not depend on any past experience with similar detections.
\note Use as confidence measure where a low value means less confidence
and a high value indicates strong confidence.";
CM_ SG_ 1094 DET_OUTSIDE_SECTOR_281 "Flag to indicate detections outside the sector, set if the wrong sector calibration matrix was used";
CM_ SG_ 1094 DET_HVC_FLAG_281 "Core2 Vehicle clutter flag";
CM_ SG_ 1094 DET_CONFD_AZIMUTH_281 "Define the Confidence of Azimuth for Detection ";
CM_ SG_ 1094 DET_CONFD_ELEVATION_281 "Define the Confidence of Elevation for the Detection ";
CM_ SG_ 1094 DET_BI_STATIC_FLAG_282 "1 if detection is bi-static 0 otherwise";
CM_ SG_ 1094 DET_BI_STATIC_FLAG_283 "1 if detection is bi-static 0 otherwise";
CM_ SG_ 1094 DET_BI_STATIC_FLAG_284 "1 if detection is bi-static 0 otherwise";
CM_ SG_ 1094 DET_MH_SCAN_INDEX_4LSB_281_284 "Scan index of the measured detection";
CM_ SG_ 1094 DET_MH_CYCLE_COUNTER_281_284 "Detection Alive Counter";
CM_ SG_ 1095 DET_RANGE_285 " measured position  of the detection";
CM_ SG_ 1095 DET_RANGE_ERR_285 "RMSE or standard deviation of the measured angle  of the detection";
CM_ SG_ 1095 DET_RANGE_VELOCITY_285 "Radial velocity of the detection positive in direction to the sensor";
CM_ SG_ 1095 DET_RANGE_VELOCITY_ERR_285 "RMSE or standard deviation of the measure radial velocity of the detection";
CM_ SG_ 1095 DET_AZIMUTH_285 "Measured angle  of the detection";
CM_ SG_ 1095 DET_AZIMUTH_ERR_285 "RMSE or standard deviation of the measured angle  of the detection";
CM_ SG_ 1095 DET_ELEVATION_285 "measured elevation of the detection";
CM_ SG_ 1095 DET_ELEVATION_ERR_285 "RMSE or standard deviation of the measured elevation  of the detection";
CM_ SG_ 1095 DET_RCS_285 "Radar Cross Section or Amplitude, is a measure of how detectable an object is by radar. A larger RCS indicates that an object is more easily detected.";
CM_ SG_ 1095 DET_VALID_FLAG_285 "is set if the measured detection is valid";
CM_ SG_ 1095 DET_BI_STATIC_FLAG_285 "1 if detection is bi-static 0 otherwise";
CM_ SG_ 1095 DET_SUPER_RES_TARGET_285 "flasg is set if the detection is super resolution target";
CM_ SG_ 1095 DET_SNR_285 "The signal to noise ratio (SNR) of the radar detection";
CM_ SG_ 1095 DET_POINT_TARGET_PROB_285 "Describes the possibility if more than one real-world object has led to this detection. 0[%] := 100[%] Multi target probability";
CM_ SG_ 1095 DET_EXISTENCE_PROB_285 "Existence probability of the detection not based on history. Value does  not depend on any past experience with similar detections.
\note Use as confidence measure where a low value means less confidence
and a high value indicates strong confidence.";
CM_ SG_ 1095 DET_OUTSIDE_SECTOR_285 "Flag to indicate detections outside the sector, set if the wrong sector calibration matrix was used";
CM_ SG_ 1095 DET_HVC_FLAG_285 "Core2 Vehicle clutter flag";
CM_ SG_ 1095 DET_CONFD_AZIMUTH_285 "Define the Confidence of Azimuth for Detection ";
CM_ SG_ 1095 DET_CONFD_ELEVATION_285 "Define the Confidence of Elevation for the Detection ";
CM_ SG_ 1095 DET_BI_STATIC_FLAG_286 "1 if detection is bi-static 0 otherwise";
CM_ SG_ 1095 DET_BI_STATIC_FLAG_287 "1 if detection is bi-static 0 otherwise";
CM_ SG_ 1095 DET_BI_STATIC_FLAG_288 "1 if detection is bi-static 0 otherwise";
CM_ SG_ 1095 DET_MH_SCAN_INDEX_4LSB_285_288 "Scan index of the measured detection";
CM_ SG_ 1095 DET_MH_CYCLE_COUNTER_285_288 "Detection Alive Counter";
CM_ SG_ 1096 DET_RANGE_289 " measured position  of the detection";
CM_ SG_ 1096 DET_RANGE_ERR_289 "RMSE or standard deviation of the measured angle  of the detection";
CM_ SG_ 1096 DET_RANGE_VELOCITY_289 "Radial velocity of the detection positive in direction to the sensor";
CM_ SG_ 1096 DET_RANGE_VELOCITY_ERR_289 "RMSE or standard deviation of the measure radial velocity of the detection";
CM_ SG_ 1096 DET_AZIMUTH_289 "Measured angle  of the detection";
CM_ SG_ 1096 DET_AZIMUTH_ERR_289 "RMSE or standard deviation of the measured angle  of the detection";
CM_ SG_ 1096 DET_ELEVATION_289 "measured elevation of the detection";
CM_ SG_ 1096 DET_ELEVATION_ERR_289 "RMSE or standard deviation of the measured elevation  of the detection";
CM_ SG_ 1096 DET_RCS_289 "Radar Cross Section or Amplitude, is a measure of how detectable an object is by radar. A larger RCS indicates that an object is more easily detected.";
CM_ SG_ 1096 DET_VALID_FLAG_289 "is set if the measured detection is valid";
CM_ SG_ 1096 DET_BI_STATIC_FLAG_289 "1 if detection is bi-static 0 otherwise";
CM_ SG_ 1096 DET_SUPER_RES_TARGET_289 "flasg is set if the detection is super resolution target";
CM_ SG_ 1096 DET_SNR_289 "The signal to noise ratio (SNR) of the radar detection";
CM_ SG_ 1096 DET_POINT_TARGET_PROB_289 "Describes the possibility if more than one real-world object has led to this detection. 0[%] := 100[%] Multi target probability";
CM_ SG_ 1096 DET_EXISTENCE_PROB_289 "Existence probability of the detection not based on history. Value does  not depend on any past experience with similar detections.
\note Use as confidence measure where a low value means less confidence
and a high value indicates strong confidence.";
CM_ SG_ 1096 DET_OUTSIDE_SECTOR_289 "Flag to indicate detections outside the sector, set if the wrong sector calibration matrix was used";
CM_ SG_ 1096 DET_HVC_FLAG_289 "Core2 Vehicle clutter flag";
CM_ SG_ 1096 DET_CONFD_AZIMUTH_289 "Define the Confidence of Azimuth for Detection ";
CM_ SG_ 1096 DET_CONFD_ELEVATION_289 "Define the Confidence of Elevation for the Detection ";
CM_ SG_ 1096 DET_BI_STATIC_FLAG_290 "1 if detection is bi-static 0 otherwise";
CM_ SG_ 1096 DET_BI_STATIC_FLAG_291 "1 if detection is bi-static 0 otherwise";
CM_ SG_ 1096 DET_BI_STATIC_FLAG_292 "1 if detection is bi-static 0 otherwise";
CM_ SG_ 1096 DET_MH_SCAN_INDEX_4LSB_289_292 "Scan index of the measured detection";
CM_ SG_ 1096 DET_MH_CYCLE_COUNTER_289_292 "Detection Alive Counter";
CM_ SG_ 1097 DET_RANGE_293 " measured position  of the detection";
CM_ SG_ 1097 DET_RANGE_ERR_293 "RMSE or standard deviation of the measured angle  of the detection";
CM_ SG_ 1097 DET_RANGE_VELOCITY_293 "Radial velocity of the detection positive in direction to the sensor";
CM_ SG_ 1097 DET_RANGE_VELOCITY_ERR_293 "RMSE or standard deviation of the measure radial velocity of the detection";
CM_ SG_ 1097 DET_AZIMUTH_293 "Measured angle  of the detection";
CM_ SG_ 1097 DET_AZIMUTH_ERR_293 "RMSE or standard deviation of the measured angle  of the detection";
CM_ SG_ 1097 DET_ELEVATION_293 "measured elevation of the detection";
CM_ SG_ 1097 DET_ELEVATION_ERR_293 "RMSE or standard deviation of the measured elevation  of the detection";
CM_ SG_ 1097 DET_RCS_293 "Radar Cross Section or Amplitude, is a measure of how detectable an object is by radar. A larger RCS indicates that an object is more easily detected.";
CM_ SG_ 1097 DET_VALID_FLAG_293 "is set if the measured detection is valid";
CM_ SG_ 1097 DET_BI_STATIC_FLAG_293 "1 if detection is bi-static 0 otherwise";
CM_ SG_ 1097 DET_SUPER_RES_TARGET_293 "flasg is set if the detection is super resolution target";
CM_ SG_ 1097 DET_SNR_293 "The signal to noise ratio (SNR) of the radar detection";
CM_ SG_ 1097 DET_POINT_TARGET_PROB_293 "Describes the possibility if more than one real-world object has led to this detection. 0[%] := 100[%] Multi target probability";
CM_ SG_ 1097 DET_EXISTENCE_PROB_293 "Existence probability of the detection not based on history. Value does  not depend on any past experience with similar detections.
\note Use as confidence measure where a low value means less confidence
and a high value indicates strong confidence.";
CM_ SG_ 1097 DET_OUTSIDE_SECTOR_293 "Flag to indicate detections outside the sector, set if the wrong sector calibration matrix was used";
CM_ SG_ 1097 DET_HVC_FLAG_293 "Core2 Vehicle clutter flag";
CM_ SG_ 1097 DET_CONFD_AZIMUTH_293 "Define the Confidence of Azimuth for Detection ";
CM_ SG_ 1097 DET_CONFD_ELEVATION_293 "Define the Confidence of Elevation for the Detection ";
CM_ SG_ 1097 DET_BI_STATIC_FLAG_294 "1 if detection is bi-static 0 otherwise";
CM_ SG_ 1097 DET_BI_STATIC_FLAG_295 "1 if detection is bi-static 0 otherwise";
CM_ SG_ 1097 DET_BI_STATIC_FLAG_296 "1 if detection is bi-static 0 otherwise";
CM_ SG_ 1097 DET_MH_SCAN_INDEX_4LSB_293_296 "Scan index of the measured detection";
CM_ SG_ 1097 DET_MH_CYCLE_COUNTER_293_296 "Detection Alive Counter";
CM_ SG_ 1098 DET_RANGE_297 " measured position  of the detection";
CM_ SG_ 1098 DET_RANGE_ERR_297 "RMSE or standard deviation of the measured angle  of the detection";
CM_ SG_ 1098 DET_RANGE_VELOCITY_297 "Radial velocity of the detection positive in direction to the sensor";
CM_ SG_ 1098 DET_RANGE_VELOCITY_ERR_297 "RMSE or standard deviation of the measure radial velocity of the detection";
CM_ SG_ 1098 DET_AZIMUTH_297 "Measured angle  of the detection";
CM_ SG_ 1098 DET_AZIMUTH_ERR_297 "RMSE or standard deviation of the measured angle  of the detection";
CM_ SG_ 1098 DET_ELEVATION_297 "measured elevation of the detection";
CM_ SG_ 1098 DET_ELEVATION_ERR_297 "RMSE or standard deviation of the measured elevation  of the detection";
CM_ SG_ 1098 DET_RCS_297 "Radar Cross Section or Amplitude, is a measure of how detectable an object is by radar. A larger RCS indicates that an object is more easily detected.";
CM_ SG_ 1098 DET_VALID_FLAG_297 "is set if the measured detection is valid";
CM_ SG_ 1098 DET_BI_STATIC_FLAG_297 "1 if detection is bi-static 0 otherwise";
CM_ SG_ 1098 DET_SUPER_RES_TARGET_297 "flasg is set if the detection is super resolution target";
CM_ SG_ 1098 DET_SNR_297 "The signal to noise ratio (SNR) of the radar detection";
CM_ SG_ 1098 DET_POINT_TARGET_PROB_297 "Describes the possibility if more than one real-world object has led to this detection. 0[%] := 100[%] Multi target probability";
CM_ SG_ 1098 DET_EXISTENCE_PROB_297 "Existence probability of the detection not based on history. Value does  not depend on any past experience with similar detections.
\note Use as confidence measure where a low value means less confidence
and a high value indicates strong confidence.";
CM_ SG_ 1098 DET_OUTSIDE_SECTOR_297 "Flag to indicate detections outside the sector, set if the wrong sector calibration matrix was used";
CM_ SG_ 1098 DET_HVC_FLAG_297 "Core2 Vehicle clutter flag";
CM_ SG_ 1098 DET_CONFD_AZIMUTH_297 "Define the Confidence of Azimuth for Detection ";
CM_ SG_ 1098 DET_CONFD_ELEVATION_297 "Define the Confidence of Elevation for the Detection ";
CM_ SG_ 1098 DET_BI_STATIC_FLAG_298 "1 if detection is bi-static 0 otherwise";
CM_ SG_ 1098 DET_BI_STATIC_FLAG_299 "1 if detection is bi-static 0 otherwise";
CM_ SG_ 1098 DET_BI_STATIC_FLAG_300 "1 if detection is bi-static 0 otherwise";
CM_ SG_ 1098 DET_MH_SCAN_INDEX_4LSB_297_300 "Scan index of the measured detection";
CM_ SG_ 1098 DET_MH_CYCLE_COUNTER_297_300 "Detection Alive Counter";
CM_ SG_ 1099 DET_RANGE_301 " measured position  of the detection";
CM_ SG_ 1099 DET_RANGE_ERR_301 "RMSE or standard deviation of the measured angle  of the detection";
CM_ SG_ 1099 DET_RANGE_VELOCITY_301 "Radial velocity of the detection positive in direction to the sensor";
CM_ SG_ 1099 DET_RANGE_VELOCITY_ERR_301 "RMSE or standard deviation of the measure radial velocity of the detection";
CM_ SG_ 1099 DET_AZIMUTH_301 "Measured angle  of the detection";
CM_ SG_ 1099 DET_AZIMUTH_ERR_301 "RMSE or standard deviation of the measured angle  of the detection";
CM_ SG_ 1099 DET_ELEVATION_301 "measured elevation of the detection";
CM_ SG_ 1099 DET_ELEVATION_ERR_301 "RMSE or standard deviation of the measured elevation  of the detection";
CM_ SG_ 1099 DET_RCS_301 "Radar Cross Section or Amplitude, is a measure of how detectable an object is by radar. A larger RCS indicates that an object is more easily detected.";
CM_ SG_ 1099 DET_VALID_FLAG_301 "is set if the measured detection is valid";
CM_ SG_ 1099 DET_BI_STATIC_FLAG_301 "1 if detection is bi-static 0 otherwise";
CM_ SG_ 1099 DET_SUPER_RES_TARGET_301 "flasg is set if the detection is super resolution target";
CM_ SG_ 1099 DET_SNR_301 "The signal to noise ratio (SNR) of the radar detection";
CM_ SG_ 1099 DET_POINT_TARGET_PROB_301 "Describes the possibility if more than one real-world object has led to this detection. 0[%] := 100[%] Multi target probability";
CM_ SG_ 1099 DET_EXISTENCE_PROB_301 "Existence probability of the detection not based on history. Value does  not depend on any past experience with similar detections.
\note Use as confidence measure where a low value means less confidence
and a high value indicates strong confidence.";
CM_ SG_ 1099 DET_OUTSIDE_SECTOR_301 "Flag to indicate detections outside the sector, set if the wrong sector calibration matrix was used";
CM_ SG_ 1099 DET_HVC_FLAG_301 "Core2 Vehicle clutter flag";
CM_ SG_ 1099 DET_CONFD_AZIMUTH_301 "Define the Confidence of Azimuth for Detection ";
CM_ SG_ 1099 DET_CONFD_ELEVATION_301 "Define the Confidence of Elevation for the Detection ";
CM_ SG_ 1099 DET_BI_STATIC_FLAG_302 "1 if detection is bi-static 0 otherwise";
CM_ SG_ 1099 DET_BI_STATIC_FLAG_303 "1 if detection is bi-static 0 otherwise";
CM_ SG_ 1099 DET_BI_STATIC_FLAG_304 "1 if detection is bi-static 0 otherwise";
CM_ SG_ 1099 DET_MH_SCAN_INDEX_4LSB_301_304 "Scan index of the measured detection";
CM_ SG_ 1099 DET_MH_CYCLE_COUNTER_301_304 "Detection Alive Counter";
CM_ SG_ 1100 DET_RANGE_305 " measured position  of the detection";
CM_ SG_ 1100 DET_RANGE_ERR_305 "RMSE or standard deviation of the measured angle  of the detection";
CM_ SG_ 1100 DET_RANGE_VELOCITY_305 "Radial velocity of the detection positive in direction to the sensor";
CM_ SG_ 1100 DET_RANGE_VELOCITY_ERR_305 "RMSE or standard deviation of the measure radial velocity of the detection";
CM_ SG_ 1100 DET_AZIMUTH_305 "Measured angle  of the detection";
CM_ SG_ 1100 DET_AZIMUTH_ERR_305 "RMSE or standard deviation of the measured angle  of the detection";
CM_ SG_ 1100 DET_ELEVATION_305 "measured elevation of the detection";
CM_ SG_ 1100 DET_ELEVATION_ERR_305 "RMSE or standard deviation of the measured elevation  of the detection";
CM_ SG_ 1100 DET_RCS_305 "Radar Cross Section or Amplitude, is a measure of how detectable an object is by radar. A larger RCS indicates that an object is more easily detected.";
CM_ SG_ 1100 DET_VALID_FLAG_305 "is set if the measured detection is valid";
CM_ SG_ 1100 DET_BI_STATIC_FLAG_305 "1 if detection is bi-static 0 otherwise";
CM_ SG_ 1100 DET_SUPER_RES_TARGET_305 "flasg is set if the detection is super resolution target";
CM_ SG_ 1100 DET_SNR_305 "The signal to noise ratio (SNR) of the radar detection";
CM_ SG_ 1100 DET_POINT_TARGET_PROB_305 "Describes the possibility if more than one real-world object has led to this detection. 0[%] := 100[%] Multi target probability";
CM_ SG_ 1100 DET_EXISTENCE_PROB_305 "Existence probability of the detection not based on history. Value does  not depend on any past experience with similar detections.
\note Use as confidence measure where a low value means less confidence
and a high value indicates strong confidence.";
CM_ SG_ 1100 DET_OUTSIDE_SECTOR_305 "Flag to indicate detections outside the sector, set if the wrong sector calibration matrix was used";
CM_ SG_ 1100 DET_HVC_FLAG_305 "Core2 Vehicle clutter flag";
CM_ SG_ 1100 DET_CONFD_AZIMUTH_305 "Define the Confidence of Azimuth for Detection ";
CM_ SG_ 1100 DET_CONFD_ELEVATION_305 "Define the Confidence of Elevation for the Detection ";
CM_ SG_ 1100 DET_BI_STATIC_FLAG_306 "1 if detection is bi-static 0 otherwise";
CM_ SG_ 1100 DET_BI_STATIC_FLAG_307 "1 if detection is bi-static 0 otherwise";
CM_ SG_ 1100 DET_BI_STATIC_FLAG_308 "1 if detection is bi-static 0 otherwise";
CM_ SG_ 1100 DET_MH_SCAN_INDEX_4LSB_305_308 "Scan index of the measured detection";
CM_ SG_ 1100 DET_MH_CYCLE_COUNTER_305_308 "Detection Alive Counter";
CM_ SG_ 1101 DET_RANGE_309 " measured position  of the detection";
CM_ SG_ 1101 DET_RANGE_ERR_309 "RMSE or standard deviation of the measured angle  of the detection";
CM_ SG_ 1101 DET_RANGE_VELOCITY_309 "Radial velocity of the detection positive in direction to the sensor";
CM_ SG_ 1101 DET_RANGE_VELOCITY_ERR_309 "RMSE or standard deviation of the measure radial velocity of the detection";
CM_ SG_ 1101 DET_AZIMUTH_309 "Measured angle  of the detection";
CM_ SG_ 1101 DET_AZIMUTH_ERR_309 "RMSE or standard deviation of the measured angle  of the detection";
CM_ SG_ 1101 DET_ELEVATION_309 "measured elevation of the detection";
CM_ SG_ 1101 DET_ELEVATION_ERR_309 "RMSE or standard deviation of the measured elevation  of the detection";
CM_ SG_ 1101 DET_RCS_309 "Radar Cross Section or Amplitude, is a measure of how detectable an object is by radar. A larger RCS indicates that an object is more easily detected.";
CM_ SG_ 1101 DET_VALID_FLAG_309 "is set if the measured detection is valid";
CM_ SG_ 1101 DET_BI_STATIC_FLAG_309 "1 if detection is bi-static 0 otherwise";
CM_ SG_ 1101 DET_SUPER_RES_TARGET_309 "flasg is set if the detection is super resolution target";
CM_ SG_ 1101 DET_SNR_309 "The signal to noise ratio (SNR) of the radar detection";
CM_ SG_ 1101 DET_POINT_TARGET_PROB_309 "Describes the possibility if more than one real-world object has led to this detection. 0[%] := 100[%] Multi target probability";
CM_ SG_ 1101 DET_EXISTENCE_PROB_309 "Existence probability of the detection not based on history. Value does  not depend on any past experience with similar detections.
\note Use as confidence measure where a low value means less confidence
and a high value indicates strong confidence.";
CM_ SG_ 1101 DET_OUTSIDE_SECTOR_309 "Flag to indicate detections outside the sector, set if the wrong sector calibration matrix was used";
CM_ SG_ 1101 DET_HVC_FLAG_309 "Core2 Vehicle clutter flag";
CM_ SG_ 1101 DET_CONFD_AZIMUTH_309 "Define the Confidence of Azimuth for Detection ";
CM_ SG_ 1101 DET_CONFD_ELEVATION_309 "Define the Confidence of Elevation for the Detection ";
CM_ SG_ 1101 DET_BI_STATIC_FLAG_310 "1 if detection is bi-static 0 otherwise";
CM_ SG_ 1101 DET_BI_STATIC_FLAG_311 "1 if detection is bi-static 0 otherwise";
CM_ SG_ 1101 DET_BI_STATIC_FLAG_312 "1 if detection is bi-static 0 otherwise";
CM_ SG_ 1101 DET_MH_SCAN_INDEX_4LSB_309_312 "Scan index of the measured detection";
CM_ SG_ 1101 DET_MH_CYCLE_COUNTER_309_312 "Detection Alive Counter";
CM_ SG_ 1102 DET_RANGE_313 " measured position  of the detection";
CM_ SG_ 1102 DET_RANGE_ERR_313 "RMSE or standard deviation of the measured angle  of the detection";
CM_ SG_ 1102 DET_RANGE_VELOCITY_313 "Radial velocity of the detection positive in direction to the sensor";
CM_ SG_ 1102 DET_RANGE_VELOCITY_ERR_313 "RMSE or standard deviation of the measure radial velocity of the detection";
CM_ SG_ 1102 DET_AZIMUTH_313 "Measured angle  of the detection";
CM_ SG_ 1102 DET_AZIMUTH_ERR_313 "RMSE or standard deviation of the measured angle  of the detection";
CM_ SG_ 1102 DET_ELEVATION_313 "measured elevation of the detection";
CM_ SG_ 1102 DET_ELEVATION_ERR_313 "RMSE or standard deviation of the measured elevation  of the detection";
CM_ SG_ 1102 DET_RCS_313 "Radar Cross Section or Amplitude, is a measure of how detectable an object is by radar. A larger RCS indicates that an object is more easily detected.";
CM_ SG_ 1102 DET_VALID_FLAG_313 "is set if the measured detection is valid";
CM_ SG_ 1102 DET_BI_STATIC_FLAG_313 "1 if detection is bi-static 0 otherwise";
CM_ SG_ 1102 DET_SUPER_RES_TARGET_313 "flasg is set if the detection is super resolution target";
CM_ SG_ 1102 DET_SNR_313 "The signal to noise ratio (SNR) of the radar detection";
CM_ SG_ 1102 DET_POINT_TARGET_PROB_313 "Describes the possibility if more than one real-world object has led to this detection. 0[%] := 100[%] Multi target probability";
CM_ SG_ 1102 DET_EXISTENCE_PROB_313 "Existence probability of the detection not based on history. Value does  not depend on any past experience with similar detections.
\note Use as confidence measure where a low value means less confidence
and a high value indicates strong confidence.";
CM_ SG_ 1102 DET_OUTSIDE_SECTOR_313 "Flag to indicate detections outside the sector, set if the wrong sector calibration matrix was used";
CM_ SG_ 1102 DET_HVC_FLAG_313 "Core2 Vehicle clutter flag";
CM_ SG_ 1102 DET_CONFD_AZIMUTH_313 "Define the Confidence of Azimuth for Detection ";
CM_ SG_ 1102 DET_CONFD_ELEVATION_313 "Define the Confidence of Elevation for the Detection ";
CM_ SG_ 1102 DET_BI_STATIC_FLAG_314 "1 if detection is bi-static 0 otherwise";
CM_ SG_ 1102 DET_BI_STATIC_FLAG_315 "1 if detection is bi-static 0 otherwise";
CM_ SG_ 1102 DET_BI_STATIC_FLAG_316 "1 if detection is bi-static 0 otherwise";
CM_ SG_ 1102 DET_MH_SCAN_INDEX_4LSB_313_316 "Scan index of the measured detection";
CM_ SG_ 1102 DET_MH_CYCLE_COUNTER_313_316 "Detection Alive Counter";
CM_ SG_ 1103 DET_RANGE_317 " measured position  of the detection";
CM_ SG_ 1103 DET_RANGE_ERR_317 "RMSE or standard deviation of the measured angle  of the detection";
CM_ SG_ 1103 DET_RANGE_VELOCITY_317 "Radial velocity of the detection positive in direction to the sensor";
CM_ SG_ 1103 DET_RANGE_VELOCITY_ERR_317 "RMSE or standard deviation of the measure radial velocity of the detection";
CM_ SG_ 1103 DET_AZIMUTH_317 "Measured angle  of the detection";
CM_ SG_ 1103 DET_AZIMUTH_ERR_317 "RMSE or standard deviation of the measured angle  of the detection";
CM_ SG_ 1103 DET_ELEVATION_317 "measured elevation of the detection";
CM_ SG_ 1103 DET_ELEVATION_ERR_317 "RMSE or standard deviation of the measured elevation  of the detection";
CM_ SG_ 1103 DET_RCS_317 "Radar Cross Section or Amplitude, is a measure of how detectable an object is by radar. A larger RCS indicates that an object is more easily detected.";
CM_ SG_ 1103 DET_VALID_FLAG_317 "is set if the measured detection is valid";
CM_ SG_ 1103 DET_BI_STATIC_FLAG_317 "1 if detection is bi-static 0 otherwise";
CM_ SG_ 1103 DET_SUPER_RES_TARGET_317 "flasg is set if the detection is super resolution target";
CM_ SG_ 1103 DET_SNR_317 "The signal to noise ratio (SNR) of the radar detection";
CM_ SG_ 1103 DET_POINT_TARGET_PROB_317 "Describes the possibility if more than one real-world object has led to this detection. 0[%] := 100[%] Multi target probability";
CM_ SG_ 1103 DET_EXISTENCE_PROB_317 "Existence probability of the detection not based on history. Value does  not depend on any past experience with similar detections.
\note Use as confidence measure where a low value means less confidence
and a high value indicates strong confidence.";
CM_ SG_ 1103 DET_OUTSIDE_SECTOR_317 "Flag to indicate detections outside the sector, set if the wrong sector calibration matrix was used";
CM_ SG_ 1103 DET_HVC_FLAG_317 "Core2 Vehicle clutter flag";
CM_ SG_ 1103 DET_CONFD_AZIMUTH_317 "Define the Confidence of Azimuth for Detection ";
CM_ SG_ 1103 DET_CONFD_ELEVATION_317 "Define the Confidence of Elevation for the Detection ";
CM_ SG_ 1103 DET_BI_STATIC_FLAG_318 "1 if detection is bi-static 0 otherwise";
CM_ SG_ 1103 DET_BI_STATIC_FLAG_319 "1 if detection is bi-static 0 otherwise";
CM_ SG_ 1103 DET_BI_STATIC_FLAG_320 "1 if detection is bi-static 0 otherwise";
CM_ SG_ 1103 DET_MH_SCAN_INDEX_4LSB_317_320 "Scan index of the measured detection";
CM_ SG_ 1103 DET_MH_CYCLE_COUNTER_317_320 "Detection Alive Counter";
CM_ SG_ 1104 DET_RANGE_321 " measured position  of the detection";
CM_ SG_ 1104 DET_RANGE_ERR_321 "RMSE or standard deviation of the measured angle  of the detection";
CM_ SG_ 1104 DET_RANGE_VELOCITY_321 "Radial velocity of the detection positive in direction to the sensor";
CM_ SG_ 1104 DET_RANGE_VELOCITY_ERR_321 "RMSE or standard deviation of the measure radial velocity of the detection";
CM_ SG_ 1104 DET_AZIMUTH_321 "Measured angle  of the detection";
CM_ SG_ 1104 DET_AZIMUTH_ERR_321 "RMSE or standard deviation of the measured angle  of the detection";
CM_ SG_ 1104 DET_ELEVATION_321 "measured elevation of the detection";
CM_ SG_ 1104 DET_ELEVATION_ERR_321 "RMSE or standard deviation of the measured elevation  of the detection";
CM_ SG_ 1104 DET_RCS_321 "Radar Cross Section or Amplitude, is a measure of how detectable an object is by radar. A larger RCS indicates that an object is more easily detected.";
CM_ SG_ 1104 DET_VALID_FLAG_321 "is set if the measured detection is valid";
CM_ SG_ 1104 DET_BI_STATIC_FLAG_321 "1 if detection is bi-static 0 otherwise";
CM_ SG_ 1104 DET_SUPER_RES_TARGET_321 "flasg is set if the detection is super resolution target";
CM_ SG_ 1104 DET_SNR_321 "The signal to noise ratio (SNR) of the radar detection";
CM_ SG_ 1104 DET_POINT_TARGET_PROB_321 "Describes the possibility if more than one real-world object has led to this detection. 0[%] := 100[%] Multi target probability";
CM_ SG_ 1104 DET_EXISTENCE_PROB_321 "Existence probability of the detection not based on history. Value does  not depend on any past experience with similar detections.
\note Use as confidence measure where a low value means less confidence
and a high value indicates strong confidence.";
CM_ SG_ 1104 DET_OUTSIDE_SECTOR_321 "Flag to indicate detections outside the sector, set if the wrong sector calibration matrix was used";
CM_ SG_ 1104 DET_HVC_FLAG_321 "Core2 Vehicle clutter flag";
CM_ SG_ 1104 DET_CONFD_AZIMUTH_321 "Define the Confidence of Azimuth for Detection ";
CM_ SG_ 1104 DET_CONFD_ELEVATION_321 "Define the Confidence of Elevation for the Detection ";
CM_ SG_ 1104 DET_BI_STATIC_FLAG_322 "1 if detection is bi-static 0 otherwise";
CM_ SG_ 1104 DET_BI_STATIC_FLAG_323 "1 if detection is bi-static 0 otherwise";
CM_ SG_ 1104 DET_BI_STATIC_FLAG_324 "1 if detection is bi-static 0 otherwise";
CM_ SG_ 1104 DET_MH_SCAN_INDEX_4LSB_321_324 "Scan index of the measured detection";
CM_ SG_ 1104 DET_MH_CYCLE_COUNTER_321_324 "Detection Alive Counter";
CM_ SG_ 1105 DET_RANGE_325 " measured position  of the detection";
CM_ SG_ 1105 DET_RANGE_ERR_325 "RMSE or standard deviation of the measured angle  of the detection";
CM_ SG_ 1105 DET_RANGE_VELOCITY_325 "Radial velocity of the detection positive in direction to the sensor";
CM_ SG_ 1105 DET_RANGE_VELOCITY_ERR_325 "RMSE or standard deviation of the measure radial velocity of the detection";
CM_ SG_ 1105 DET_AZIMUTH_325 "Measured angle  of the detection";
CM_ SG_ 1105 DET_AZIMUTH_ERR_325 "RMSE or standard deviation of the measured angle  of the detection";
CM_ SG_ 1105 DET_ELEVATION_325 "measured elevation of the detection";
CM_ SG_ 1105 DET_ELEVATION_ERR_325 "RMSE or standard deviation of the measured elevation  of the detection";
CM_ SG_ 1105 DET_RCS_325 "Radar Cross Section or Amplitude, is a measure of how detectable an object is by radar. A larger RCS indicates that an object is more easily detected.";
CM_ SG_ 1105 DET_VALID_FLAG_325 "is set if the measured detection is valid";
CM_ SG_ 1105 DET_BI_STATIC_FLAG_325 "1 if detection is bi-static 0 otherwise";
CM_ SG_ 1105 DET_SUPER_RES_TARGET_325 "flasg is set if the detection is super resolution target";
CM_ SG_ 1105 DET_SNR_325 "The signal to noise ratio (SNR) of the radar detection";
CM_ SG_ 1105 DET_POINT_TARGET_PROB_325 "Describes the possibility if more than one real-world object has led to this detection. 0[%] := 100[%] Multi target probability";
CM_ SG_ 1105 DET_EXISTENCE_PROB_325 "Existence probability of the detection not based on history. Value does  not depend on any past experience with similar detections.
\note Use as confidence measure where a low value means less confidence
and a high value indicates strong confidence.";
CM_ SG_ 1105 DET_OUTSIDE_SECTOR_325 "Flag to indicate detections outside the sector, set if the wrong sector calibration matrix was used";
CM_ SG_ 1105 DET_HVC_FLAG_325 "Core2 Vehicle clutter flag";
CM_ SG_ 1105 DET_CONFD_AZIMUTH_325 "Define the Confidence of Azimuth for Detection ";
CM_ SG_ 1105 DET_CONFD_ELEVATION_325 "Define the Confidence of Elevation for the Detection ";
CM_ SG_ 1105 DET_BI_STATIC_FLAG_326 "1 if detection is bi-static 0 otherwise";
CM_ SG_ 1105 DET_BI_STATIC_FLAG_327 "1 if detection is bi-static 0 otherwise";
CM_ SG_ 1105 DET_BI_STATIC_FLAG_328 "1 if detection is bi-static 0 otherwise";
CM_ SG_ 1105 DET_MH_SCAN_INDEX_4LSB_325_328 "Scan index of the measured detection";
CM_ SG_ 1105 DET_MH_CYCLE_COUNTER_325_328 "Detection Alive Counter";
CM_ SG_ 1106 DET_RANGE_329 " measured position  of the detection";
CM_ SG_ 1106 DET_RANGE_ERR_329 "RMSE or standard deviation of the measured angle  of the detection";
CM_ SG_ 1106 DET_RANGE_VELOCITY_329 "Radial velocity of the detection positive in direction to the sensor";
CM_ SG_ 1106 DET_RANGE_VELOCITY_ERR_329 "RMSE or standard deviation of the measure radial velocity of the detection";
CM_ SG_ 1106 DET_AZIMUTH_329 "Measured angle  of the detection";
CM_ SG_ 1106 DET_AZIMUTH_ERR_329 "RMSE or standard deviation of the measured angle  of the detection";
CM_ SG_ 1106 DET_ELEVATION_329 "measured elevation of the detection";
CM_ SG_ 1106 DET_ELEVATION_ERR_329 "RMSE or standard deviation of the measured elevation  of the detection";
CM_ SG_ 1106 DET_RCS_329 "Radar Cross Section or Amplitude, is a measure of how detectable an object is by radar. A larger RCS indicates that an object is more easily detected.";
CM_ SG_ 1106 DET_VALID_FLAG_329 "is set if the measured detection is valid";
CM_ SG_ 1106 DET_BI_STATIC_FLAG_329 "1 if detection is bi-static 0 otherwise";
CM_ SG_ 1106 DET_SUPER_RES_TARGET_329 "flasg is set if the detection is super resolution target";
CM_ SG_ 1106 DET_SNR_329 "The signal to noise ratio (SNR) of the radar detection";
CM_ SG_ 1106 DET_POINT_TARGET_PROB_329 "Describes the possibility if more than one real-world object has led to this detection. 0[%] := 100[%] Multi target probability";
CM_ SG_ 1106 DET_EXISTENCE_PROB_329 "Existence probability of the detection not based on history. Value does  not depend on any past experience with similar detections.
\note Use as confidence measure where a low value means less confidence
and a high value indicates strong confidence.";
CM_ SG_ 1106 DET_OUTSIDE_SECTOR_329 "Flag to indicate detections outside the sector, set if the wrong sector calibration matrix was used";
CM_ SG_ 1106 DET_HVC_FLAG_329 "Core2 Vehicle clutter flag";
CM_ SG_ 1106 DET_CONFD_AZIMUTH_329 "Define the Confidence of Azimuth for Detection ";
CM_ SG_ 1106 DET_CONFD_ELEVATION_329 "Define the Confidence of Elevation for the Detection ";
CM_ SG_ 1106 DET_BI_STATIC_FLAG_330 "1 if detection is bi-static 0 otherwise";
CM_ SG_ 1106 DET_BI_STATIC_FLAG_331 "1 if detection is bi-static 0 otherwise";
CM_ SG_ 1106 DET_BI_STATIC_FLAG_332 "1 if detection is bi-static 0 otherwise";
CM_ SG_ 1106 DET_MH_SCAN_INDEX_4LSB_329_332 "Scan index of the measured detection";
CM_ SG_ 1106 DET_MH_CYCLE_COUNTER_329_332 "Detection Alive Counter";
BA_DEF_ BO_  "CanTpBs" INT 0 255;
BA_DEF_ BO_  "DiagRequest" ENUM  "No","Yes";
BA_DEF_ BO_  "DiagResponse" ENUM  "No","Yes";
BA_DEF_ BO_  "E2EDataId" INT 0 65535;
BA_DEF_ BO_  "E2EDataLength" INT 0 65535;
BA_DEF_ BO_  "E2EProfile" STRING ;
BA_DEF_ BO_  "EventRateOfChange" INT 10 10000;
BA_DEF_ BO_  "GenMsgCycleTime" INT 0 100000;
BA_DEF_ BO_  "GenMsgILSupport" ENUM  "No","Yes";
BA_DEF_ BO_  "GenMsgNrOfRepetition" INT 0 100;
BA_DEF_ BO_  "GenMsgSendType" ENUM  "FixedPeriodic","Event","EnabledPeriodic","NotUsed","NotUsed","EventPeriodic","NotUsed","NotUsed","NoMsgSendType";
BA_DEF_ BO_  "NetworkInitialization" ENUM  "No","Yes";
BA_DEF_ BO_  "NmAsrMessage" ENUM  "No","Yes";
BA_DEF_ BO_  "NmMessage" ENUM  "No","Yes";
BA_DEF_ BO_  "SCP_AuthInfoTxLength" INT 0 512;
BA_DEF_ BO_  "SCP_DataId" INT 0 65535;
BA_DEF_ BO_  "SCP_FreshnessValueId" INT 0 65535;
BA_DEF_ BO_  "SCP_FreshnessValueLength" INT 0 512;
BA_DEF_ BO_  "SCP_FreshnessValueTxLength" INT 0 512;
BA_DEF_ BO_  "SC_Message" ENUM  "No","Yes","Yes, split message";
BA_DEF_ BO_  "TpTxIndex" INT 0 255;
BA_DEF_ BO_  "VFrameFormat" ENUM  "StandardCAN","ExtendedCAN","reserved","reserved","reserved","reserved","reserved","reserved","reserved","reserved","reserved","reserved","reserved","reserved","StandardCAN_FD","ExtendedCAN_FD";
BA_DEF_ SG_  "GenSigCmt" STRING ;
BA_DEF_ SG_  "GenSigCycleTime" INT 0 0;
BA_DEF_ SG_  "GenSigSendType" ENUM  "Cyclic","OnWrite","vector_leerstring","OnChange","vector_leerstring","IfActive","vector_leerstring","NoSigSendType";
BA_DEF_ SG_  "GenSigStartValue" INT 0 1000000000;
BA_DEF_ SG_  "GenSigTimeoutTime" INT 0 0;
BA_DEF_ SG_  "GenSigVtEn" STRING ;
BA_DEF_ SG_  "GenSigVtName" STRING ;
BA_DEF_ SG_  "InvalidValue" STRING ;
BA_DEF_DEF_  "CanTpBs" 255;
BA_DEF_DEF_  "DiagRequest" "No";
BA_DEF_DEF_  "DiagResponse" "No";
BA_DEF_DEF_  "E2EDataId" 0;
BA_DEF_DEF_  "E2EDataLength" 0;
BA_DEF_DEF_  "E2EProfile" "";
BA_DEF_DEF_  "EventRateOfChange" 10000;
BA_DEF_DEF_  "GenMsgCycleTime" 0;
BA_DEF_DEF_  "GenMsgILSupport" "Yes";
BA_DEF_DEF_  "GenMsgNrOfRepetition" 0;
BA_DEF_DEF_  "GenMsgSendType" "NoMsgSendType";
BA_DEF_DEF_  "NetworkInitialization" "Yes";
BA_DEF_DEF_  "NmAsrMessage" "No";
BA_DEF_DEF_  "NmMessage" "No";
BA_DEF_DEF_  "SCP_AuthInfoTxLength" 28;
BA_DEF_DEF_  "SCP_DataId" 0;
BA_DEF_DEF_  "SCP_FreshnessValueId" 0;
BA_DEF_DEF_  "SCP_FreshnessValueLength" 48;
BA_DEF_DEF_  "SCP_FreshnessValueTxLength" 4;
BA_DEF_DEF_  "SC_Message" "No";
BA_DEF_DEF_  "TpTxIndex" 0;
BA_DEF_DEF_  "VFrameFormat" "StandardCAN_FD";
BA_DEF_DEF_  "GenSigCmt" "";
BA_DEF_DEF_  "GenSigCycleTime" 0;
BA_DEF_DEF_  "GenSigSendType" "NoSigSendType";
BA_DEF_DEF_  "GenSigStartValue" 0;
BA_DEF_DEF_  "GenSigTimeoutTime" 0;
BA_DEF_DEF_  "GenSigVtEn" "";
BA_DEF_DEF_  "GenSigVtName" "";
BA_DEF_DEF_  "InvalidValue" "";
BA_ "GenMsgSendType" BO_ 1089 1;
BA_ "GenMsgSendType" BO_ 1090 1;
BA_ "GenMsgSendType" BO_ 1091 1;
BA_ "GenMsgSendType" BO_ 1092 1;
BA_ "GenMsgSendType" BO_ 1093 1;
BA_ "GenMsgSendType" BO_ 1094 1;
BA_ "GenMsgSendType" BO_ 1095 1;
BA_ "GenMsgSendType" BO_ 1096 1;
BA_ "GenMsgSendType" BO_ 1097 1;
BA_ "GenMsgSendType" BO_ 1098 1;
BA_ "GenMsgSendType" BO_ 1099 1;
BA_ "GenMsgSendType" BO_ 1100 1;
BA_ "GenMsgSendType" BO_ 1101 1;
BA_ "GenMsgSendType" BO_ 1102 1;
BA_ "GenMsgSendType" BO_ 1103 1;
BA_ "GenMsgSendType" BO_ 1104 1;
BA_ "GenMsgSendType" BO_ 1105 1;
BA_ "GenMsgSendType" BO_ 1106 1;
BA_ "GenSigStartValue" SG_ 1089 DET_RANGE_VELOCITY_261 16384;
BA_ "GenSigStartValue" SG_ 1089 DET_RCS_261 128;
BA_ "GenSigStartValue" SG_ 1089 DET_RANGE_VELOCITY_262 16384;
BA_ "GenSigStartValue" SG_ 1089 DET_RCS_262 128;
BA_ "GenSigStartValue" SG_ 1089 DET_RANGE_VELOCITY_263 16384;
BA_ "GenSigStartValue" SG_ 1089 DET_RCS_263 128;
BA_ "GenSigStartValue" SG_ 1089 DET_RANGE_VELOCITY_264 16384;
BA_ "GenSigStartValue" SG_ 1089 DET_RCS_264 128;
BA_ "GenSigStartValue" SG_ 1090 DET_RANGE_VELOCITY_265 16384;
BA_ "GenSigStartValue" SG_ 1090 DET_RCS_265 128;
BA_ "GenSigStartValue" SG_ 1090 DET_RANGE_VELOCITY_266 16384;
BA_ "GenSigStartValue" SG_ 1090 DET_RCS_266 128;
BA_ "GenSigStartValue" SG_ 1090 DET_RANGE_VELOCITY_267 16384;
BA_ "GenSigStartValue" SG_ 1090 DET_RCS_267 128;
BA_ "GenSigStartValue" SG_ 1090 DET_RANGE_VELOCITY_268 16384;
BA_ "GenSigStartValue" SG_ 1090 DET_RCS_268 128;
BA_ "GenSigStartValue" SG_ 1091 DET_RANGE_VELOCITY_269 16384;
BA_ "GenSigStartValue" SG_ 1091 DET_RCS_269 128;
BA_ "GenSigStartValue" SG_ 1091 DET_RANGE_VELOCITY_270 16384;
BA_ "GenSigStartValue" SG_ 1091 DET_RCS_270 128;
BA_ "GenSigStartValue" SG_ 1091 DET_RANGE_VELOCITY_271 16384;
BA_ "GenSigStartValue" SG_ 1091 DET_RCS_271 128;
BA_ "GenSigStartValue" SG_ 1091 DET_RANGE_VELOCITY_272 16384;
BA_ "GenSigStartValue" SG_ 1091 DET_RCS_272 128;
BA_ "GenSigStartValue" SG_ 1092 DET_RANGE_VELOCITY_273 16384;
BA_ "GenSigStartValue" SG_ 1092 DET_RCS_273 128;
BA_ "GenSigStartValue" SG_ 1092 DET_RANGE_VELOCITY_274 16384;
BA_ "GenSigStartValue" SG_ 1092 DET_RCS_274 128;
BA_ "GenSigStartValue" SG_ 1092 DET_RANGE_VELOCITY_275 16384;
BA_ "GenSigStartValue" SG_ 1092 DET_RCS_275 128;
BA_ "GenSigStartValue" SG_ 1092 DET_RANGE_VELOCITY_276 16384;
BA_ "GenSigStartValue" SG_ 1092 DET_RCS_276 128;
BA_ "GenSigStartValue" SG_ 1093 DET_RANGE_VELOCITY_277 16384;
BA_ "GenSigStartValue" SG_ 1093 DET_RCS_277 128;
BA_ "GenSigStartValue" SG_ 1093 DET_RANGE_VELOCITY_278 16384;
BA_ "GenSigStartValue" SG_ 1093 DET_RCS_278 128;
BA_ "GenSigStartValue" SG_ 1093 DET_RANGE_VELOCITY_279 16384;
BA_ "GenSigStartValue" SG_ 1093 DET_RCS_279 128;
BA_ "GenSigStartValue" SG_ 1093 DET_RANGE_VELOCITY_280 16384;
BA_ "GenSigStartValue" SG_ 1093 DET_RCS_280 128;
BA_ "GenSigStartValue" SG_ 1094 DET_RANGE_VELOCITY_281 16384;
BA_ "GenSigStartValue" SG_ 1094 DET_RCS_281 128;
BA_ "GenSigStartValue" SG_ 1094 DET_RANGE_VELOCITY_282 16384;
BA_ "GenSigStartValue" SG_ 1094 DET_RCS_282 128;
BA_ "GenSigStartValue" SG_ 1094 DET_RANGE_VELOCITY_283 16384;
BA_ "GenSigStartValue" SG_ 1094 DET_RCS_283 128;
BA_ "GenSigStartValue" SG_ 1094 DET_RANGE_VELOCITY_284 16384;
BA_ "GenSigStartValue" SG_ 1094 DET_RCS_284 128;
BA_ "GenSigStartValue" SG_ 1095 DET_RANGE_VELOCITY_285 16384;
BA_ "GenSigStartValue" SG_ 1095 DET_RCS_285 128;
BA_ "GenSigStartValue" SG_ 1095 DET_RANGE_VELOCITY_286 16384;
BA_ "GenSigStartValue" SG_ 1095 DET_RCS_286 128;
BA_ "GenSigStartValue" SG_ 1095 DET_RANGE_VELOCITY_287 16384;
BA_ "GenSigStartValue" SG_ 1095 DET_RCS_287 128;
BA_ "GenSigStartValue" SG_ 1095 DET_RANGE_VELOCITY_288 16384;
BA_ "GenSigStartValue" SG_ 1095 DET_RCS_288 128;
BA_ "GenSigStartValue" SG_ 1096 DET_RANGE_VELOCITY_289 16384;
BA_ "GenSigStartValue" SG_ 1096 DET_RCS_289 128;
BA_ "GenSigStartValue" SG_ 1096 DET_RANGE_VELOCITY_290 16384;
BA_ "GenSigStartValue" SG_ 1096 DET_RCS_290 128;
BA_ "GenSigStartValue" SG_ 1096 DET_RANGE_VELOCITY_291 16384;
BA_ "GenSigStartValue" SG_ 1096 DET_RCS_291 128;
BA_ "GenSigStartValue" SG_ 1096 DET_RANGE_VELOCITY_292 16384;
BA_ "GenSigStartValue" SG_ 1096 DET_RCS_292 128;
BA_ "GenSigStartValue" SG_ 1097 DET_RANGE_VELOCITY_293 16384;
BA_ "GenSigStartValue" SG_ 1097 DET_RCS_293 128;
BA_ "GenSigStartValue" SG_ 1097 DET_RANGE_VELOCITY_294 16384;
BA_ "GenSigStartValue" SG_ 1097 DET_RCS_294 128;
BA_ "GenSigStartValue" SG_ 1097 DET_RANGE_VELOCITY_295 16384;
BA_ "GenSigStartValue" SG_ 1097 DET_RCS_295 128;
BA_ "GenSigStartValue" SG_ 1097 DET_RANGE_VELOCITY_296 16384;
BA_ "GenSigStartValue" SG_ 1097 DET_RCS_296 128;
BA_ "GenSigStartValue" SG_ 1098 DET_RANGE_VELOCITY_297 16384;
BA_ "GenSigStartValue" SG_ 1098 DET_RCS_297 128;
BA_ "GenSigStartValue" SG_ 1098 DET_RANGE_VELOCITY_298 16384;
BA_ "GenSigStartValue" SG_ 1098 DET_RCS_298 128;
BA_ "GenSigStartValue" SG_ 1098 DET_RANGE_VELOCITY_299 16384;
BA_ "GenSigStartValue" SG_ 1098 DET_RCS_299 128;
BA_ "GenSigStartValue" SG_ 1098 DET_RANGE_VELOCITY_300 16384;
BA_ "GenSigStartValue" SG_ 1098 DET_RCS_300 128;
BA_ "GenSigStartValue" SG_ 1099 DET_RANGE_VELOCITY_301 16384;
BA_ "GenSigStartValue" SG_ 1099 DET_RCS_301 128;
BA_ "GenSigStartValue" SG_ 1099 DET_RANGE_VELOCITY_302 16384;
BA_ "GenSigStartValue" SG_ 1099 DET_RCS_302 128;
BA_ "GenSigStartValue" SG_ 1099 DET_RANGE_VELOCITY_303 16384;
BA_ "GenSigStartValue" SG_ 1099 DET_RCS_303 128;
BA_ "GenSigStartValue" SG_ 1099 DET_RANGE_VELOCITY_304 16384;
BA_ "GenSigStartValue" SG_ 1099 DET_RCS_304 128;
BA_ "GenSigStartValue" SG_ 1100 DET_RANGE_VELOCITY_305 16384;
BA_ "GenSigStartValue" SG_ 1100 DET_RCS_305 128;
BA_ "GenSigStartValue" SG_ 1100 DET_RANGE_VELOCITY_306 16384;
BA_ "GenSigStartValue" SG_ 1100 DET_RCS_306 128;
BA_ "GenSigStartValue" SG_ 1100 DET_RANGE_VELOCITY_307 16384;
BA_ "GenSigStartValue" SG_ 1100 DET_RCS_307 128;
BA_ "GenSigStartValue" SG_ 1100 DET_RANGE_VELOCITY_308 16384;
BA_ "GenSigStartValue" SG_ 1100 DET_RCS_308 128;
BA_ "GenSigStartValue" SG_ 1101 DET_RANGE_VELOCITY_309 16384;
BA_ "GenSigStartValue" SG_ 1101 DET_RCS_309 128;
BA_ "GenSigStartValue" SG_ 1101 DET_RANGE_VELOCITY_310 16384;
BA_ "GenSigStartValue" SG_ 1101 DET_RCS_310 128;
BA_ "GenSigStartValue" SG_ 1101 DET_RANGE_VELOCITY_311 16384;
BA_ "GenSigStartValue" SG_ 1101 DET_RCS_311 128;
BA_ "GenSigStartValue" SG_ 1101 DET_RANGE_VELOCITY_312 16384;
BA_ "GenSigStartValue" SG_ 1101 DET_RCS_312 128;
BA_ "GenSigStartValue" SG_ 1102 DET_RANGE_VELOCITY_313 16384;
BA_ "GenSigStartValue" SG_ 1102 DET_RCS_313 128;
BA_ "GenSigStartValue" SG_ 1102 DET_RANGE_VELOCITY_314 16384;
BA_ "GenSigStartValue" SG_ 1102 DET_RCS_314 128;
BA_ "GenSigStartValue" SG_ 1102 DET_RANGE_VELOCITY_315 16384;
BA_ "GenSigStartValue" SG_ 1102 DET_RCS_315 128;
BA_ "GenSigStartValue" SG_ 1102 DET_RANGE_VELOCITY_316 16384;
BA_ "GenSigStartValue" SG_ 1102 DET_RCS_316 128;
BA_ "GenSigStartValue" SG_ 1103 DET_RANGE_VELOCITY_317 16384;
BA_ "GenSigStartValue" SG_ 1103 DET_RCS_317 128;
BA_ "GenSigStartValue" SG_ 1103 DET_RANGE_VELOCITY_318 16384;
BA_ "GenSigStartValue" SG_ 1103 DET_RCS_318 128;
BA_ "GenSigStartValue" SG_ 1103 DET_RANGE_VELOCITY_319 16384;
BA_ "GenSigStartValue" SG_ 1103 DET_RCS_319 128;
BA_ "GenSigStartValue" SG_ 1103 DET_RANGE_VELOCITY_320 16384;
BA_ "GenSigStartValue" SG_ 1103 DET_RCS_320 128;
BA_ "GenSigStartValue" SG_ 1104 DET_RANGE_VELOCITY_321 16384;
BA_ "GenSigStartValue" SG_ 1104 DET_RCS_321 128;
BA_ "GenSigStartValue" SG_ 1104 DET_RANGE_VELOCITY_322 16384;
BA_ "GenSigStartValue" SG_ 1104 DET_RCS_322 128;
BA_ "GenSigStartValue" SG_ 1104 DET_RANGE_VELOCITY_323 16384;
BA_ "GenSigStartValue" SG_ 1104 DET_RCS_323 128;
BA_ "GenSigStartValue" SG_ 1104 DET_RANGE_VELOCITY_324 16384;
BA_ "GenSigStartValue" SG_ 1104 DET_RCS_324 128;
BA_ "GenSigStartValue" SG_ 1105 DET_RANGE_VELOCITY_325 16384;
BA_ "GenSigStartValue" SG_ 1105 DET_RCS_325 128;
BA_ "GenSigStartValue" SG_ 1105 DET_RANGE_VELOCITY_326 16384;
BA_ "GenSigStartValue" SG_ 1105 DET_RCS_326 128;
BA_ "GenSigStartValue" SG_ 1105 DET_RANGE_VELOCITY_327 16384;
BA_ "GenSigStartValue" SG_ 1105 DET_RCS_327 128;
BA_ "GenSigStartValue" SG_ 1105 DET_RANGE_VELOCITY_328 16384;
BA_ "GenSigStartValue" SG_ 1105 DET_RCS_328 128;
BA_ "GenSigStartValue" SG_ 1106 DET_RANGE_VELOCITY_329 16384;
BA_ "GenSigStartValue" SG_ 1106 DET_RCS_329 128;
BA_ "GenSigStartValue" SG_ 1106 DET_RANGE_VELOCITY_330 16384;
BA_ "GenSigStartValue" SG_ 1106 DET_RCS_330 128;
BA_ "GenSigStartValue" SG_ 1106 DET_RANGE_VELOCITY_331 16384;
BA_ "GenSigStartValue" SG_ 1106 DET_RCS_331 128;
BA_ "GenSigStartValue" SG_ 1106 DET_RANGE_VELOCITY_332 16384;
BA_ "GenSigStartValue" SG_ 1106 DET_RCS_332 128;
VAL_ 1089 DET_CONFD_AZIMUTH_261 0 "High" 1 "MidHigh" 2 "MidLow" 3 "Low" ;
VAL_ 1089 DET_CONFD_ELEVATION_261 0 "High" 1 "MidHigh" 2 "MidLow" 3 "Low" ;
VAL_ 1089 DET_CONFD_AZIMUTH_262 0 "High" 1 "MidHigh" 2 "MidLow" 3 "Low" ;
VAL_ 1089 DET_CONFD_ELEVATION_262 0 "High" 1 "MidHigh" 2 "MidLow" 3 "Low" ;
VAL_ 1089 DET_CONFD_AZIMUTH_263 0 "High" 1 "MidHigh" 2 "MidLow" 3 "Low" ;
VAL_ 1089 DET_CONFD_ELEVATION_263 0 "High" 1 "MidHigh" 2 "MidLow" 3 "Low" ;
VAL_ 1090 DET_CONFD_AZIMUTH_265 0 "High" 1 "MidHigh" 2 "MidLow" 3 "Low" ;
VAL_ 1090 DET_CONFD_ELEVATION_265 0 "High" 1 "MidHigh" 2 "MidLow" 3 "Low" ;
VAL_ 1090 DET_CONFD_AZIMUTH_266 0 "High" 1 "MidHigh" 2 "MidLow" 3 "Low" ;
VAL_ 1090 DET_CONFD_ELEVATION_266 0 "High" 1 "MidHigh" 2 "MidLow" 3 "Low" ;
VAL_ 1090 DET_CONFD_AZIMUTH_267 0 "High" 1 "MidHigh" 2 "MidLow" 3 "Low" ;
VAL_ 1090 DET_CONFD_ELEVATION_267 0 "High" 1 "MidHigh" 2 "MidLow" 3 "Low" ;
VAL_ 1091 DET_CONFD_AZIMUTH_269 0 "High" 1 "MidHigh" 2 "MidLow" 3 "Low" ;
VAL_ 1091 DET_CONFD_ELEVATION_269 0 "High" 1 "MidHigh" 2 "MidLow" 3 "Low" ;
VAL_ 1091 DET_CONFD_AZIMUTH_270 0 "High" 1 "MidHigh" 2 "MidLow" 3 "Low" ;
VAL_ 1091 DET_CONFD_ELEVATION_270 0 "High" 1 "MidHigh" 2 "MidLow" 3 "Low" ;
VAL_ 1091 DET_CONFD_AZIMUTH_271 0 "High" 1 "MidHigh" 2 "MidLow" 3 "Low" ;
VAL_ 1091 DET_CONFD_ELEVATION_271 0 "High" 1 "MidHigh" 2 "MidLow" 3 "Low" ;
VAL_ 1092 DET_CONFD_AZIMUTH_273 0 "High" 1 "MidHigh" 2 "MidLow" 3 "Low" ;
VAL_ 1092 DET_CONFD_ELEVATION_273 0 "High" 1 "MidHigh" 2 "MidLow" 3 "Low" ;
VAL_ 1092 DET_CONFD_AZIMUTH_274 0 "High" 1 "MidHigh" 2 "MidLow" 3 "Low" ;
VAL_ 1092 DET_CONFD_ELEVATION_274 0 "High" 1 "MidHigh" 2 "MidLow" 3 "Low" ;
VAL_ 1092 DET_CONFD_AZIMUTH_275 0 "High" 1 "MidHigh" 2 "MidLow" 3 "Low" ;
VAL_ 1092 DET_CONFD_ELEVATION_275 0 "High" 1 "MidHigh" 2 "MidLow" 3 "Low" ;
VAL_ 1093 DET_CONFD_AZIMUTH_277 0 "High" 1 "MidHigh" 2 "MidLow" 3 "Low" ;
VAL_ 1093 DET_CONFD_ELEVATION_277 0 "High" 1 "MidHigh" 2 "MidLow" 3 "Low" ;
VAL_ 1093 DET_CONFD_AZIMUTH_278 0 "High" 1 "MidHigh" 2 "MidLow" 3 "Low" ;
VAL_ 1093 DET_CONFD_ELEVATION_278 0 "High" 1 "MidHigh" 2 "MidLow" 3 "Low" ;
VAL_ 1093 DET_CONFD_AZIMUTH_279 0 "High" 1 "MidHigh" 2 "MidLow" 3 "Low" ;
VAL_ 1093 DET_CONFD_ELEVATION_279 0 "High" 1 "MidHigh" 2 "MidLow" 3 "Low" ;
VAL_ 1094 DET_CONFD_AZIMUTH_281 0 "High" 1 "MidHigh" 2 "MidLow" 3 "Low" ;
VAL_ 1094 DET_CONFD_ELEVATION_281 0 "High" 1 "MidHigh" 2 "MidLow" 3 "Low" ;
VAL_ 1094 DET_CONFD_AZIMUTH_282 0 "High" 1 "MidHigh" 2 "MidLow" 3 "Low" ;
VAL_ 1094 DET_CONFD_ELEVATION_282 0 "High" 1 "MidHigh" 2 "MidLow" 3 "Low" ;
VAL_ 1094 DET_CONFD_AZIMUTH_283 0 "High" 1 "MidHigh" 2 "MidLow" 3 "Low" ;
VAL_ 1094 DET_CONFD_ELEVATION_283 0 "High" 1 "MidHigh" 2 "MidLow" 3 "Low" ;
VAL_ 1095 DET_CONFD_AZIMUTH_285 0 "High" 1 "MidHigh" 2 "MidLow" 3 "Low" ;
VAL_ 1095 DET_CONFD_ELEVATION_285 0 "High" 1 "MidHigh" 2 "MidLow" 3 "Low" ;
VAL_ 1095 DET_CONFD_AZIMUTH_286 0 "High" 1 "MidHigh" 2 "MidLow" 3 "Low" ;
VAL_ 1095 DET_CONFD_ELEVATION_286 0 "High" 1 "MidHigh" 2 "MidLow" 3 "Low" ;
VAL_ 1095 DET_CONFD_AZIMUTH_287 0 "High" 1 "MidHigh" 2 "MidLow" 3 "Low" ;
VAL_ 1095 DET_CONFD_ELEVATION_287 0 "High" 1 "MidHigh" 2 "MidLow" 3 "Low" ;
VAL_ 1096 DET_CONFD_AZIMUTH_289 0 "High" 1 "MidHigh" 2 "MidLow" 3 "Low" ;
VAL_ 1096 DET_CONFD_ELEVATION_289 0 "High" 1 "MidHigh" 2 "MidLow" 3 "Low" ;
VAL_ 1096 DET_CONFD_AZIMUTH_290 0 "High" 1 "MidHigh" 2 "MidLow" 3 "Low" ;
VAL_ 1096 DET_CONFD_ELEVATION_290 0 "High" 1 "MidHigh" 2 "MidLow" 3 "Low" ;
VAL_ 1096 DET_CONFD_AZIMUTH_291 0 "High" 1 "MidHigh" 2 "MidLow" 3 "Low" ;
VAL_ 1096 DET_CONFD_ELEVATION_291 0 "High" 1 "MidHigh" 2 "MidLow" 3 "Low" ;
VAL_ 1097 DET_CONFD_AZIMUTH_293 0 "High" 1 "MidHigh" 2 "MidLow" 3 "Low" ;
VAL_ 1097 DET_CONFD_ELEVATION_293 0 "High" 1 "MidHigh" 2 "MidLow" 3 "Low" ;
VAL_ 1097 DET_CONFD_AZIMUTH_294 0 "High" 1 "MidHigh" 2 "MidLow" 3 "Low" ;
VAL_ 1097 DET_CONFD_ELEVATION_294 0 "High" 1 "MidHigh" 2 "MidLow" 3 "Low" ;
VAL_ 1097 DET_CONFD_AZIMUTH_295 0 "High" 1 "MidHigh" 2 "MidLow" 3 "Low" ;
VAL_ 1097 DET_CONFD_ELEVATION_295 0 "High" 1 "MidHigh" 2 "MidLow" 3 "Low" ;
VAL_ 1098 DET_CONFD_AZIMUTH_297 0 "High" 1 "MidHigh" 2 "MidLow" 3 "Low" ;
VAL_ 1098 DET_CONFD_ELEVATION_297 0 "High" 1 "MidHigh" 2 "MidLow" 3 "Low" ;
VAL_ 1098 DET_CONFD_AZIMUTH_298 0 "High" 1 "MidHigh" 2 "MidLow" 3 "Low" ;
VAL_ 1098 DET_CONFD_ELEVATION_298 0 "High" 1 "MidHigh" 2 "MidLow" 3 "Low" ;
VAL_ 1098 DET_CONFD_AZIMUTH_299 0 "High" 1 "MidHigh" 2 "MidLow" 3 "Low" ;
VAL_ 1098 DET_CONFD_ELEVATION_299 0 "High" 1 "MidHigh" 2 "MidLow" 3 "Low" ;
VAL_ 1099 DET_CONFD_AZIMUTH_301 0 "High" 1 "MidHigh" 2 "MidLow" 3 "Low" ;
VAL_ 1099 DET_CONFD_ELEVATION_301 0 "High" 1 "MidHigh" 2 "MidLow" 3 "Low" ;
VAL_ 1099 DET_CONFD_AZIMUTH_302 0 "High" 1 "MidHigh" 2 "MidLow" 3 "Low" ;
VAL_ 1099 DET_CONFD_ELEVATION_302 0 "High" 1 "MidHigh" 2 "MidLow" 3 "Low" ;
VAL_ 1099 DET_CONFD_AZIMUTH_303 0 "High" 1 "MidHigh" 2 "MidLow" 3 "Low" ;
VAL_ 1099 DET_CONFD_ELEVATION_303 0 "High" 1 "MidHigh" 2 "MidLow" 3 "Low" ;
VAL_ 1100 DET_CONFD_AZIMUTH_305 0 "High" 1 "MidHigh" 2 "MidLow" 3 "Low" ;
VAL_ 1100 DET_CONFD_ELEVATION_305 0 "High" 1 "MidHigh" 2 "MidLow" 3 "Low" ;
VAL_ 1100 DET_CONFD_AZIMUTH_306 0 "High" 1 "MidHigh" 2 "MidLow" 3 "Low" ;
VAL_ 1100 DET_CONFD_ELEVATION_306 0 "High" 1 "MidHigh" 2 "MidLow" 3 "Low" ;
VAL_ 1100 DET_CONFD_AZIMUTH_307 0 "High" 1 "MidHigh" 2 "MidLow" 3 "Low" ;
VAL_ 1100 DET_CONFD_ELEVATION_307 0 "High" 1 "MidHigh" 2 "MidLow" 3 "Low" ;
VAL_ 1101 DET_CONFD_AZIMUTH_309 0 "High" 1 "MidHigh" 2 "MidLow" 3 "Low" ;
VAL_ 1101 DET_CONFD_ELEVATION_309 0 "High" 1 "MidHigh" 2 "MidLow" 3 "Low" ;
VAL_ 1101 DET_CONFD_AZIMUTH_310 0 "High" 1 "MidHigh" 2 "MidLow" 3 "Low" ;
VAL_ 1101 DET_CONFD_ELEVATION_310 0 "High" 1 "MidHigh" 2 "MidLow" 3 "Low" ;
VAL_ 1101 DET_CONFD_AZIMUTH_311 0 "High" 1 "MidHigh" 2 "MidLow" 3 "Low" ;
VAL_ 1101 DET_CONFD_ELEVATION_311 0 "High" 1 "MidHigh" 2 "MidLow" 3 "Low" ;
VAL_ 1102 DET_CONFD_AZIMUTH_313 0 "High" 1 "MidHigh" 2 "MidLow" 3 "Low" ;
VAL_ 1102 DET_CONFD_ELEVATION_313 0 "High" 1 "MidHigh" 2 "MidLow" 3 "Low" ;
VAL_ 1102 DET_CONFD_AZIMUTH_314 0 "High" 1 "MidHigh" 2 "MidLow" 3 "Low" ;
VAL_ 1102 DET_CONFD_ELEVATION_314 0 "High" 1 "MidHigh" 2 "MidLow" 3 "Low" ;
VAL_ 1102 DET_CONFD_AZIMUTH_315 0 "High" 1 "MidHigh" 2 "MidLow" 3 "Low" ;
VAL_ 1102 DET_CONFD_ELEVATION_315 0 "High" 1 "MidHigh" 2 "MidLow" 3 "Low" ;
VAL_ 1103 DET_CONFD_AZIMUTH_317 0 "High" 1 "MidHigh" 2 "MidLow" 3 "Low" ;
VAL_ 1103 DET_CONFD_ELEVATION_317 0 "High" 1 "MidHigh" 2 "MidLow" 3 "Low" ;
VAL_ 1103 DET_CONFD_AZIMUTH_318 0 "High" 1 "MidHigh" 2 "MidLow" 3 "Low" ;
VAL_ 1103 DET_CONFD_ELEVATION_318 0 "High" 1 "MidHigh" 2 "MidLow" 3 "Low" ;
VAL_ 1103 DET_CONFD_AZIMUTH_319 0 "High" 1 "MidHigh" 2 "MidLow" 3 "Low" ;
VAL_ 1103 DET_CONFD_ELEVATION_319 0 "High" 1 "MidHigh" 2 "MidLow" 3 "Low" ;
VAL_ 1104 DET_CONFD_AZIMUTH_321 0 "High" 1 "MidHigh" 2 "MidLow" 3 "Low" ;
VAL_ 1104 DET_CONFD_ELEVATION_321 0 "High" 1 "MidHigh" 2 "MidLow" 3 "Low" ;
VAL_ 1104 DET_CONFD_AZIMUTH_322 0 "High" 1 "MidHigh" 2 "MidLow" 3 "Low" ;
VAL_ 1104 DET_CONFD_ELEVATION_322 0 "High" 1 "MidHigh" 2 "MidLow" 3 "Low" ;
VAL_ 1104 DET_CONFD_AZIMUTH_323 0 "High" 1 "MidHigh" 2 "MidLow" 3 "Low" ;
VAL_ 1104 DET_CONFD_ELEVATION_323 0 "High" 1 "MidHigh" 2 "MidLow" 3 "Low" ;
VAL_ 1105 DET_CONFD_AZIMUTH_325 0 "High" 1 "MidHigh" 2 "MidLow" 3 "Low" ;
VAL_ 1105 DET_CONFD_ELEVATION_325 0 "High" 1 "MidHigh" 2 "MidLow" 3 "Low" ;
VAL_ 1105 DET_CONFD_AZIMUTH_326 0 "High" 1 "MidHigh" 2 "MidLow" 3 "Low" ;
VAL_ 1105 DET_CONFD_ELEVATION_326 0 "High" 1 "MidHigh" 2 "MidLow" 3 "Low" ;
VAL_ 1105 DET_CONFD_AZIMUTH_327 0 "High" 1 "MidHigh" 2 "MidLow" 3 "Low" ;
VAL_ 1105 DET_CONFD_ELEVATION_327 0 "High" 1 "MidHigh" 2 "MidLow" 3 "Low" ;
VAL_ 1106 DET_CONFD_AZIMUTH_329 0 "High" 1 "MidHigh" 2 "MidLow" 3 "Low" ;
VAL_ 1106 DET_CONFD_ELEVATION_329 0 "High" 1 "MidHigh" 2 "MidLow" 3 "Low" ;
VAL_ 1106 DET_CONFD_AZIMUTH_330 0 "High" 1 "MidHigh" 2 "MidLow" 3 "Low" ;
VAL_ 1106 DET_CONFD_ELEVATION_330 0 "High" 1 "MidHigh" 2 "MidLow" 3 "Low" ;
VAL_ 1106 DET_CONFD_AZIMUTH_331 0 "High" 1 "MidHigh" 2 "MidLow" 3 "Low" ;
VAL_ 1106 DET_CONFD_ELEVATION_331 0 "High" 1 "MidHigh" 2 "MidLow" 3 "Low" ;
SIG_GROUP_ 1089 Detections_261_264 1 : DET_MH_CRC16_261_264 DET_MH_CYCLE_COUNTER_261_264 DET_MH_SCAN_INDEX_4LSB_261_264 DET_CONFD_ELEVATION_261 DET_CONFD_AZIMUTH_261 DET_HVC_FLAG_261 DET_OUTSIDE_SECTOR_261 DET_EXISTENCE_PROB_261 DET_POINT_TARGET_PROB_261 DET_SNR_261 DET_SUPER_RES_TARGET_261 DET_BI_STATIC_FLAG_261 DET_VALID_FLAG_261 DET_RCS_261 DET_ELEVATION_ERR_261 DET_ELEVATION_261 DET_AZIMUTH_ERR_261 DET_AZIMUTH_261 DET_RANGE_VELOCITY_ERR_261 DET_RANGE_VELOCITY_261 DET_RANGE_ERR_261 DET_RANGE_261 DET_CONFD_ELEVATION_262 DET_CONFD_AZIMUTH_262 DET_HVC_FLAG_262 DET_OUTSIDE_SECTOR_262 DET_EXISTENCE_PROB_262 DET_POINT_TARGET_PROB_262 DET_SNR_262 DET_SUPER_RES_TARGET_262 DET_BI_STATIC_FLAG_262 DET_VALID_FLAG_262 DET_RCS_262 DET_ELEVATION_ERR_262 DET_ELEVATION_262 DET_AZIMUTH_ERR_262 DET_AZIMUTH_262 DET_RANGE_VELOCITY_ERR_262 DET_RANGE_VELOCITY_262 DET_RANGE_ERR_262 DET_RANGE_262 DET_CONFD_ELEVATION_263 DET_CONFD_AZIMUTH_263 DET_HVC_FLAG_263 DET_OUTSIDE_SECTOR_263 DET_EXISTENCE_PROB_263 DET_POINT_TARGET_PROB_263 DET_SNR_263 DET_SUPER_RES_TARGET_263 DET_BI_STATIC_FLAG_263 DET_VALID_FLAG_263 DET_RCS_263 DET_ELEVATION_ERR_263 DET_ELEVATION_263 DET_AZIMUTH_ERR_263 DET_AZIMUTH_263 DET_RANGE_VELOCITY_ERR_263 DET_RANGE_VELOCITY_263 DET_RANGE_ERR_263 DET_RANGE_263 DET_CONFD_ELEVATION_264 DET_CONFD_AZIMUTH_264 DET_HVC_FLAG_264 DET_OUTSIDE_SECTOR_264 DET_EXISTENCE_PROB_264 DET_POINT_TARGET_PROB_264 DET_SNR_264 DET_SUPER_RES_TARGET_264 DET_BI_STATIC_FLAG_264 DET_VALID_FLAG_264 DET_RCS_264 DET_ELEVATION_ERR_264 DET_ELEVATION_264 DET_AZIMUTH_ERR_264 DET_AZIMUTH_264 DET_RANGE_VELOCITY_ERR_264 DET_RANGE_VELOCITY_264 DET_RANGE_ERR_264 DET_RANGE_264;
SIG_GROUP_ 1090 Detections_265_268 1 : DET_MH_CRC16_265_268 DET_MH_CYCLE_COUNTER_265_268 DET_MH_SCAN_INDEX_4LSB_265_268 DET_CONFD_ELEVATION_265 DET_CONFD_AZIMUTH_265 DET_HVC_FLAG_265 DET_OUTSIDE_SECTOR_265 DET_EXISTENCE_PROB_265 DET_POINT_TARGET_PROB_265 DET_SNR_265 DET_SUPER_RES_TARGET_265 DET_BI_STATIC_FLAG_265 DET_VALID_FLAG_265 DET_RCS_265 DET_ELEVATION_ERR_265 DET_ELEVATION_265 DET_AZIMUTH_ERR_265 DET_AZIMUTH_265 DET_RANGE_VELOCITY_ERR_265 DET_RANGE_VELOCITY_265 DET_RANGE_ERR_265 DET_RANGE_265 DET_CONFD_ELEVATION_266 DET_CONFD_AZIMUTH_266 DET_HVC_FLAG_266 DET_OUTSIDE_SECTOR_266 DET_EXISTENCE_PROB_266 DET_POINT_TARGET_PROB_266 DET_SNR_266 DET_SUPER_RES_TARGET_266 DET_BI_STATIC_FLAG_266 DET_VALID_FLAG_266 DET_RCS_266 DET_ELEVATION_ERR_266 DET_ELEVATION_266 DET_AZIMUTH_ERR_266 DET_AZIMUTH_266 DET_RANGE_VELOCITY_ERR_266 DET_RANGE_VELOCITY_266 DET_RANGE_ERR_266 DET_RANGE_266 DET_CONFD_ELEVATION_267 DET_CONFD_AZIMUTH_267 DET_HVC_FLAG_267 DET_OUTSIDE_SECTOR_267 DET_EXISTENCE_PROB_267 DET_POINT_TARGET_PROB_267 DET_SNR_267 DET_SUPER_RES_TARGET_267 DET_BI_STATIC_FLAG_267 DET_VALID_FLAG_267 DET_RCS_267 DET_ELEVATION_ERR_267 DET_ELEVATION_267 DET_AZIMUTH_ERR_267 DET_AZIMUTH_267 DET_RANGE_VELOCITY_ERR_267 DET_RANGE_VELOCITY_267 DET_RANGE_ERR_267 DET_RANGE_267 DET_CONFD_ELEVATION_268 DET_CONFD_AZIMUTH_268 DET_HVC_FLAG_268 DET_OUTSIDE_SECTOR_268 DET_EXISTENCE_PROB_268 DET_POINT_TARGET_PROB_268 DET_SNR_268 DET_SUPER_RES_TARGET_268 DET_BI_STATIC_FLAG_268 DET_VALID_FLAG_268 DET_RCS_268 DET_ELEVATION_ERR_268 DET_ELEVATION_268 DET_AZIMUTH_ERR_268 DET_AZIMUTH_268 DET_RANGE_VELOCITY_ERR_268 DET_RANGE_VELOCITY_268 DET_RANGE_ERR_268 DET_RANGE_268;
SIG_GROUP_ 1091 Detections_269_272 1 : DET_MH_CRC16_269_272 DET_MH_CYCLE_COUNTER_269_272 DET_MH_SCAN_INDEX_4LSB_269_272 DET_CONFD_ELEVATION_269 DET_CONFD_AZIMUTH_269 DET_HVC_FLAG_269 DET_OUTSIDE_SECTOR_269 DET_EXISTENCE_PROB_269 DET_POINT_TARGET_PROB_269 DET_SNR_269 DET_SUPER_RES_TARGET_269 DET_BI_STATIC_FLAG_269 DET_VALID_FLAG_269 DET_RCS_269 DET_ELEVATION_ERR_269 DET_ELEVATION_269 DET_AZIMUTH_ERR_269 DET_AZIMUTH_269 DET_RANGE_VELOCITY_ERR_269 DET_RANGE_VELOCITY_269 DET_RANGE_ERR_269 DET_RANGE_269 DET_CONFD_ELEVATION_270 DET_CONFD_AZIMUTH_270 DET_HVC_FLAG_270 DET_OUTSIDE_SECTOR_270 DET_EXISTENCE_PROB_270 DET_POINT_TARGET_PROB_270 DET_SNR_270 DET_SUPER_RES_TARGET_270 DET_BI_STATIC_FLAG_270 DET_VALID_FLAG_270 DET_RCS_270 DET_ELEVATION_ERR_270 DET_ELEVATION_270 DET_AZIMUTH_ERR_270 DET_AZIMUTH_270 DET_RANGE_VELOCITY_ERR_270 DET_RANGE_VELOCITY_270 DET_RANGE_ERR_270 DET_RANGE_270 DET_CONFD_ELEVATION_271 DET_CONFD_AZIMUTH_271 DET_HVC_FLAG_271 DET_OUTSIDE_SECTOR_271 DET_EXISTENCE_PROB_271 DET_POINT_TARGET_PROB_271 DET_SNR_271 DET_SUPER_RES_TARGET_271 DET_BI_STATIC_FLAG_271 DET_VALID_FLAG_271 DET_RCS_271 DET_ELEVATION_ERR_271 DET_ELEVATION_271 DET_AZIMUTH_ERR_271 DET_AZIMUTH_271 DET_RANGE_VELOCITY_ERR_271 DET_RANGE_VELOCITY_271 DET_RANGE_ERR_271 DET_RANGE_271 DET_CONFD_ELEVATION_272 DET_CONFD_AZIMUTH_272 DET_HVC_FLAG_272 DET_OUTSIDE_SECTOR_272 DET_EXISTENCE_PROB_272 DET_POINT_TARGET_PROB_272 DET_SNR_272 DET_SUPER_RES_TARGET_272 DET_BI_STATIC_FLAG_272 DET_VALID_FLAG_272 DET_RCS_272 DET_ELEVATION_ERR_272 DET_ELEVATION_272 DET_AZIMUTH_ERR_272 DET_AZIMUTH_272 DET_RANGE_VELOCITY_ERR_272 DET_RANGE_VELOCITY_272 DET_RANGE_ERR_272 DET_RANGE_272;
SIG_GROUP_ 1092 Detections_273_276 1 : DET_MH_CRC16_273_276 DET_MH_CYCLE_COUNTER_273_276 DET_MH_SCAN_INDEX_4LSB_273_276 DET_CONFD_ELEVATION_273 DET_CONFD_AZIMUTH_273 DET_HVC_FLAG_273 DET_OUTSIDE_SECTOR_273 DET_EXISTENCE_PROB_273 DET_POINT_TARGET_PROB_273 DET_SNR_273 DET_SUPER_RES_TARGET_273 DET_BI_STATIC_FLAG_273 DET_VALID_FLAG_273 DET_RCS_273 DET_ELEVATION_ERR_273 DET_ELEVATION_273 DET_AZIMUTH_ERR_273 DET_AZIMUTH_273 DET_RANGE_VELOCITY_ERR_273 DET_RANGE_VELOCITY_273 DET_RANGE_ERR_273 DET_RANGE_273 DET_CONFD_ELEVATION_274 DET_CONFD_AZIMUTH_274 DET_HVC_FLAG_274 DET_OUTSIDE_SECTOR_274 DET_EXISTENCE_PROB_274 DET_POINT_TARGET_PROB_274 DET_SNR_274 DET_SUPER_RES_TARGET_274 DET_BI_STATIC_FLAG_274 DET_VALID_FLAG_274 DET_RCS_274 DET_ELEVATION_ERR_274 DET_ELEVATION_274 DET_AZIMUTH_ERR_274 DET_AZIMUTH_274 DET_RANGE_VELOCITY_ERR_274 DET_RANGE_VELOCITY_274 DET_RANGE_ERR_274 DET_RANGE_274 DET_CONFD_ELEVATION_275 DET_CONFD_AZIMUTH_275 DET_HVC_FLAG_275 DET_OUTSIDE_SECTOR_275 DET_EXISTENCE_PROB_275 DET_POINT_TARGET_PROB_275 DET_SNR_275 DET_SUPER_RES_TARGET_275 DET_BI_STATIC_FLAG_275 DET_VALID_FLAG_275 DET_RCS_275 DET_ELEVATION_ERR_275 DET_ELEVATION_275 DET_AZIMUTH_ERR_275 DET_AZIMUTH_275 DET_RANGE_VELOCITY_ERR_275 DET_RANGE_VELOCITY_275 DET_RANGE_ERR_275 DET_RANGE_275 DET_CONFD_ELEVATION_276 DET_CONFD_AZIMUTH_276 DET_HVC_FLAG_276 DET_OUTSIDE_SECTOR_276 DET_EXISTENCE_PROB_276 DET_POINT_TARGET_PROB_276 DET_SNR_276 DET_SUPER_RES_TARGET_276 DET_BI_STATIC_FLAG_276 DET_VALID_FLAG_276 DET_RCS_276 DET_ELEVATION_ERR_276 DET_ELEVATION_276 DET_AZIMUTH_ERR_276 DET_AZIMUTH_276 DET_RANGE_VELOCITY_ERR_276 DET_RANGE_VELOCITY_276 DET_RANGE_ERR_276 DET_RANGE_276;
SIG_GROUP_ 1093 Detections_277_280 1 : DET_MH_CRC16_277_280 DET_MH_CYCLE_COUNTER_277_280 DET_MH_SCAN_INDEX_4LSB_277_280 DET_CONFD_ELEVATION_277 DET_CONFD_AZIMUTH_277 DET_HVC_FLAG_277 DET_OUTSIDE_SECTOR_277 DET_EXISTENCE_PROB_277 DET_POINT_TARGET_PROB_277 DET_SNR_277 DET_SUPER_RES_TARGET_277 DET_BI_STATIC_FLAG_277 DET_VALID_FLAG_277 DET_RCS_277 DET_ELEVATION_ERR_277 DET_ELEVATION_277 DET_AZIMUTH_ERR_277 DET_AZIMUTH_277 DET_RANGE_VELOCITY_ERR_277 DET_RANGE_VELOCITY_277 DET_RANGE_ERR_277 DET_RANGE_277 DET_CONFD_ELEVATION_278 DET_CONFD_AZIMUTH_278 DET_HVC_FLAG_278 DET_OUTSIDE_SECTOR_278 DET_EXISTENCE_PROB_278 DET_POINT_TARGET_PROB_278 DET_SNR_278 DET_SUPER_RES_TARGET_278 DET_BI_STATIC_FLAG_278 DET_VALID_FLAG_278 DET_RCS_278 DET_ELEVATION_ERR_278 DET_ELEVATION_278 DET_AZIMUTH_ERR_278 DET_AZIMUTH_278 DET_RANGE_VELOCITY_ERR_278 DET_RANGE_VELOCITY_278 DET_RANGE_ERR_278 DET_RANGE_278 DET_CONFD_ELEVATION_279 DET_CONFD_AZIMUTH_279 DET_HVC_FLAG_279 DET_OUTSIDE_SECTOR_279 DET_EXISTENCE_PROB_279 DET_POINT_TARGET_PROB_279 DET_SNR_279 DET_SUPER_RES_TARGET_279 DET_BI_STATIC_FLAG_279 DET_VALID_FLAG_279 DET_RCS_279 DET_ELEVATION_ERR_279 DET_ELEVATION_279 DET_AZIMUTH_ERR_279 DET_AZIMUTH_279 DET_RANGE_VELOCITY_ERR_279 DET_RANGE_VELOCITY_279 DET_RANGE_ERR_279 DET_RANGE_279 DET_CONFD_ELEVATION_280 DET_CONFD_AZIMUTH_280 DET_HVC_FLAG_280 DET_OUTSIDE_SECTOR_280 DET_EXISTENCE_PROB_280 DET_POINT_TARGET_PROB_280 DET_SNR_280 DET_SUPER_RES_TARGET_280 DET_BI_STATIC_FLAG_280 DET_VALID_FLAG_280 DET_RCS_280 DET_ELEVATION_ERR_280 DET_ELEVATION_280 DET_AZIMUTH_ERR_280 DET_AZIMUTH_280 DET_RANGE_VELOCITY_ERR_280 DET_RANGE_VELOCITY_280 DET_RANGE_ERR_280 DET_RANGE_280;
SIG_GROUP_ 1094 Detections_281_284 1 : DET_MH_CRC16_281_284 DET_MH_CYCLE_COUNTER_281_284 DET_MH_SCAN_INDEX_4LSB_281_284 DET_CONFD_ELEVATION_281 DET_CONFD_AZIMUTH_281 DET_HVC_FLAG_281 DET_OUTSIDE_SECTOR_281 DET_EXISTENCE_PROB_281 DET_POINT_TARGET_PROB_281 DET_SNR_281 DET_SUPER_RES_TARGET_281 DET_BI_STATIC_FLAG_281 DET_VALID_FLAG_281 DET_RCS_281 DET_ELEVATION_ERR_281 DET_ELEVATION_281 DET_AZIMUTH_ERR_281 DET_AZIMUTH_281 DET_RANGE_VELOCITY_ERR_281 DET_RANGE_VELOCITY_281 DET_RANGE_ERR_281 DET_RANGE_281 DET_CONFD_ELEVATION_282 DET_CONFD_AZIMUTH_282 DET_HVC_FLAG_282 DET_OUTSIDE_SECTOR_282 DET_EXISTENCE_PROB_282 DET_POINT_TARGET_PROB_282 DET_SNR_282 DET_SUPER_RES_TARGET_282 DET_BI_STATIC_FLAG_282 DET_VALID_FLAG_282 DET_RCS_282 DET_ELEVATION_ERR_282 DET_ELEVATION_282 DET_AZIMUTH_ERR_282 DET_AZIMUTH_282 DET_RANGE_VELOCITY_ERR_282 DET_RANGE_VELOCITY_282 DET_RANGE_ERR_282 DET_RANGE_282 DET_CONFD_ELEVATION_283 DET_CONFD_AZIMUTH_283 DET_HVC_FLAG_283 DET_OUTSIDE_SECTOR_283 DET_EXISTENCE_PROB_283 DET_POINT_TARGET_PROB_283 DET_SNR_283 DET_SUPER_RES_TARGET_283 DET_BI_STATIC_FLAG_283 DET_VALID_FLAG_283 DET_RCS_283 DET_ELEVATION_ERR_283 DET_ELEVATION_283 DET_AZIMUTH_ERR_283 DET_AZIMUTH_283 DET_RANGE_VELOCITY_ERR_283 DET_RANGE_VELOCITY_283 DET_RANGE_ERR_283 DET_RANGE_283 DET_CONFD_ELEVATION_284 DET_CONFD_AZIMUTH_284 DET_HVC_FLAG_284 DET_OUTSIDE_SECTOR_284 DET_EXISTENCE_PROB_284 DET_POINT_TARGET_PROB_284 DET_SNR_284 DET_SUPER_RES_TARGET_284 DET_BI_STATIC_FLAG_284 DET_VALID_FLAG_284 DET_RCS_284 DET_ELEVATION_ERR_284 DET_ELEVATION_284 DET_AZIMUTH_ERR_284 DET_AZIMUTH_284 DET_RANGE_VELOCITY_ERR_284 DET_RANGE_VELOCITY_284 DET_RANGE_ERR_284 DET_RANGE_284;
SIG_GROUP_ 1095 Detections_285_288 1 : DET_MH_CRC16_285_288 DET_MH_CYCLE_COUNTER_285_288 DET_MH_SCAN_INDEX_4LSB_285_288 DET_CONFD_ELEVATION_285 DET_CONFD_AZIMUTH_285 DET_HVC_FLAG_285 DET_OUTSIDE_SECTOR_285 DET_EXISTENCE_PROB_285 DET_POINT_TARGET_PROB_285 DET_SNR_285 DET_SUPER_RES_TARGET_285 DET_BI_STATIC_FLAG_285 DET_VALID_FLAG_285 DET_RCS_285 DET_ELEVATION_ERR_285 DET_ELEVATION_285 DET_AZIMUTH_ERR_285 DET_AZIMUTH_285 DET_RANGE_VELOCITY_ERR_285 DET_RANGE_VELOCITY_285 DET_RANGE_ERR_285 DET_RANGE_285 DET_CONFD_ELEVATION_286 DET_CONFD_AZIMUTH_286 DET_HVC_FLAG_286 DET_OUTSIDE_SECTOR_286 DET_EXISTENCE_PROB_286 DET_POINT_TARGET_PROB_286 DET_SNR_286 DET_SUPER_RES_TARGET_286 DET_BI_STATIC_FLAG_286 DET_VALID_FLAG_286 DET_RCS_286 DET_ELEVATION_ERR_286 DET_ELEVATION_286 DET_AZIMUTH_ERR_286 DET_AZIMUTH_286 DET_RANGE_VELOCITY_ERR_286 DET_RANGE_VELOCITY_286 DET_RANGE_ERR_286 DET_RANGE_286 DET_CONFD_ELEVATION_287 DET_CONFD_AZIMUTH_287 DET_HVC_FLAG_287 DET_OUTSIDE_SECTOR_287 DET_EXISTENCE_PROB_287 DET_POINT_TARGET_PROB_287 DET_SNR_287 DET_SUPER_RES_TARGET_287 DET_BI_STATIC_FLAG_287 DET_VALID_FLAG_287 DET_RCS_287 DET_ELEVATION_ERR_287 DET_ELEVATION_287 DET_AZIMUTH_ERR_287 DET_AZIMUTH_287 DET_RANGE_VELOCITY_ERR_287 DET_RANGE_VELOCITY_287 DET_RANGE_ERR_287 DET_RANGE_287 DET_CONFD_ELEVATION_288 DET_CONFD_AZIMUTH_288 DET_HVC_FLAG_288 DET_OUTSIDE_SECTOR_288 DET_EXISTENCE_PROB_288 DET_POINT_TARGET_PROB_288 DET_SNR_288 DET_SUPER_RES_TARGET_288 DET_BI_STATIC_FLAG_288 DET_VALID_FLAG_288 DET_RCS_288 DET_ELEVATION_ERR_288 DET_ELEVATION_288 DET_AZIMUTH_ERR_288 DET_AZIMUTH_288 DET_RANGE_VELOCITY_ERR_288 DET_RANGE_VELOCITY_288 DET_RANGE_ERR_288 DET_RANGE_288;
SIG_GROUP_ 1096 Detections_289_292 1 : DET_MH_CRC16_289_292 DET_MH_CYCLE_COUNTER_289_292 DET_MH_SCAN_INDEX_4LSB_289_292 DET_CONFD_ELEVATION_289 DET_CONFD_AZIMUTH_289 DET_HVC_FLAG_289 DET_OUTSIDE_SECTOR_289 DET_EXISTENCE_PROB_289 DET_POINT_TARGET_PROB_289 DET_SNR_289 DET_SUPER_RES_TARGET_289 DET_BI_STATIC_FLAG_289 DET_VALID_FLAG_289 DET_RCS_289 DET_ELEVATION_ERR_289 DET_ELEVATION_289 DET_AZIMUTH_ERR_289 DET_AZIMUTH_289 DET_RANGE_VELOCITY_ERR_289 DET_RANGE_VELOCITY_289 DET_RANGE_ERR_289 DET_RANGE_289 DET_CONFD_ELEVATION_290 DET_CONFD_AZIMUTH_290 DET_HVC_FLAG_290 DET_OUTSIDE_SECTOR_290 DET_EXISTENCE_PROB_290 DET_POINT_TARGET_PROB_290 DET_SNR_290 DET_SUPER_RES_TARGET_290 DET_BI_STATIC_FLAG_290 DET_VALID_FLAG_290 DET_RCS_290 DET_ELEVATION_ERR_290 DET_ELEVATION_290 DET_AZIMUTH_ERR_290 DET_AZIMUTH_290 DET_RANGE_VELOCITY_ERR_290 DET_RANGE_VELOCITY_290 DET_RANGE_ERR_290 DET_RANGE_290 DET_CONFD_ELEVATION_291 DET_CONFD_AZIMUTH_291 DET_HVC_FLAG_291 DET_OUTSIDE_SECTOR_291 DET_EXISTENCE_PROB_291 DET_POINT_TARGET_PROB_291 DET_SNR_291 DET_SUPER_RES_TARGET_291 DET_BI_STATIC_FLAG_291 DET_VALID_FLAG_291 DET_RCS_291 DET_ELEVATION_ERR_291 DET_ELEVATION_291 DET_AZIMUTH_ERR_291 DET_AZIMUTH_291 DET_RANGE_VELOCITY_ERR_291 DET_RANGE_VELOCITY_291 DET_RANGE_ERR_291 DET_RANGE_291 DET_CONFD_ELEVATION_292 DET_CONFD_AZIMUTH_292 DET_HVC_FLAG_292 DET_OUTSIDE_SECTOR_292 DET_EXISTENCE_PROB_292 DET_POINT_TARGET_PROB_292 DET_SNR_292 DET_SUPER_RES_TARGET_292 DET_BI_STATIC_FLAG_292 DET_VALID_FLAG_292 DET_RCS_292 DET_ELEVATION_ERR_292 DET_ELEVATION_292 DET_AZIMUTH_ERR_292 DET_AZIMUTH_292 DET_RANGE_VELOCITY_ERR_292 DET_RANGE_VELOCITY_292 DET_RANGE_ERR_292 DET_RANGE_292;
SIG_GROUP_ 1097 Detections_293_296 1 : DET_MH_CRC16_293_296 DET_MH_CYCLE_COUNTER_293_296 DET_MH_SCAN_INDEX_4LSB_293_296 DET_CONFD_ELEVATION_293 DET_CONFD_AZIMUTH_293 DET_HVC_FLAG_293 DET_OUTSIDE_SECTOR_293 DET_EXISTENCE_PROB_293 DET_POINT_TARGET_PROB_293 DET_SNR_293 DET_SUPER_RES_TARGET_293 DET_BI_STATIC_FLAG_293 DET_VALID_FLAG_293 DET_RCS_293 DET_ELEVATION_ERR_293 DET_ELEVATION_293 DET_AZIMUTH_ERR_293 DET_AZIMUTH_293 DET_RANGE_VELOCITY_ERR_293 DET_RANGE_VELOCITY_293 DET_RANGE_ERR_293 DET_RANGE_293 DET_CONFD_ELEVATION_294 DET_CONFD_AZIMUTH_294 DET_HVC_FLAG_294 DET_OUTSIDE_SECTOR_294 DET_EXISTENCE_PROB_294 DET_POINT_TARGET_PROB_294 DET_SNR_294 DET_SUPER_RES_TARGET_294 DET_BI_STATIC_FLAG_294 DET_VALID_FLAG_294 DET_RCS_294 DET_ELEVATION_ERR_294 DET_ELEVATION_294 DET_AZIMUTH_ERR_294 DET_AZIMUTH_294 DET_RANGE_VELOCITY_ERR_294 DET_RANGE_VELOCITY_294 DET_RANGE_ERR_294 DET_RANGE_294 DET_CONFD_ELEVATION_295 DET_CONFD_AZIMUTH_295 DET_HVC_FLAG_295 DET_OUTSIDE_SECTOR_295 DET_EXISTENCE_PROB_295 DET_POINT_TARGET_PROB_295 DET_SNR_295 DET_SUPER_RES_TARGET_295 DET_BI_STATIC_FLAG_295 DET_VALID_FLAG_295 DET_RCS_295 DET_ELEVATION_ERR_295 DET_ELEVATION_295 DET_AZIMUTH_ERR_295 DET_AZIMUTH_295 DET_RANGE_VELOCITY_ERR_295 DET_RANGE_VELOCITY_295 DET_RANGE_ERR_295 DET_RANGE_295 DET_CONFD_ELEVATION_296 DET_CONFD_AZIMUTH_296 DET_HVC_FLAG_296 DET_OUTSIDE_SECTOR_296 DET_EXISTENCE_PROB_296 DET_POINT_TARGET_PROB_296 DET_SNR_296 DET_SUPER_RES_TARGET_296 DET_BI_STATIC_FLAG_296 DET_VALID_FLAG_296 DET_RCS_296 DET_ELEVATION_ERR_296 DET_ELEVATION_296 DET_AZIMUTH_ERR_296 DET_AZIMUTH_296 DET_RANGE_VELOCITY_ERR_296 DET_RANGE_VELOCITY_296 DET_RANGE_ERR_296 DET_RANGE_296;
SIG_GROUP_ 1098 Detections_297_300 1 : DET_MH_CRC16_297_300 DET_MH_CYCLE_COUNTER_297_300 DET_MH_SCAN_INDEX_4LSB_297_300 DET_CONFD_ELEVATION_297 DET_CONFD_AZIMUTH_297 DET_HVC_FLAG_297 DET_OUTSIDE_SECTOR_297 DET_EXISTENCE_PROB_297 DET_POINT_TARGET_PROB_297 DET_SNR_297 DET_SUPER_RES_TARGET_297 DET_BI_STATIC_FLAG_297 DET_VALID_FLAG_297 DET_RCS_297 DET_ELEVATION_ERR_297 DET_ELEVATION_297 DET_AZIMUTH_ERR_297 DET_AZIMUTH_297 DET_RANGE_VELOCITY_ERR_297 DET_RANGE_VELOCITY_297 DET_RANGE_ERR_297 DET_RANGE_297 DET_CONFD_ELEVATION_298 DET_CONFD_AZIMUTH_298 DET_HVC_FLAG_298 DET_OUTSIDE_SECTOR_298 DET_EXISTENCE_PROB_298 DET_POINT_TARGET_PROB_298 DET_SNR_298 DET_SUPER_RES_TARGET_298 DET_BI_STATIC_FLAG_298 DET_VALID_FLAG_298 DET_RCS_298 DET_ELEVATION_ERR_298 DET_ELEVATION_298 DET_AZIMUTH_ERR_298 DET_AZIMUTH_298 DET_RANGE_VELOCITY_ERR_298 DET_RANGE_VELOCITY_298 DET_RANGE_ERR_298 DET_RANGE_298 DET_CONFD_ELEVATION_299 DET_CONFD_AZIMUTH_299 DET_HVC_FLAG_299 DET_OUTSIDE_SECTOR_299 DET_EXISTENCE_PROB_299 DET_POINT_TARGET_PROB_299 DET_SNR_299 DET_SUPER_RES_TARGET_299 DET_BI_STATIC_FLAG_299 DET_VALID_FLAG_299 DET_RCS_299 DET_ELEVATION_ERR_299 DET_ELEVATION_299 DET_AZIMUTH_ERR_299 DET_AZIMUTH_299 DET_RANGE_VELOCITY_ERR_299 DET_RANGE_VELOCITY_299 DET_RANGE_ERR_299 DET_RANGE_299 DET_CONFD_ELEVATION_300 DET_CONFD_AZIMUTH_300 DET_HVC_FLAG_300 DET_OUTSIDE_SECTOR_300 DET_EXISTENCE_PROB_300 DET_POINT_TARGET_PROB_300 DET_SNR_300 DET_SUPER_RES_TARGET_300 DET_BI_STATIC_FLAG_300 DET_VALID_FLAG_300 DET_RCS_300 DET_ELEVATION_ERR_300 DET_ELEVATION_300 DET_AZIMUTH_ERR_300 DET_AZIMUTH_300 DET_RANGE_VELOCITY_ERR_300 DET_RANGE_VELOCITY_300 DET_RANGE_ERR_300 DET_RANGE_300;
SIG_GROUP_ 1099 Detections_301_304 1 : DET_MH_CRC16_301_304 DET_MH_CYCLE_COUNTER_301_304 DET_MH_SCAN_INDEX_4LSB_301_304 DET_CONFD_ELEVATION_301 DET_CONFD_AZIMUTH_301 DET_HVC_FLAG_301 DET_OUTSIDE_SECTOR_301 DET_EXISTENCE_PROB_301 DET_POINT_TARGET_PROB_301 DET_SNR_301 DET_SUPER_RES_TARGET_301 DET_BI_STATIC_FLAG_301 DET_VALID_FLAG_301 DET_RCS_301 DET_ELEVATION_ERR_301 DET_ELEVATION_301 DET_AZIMUTH_ERR_301 DET_AZIMUTH_301 DET_RANGE_VELOCITY_ERR_301 DET_RANGE_VELOCITY_301 DET_RANGE_ERR_301 DET_RANGE_301 DET_CONFD_ELEVATION_302 DET_CONFD_AZIMUTH_302 DET_HVC_FLAG_302 DET_OUTSIDE_SECTOR_302 DET_EXISTENCE_PROB_302 DET_POINT_TARGET_PROB_302 DET_SNR_302 DET_SUPER_RES_TARGET_302 DET_BI_STATIC_FLAG_302 DET_VALID_FLAG_302 DET_RCS_302 DET_ELEVATION_ERR_302 DET_ELEVATION_302 DET_AZIMUTH_ERR_302 DET_AZIMUTH_302 DET_RANGE_VELOCITY_ERR_302 DET_RANGE_VELOCITY_302 DET_RANGE_ERR_302 DET_RANGE_302 DET_CONFD_ELEVATION_303 DET_CONFD_AZIMUTH_303 DET_HVC_FLAG_303 DET_OUTSIDE_SECTOR_303 DET_EXISTENCE_PROB_303 DET_POINT_TARGET_PROB_303 DET_SNR_303 DET_SUPER_RES_TARGET_303 DET_BI_STATIC_FLAG_303 DET_VALID_FLAG_303 DET_RCS_303 DET_ELEVATION_ERR_303 DET_ELEVATION_303 DET_AZIMUTH_ERR_303 DET_AZIMUTH_303 DET_RANGE_VELOCITY_ERR_303 DET_RANGE_VELOCITY_303 DET_RANGE_ERR_303 DET_RANGE_303 DET_CONFD_ELEVATION_304 DET_CONFD_AZIMUTH_304 DET_HVC_FLAG_304 DET_OUTSIDE_SECTOR_304 DET_EXISTENCE_PROB_304 DET_POINT_TARGET_PROB_304 DET_SNR_304 DET_SUPER_RES_TARGET_304 DET_BI_STATIC_FLAG_304 DET_VALID_FLAG_304 DET_RCS_304 DET_ELEVATION_ERR_304 DET_ELEVATION_304 DET_AZIMUTH_ERR_304 DET_AZIMUTH_304 DET_RANGE_VELOCITY_ERR_304 DET_RANGE_VELOCITY_304 DET_RANGE_ERR_304 DET_RANGE_304;
SIG_GROUP_ 1100 Detections_305_308 1 : DET_MH_CRC16_305_308 DET_MH_CYCLE_COUNTER_305_308 DET_MH_SCAN_INDEX_4LSB_305_308 DET_CONFD_ELEVATION_305 DET_CONFD_AZIMUTH_305 DET_HVC_FLAG_305 DET_OUTSIDE_SECTOR_305 DET_EXISTENCE_PROB_305 DET_POINT_TARGET_PROB_305 DET_SNR_305 DET_SUPER_RES_TARGET_305 DET_BI_STATIC_FLAG_305 DET_VALID_FLAG_305 DET_RCS_305 DET_ELEVATION_ERR_305 DET_ELEVATION_305 DET_AZIMUTH_ERR_305 DET_AZIMUTH_305 DET_RANGE_VELOCITY_ERR_305 DET_RANGE_VELOCITY_305 DET_RANGE_ERR_305 DET_RANGE_305 DET_CONFD_ELEVATION_306 DET_CONFD_AZIMUTH_306 DET_HVC_FLAG_306 DET_OUTSIDE_SECTOR_306 DET_EXISTENCE_PROB_306 DET_POINT_TARGET_PROB_306 DET_SNR_306 DET_SUPER_RES_TARGET_306 DET_BI_STATIC_FLAG_306 DET_VALID_FLAG_306 DET_RCS_306 DET_ELEVATION_ERR_306 DET_ELEVATION_306 DET_AZIMUTH_ERR_306 DET_AZIMUTH_306 DET_RANGE_VELOCITY_ERR_306 DET_RANGE_VELOCITY_306 DET_RANGE_ERR_306 DET_RANGE_306 DET_CONFD_ELEVATION_307 DET_CONFD_AZIMUTH_307 DET_HVC_FLAG_307 DET_OUTSIDE_SECTOR_307 DET_EXISTENCE_PROB_307 DET_POINT_TARGET_PROB_307 DET_SNR_307 DET_SUPER_RES_TARGET_307 DET_BI_STATIC_FLAG_307 DET_VALID_FLAG_307 DET_RCS_307 DET_ELEVATION_ERR_307 DET_ELEVATION_307 DET_AZIMUTH_ERR_307 DET_AZIMUTH_307 DET_RANGE_VELOCITY_ERR_307 DET_RANGE_VELOCITY_307 DET_RANGE_ERR_307 DET_RANGE_307 DET_CONFD_ELEVATION_308 DET_CONFD_AZIMUTH_308 DET_HVC_FLAG_308 DET_OUTSIDE_SECTOR_308 DET_EXISTENCE_PROB_308 DET_POINT_TARGET_PROB_308 DET_SNR_308 DET_SUPER_RES_TARGET_308 DET_BI_STATIC_FLAG_308 DET_VALID_FLAG_308 DET_RCS_308 DET_ELEVATION_ERR_308 DET_ELEVATION_308 DET_AZIMUTH_ERR_308 DET_AZIMUTH_308 DET_RANGE_VELOCITY_ERR_308 DET_RANGE_VELOCITY_308 DET_RANGE_ERR_308 DET_RANGE_308;
SIG_GROUP_ 1101 Detections_309_312 1 : DET_MH_CRC16_309_312 DET_MH_CYCLE_COUNTER_309_312 DET_MH_SCAN_INDEX_4LSB_309_312 DET_CONFD_ELEVATION_309 DET_CONFD_AZIMUTH_309 DET_HVC_FLAG_309 DET_OUTSIDE_SECTOR_309 DET_EXISTENCE_PROB_309 DET_POINT_TARGET_PROB_309 DET_SNR_309 DET_SUPER_RES_TARGET_309 DET_BI_STATIC_FLAG_309 DET_VALID_FLAG_309 DET_RCS_309 DET_ELEVATION_ERR_309 DET_ELEVATION_309 DET_AZIMUTH_ERR_309 DET_AZIMUTH_309 DET_RANGE_VELOCITY_ERR_309 DET_RANGE_VELOCITY_309 DET_RANGE_ERR_309 DET_RANGE_309 DET_CONFD_ELEVATION_310 DET_CONFD_AZIMUTH_310 DET_HVC_FLAG_310 DET_OUTSIDE_SECTOR_310 DET_EXISTENCE_PROB_310 DET_POINT_TARGET_PROB_310 DET_SNR_310 DET_SUPER_RES_TARGET_310 DET_BI_STATIC_FLAG_310 DET_VALID_FLAG_310 DET_RCS_310 DET_ELEVATION_ERR_310 DET_ELEVATION_310 DET_AZIMUTH_ERR_310 DET_AZIMUTH_310 DET_RANGE_VELOCITY_ERR_310 DET_RANGE_VELOCITY_310 DET_RANGE_ERR_310 DET_RANGE_310 DET_CONFD_ELEVATION_311 DET_CONFD_AZIMUTH_311 DET_HVC_FLAG_311 DET_OUTSIDE_SECTOR_311 DET_EXISTENCE_PROB_311 DET_POINT_TARGET_PROB_311 DET_SNR_311 DET_SUPER_RES_TARGET_311 DET_BI_STATIC_FLAG_311 DET_VALID_FLAG_311 DET_RCS_311 DET_ELEVATION_ERR_311 DET_ELEVATION_311 DET_AZIMUTH_ERR_311 DET_AZIMUTH_311 DET_RANGE_VELOCITY_ERR_311 DET_RANGE_VELOCITY_311 DET_RANGE_ERR_311 DET_RANGE_311 DET_CONFD_ELEVATION_312 DET_CONFD_AZIMUTH_312 DET_HVC_FLAG_312 DET_OUTSIDE_SECTOR_312 DET_EXISTENCE_PROB_312 DET_POINT_TARGET_PROB_312 DET_SNR_312 DET_SUPER_RES_TARGET_312 DET_BI_STATIC_FLAG_312 DET_VALID_FLAG_312 DET_RCS_312 DET_ELEVATION_ERR_312 DET_ELEVATION_312 DET_AZIMUTH_ERR_312 DET_AZIMUTH_312 DET_RANGE_VELOCITY_ERR_312 DET_RANGE_VELOCITY_312 DET_RANGE_ERR_312 DET_RANGE_312;
SIG_GROUP_ 1102 Detections_313_316 1 : DET_MH_CRC16_313_316 DET_MH_CYCLE_COUNTER_313_316 DET_MH_SCAN_INDEX_4LSB_313_316 DET_CONFD_ELEVATION_313 DET_CONFD_AZIMUTH_313 DET_HVC_FLAG_313 DET_OUTSIDE_SECTOR_313 DET_EXISTENCE_PROB_313 DET_POINT_TARGET_PROB_313 DET_SNR_313 DET_SUPER_RES_TARGET_313 DET_BI_STATIC_FLAG_313 DET_VALID_FLAG_313 DET_RCS_313 DET_ELEVATION_ERR_313 DET_ELEVATION_313 DET_AZIMUTH_ERR_313 DET_AZIMUTH_313 DET_RANGE_VELOCITY_ERR_313 DET_RANGE_VELOCITY_313 DET_RANGE_ERR_313 DET_RANGE_313 DET_CONFD_ELEVATION_314 DET_CONFD_AZIMUTH_314 DET_HVC_FLAG_314 DET_OUTSIDE_SECTOR_314 DET_EXISTENCE_PROB_314 DET_POINT_TARGET_PROB_314 DET_SNR_314 DET_SUPER_RES_TARGET_314 DET_BI_STATIC_FLAG_314 DET_VALID_FLAG_314 DET_RCS_314 DET_ELEVATION_ERR_314 DET_ELEVATION_314 DET_AZIMUTH_ERR_314 DET_AZIMUTH_314 DET_RANGE_VELOCITY_ERR_314 DET_RANGE_VELOCITY_314 DET_RANGE_ERR_314 DET_RANGE_314 DET_CONFD_ELEVATION_315 DET_CONFD_AZIMUTH_315 DET_HVC_FLAG_315 DET_OUTSIDE_SECTOR_315 DET_EXISTENCE_PROB_315 DET_POINT_TARGET_PROB_315 DET_SNR_315 DET_SUPER_RES_TARGET_315 DET_BI_STATIC_FLAG_315 DET_VALID_FLAG_315 DET_RCS_315 DET_ELEVATION_ERR_315 DET_ELEVATION_315 DET_AZIMUTH_ERR_315 DET_AZIMUTH_315 DET_RANGE_VELOCITY_ERR_315 DET_RANGE_VELOCITY_315 DET_RANGE_ERR_315 DET_RANGE_315 DET_CONFD_ELEVATION_316 DET_CONFD_AZIMUTH_316 DET_HVC_FLAG_316 DET_OUTSIDE_SECTOR_316 DET_EXISTENCE_PROB_316 DET_POINT_TARGET_PROB_316 DET_SNR_316 DET_SUPER_RES_TARGET_316 DET_BI_STATIC_FLAG_316 DET_VALID_FLAG_316 DET_RCS_316 DET_ELEVATION_ERR_316 DET_ELEVATION_316 DET_AZIMUTH_ERR_316 DET_AZIMUTH_316 DET_RANGE_VELOCITY_ERR_316 DET_RANGE_VELOCITY_316 DET_RANGE_ERR_316 DET_RANGE_316;
SIG_GROUP_ 1103 Detections_317_320 1 : DET_MH_CRC16_317_320 DET_MH_CYCLE_COUNTER_317_320 DET_MH_SCAN_INDEX_4LSB_317_320 DET_CONFD_ELEVATION_317 DET_CONFD_AZIMUTH_317 DET_HVC_FLAG_317 DET_OUTSIDE_SECTOR_317 DET_EXISTENCE_PROB_317 DET_POINT_TARGET_PROB_317 DET_SNR_317 DET_SUPER_RES_TARGET_317 DET_BI_STATIC_FLAG_317 DET_VALID_FLAG_317 DET_RCS_317 DET_ELEVATION_ERR_317 DET_ELEVATION_317 DET_AZIMUTH_ERR_317 DET_AZIMUTH_317 DET_RANGE_VELOCITY_ERR_317 DET_RANGE_VELOCITY_317 DET_RANGE_ERR_317 DET_RANGE_317 DET_CONFD_ELEVATION_318 DET_CONFD_AZIMUTH_318 DET_HVC_FLAG_318 DET_OUTSIDE_SECTOR_318 DET_EXISTENCE_PROB_318 DET_POINT_TARGET_PROB_318 DET_SNR_318 DET_SUPER_RES_TARGET_318 DET_BI_STATIC_FLAG_318 DET_VALID_FLAG_318 DET_RCS_318 DET_ELEVATION_ERR_318 DET_ELEVATION_318 DET_AZIMUTH_ERR_318 DET_AZIMUTH_318 DET_RANGE_VELOCITY_ERR_318 DET_RANGE_VELOCITY_318 DET_RANGE_ERR_318 DET_RANGE_318 DET_CONFD_ELEVATION_319 DET_CONFD_AZIMUTH_319 DET_HVC_FLAG_319 DET_OUTSIDE_SECTOR_319 DET_EXISTENCE_PROB_319 DET_POINT_TARGET_PROB_319 DET_SNR_319 DET_SUPER_RES_TARGET_319 DET_BI_STATIC_FLAG_319 DET_VALID_FLAG_319 DET_RCS_319 DET_ELEVATION_ERR_319 DET_ELEVATION_319 DET_AZIMUTH_ERR_319 DET_AZIMUTH_319 DET_RANGE_VELOCITY_ERR_319 DET_RANGE_VELOCITY_319 DET_RANGE_ERR_319 DET_RANGE_319 DET_CONFD_ELEVATION_320 DET_CONFD_AZIMUTH_320 DET_HVC_FLAG_320 DET_OUTSIDE_SECTOR_320 DET_EXISTENCE_PROB_320 DET_POINT_TARGET_PROB_320 DET_SNR_320 DET_SUPER_RES_TARGET_320 DET_BI_STATIC_FLAG_320 DET_VALID_FLAG_320 DET_RCS_320 DET_ELEVATION_ERR_320 DET_ELEVATION_320 DET_AZIMUTH_ERR_320 DET_AZIMUTH_320 DET_RANGE_VELOCITY_ERR_320 DET_RANGE_VELOCITY_320 DET_RANGE_ERR_320 DET_RANGE_320;
SIG_GROUP_ 1104 Detections_321_324 1 : DET_MH_CRC16_321_324 DET_MH_CYCLE_COUNTER_321_324 DET_MH_SCAN_INDEX_4LSB_321_324 DET_CONFD_ELEVATION_321 DET_CONFD_AZIMUTH_321 DET_HVC_FLAG_321 DET_OUTSIDE_SECTOR_321 DET_EXISTENCE_PROB_321 DET_POINT_TARGET_PROB_321 DET_SNR_321 DET_SUPER_RES_TARGET_321 DET_BI_STATIC_FLAG_321 DET_VALID_FLAG_321 DET_RCS_321 DET_ELEVATION_ERR_321 DET_ELEVATION_321 DET_AZIMUTH_ERR_321 DET_AZIMUTH_321 DET_RANGE_VELOCITY_ERR_321 DET_RANGE_VELOCITY_321 DET_RANGE_ERR_321 DET_RANGE_321 DET_CONFD_ELEVATION_322 DET_CONFD_AZIMUTH_322 DET_HVC_FLAG_322 DET_OUTSIDE_SECTOR_322 DET_EXISTENCE_PROB_322 DET_POINT_TARGET_PROB_322 DET_SNR_322 DET_SUPER_RES_TARGET_322 DET_BI_STATIC_FLAG_322 DET_VALID_FLAG_322 DET_RCS_322 DET_ELEVATION_ERR_322 DET_ELEVATION_322 DET_AZIMUTH_ERR_322 DET_AZIMUTH_322 DET_RANGE_VELOCITY_ERR_322 DET_RANGE_VELOCITY_322 DET_RANGE_ERR_322 DET_RANGE_322 DET_CONFD_ELEVATION_323 DET_CONFD_AZIMUTH_323 DET_HVC_FLAG_323 DET_OUTSIDE_SECTOR_323 DET_EXISTENCE_PROB_323 DET_POINT_TARGET_PROB_323 DET_SNR_323 DET_SUPER_RES_TARGET_323 DET_BI_STATIC_FLAG_323 DET_VALID_FLAG_323 DET_RCS_323 DET_ELEVATION_ERR_323 DET_ELEVATION_323 DET_AZIMUTH_ERR_323 DET_AZIMUTH_323 DET_RANGE_VELOCITY_ERR_323 DET_RANGE_VELOCITY_323 DET_RANGE_ERR_323 DET_RANGE_323 DET_CONFD_ELEVATION_324 DET_CONFD_AZIMUTH_324 DET_HVC_FLAG_324 DET_OUTSIDE_SECTOR_324 DET_EXISTENCE_PROB_324 DET_POINT_TARGET_PROB_324 DET_SNR_324 DET_SUPER_RES_TARGET_324 DET_BI_STATIC_FLAG_324 DET_VALID_FLAG_324 DET_RCS_324 DET_ELEVATION_ERR_324 DET_ELEVATION_324 DET_AZIMUTH_ERR_324 DET_AZIMUTH_324 DET_RANGE_VELOCITY_ERR_324 DET_RANGE_VELOCITY_324 DET_RANGE_ERR_324 DET_RANGE_324;
SIG_GROUP_ 1105 Detections_325_328 1 : DET_MH_CRC16_325_328 DET_MH_CYCLE_COUNTER_325_328 DET_MH_SCAN_INDEX_4LSB_325_328 DET_CONFD_ELEVATION_325 DET_CONFD_AZIMUTH_325 DET_HVC_FLAG_325 DET_OUTSIDE_SECTOR_325 DET_EXISTENCE_PROB_325 DET_POINT_TARGET_PROB_325 DET_SNR_325 DET_SUPER_RES_TARGET_325 DET_BI_STATIC_FLAG_325 DET_VALID_FLAG_325 DET_RCS_325 DET_ELEVATION_ERR_325 DET_ELEVATION_325 DET_AZIMUTH_ERR_325 DET_AZIMUTH_325 DET_RANGE_VELOCITY_ERR_325 DET_RANGE_VELOCITY_325 DET_RANGE_ERR_325 DET_RANGE_325 DET_CONFD_ELEVATION_326 DET_CONFD_AZIMUTH_326 DET_HVC_FLAG_326 DET_OUTSIDE_SECTOR_326 DET_EXISTENCE_PROB_326 DET_POINT_TARGET_PROB_326 DET_SNR_326 DET_SUPER_RES_TARGET_326 DET_BI_STATIC_FLAG_326 DET_VALID_FLAG_326 DET_RCS_326 DET_ELEVATION_ERR_326 DET_ELEVATION_326 DET_AZIMUTH_ERR_326 DET_AZIMUTH_326 DET_RANGE_VELOCITY_ERR_326 DET_RANGE_VELOCITY_326 DET_RANGE_ERR_326 DET_RANGE_326 DET_CONFD_ELEVATION_327 DET_CONFD_AZIMUTH_327 DET_HVC_FLAG_327 DET_OUTSIDE_SECTOR_327 DET_EXISTENCE_PROB_327 DET_POINT_TARGET_PROB_327 DET_SNR_327 DET_SUPER_RES_TARGET_327 DET_BI_STATIC_FLAG_327 DET_VALID_FLAG_327 DET_RCS_327 DET_ELEVATION_ERR_327 DET_ELEVATION_327 DET_AZIMUTH_ERR_327 DET_AZIMUTH_327 DET_RANGE_VELOCITY_ERR_327 DET_RANGE_VELOCITY_327 DET_RANGE_ERR_327 DET_RANGE_327 DET_CONFD_ELEVATION_328 DET_CONFD_AZIMUTH_328 DET_HVC_FLAG_328 DET_OUTSIDE_SECTOR_328 DET_EXISTENCE_PROB_328 DET_POINT_TARGET_PROB_328 DET_SNR_328 DET_SUPER_RES_TARGET_328 DET_BI_STATIC_FLAG_328 DET_VALID_FLAG_328 DET_RCS_328 DET_ELEVATION_ERR_328 DET_ELEVATION_328 DET_AZIMUTH_ERR_328 DET_AZIMUTH_328 DET_RANGE_VELOCITY_ERR_328 DET_RANGE_VELOCITY_328 DET_RANGE_ERR_328 DET_RANGE_328;
SIG_GROUP_ 1106 Detections_329_332 1 : DET_MH_CRC16_329_332 DET_MH_CYCLE_COUNTER_329_332 DET_MH_SCAN_INDEX_4LSB_329_332 DET_CONFD_ELEVATION_329 DET_CONFD_AZIMUTH_329 DET_HVC_FLAG_329 DET_OUTSIDE_SECTOR_329 DET_EXISTENCE_PROB_329 DET_POINT_TARGET_PROB_329 DET_SNR_329 DET_SUPER_RES_TARGET_329 DET_BI_STATIC_FLAG_329 DET_VALID_FLAG_329 DET_RCS_329 DET_ELEVATION_ERR_329 DET_ELEVATION_329 DET_AZIMUTH_ERR_329 DET_AZIMUTH_329 DET_RANGE_VELOCITY_ERR_329 DET_RANGE_VELOCITY_329 DET_RANGE_ERR_329 DET_RANGE_329 DET_CONFD_ELEVATION_330 DET_CONFD_AZIMUTH_330 DET_HVC_FLAG_330 DET_OUTSIDE_SECTOR_330 DET_EXISTENCE_PROB_330 DET_POINT_TARGET_PROB_330 DET_SNR_330 DET_SUPER_RES_TARGET_330 DET_BI_STATIC_FLAG_330 DET_VALID_FLAG_330 DET_RCS_330 DET_ELEVATION_ERR_330 DET_ELEVATION_330 DET_AZIMUTH_ERR_330 DET_AZIMUTH_330 DET_RANGE_VELOCITY_ERR_330 DET_RANGE_VELOCITY_330 DET_RANGE_ERR_330 DET_RANGE_330 DET_CONFD_ELEVATION_331 DET_CONFD_AZIMUTH_331 DET_HVC_FLAG_331 DET_OUTSIDE_SECTOR_331 DET_EXISTENCE_PROB_331 DET_POINT_TARGET_PROB_331 DET_SNR_331 DET_SUPER_RES_TARGET_331 DET_BI_STATIC_FLAG_331 DET_VALID_FLAG_331 DET_RCS_331 DET_ELEVATION_ERR_331 DET_ELEVATION_331 DET_AZIMUTH_ERR_331 DET_AZIMUTH_331 DET_RANGE_VELOCITY_ERR_331 DET_RANGE_VELOCITY_331 DET_RANGE_ERR_331 DET_RANGE_331 DET_CONFD_ELEVATION_332 DET_CONFD_AZIMUTH_332 DET_HVC_FLAG_332 DET_OUTSIDE_SECTOR_332 DET_EXISTENCE_PROB_332 DET_POINT_TARGET_PROB_332 DET_SNR_332 DET_SUPER_RES_TARGET_332 DET_BI_STATIC_FLAG_332 DET_VALID_FLAG_332 DET_RCS_332 DET_ELEVATION_ERR_332 DET_ELEVATION_332 DET_AZIMUTH_ERR_332 DET_AZIMUTH_332 DET_RANGE_VELOCITY_ERR_332 DET_RANGE_VELOCITY_332 DET_RANGE_ERR_332 DET_RANGE_332;

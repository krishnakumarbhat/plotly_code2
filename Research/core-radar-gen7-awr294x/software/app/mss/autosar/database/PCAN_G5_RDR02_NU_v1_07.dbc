VERSION "created by canmatrix"

NS_ :

BS_:

BU_: External_Tool ASDM G5_RDR02

VAL_TABLE_ VitSig_HED_AF_ALGO_PLATFORM 1 "FLR4p" 0 "GEN5";
VAL_TABLE_ vtSig_CAN_PLATFORM_VARIANT 0 "VARIANT_INVALID" 1 "VARIANT_MRR3" 2 "VARIANT_SRR5" 3 "VARIANT_RACAM" 4 "VARIANT_MRR360" 5 "VARIANT_MRR3LLP_A01" 6 "VARIANT_MRR3LLP";
VAL_TABLE_ vtSig_HED_TIME_SYNC_SRC_MASTER 1 "GLOBAL" 0 "LOCAL";
VAL_TABLE_ vtSig_STS_HARDWARE 5 "RESERVED2" 4 "RESERVED1" 3 "RCM_RDI3_HIL" 2 "RCM_RDI3_LOG" 1 "RCM" 0 "UNKNOWN";

BO_ 384 RDR_DETECTION_001_004: 64 G5_RDR02
 SG_ DET_RANGE_001 : 7|15@0+ (0.015625,0) [0|500] "m" ASDM
 SG_ DET_RANGE_ERR_001 : 8|7@0+ (0.0075,0) [0|0.9525] "m" ASDM
 SG_ DET_RANGE_VELOCITY_001 : 17|15@0+ (0.0078125,-128) [-128|127.9921875] "m/s" ASDM
 SG_ DET_RANGE_VELOCITY_ERR_001 : 34|8@0+ (0.003,0) [0|0.765] "m/s" ASDM
 SG_ DET_AZIMUTH_001 : 60|13@0+ (0.0004,-1.5708) [-1.5708|1.5708] "rad" ASDM
 SG_ DET_AZIMUTH_ERR_001 : 78|7@0+ (0.00087267,0) [0|0.11082909] "rad" ASDM
 SG_ DET_ELEVATION_001 : 42|8@0+ (0.00275,-0.34925) [-0.34925|0.34925] "rad" ASDM
 SG_ DET_ELEVATION_ERR_001 : 50|6@0+ (0.00174533,0) [0|0.10995579] "rad" ASDM
 SG_ DET_RCS_001 : 119|8@0+ (0.5,-64) [-64|63.5] "dBsm" ASDM
 SG_ DET_VALID_FLAG_001 : 100|1@0+ (1,0) [0|1] "" ASDM
 SG_ DET_BI_STATIC_FLAG_001 : 487|1@0+ (1,0) [0|1] "" ASDM
 SG_ DET_SUPER_RES_TARGET_001 : 79|1@0+ (1,0) [0|1] "" ASDM
 SG_ DET_SNR_001 : 111|8@0+ (0.35156,0) [0|89.6478] "dB" ASDM
 SG_ DET_POINT_TARGET_PROB_001 : 95|4@0+ (6.67,0) [0|100] "%" ASDM
 SG_ DET_EXISTENCE_PROB_001 : 91|6@0+ (1.588,0) [0|100] "%" ASDM
 SG_ DET_OUTSIDE_SECTOR_001 : 101|1@0+ (1,0) [0|1] "" ASDM
 SG_ DET_HVC_FLAG_001 : 87|1@0+ (1,0) [0|1] "" ASDM
 SG_ DET_CONFD_AZIMUTH_001 : 97|2@0+ (1,0) [0|3] "" ASDM
 SG_ DET_CONFD_ELEVATION_001 : 99|2@0+ (1,0) [0|3] "" ASDM
 SG_ DET_AZIMUTH_AMB_ID_001 : 82|3@0+ (1,0) [0|7] "" ASDM
 SG_ DET_AMBG_AZIMUTH_PROB_001 : 86|4@0+ (6.67,0) [0|100] "%" ASDM
 SG_ DET_RANGE_002 : 127|15@0+ (0.015625,0) [0|500] "m" ASDM
 SG_ DET_RANGE_ERR_002 : 128|7@0+ (0.0075,0) [0|0.9525] "m" ASDM
 SG_ DET_RANGE_VELOCITY_002 : 137|15@0+ (0.0078125,-128) [-128|127.9921875] "m/s" ASDM
 SG_ DET_RANGE_VELOCITY_ERR_002 : 154|8@0+ (0.003,0) [0|0.765] "m/s" ASDM
 SG_ DET_AZIMUTH_002 : 180|13@0+ (0.0004,-1.5708) [-1.5708|1.5708] "rad" ASDM
 SG_ DET_AZIMUTH_ERR_002 : 198|7@0+ (0.00087267,0) [0|0.11082909] "rad" ASDM
 SG_ DET_ELEVATION_002 : 162|8@0+ (0.00275,-0.34925) [-0.34925|0.34925] "rad" ASDM
 SG_ DET_ELEVATION_ERR_002 : 170|6@0+ (0.00174533,0) [0|0.10995579] "rad" ASDM
 SG_ DET_RCS_002 : 239|8@0+ (0.5,-64) [-64|63.5] "dBsm" ASDM
 SG_ DET_VALID_FLAG_002 : 220|1@0+ (1,0) [0|1] "" ASDM
 SG_ DET_BI_STATIC_FLAG_002 : 486|1@0+ (1,0) [0|1] "" ASDM
 SG_ DET_SUPER_RES_TARGET_002 : 199|1@0+ (1,0) [0|1] "" ASDM
 SG_ DET_SNR_002 : 231|8@0+ (0.35156,0) [0|89.6478] "dB" ASDM
 SG_ DET_POINT_TARGET_PROB_002 : 215|4@0+ (6.67,0) [0|100] "%" ASDM
 SG_ DET_EXISTENCE_PROB_002 : 211|6@0+ (1.588,0) [0|100] "%" ASDM
 SG_ DET_OUTSIDE_SECTOR_002 : 221|1@0+ (1,0) [0|1] "" ASDM
 SG_ DET_HVC_FLAG_002 : 207|1@0+ (1,0) [0|1] "" ASDM
 SG_ DET_CONFD_AZIMUTH_002 : 217|2@0+ (1,0) [0|3] "" ASDM
 SG_ DET_CONFD_ELEVATION_002 : 219|2@0+ (1,0) [0|3] "" ASDM
 SG_ DET_AZIMUTH_AMB_ID_002 : 202|3@0+ (1,0) [0|7] "" ASDM
 SG_ DET_AMBG_AZIMUTH_PROB_002 : 206|4@0+ (6.67,0) [0|100] "%" ASDM
 SG_ DET_RANGE_003 : 247|15@0+ (0.015625,0) [0|500] "m" ASDM
 SG_ DET_RANGE_ERR_003 : 248|7@0+ (0.0075,0) [0|0.9525] "m" ASDM
 SG_ DET_RANGE_VELOCITY_003 : 257|15@0+ (0.0078125,-128) [-128|127.9921875] "m/s" ASDM
 SG_ DET_RANGE_VELOCITY_ERR_003 : 274|8@0+ (0.003,0) [0|0.765] "m/s" ASDM
 SG_ DET_AZIMUTH_003 : 300|13@0+ (0.0004,-1.5708) [-1.5708|1.5708] "rad" ASDM
 SG_ DET_AZIMUTH_ERR_003 : 318|7@0+ (0.00087267,0) [0|0.11082909] "rad" ASDM
 SG_ DET_ELEVATION_003 : 282|8@0+ (0.00275,-0.34925) [-0.34925|0.34925] "rad" ASDM
 SG_ DET_ELEVATION_ERR_003 : 290|6@0+ (0.00174533,0) [0|0.10995579] "rad" ASDM
 SG_ DET_RCS_003 : 359|8@0+ (0.5,-64) [-64|63.5] "dBsm" ASDM
 SG_ DET_VALID_FLAG_003 : 340|1@0+ (1,0) [0|1] "" ASDM
 SG_ DET_BI_STATIC_FLAG_003 : 485|1@0+ (1,0) [0|1] "" ASDM
 SG_ DET_SUPER_RES_TARGET_003 : 319|1@0+ (1,0) [0|1] "" ASDM
 SG_ DET_SNR_003 : 351|8@0+ (0.35156,0) [0|89.6478] "dB" ASDM
 SG_ DET_POINT_TARGET_PROB_003 : 335|4@0+ (6.67,0) [0|100] "%" ASDM
 SG_ DET_EXISTENCE_PROB_003 : 331|6@0+ (1.588,0) [0|100] "%" ASDM
 SG_ DET_OUTSIDE_SECTOR_003 : 341|1@0+ (1,0) [0|1] "" ASDM
 SG_ DET_HVC_FLAG_003 : 327|1@0+ (1,0) [0|1] "" ASDM
 SG_ DET_CONFD_AZIMUTH_003 : 337|2@0+ (1,0) [0|3] "" ASDM
 SG_ DET_CONFD_ELEVATION_003 : 339|2@0+ (1,0) [0|3] "" ASDM
 SG_ DET_AZIMUTH_AMB_ID_003 : 322|3@0+ (1,0) [0|7] "" ASDM
 SG_ DET_AMBG_AZIMUTH_PROB_003 : 326|4@0+ (6.67,0) [0|100] "%" ASDM
 SG_ DET_RANGE_004 : 367|15@0+ (0.015625,0) [0|500] "m" ASDM
 SG_ DET_RANGE_ERR_004 : 368|7@0+ (0.0075,0) [0|0.9525] "m" ASDM
 SG_ DET_RANGE_VELOCITY_004 : 377|15@0+ (0.0078125,-128) [-128|127.9921875] "m/s" ASDM
 SG_ DET_RANGE_VELOCITY_ERR_004 : 394|8@0+ (0.003,0) [0|0.765] "m/s" ASDM
 SG_ DET_AZIMUTH_004 : 420|13@0+ (0.0004,-1.5708) [-1.5708|1.5708] "rad" ASDM
 SG_ DET_AZIMUTH_ERR_004 : 438|7@0+ (0.00087267,0) [0|0.11082909] "rad" ASDM
 SG_ DET_ELEVATION_004 : 402|8@0+ (0.00275,-0.34925) [-0.34925|0.34925] "rad" ASDM
 SG_ DET_ELEVATION_ERR_004 : 410|6@0+ (0.00174533,0) [0|0.10995579] "rad" ASDM
 SG_ DET_RCS_004 : 479|8@0+ (0.5,-64) [-64|63.5] "dBsm" ASDM
 SG_ DET_VALID_FLAG_004 : 460|1@0+ (1,0) [0|1] "" ASDM
 SG_ DET_BI_STATIC_FLAG_004 : 484|1@0+ (1,0) [0|1] "" ASDM
 SG_ DET_SUPER_RES_TARGET_004 : 439|1@0+ (1,0) [0|1] "" ASDM
 SG_ DET_SNR_004 : 471|8@0+ (0.35156,0) [0|89.6478] "dB" ASDM
 SG_ DET_POINT_TARGET_PROB_004 : 455|4@0+ (6.67,0) [0|100] "%" ASDM
 SG_ DET_EXISTENCE_PROB_004 : 451|6@0+ (1.588,0) [0|100] "%" ASDM
 SG_ DET_OUTSIDE_SECTOR_004 : 461|1@0+ (1,0) [0|1] "" ASDM
 SG_ DET_HVC_FLAG_004 : 447|1@0+ (1,0) [0|1] "" ASDM
 SG_ DET_CONFD_AZIMUTH_004 : 457|2@0+ (1,0) [0|3] "" ASDM
 SG_ DET_CONFD_ELEVATION_004 : 459|2@0+ (1,0) [0|3] "" ASDM
 SG_ DET_AZIMUTH_AMB_ID_004 : 442|3@0+ (1,0) [0|7] "" ASDM
 SG_ DET_AMBG_AZIMUTH_PROB_004 : 446|4@0+ (6.67,0) [0|100] "%" ASDM
 SG_ DET_MH_SCAN_INDEX_4LSB_001_004 : 483|4@0+ (1,0) [0|15] "" ASDM
 SG_ DET_MH_CYCLE_COUNTER_001_004 : 495|8@0+ (1,0) [0|255] "" ASDM
 SG_ DET_MH_CRC16_001_004 : 503|16@0+ (1,0) [0|65535] "" ASDM

BO_ 27 RDR_DIAG_REQ_PHYS: 64 ASDM
 SG_ Diag_Req_Phys : 7|64@0+ (1,0) [0|0] "" G5_RDR02

BO_ 28 RDR_DIAG_RESP_PHYS: 64 G5_RDR02
 SG_ Diag_Resp_Phys : 7|64@0+ (1,0) [0|0] "" ASDM

BO_ 1 SYS_TIME_SYNC: 8 ASDM
 SG_ TSYN_USERBYTE m32 : 31|8@0+ (1,0) [0|0] "" G5_RDR02
 SG_ TSYN_TIMEDOMAIN : 23|4@0+ (1,0) [0|15] "" G5_RDR02
 SG_ TSYN_SYNCTIME_SEC m32 : 39|32@0+ (1,0) [0|4294967295] "s" G5_RDR02
 SG_ TSYN_SYNCTIME_NANOSEC m40 : 39|32@0+ (1,0) [0|999999999] "ns" G5_RDR02
 SG_ TSYN_SGW m40 : 26|1@0+ (1,0) [0|0] "" G5_RDR02
 SG_ TSYN_SEQUENCE_COUNTER : 19|4@0+ (1,0) [0|15] "" G5_RDR02
 SG_ TSYN_RESERVED m40 : 31|5@0+ (1,0) [0|0] "" G5_RDR02
 SG_ TSYN_PDU M : 7|8@0+ (1,0) [0|255] "" G5_RDR02
 SG_ TSYN_OVS m40 : 25|2@0+ (1,0) [0|0] "" G5_RDR02
 SG_ TSYNC_CRC : 15|8@0+ (1,0) [0|255] "" G5_RDR02

BO_ 2 SYS_VEHICLE_STATUS: 64 ASDM
 SG_ SSTS_SW_VERSION_ASDM : 23|32@0+ (1,0) [0|4294967295] "" G5_RDR02
 SG_ SSTS_CAN_PCAN_MINOR_ASDM : 7|8@0+ (1,0) [0|255] "" G5_RDR02
 SG_ SSTS_CAN_PCAN_MAJOR_ASDM : 15|8@0+ (1,0) [0|255] "" G5_RDR02
 SG_ SSTS_YAW_RATE_CALC_QF : 71|2@0+ (1,0) [0|3] "" G5_RDR02
 SG_ SSTS_YAW_RATE_BIAS : 54|4@0+ (0.025,0) [0|0.375] "rad/s" G5_RDR02
 SG_ SSTS_YAW_RATE_CALC : 49|10@0+ (0.005,-2.24) [-2.24|2.24] "rad/s" G5_RDR02
 SG_ SSTS_VEH_SPD_COMP_FACTOR : 69|8@0- (0.001953125,1) [0.75|1.248046875] "NA" G5_RDR02
 SG_ SSTS_VEHICLE_SPEED_CALC_QF : 73|2@0+ (1,0) [0|3] "" G5_RDR02
 SG_ SSTS_VEHICLE_SPEED_CALC : 85|14@0+ (0.01,0) [0|163.83] "m/s" G5_RDR02
 SG_ SSTS_VEH_BATT_VOLT : 151|8@0+ (0.0625,0) [0|15.875] "V" G5_RDR02
 SG_ SSTS_IGN_STATUS : 139|4@0+ (1,0) [0|15] "" G5_RDR02
 SG_ SSTS_GEAR_POSITION : 143|4@0+ (1,0) [0|15] "" G5_RDR02
 SG_ SSTS_WIPER_STATUS : 128|1@0+ (1,0) [0|1] "" G5_RDR02
 SG_ SSTS_PWPCKTQ_D_STAT : 108|2@0+ (1,0) [0|3] "SED" G5_RDR02
 SG_ SSTS_CC_STAT_D_ACTL : 111|3@0+ (1,0) [0|7] "SED" G5_RDR02
 SG_ SSTS_ElPW_D_STAT : 106|3@0+ (1,0) [0|7] "SED" G5_RDR02
 SG_ SSTS_VEHOVERGND_V_EST : 119|16@0+ (0.01,0) [0|655.33] "kph" G5_RDR02
 SG_ SSTS_LROS_DRIVE_DIR : 133|4@0+ (1,0) [0|3] "" G5_RDR02
 SG_ SSTS_LROS_DRIVE_REVERSE : 129|1@0+ (1,0) [0|1] "" G5_RDR02
 SG_ SSTS_LEFT_BLINK : 134|1@0+ (1,0) [0|1] "" G5_RDR02
 SG_ SSTS_RIGHT_BLINK : 135|1@0+ (1,0) [0|1] "" G5_RDR02
 SG_ SSTS_STEERING_ANGLE_SIGN : 167|1@0+ (1,0) [0|1] "" G5_RDR02
 SG_ SSTS_STEERING_ANGLE : 166|8@0+ (0.0174533,0) [0|3.141599] "rad" G5_RDR02
 SG_ SSTS_MH_VS_CYCLE_COUNTER : 191|8@0+ (1,0) [0|255] "" G5_RDR02
 SG_ SSTS_MH_VS_CRC16 : 199|16@0+ (1,0) [0|65535] "" G5_RDR02

BO_ 141 RDR_STATUS_001: 64 G5_RDR02
 SG_ STS_TIME_STAMP_DELTA : 247|16@0- (1,0) [-32768|32767] "us" ASDM
 SG_ STS_PCAN_PROTOCOL_VER_MINOR : 135|8@0+ (1,0) [0|255] "" ASDM
 SG_ STS_PCAN_PROTOCOL_VER_MAJOR : 127|8@0+ (1,0) [0|255] "" ASDM
 SG_ STS_PLATFORM_VARIANT : 151|8@0+ (1,0) [0|65535] "" ASDM
 SG_ STS_HARDWARE_VERSION : 139|4@0+ (1,0) [0|0] "" ASDM
 SG_ STS_SERIAL_NUMBER_SEQUENCE : 163|12@0+ (1,0) [0|0] "" ASDM
 SG_ STS_SERIAL_NUM_JULIAN_YEAR : 159|3@0+ (1,2020) [2020|2027] "years" ASDM
 SG_ STS_SERIAL_NUM_JULIAN_DAY : 156|9@0+ (1,0) [0|0] "" ASDM
 SG_ STS_SW_VERSION_FIELD1 : 183|8@0+ (1,0) [0|255] "" ASDM
 SG_ STS_SW_VERSION_FIELD2 : 191|8@0+ (1,0) [0|255] "" ASDM
 SG_ STS_SW_VERSION_FIELD3 : 199|8@0+ (1,0) [0|255] "" ASDM
 SG_ STS_SW_VERSION_FIELD4 : 207|8@0+ (1,0) [0|255] "" ASDM
 SG_ STS_PBL_VERSION_FIELD1 : 215|8@0+ (1,0) [0|255] "" ASDM
 SG_ STS_PBL_VERSION_FIELD2 : 223|8@0+ (1,0) [0|255] "" ASDM
 SG_ STS_PBL_VERSION_FIELD3 : 231|8@0+ (1,0) [0|255] "" ASDM
 SG_ STS_PBL_VERSION_FIELD4 : 239|8@0+ (1,0) [0|255] "" ASDM
 SG_ STS_USC_CAL_VER_MAJOR : 7|16@0+ (1,0) [0|65535] "" ASDM
 SG_ STS_USC_CAL_VER_MINOR : 23|16@0+ (1,0) [0|65535] "" ASDM
 SG_ STS_USC_SECTION_COMPTBLITY : 39|16@0+ (1,0) [0|255] "" ASDM
 SG_ STS_SMC_CAL_VER_MAJOR : 55|16@0+ (1,0) [0|65535] "" ASDM
 SG_ STS_SMC_CAL_VER_MINOR : 71|16@0+ (1,0) [0|65535] "" ASDM
 SG_ STS_SMC_SECTION_COMPTBLITY : 87|16@0+ (1,0) [0|65535] "" ASDM
 SG_ STS_SMC_PLATFROM_VERSION : 103|8@0+ (1,0) [0|65535] "" ASDM
 SG_ STS_SENSOR_POLARITY : 266|1@0+ (1,0) [0|1] "" ASDM,External_Tool
 SG_ STS_SENSOR_MOUNT_POS_X : 311|16@0- (0.0001,0) [-3.2768|3.2767] "m" ASDM,External_Tool
 SG_ STS_SENSOR_MOUNT_POS_Y : 327|16@0- (0.0001,0) [-3.2768|3.2767] "m" ASDM,External_Tool
 SG_ STS_SENSOR_MOUNT_POS_Z : 343|16@0- (0.0001,0) [-3.2768|3.2767] "m" ASDM,External_Tool
 SG_ STS_SENSOR_MOUNT_ORNT_YAW : 263|13@0+ (0.0004,-1.5708) [-1.5708|1.7056] "rad" ASDM,External_Tool
 SG_ STS_SENSOR_MOUNT_ORNT_PITCH : 276|13@0+ (0.0004,-1.5708) [-1.5708|1.7056] "rad" ASDM,External_Tool
 SG_ STS_SENSOR_MOUNT_ORNT_ROLL : 292|13@0+ (0.0004,-1.5708) [-1.5708|1.7056] "rad" ASDM,External_Tool
 SG_ STS_SENSOR_MOUNT_LOCATION : 359|8@0+ (1,0) [0|255] "" ASDM,External_Tool
 SG_ STS_SENSOR_HEIGHT : 367|32@0+ (0.01,0) [0|42949672.95] "m" ASDM,External_Tool
 SG_ STS_DET_DBC_BASE_VER_MINOR : 407|8@0+ (1,0) [0|255] "" ASDM
 SG_ STS_DET_DBC_BASE_VER_MAJOR : 399|8@0+ (1,0) [0|255] "" ASDM
 SG_ STS_TIME_SINCE_POWER_ON : 423|32@0+ (1,0) [0|4294967295] "s" ASDM
 SG_ STS_SENSOR_POSITION : 115|4@0+ (1,0) [0|15] "" ASDM
 SG_ STS_MH_001_CRC16 : 463|16@0+ (1,0) [0|65535] "" ASDM
 SG_ STS_MH_001_CYCLE_COUNTER : 455|8@0+ (1,0) [0|255] "" ASDM

BO_ 142 RDR_STATUS_002: 64 G5_RDR02
 SG_ STS_MH_002_CYCLE_COUNTER : 495|8@0+ (1,0) [0|255] "" ASDM
 SG_ STS_MH_002_CRC16 : 503|16@0+ (1,0) [0|65535] "" ASDM
 SG_ STS_MMIC_SELECT M : 199|1@0+ (1,0) [0|0] "" ASDM
 SG_ STS_VEH_SPD_COMP_FACTOR : 39|8@0- (0.001953125,1) [0.75|1.248046875] "NA" ASDM
 SG_ STS_USC_LOAD_ERROR : 117|1@0+ (1,0) [0|0] "" ASDM
 SG_ STS_SMC_LOAD_ERROR : 114|1@0+ (1,0) [0|0] "" ASDM
 SG_ STS_UNIT_CL_BLK_CKSM_ERR : 115|1@0+ (1,0) [0|0] "" ASDM
 SG_ STS_UNIT_CAL_CHKSM_ERROR : 104|1@0+ (1,0) [0|0] "" ASDM
 SG_ STS_VER_MISALIGNMENT_ERR : 125|1@0+ (1,0) [0|0] "" ASDM
 SG_ STS_LINEARIZER_SPI_TX_ERR : 126|1@0+ (1,0) [0|0] "" ASDM
 SG_ STS_ADC_SPI_TRANSFER_ERROR : 112|1@0+ (1,0) [0|0] "" ASDM
 SG_ STS_TRANSMITTER_ID_ERROR : 127|1@0+ (1,0) [0|0] "" ASDM
 SG_ STS_SATURATED_TUNING_FREQ_ERR : 113|1@0+ (1,0) [0|0] "" ASDM
 SG_ STS_RADAR_DATA_SYNC_ERROR : 102|1@0+ (1,0) [0|0] "" ASDM
 SG_ STS_RADAR_LO_PWR_ERROR : 116|1@0+ (1,0) [0|0] "" ASDM
 SG_ STS_RADAR_TX_POWER_ERROR : 99|1@0+ (1,0) [0|0] "" ASDM
 SG_ STS_TIMER_CREATE_ERROR : 118|1@0+ (1,0) [0|0] "" ASDM
 SG_ STS_CALIBRATION_ERROR : 103|1@0+ (1,0) [0|0] "" ASDM
 SG_ STS_SPI_FEE_ERROR : 110|1@0+ (1,0) [0|0] "" ASDM
 SG_ STS_SPI_COOMM_ERROR : 86|1@0+ (1,0) [0|0] "" ASDM
 SG_ STS_HOR_MISALIGNMENT_ERR : 109|1@0+ (1,0) [0|0] "" ASDM
 SG_ STS_SIGNAL_WAIT_ERROR : 100|1@0+ (1,0) [0|0] "" ASDM
 SG_ STS_SIGNAL_SEND_ERROR : 101|1@0+ (1,0) [0|0] "" ASDM
 SG_ STS_SIGNAL_CREATE_ERROR : 92|1@0+ (1,0) [0|0] "" ASDM
 SG_ STS_SHARED_MEM_WRITE_ERROR : 94|1@0+ (1,0) [0|0] "" ASDM
 SG_ STS_SHARED_MEM_READ_ERROR : 84|1@0+ (1,0) [0|0] "" ASDM
 SG_ STS_SHARED_MEM_CONFIG_ERROR : 107|1@0+ (1,0) [0|0] "" ASDM
 SG_ STS_SHARE_MEM_INIT_ERROR : 89|1@0+ (1,0) [0|0] "" ASDM
 SG_ STS_RAM_TEST_ERROR : 81|1@0+ (1,0) [0|0] "" ASDM
 SG_ STS_MMAP_MEMORY_ERROR : 96|1@0+ (1,0) [0|0] "" ASDM
 SG_ STS_ISR_ATTACH_ERROR : 108|1@0+ (1,0) [0|0] "" ASDM
 SG_ STS_IPC_DRV_WRITE_ERROR : 93|1@0+ (1,0) [0|0] "" ASDM
 SG_ STS_IPC_DRV_TRIGGER_ERROR : 87|1@0+ (1,0) [0|0] "" ASDM
 SG_ STS_IPC_DRV_SYNC_ERROR : 111|1@0+ (1,0) [0|0] "" ASDM
 SG_ STS_IPC_DRV_READ_ERROR : 83|1@0+ (1,0) [0|0] "" ASDM
 SG_ STS_IPC_DRV_INIT_ERROR : 90|1@0+ (1,0) [0|0] "" ASDM
 SG_ STS_INTERRUPT_ENABLE_ERROR : 82|1@0+ (1,0) [0|0] "" ASDM
 SG_ STS_HIL_FORMAT_ERROR : 119|1@0+ (1,0) [0|0] "" ASDM
 SG_ STS_FLASH_FILESYSTEM_ERROR : 105|1@0+ (1,0) [0|0] "" ASDM
 SG_ STS_IPC_INIT : 124|1@0+ (1,0) [0|0] "" ASDM
 SG_ STS_INIT_ERROR : 80|1@0+ (1,0) [0|0] "" ASDM
 SG_ STS_CAN_XMT_ERROR : 85|1@0+ (1,0) [0|0] "" ASDM
 SG_ STS_CAN_RCV_ERROR : 95|1@0+ (1,0) [0|0] "" ASDM
 SG_ STS_CAN_HARDWARE_ERROR : 91|1@0+ (1,0) [0|0] "" ASDM
 SG_ STS_TIMESYNC_JITTER : 155|12@0+ (0.1,0) [0|409.5] "ms" ASDM
 SG_ STS_TIMESYNC_CORRECTION_TYP : 171|2@0+ (1,0) [0|3] "" ASDM
 SG_ STS_POINT_OF_TRIGGER : 169|10@0+ (0.1,0) [0|102.3] "ms" ASDM
 SG_ STS_NO_TSYN_ERROR : 172|1@0+ (1,0) [0|1] "" ASDM
 SG_ STS_INVALID_PDU : 173|1@0+ (1,0) [0|1] "" ASDM
 SG_ STS_SYN_CRC_ERROR : 174|1@0+ (1,0) [0|1] "" ASDM
 SG_ STS_FUP_CRC_ERROR : 175|1@0+ (1,0) [0|1] "" ASDM
 SG_ STS_SYN_SEQ_CNT_ERROR : 156|1@0+ (1,0) [0|1] "" ASDM
 SG_ STS_FUP_SEQ_CNT_ERROR : 157|1@0+ (1,0) [0|1] "" ASDM
 SG_ STS_SYN_SEC_OUT_OF_RANGE : 158|1@0+ (1,0) [0|1] "" ASDM
 SG_ STS_FUP_NSEC_OUT_OF_RANGE : 159|1@0+ (1,0) [0|1] "" ASDM
 SG_ STS_THRESHOLD_FLAG : 193|1@0+ (1,0) [0|1] "" ASDM
 SG_ STS_BRR_STATUS : 139|2@0+ (1,0) [0|2] "" ASDM
 SG_ STS_VEH_CRD_SYS_TYPE : 137|2@0+ (1,0) [0|2] "" ASDM
 SG_ STS_BLOCKAGE_STATUS : 260|3@0+ (1,0) [0|7] "" ASDM
 SG_ STS_NUM_VALID_FOV_RR : 135|4@0+ (1,0) [0|15] "" ASDM
 SG_ STS_NUM_VALID_FOV_RR_TYPE : 131|4@0+ (1,0) [0|15] "" ASDM
 SG_ STS_NUM_OF_VALID_FOV_SGMNTS : 143|4@0+ (1,0) [0|15] "" ASDM
 SG_ STS_NUM_VALID_FOV_RR_PROB : 123|4@0+ (1,0) [0|15] "" ASDM
 SG_ STS_BOARD_THERMISTOR : 463|8@0+ (1,-50) [-50|205] "C" ASDM
 SG_ STS_MMIC_MAX_TEMP : 471|8@0+ (1,-50) [-50|205] "C" ASDM
 SG_ STS_MMIC_RE_INIT_COUNT : 147|4@0+ (1,0) [0|15] "NA" ASDM
 SG_ STS_RANGE_OVERRUN_FLAG : 148|1@0+ (1,0) [0|1] "NA" ASDM
 SG_ STS_DOPPLER_OVERRUN_FLAG : 149|1@0+ (1,0) [0|1] "NA" ASDM
 SG_ STS_RDD_OVERRUN_FLAG : 150|1@0+ (1,0) [0|1] "Na" ASDM
 SG_ STS_AF_OVERRUN_FLAG : 151|1@0+ (1,0) [0|1] "NA" ASDM
 SG_ STS_MMIC0_TEMP_CHIRP m0 : 327|8@0+ (1,-50) [-50|205] "C" ASDM
 SG_ STS_MMIC0_TEMP_TX3 m0 : 319|8@0+ (1,-50) [-50|205] "C" ASDM
 SG_ STS_MMIC0_TEMP_TX2 m0 : 311|8@0+ (1,-50) [-50|205] "C" ASDM
 SG_ STS_MMIC0_TEMP_TX1 m0 : 303|8@0+ (1,-50) [-50|205] "C" ASDM
 SG_ STS_MMIC1_TEMP_CHIRP m1 : 327|8@0+ (1,-50) [-50|205] "C" ASDM
 SG_ STS_MMIC1_TEMP_TX3 m1 : 319|8@0+ (1,-50) [-50|205] "C" ASDM
 SG_ STS_MMIC1_TEMP_TX2 m1 : 311|8@0+ (1,-50) [-50|205] "C" ASDM
 SG_ STS_MMIC1_TEMP_TX1 m1 : 303|8@0+ (1,-50) [-50|205] "C" ASDM
 SG_ STS_PROCESSOR_Temp1 : 279|8@0+ (1,-50) [-50|205] "C" ASDM
 SG_ STS_PROCESSOR_Temp2 : 287|8@0+ (1,-50) [-50|205] "C" ASDM
 SG_ STS_PROCESSOR_Temp3 : 295|8@0+ (1,-50) [-50|205] "C" ASDM
 SG_ STS_SUPPLY_VOLTS_5_V : 367|8@0+ (0.08,0) [0|20.4] "V" ASDM
 SG_ STS_SUPPLY_VOLTS_2_3_V : 375|8@0+ (0.08,0) [0|20.4] "V" ASDM
 SG_ STS_SUPPLY_VOLTS_1_8_V : 359|8@0+ (0.08,0) [0|20.4] "V" ASDM
 SG_ STS_SUPPLY_VOLTS_3_3_V : 351|8@0+ (0.08,0) [0|20.4] "V" ASDM
 SG_ STS_SUPPLY_VOLTS_1_1_V : 335|8@0+ (0.08,0) [0|20.4] "V" ASDM
 SG_ STS_SUPPLY_VOLTS_0_82_V : 343|8@0+ (0.08,0) [0|20.4] "V" ASDM
 SG_ STS_MAIN_CORE_THROUGHPUT : 47|6@0+ (1.588,0) [0|100] "%" ASDM
 SG_ STS_RDD_CORE_THROUGHPUT : 453|6@0+ (1.588,0) [0|100] "%" ASDM
 SG_ STS_AF_CORE_THROUGHPUT : 445|6@0+ (1.588,0) [0|100] "%" ASDM
 SG_ STS_SYSTEM_STATUS : 196|3@0+ (1,0) [0|0] "" ASDM
 SG_ STS_SCAN_TYPE : 255|1@0+ (1,0) [0|0] "" ASDM
 SG_ STS_OVERHEAT_ERROR : 88|1@0+ (1,0) [0|0] "" ASDM
 SG_ STS_RANGE_PERF_ERROR : 98|1@0+ (1,0) [0|0] "" ASDM
 SG_ STS_COMM_ERROR : 97|1@0+ (1,0) [0|0] "" ASDM
 SG_ STS_XCVR_OPERATIONAL : 106|1@0+ (1,0) [0|0] "" ASDM
 SG_ STS_DRIVING_ENVIRONMENT : 198|2@0+ (1,0) [0|0] "" ASDM
 SG_ STS_SCAN_IDX_ROLLING_COUNT_2 : 207|2@0+ (1,0) [0|0] "" ASDM
 SG_ STS_YAW_RATE_BIAS : 67|4@0+ (0.025,0) [0|0.375] "rad/s" ASDM
 SG_ STS_AUTO_ALIGN_QUA_FACTOR : 205|2@0+ (1,0) [0|0] "" ASDM
 SG_ STS_ALIGNMENT_MODE : 203|4@0+ (1,0) [0|0] "" ASDM
 SG_ STS_CURRENT_MISALIGN_ANGLE : 191|8@0- (0.0009765625,0) [-0.174533|0.174533] "rad" ASDM
 SG_ STS_SAVED_MISALIGN_ANGLE : 215|8@0- (0.0009765625,0) [-0.174533|0.174533] "rad" ASDM
 SG_ STS_VRTCL_ALIGN_UPDATES_NBR : 239|16@0+ (1,0) [0|65535] "" ASDM
 SG_ STS_HRZNTL_ALIGN_UPDATES_NBR : 223|16@0+ (1,0) [0|65535] "" ASDM
 SG_ STS_AUTO_ALIGN_HOR_ANGLE : 254|10@0+ (0.0005,-0.1745) [-0.1745|0.337] "rad" ASDM,External_Tool
 SG_ STS_AUTO_ALIGN_VER_ANGLE : 257|10@0+ (0.0005,-0.1745) [-0.1745|0.337] "rad" ASDM,External_Tool
 SG_ STS_ACTIVE_FAULTS : 383|32@0+ (1,0) [0|4294967295] "" ASDM
 SG_ STS_LATCH_FAULTS : 415|32@0+ (1,0) [0|4294967295] "" ASDM
 SG_ STS_SCAN_INDEX : 7|16@0+ (1,0) [0|65535] "" ASDM
 SG_ STS_VEH_SPEED_DIRECTION : 22|1@0+ (1,0) [0|0] "" ASDM
 SG_ STS_RADIUS_CURVATURE : 63|8@0- (25,0) [-3200|3200] "m" ASDM
 SG_ STS_STEERING_ANGLE_SIGN : 23|1@0+ (1,0) [0|1] "" ASDM
 SG_ STS_STEERING_ANGLE : 79|8@0+ (0.0174533,0) [0|3.141599] "rad" ASDM
 SG_ STS_YAW_RATE_CALC : 41|10@0+ (0.005,-2.24) [-2.24|2.24] "rad/s" ASDM
 SG_ STS_VEHICLE_SPEED_CALC : 21|14@0+ (0.01,0) [0|163.83] "m/s" ASDM
 SG_ STS_TIME_SYNC_OFFSET : 479|16@0- (1,0) [-32768|32767] "us" ASDM

BO_ 139 RDR_STATUSCUSTOM_001: 64 G5_RDR02
 SG_ STC_SCAN_INDEX : 407|16@0+ (1,0) [0|65535] "" ASDM
 SG_ STC_MMIC0_ERR_CODE m0 : 7|32@0+ (1,0) [0|4294967295] "" ASDM
 SG_ STC_MMIC0_ISM_ERR_COUNTER m0 : 79|32@0+ (1,0) [0|4294967295] "" ASDM
 SG_ STC_MMIC0_ISM_WARN_COUNTER m0 : 303|32@0+ (1,0) [0|4294967295] "" ASDM
 SG_ STC_MMIC0_ISM_MODULE_ERR_REG m0 : 111|32@0+ (1,0) [0|4294967295] "" ASDM
 SG_ STC_MMIC0_ISM_ERR_STATUS_REG m0 : 143|32@0+ (1,0) [0|4294967295] "" ASDM
 SG_ STC_MMIC0_ISM_WARN_REG m0 : 271|32@0+ (1,0) [0|4294967295] "" ASDM
 SG_ STC_MMIC0_DRIVER_ERR_COUNTER m0 : 207|32@0+ (1,0) [0|4294967295] "" ASDM
 SG_ STC_MMIC0_T_K_UNUSED_6 m0 : 335|24@0+ (1,0) [0|255] "" ASDM
 SG_ STC_MMIC0_T_K_UNUSED_7 m0 : 359|24@0+ (1,0) [0|255] "" ASDM
 SG_ STC_MMIC0_DRIVER_ERR_FLAG1 m0 : 47|1@0+ (1,0) [0|1] "" ASDM
 SG_ STC_MMIC0_DRIVER_ERR_FLAG2 m0 : 46|1@0+ (1,0) [0|1] "" ASDM
 SG_ STC_MIPI0_ERR_COUNTER m0 : 175|32@0+ (1,0) [0|4294967295] "" ASDM
 SG_ STC_MMIC1_ERR_CODE m1 : 7|32@0+ (1,0) [0|4294967295] "" ASDM
 SG_ STC_MMIC1_ISM_ERR_COUNTER m1 : 79|32@0+ (1,0) [0|4294967295] "" ASDM
 SG_ STC_MMIC1_ISM_WARN_COUNTER m1 : 303|32@0+ (1,0) [0|4294967295] "" ASDM
 SG_ STC_MMIC1_ISM_MODULE_ERR_REG m1 : 111|32@0+ (1,0) [0|4294967295] "" ASDM
 SG_ STC_MMIC1_ISM_ERR_STATUS_REG m1 : 143|32@0+ (1,0) [0|4294967295] "" ASDM
 SG_ STC_MMIC1_ISM_WARN_REG m1 : 271|32@0+ (1,0) [0|4294967295] "" ASDM
 SG_ STC_MMIC1_DRIVER_ERR_COUNTER m1 : 207|32@0+ (1,0) [0|4294967295] "" ASDM
 SG_ STC_MMIC1_T_K_UNUSED_6 m1 : 335|24@0+ (1,0) [0|255] "" ASDM
 SG_ STC_MMIC1_T_K_UNUSED_7 m1 : 359|24@0+ (1,0) [0|255] "" ASDM
 SG_ STC_MMIC1_DRIVER_ERR_FLAG1 m1 : 47|1@0+ (1,0) [0|1] "" ASDM
 SG_ STC_MMIC1_DRIVER_ERR_FLAG2 m1 : 46|1@0+ (1,0) [0|1] "" ASDM
 SG_ STC_MIPI1_ERR_COUNTER m1 : 175|32@0+ (1,0) [0|4294967295] "" ASDM
 SG_ STC_MMIC_SELECT M : 392|1@0+ (1,0) [0|1] "" ASDM
 SG_ STC_MH_001_CYCLE_COUNTER : 423|8@0+ (1,0) [0|255] "" ASDM
 SG_ STC_MH_001_CRC16 : 431|16@0+ (1,0) [0|65535] "" ASDM

BO_ 136 RDR_HEADER_001: 64 G5_RDR02
 SG_ HED_NUM_OF_RESTBINS_USED : 31|9@0+ (1,0) [0|511] "" ASDM
 SG_ HED_NUM_OF_VALID_DETECTIONS : 38|9@0+ (1,0) [0|500] "" ASDM
 SG_ HED_INTRFC_VERSION_ID_MAJOR : 7|8@0+ (1,0) [0|255] "" ASDM
 SG_ HED_INTRFC_VERSION_ID_MINOR : 15|8@0+ (1,0) [0|255] "" ASDM
 SG_ HED_INTRFC_VERSION_ID_PATCH : 23|8@0+ (1,0) [0|255] "" ASDM
 SG_ HED_LOOK_ID : 45|3@0+ (1,0) [0|7] "" ASDM
 SG_ HED_CAN_SCAN_INDEX : 55|16@0+ (1,0) [0|65535] "" ASDM
 SG_ HED_MH_CYCLE_COUNTER : 495|8@0+ (1,0) [0|255] "" ASDM
 SG_ HED_DATA_QUALIFIER : 42|3@0+ (1,0) [0|7] "" ASDM
 SG_ HED_DET_RANGE_MAX : 71|16@0+ (0.01,0) [0|500] "m" ASDM
 SG_ HED_DET_SPEED_RANGE_MAX : 103|16@0+ (0.00390625,-128) [-128|127.99609375] "m/s" ASDM
 SG_ HED_FOV_HOR_MAX : 143|8@0+ (0.0174533,0) [0|3.14159] "rad" ASDM
 SG_ HED_FOV_VER_MAX : 159|8@0+ (0.0174533,0) [0|3.14159] "rad" ASDM
 SG_ HED_DET_RANGE_MIN : 87|16@0+ (0.01,0) [0|500] "m" ASDM
 SG_ HED_DET_SPEED_RANGE_MIN : 119|16@0+ (0.00390625,-128) [-128|127.99609375] "m/s" ASDM
 SG_ HED_FOV_HOR_MIN : 135|8@0- (0.0174533,0) [-2.2340224|2.2165691] "rad" ASDM
 SG_ HED_FOV_VER_MIN : 151|8@0- (0.0174533,0) [-2.2340224|2.2165691] "rad" ASDM
 SG_ HED_HOR_ALIGNMENT_STATUS : 167|4@0+ (1,0) [0|15] "" ASDM,External_Tool
 SG_ HED_VER_ALIGNMENT_STATUS : 163|4@0+ (1,0) [0|15] "" ASDM,External_Tool
 SG_ HED_VER_ALIGNMENT_STATE : 175|3@0+ (1,0) [0|7] "" ASDM,External_Tool
 SG_ HED_HOR_ALIGNMENT_STATE : 191|3@0+ (1,0) [0|7] "" ASDM,External_Tool
 SG_ HED_ALIGN_VER_REF : 217|10@0+ (0.0005,-0.1745) [-0.1745|0.337] "rad" ASDM,External_Tool
 SG_ HED_ALIGN_VER_QF : 207|2@0+ (1,0) [0|3] "" ASDM,External_Tool
 SG_ HED_ALIGN_VER_ANGLE : 201|10@0+ (0.0005,-0.1745) [-0.1745|0.337] "rad" ASDM,External_Tool
 SG_ HED_ALIGN_HOR_ANGLE : 172|13@0+ (0.0005,-0.1745) [-0.1745|3.921] "rad" ASDM,External_Tool
 SG_ HED_ALIGN_HOR_REF : 188|13@0+ (0.0005,-0.1745) [-0.1745|3.921] "rad" ASDM,External_Tool
 SG_ HED_ALIGN_HOR_QF : 205|2@0+ (1,0) [0|3] "" ASDM,External_Tool
 SG_ HED_SP_CORE_TIME_PEAK : 359|8@0+ (0.5,0) [0|127.5] "ms" ASDM
 SG_ HED_SP_CORE_TIME_INST : 375|8@0+ (0.5,0) [0|127.5] "ms" ASDM
 SG_ HED_RDD_CORE_TIME_PEAK : 367|8@0+ (0.5,0) [0|127.5] "ms" ASDM
 SG_ HED_RDD_CORE_TIME_INST : 383|8@0+ (0.5,0) [0|127.5] "ms" ASDM
 SG_ HED_AF_TIME_PEAK : 343|8@0+ (0.5,0) [0|127.5] "ms" ASDM
 SG_ HED_AF_TIME_INST : 351|8@0+ (0.5,0) [0|127.5] "ms" ASDM
 SG_ HED_MAIN_CORE_TIME_PEAK : 327|8@0+ (0.5,0) [0|127.5] "ms" ASDM
 SG_ HED_MAIN_CORE_TIME_INST : 335|8@0+ (0.5,0) [0|127.5] "ms" ASDM
 SG_ HED_SENSOR_TIME_STAMP_NS : 239|32@0+ (1,0) [0|4294967295] "ns" ASDM
 SG_ HED_SENSOR_TIME_STAMP_SEC : 271|32@0+ (1,0) [0|4294967295] "s" ASDM
 SG_ HED_MEASUREMENT_LATENCY : 311|16@0+ (10,0) [0|655350] "us" ASDM
 SG_ HED_TIME_SYNC_SRC_MASTER : 202|1@0+ (1,0) [0|1] "" ASDM
 SG_ HED_TIME_SYNC_VALIDITY_FLAG : 203|1@0+ (1,0) [0|1] "" ASDM
 SG_ HED_DET_SINGLE_TGT_FFT_HI_AF m1 : 407|8@0+ (1,0) [0|255] "" ASDM
 SG_ HED_DET_ESPRIT_7x7_VALID m1 : 415|7@0+ (1,0) [0|127] "" ASDM
 SG_ HED_DET_ESPRIT_7x7_INVALID m1 : 431|6@0+ (1,0) [0|63] "" ASDM
 SG_ HED_DET_NLS m1 : 223|6@0+ (1,0) [0|63] "" ASDM
 SG_ HED_DET_WTO_ESPRIT_FFT m1 : 447|7@0+ (1,0) [0|127] "" ASDM
 SG_ HED_DET_ESPRIT_MTAZ m1 : 423|7@0+ (1,0) [0|127] "" ASDM
 SG_ HED_DET_SINGLE_TGT_FFT_MH_AF m1 : 399|8@0+ (1,0) [0|255] "" ASDM
 SG_ HED_DET_PHASE_CMP_FFT_AF m1 : 391|8@0+ (1,0) [0|255] "" ASDM
 SG_ HED_MH_CRC16 : 503|16@0+ (1,0) [0|65535] "" ASDM
 SG_ HED_DET_NUM_OF_1PASS : 425|10@0+ (1,0) [0|1023] "" ASDM
 SG_ HED_DET_NUM_OF_2PASS : 440|9@0+ (1,0) [0|511] "" ASDM
 SG_ HED_TRIGGER_TIME : 463|32@0+ (1,0) [0|4294967295] "ns" ASDM
 SG_ HED_DET_BI_STATIC_COUNT : 303|8@0+ (1,0) [0|255] "" ASDM
 SG_ HED_DET_SUPER_FAST_AF m0 : 391|8@0+ (1,0) [0|255] "" ASDM
 SG_ HED_DET_ESPRIT_AF m0 : 399|8@0+ (1,0) [0|255] "" ASDM
 SG_ HED_DET_ELP_AF m0 : 423|7@0+ (1,0) [0|127] "" ASDM
 SG_ HED_DET_VALID_2PASS_AF m0 : 415|8@0+ (1,0) [0|255] "" ASDM
 SG_ HED_DET_FOURIER_AF m0 : 407|8@0+ (1,0) [0|255] "" ASDM
 SG_ HED_DET_AF_PLATFORM_SELECT M : 416|1@0+ (1,0) [0|1] "" ASDM

BO_ 15 SYS_DIAG_REQ_FUNC: 8 ASDM
 SG_ Diag_Req_Func : 7|8@0+ (1,0) [0|0] "" G5_RDR02

BO_ 24 RDR_XCP_CTO_REQ: 64 External_Tool
 SG_ STS_XCP_REQ_CTO_Byte1 : 15|8@0+ (1,0) [0|0] "" G5_RDR02
 SG_ STS_XCP_REQ_CTO_Byte2 : 23|8@0+ (1,0) [0|0] "" G5_RDR02
 SG_ STS_XCP_REQ_CTO_Byte3 : 31|8@0+ (1,0) [0|0] "" G5_RDR02
 SG_ STS_XCP_REQ_CTO_Byte4 : 39|8@0+ (1,0) [0|0] "" G5_RDR02
 SG_ STS_XCP_REQ_CTO_Byte5 : 47|8@0+ (1,0) [0|0] "" G5_RDR02
 SG_ STS_XCP_REQ_CTO_Byte6 : 55|8@0+ (1,0) [0|0] "" G5_RDR02
 SG_ STS_XCP_REQ_CTO_Byte7 : 63|8@0+ (1,0) [0|0] "" G5_RDR02
 SG_ STS_XCP_REQ_CTO_Byte8 : 71|8@0+ (1,0) [0|0] "" G5_RDR02
 SG_ STS_XCP_REQ_CTO_Byte9 : 79|8@0+ (1,0) [0|0] "" G5_RDR02
 SG_ STS_XCP_REQ_CTO_Byte10 : 87|8@0+ (1,0) [0|0] "" G5_RDR02
 SG_ STS_XCP_REQ_CTO_Byte11 : 95|8@0+ (1,0) [0|0] "" G5_RDR02
 SG_ STS_XCP_REQ_CTO_Byte12 : 103|8@0+ (1,0) [0|0] "" G5_RDR02
 SG_ STS_XCP_REQ_CTO_Byte13 : 111|8@0+ (1,0) [0|0] "" G5_RDR02
 SG_ STS_XCP_REQ_CTO_Byte14 : 119|8@0+ (1,0) [0|0] "" G5_RDR02
 SG_ STS_XCP_REQ_CTO_Byte15 : 127|8@0+ (1,0) [0|0] "" G5_RDR02
 SG_ STS_XCP_REQ_CTO_Byte16 : 135|8@0+ (1,0) [0|0] "" G5_RDR02
 SG_ STS_XCP_REQ_CTO_Byte17 : 143|8@0+ (1,0) [0|0] "" G5_RDR02
 SG_ STS_XCP_REQ_CTO_Byte18 : 151|8@0+ (1,0) [0|0] "" G5_RDR02
 SG_ STS_XCP_REQ_CTO_Byte19 : 159|8@0+ (1,0) [0|0] "" G5_RDR02
 SG_ STS_XCP_REQ_CTO_Byte20 : 167|8@0+ (1,0) [0|0] "" G5_RDR02
 SG_ STS_XCP_REQ_CTO_Byte21 : 175|8@0+ (1,0) [0|0] "" G5_RDR02
 SG_ STS_XCP_REQ_CTO_Byte22 : 183|8@0+ (1,0) [0|0] "" G5_RDR02
 SG_ STS_XCP_REQ_CTO_Byte23 : 191|8@0+ (1,0) [0|0] "" G5_RDR02
 SG_ STS_XCP_REQ_CTO_Byte24 : 199|8@0+ (1,0) [0|0] "" G5_RDR02
 SG_ STS_XCP_REQ_CTO_Byte25 : 207|8@0+ (1,0) [0|0] "" G5_RDR02
 SG_ STS_XCP_REQ_CTO_Byte26 : 215|8@0+ (1,0) [0|0] "" G5_RDR02
 SG_ STS_XCP_REQ_CTO_Byte27 : 223|8@0+ (1,0) [0|0] "" G5_RDR02
 SG_ STS_XCP_REQ_CTO_Byte28 : 231|8@0+ (1,0) [0|0] "" G5_RDR02
 SG_ STS_XCP_REQ_CTO_Byte29 : 239|8@0+ (1,0) [0|0] "" G5_RDR02
 SG_ STS_XCP_REQ_CTO_Byte30 : 247|8@0+ (1,0) [0|0] "" G5_RDR02
 SG_ STS_XCP_REQ_CTO_Byte31 : 255|8@0+ (1,0) [0|0] "" G5_RDR02
 SG_ STS_XCP_REQ_CTO_Byte32 : 263|8@0+ (1,0) [0|0] "" G5_RDR02
 SG_ STS_XCP_REQ_CTO_Byte33 : 271|8@0+ (1,0) [0|0] "" G5_RDR02
 SG_ STS_XCP_REQ_CTO_Byte34 : 279|8@0+ (1,0) [0|0] "" G5_RDR02
 SG_ STS_XCP_REQ_CTO_Byte35 : 287|8@0+ (1,0) [0|0] "" G5_RDR02
 SG_ STS_XCP_REQ_CTO_Byte36 : 295|8@0+ (1,0) [0|0] "" G5_RDR02
 SG_ STS_XCP_REQ_CTO_Byte37 : 303|8@0+ (1,0) [0|0] "" G5_RDR02
 SG_ STS_XCP_REQ_CTO_Byte38 : 311|8@0+ (1,0) [0|0] "" G5_RDR02
 SG_ STS_XCP_REQ_CTO_Byte39 : 319|8@0+ (1,0) [0|0] "" G5_RDR02
 SG_ STS_XCP_REQ_CTO_Byte40 : 327|8@0+ (1,0) [0|0] "" G5_RDR02
 SG_ STS_XCP_REQ_CTO_Byte41 : 335|8@0+ (1,0) [0|0] "" G5_RDR02
 SG_ STS_XCP_REQ_CTO_Byte42 : 343|8@0+ (1,0) [0|0] "" G5_RDR02
 SG_ STS_XCP_REQ_CTO_Byte43 : 351|8@0+ (1,0) [0|0] "" G5_RDR02
 SG_ STS_XCP_REQ_CTO_Byte44 : 359|8@0+ (1,0) [0|0] "" G5_RDR02
 SG_ STS_XCP_REQ_CTO_Byte45 : 367|8@0+ (1,0) [0|0] "" G5_RDR02
 SG_ STS_XCP_REQ_CTO_Byte46 : 375|8@0+ (1,0) [0|0] "" G5_RDR02
 SG_ STS_XCP_REQ_CTO_Byte47 : 383|8@0+ (1,0) [0|0] "" G5_RDR02
 SG_ STS_XCP_REQ_CTO_Byte48 : 391|8@0+ (1,0) [0|0] "" G5_RDR02
 SG_ STS_XCP_REQ_CTO_Byte49 : 399|8@0+ (1,0) [0|0] "" G5_RDR02
 SG_ STS_XCP_REQ_CTO_Byte50 : 407|8@0+ (1,0) [0|0] "" G5_RDR02
 SG_ STS_XCP_REQ_CTO_Byte51 : 415|8@0+ (1,0) [0|0] "" G5_RDR02
 SG_ STS_XCP_REQ_CTO_Byte52 : 423|8@0+ (1,0) [0|0] "" G5_RDR02
 SG_ STS_XCP_REQ_CTO_Byte53 : 431|8@0+ (1,0) [0|0] "" G5_RDR02
 SG_ STS_XCP_REQ_CTO_Byte54 : 439|8@0+ (1,0) [0|0] "" G5_RDR02
 SG_ STS_XCP_REQ_CTO_Byte55 : 447|8@0+ (1,0) [0|0] "" G5_RDR02
 SG_ STS_XCP_REQ_CTO_Byte56 : 455|8@0+ (1,0) [0|0] "" G5_RDR02
 SG_ STS_XCP_REQ_CTO_Byte57 : 463|8@0+ (1,0) [0|0] "" G5_RDR02
 SG_ STS_XCP_REQ_CTO_Byte58 : 471|8@0+ (1,0) [0|0] "" G5_RDR02
 SG_ STS_XCP_REQ_CTO_Byte59 : 479|8@0+ (1,0) [0|0] "" G5_RDR02
 SG_ STS_XCP_REQ_CTO_Byte60 : 487|8@0+ (1,0) [0|0] "" G5_RDR02
 SG_ STS_XCP_REQ_CTO_Byte61 : 495|8@0+ (1,0) [0|0] "" G5_RDR02
 SG_ STS_XCP_REQ_CTO_Byte62 : 503|8@0+ (1,0) [0|0] "" G5_RDR02
 SG_ STS_XCP_REQ_CTO_Byte63 : 511|8@0+ (1,0) [0|0] "" G5_RDR02
 SG_ STS_PID : 7|8@0+ (1,0) [0|0] "" G5_RDR02

BO_ 25 RDR_XCP_CTO_RESP: 64 G5_RDR02
 SG_ STS_XCP_RES_CTO_Byte0 : 7|8@0+ (1,0) [0|0] "" External_Tool
 SG_ STS_XCP_RES_CTO_Byte1 : 15|8@0+ (1,0) [0|0] "" External_Tool
 SG_ STS_XCP_RES_CTO_Byte2 : 23|8@0+ (1,0) [0|0] "" External_Tool
 SG_ STS_XCP_RES_CTO_Byte3 : 31|8@0+ (1,0) [0|0] "" External_Tool
 SG_ STS_XCP_RES_CTO_Byte4 : 39|8@0+ (1,0) [0|0] "" External_Tool
 SG_ STS_XCP_RES_CTO_Byte5 : 47|8@0+ (1,0) [0|0] "" External_Tool
 SG_ STS_XCP_RES_CTO_Byte6 : 55|8@0+ (1,0) [0|0] "" External_Tool
 SG_ STS_XCP_RES_CTO_Byte7 : 63|8@0+ (1,0) [0|0] "" External_Tool
 SG_ STS_XCP_RES_CTO_Byte8 : 71|8@0+ (1,0) [0|0] "" External_Tool
 SG_ STS_XCP_RES_CTO_Byte9 : 79|8@0+ (1,0) [0|0] "" External_Tool
 SG_ STS_XCP_RES_CTO_Byte10 : 87|8@0+ (1,0) [0|0] "" External_Tool
 SG_ STS_XCP_RES_CTO_Byte11 : 95|8@0+ (1,0) [0|0] "" External_Tool
 SG_ STS_XCP_RES_CTO_Byte12 : 103|8@0+ (1,0) [0|0] "" External_Tool
 SG_ STS_XCP_RES_CTO_Byte13 : 111|8@0+ (1,0) [0|0] "" External_Tool
 SG_ STS_XCP_RES_CTO_Byte14 : 119|8@0+ (1,0) [0|0] "" External_Tool
 SG_ STS_XCP_RES_CTO_Byte15 : 127|8@0+ (1,0) [0|0] "" External_Tool
 SG_ STS_XCP_RES_CTO_Byte16 : 135|8@0+ (1,0) [0|0] "" External_Tool
 SG_ STS_XCP_RES_CTO_Byte17 : 143|8@0+ (1,0) [0|0] "" External_Tool
 SG_ STS_XCP_RES_CTO_Byte18 : 151|8@0+ (1,0) [0|0] "" External_Tool
 SG_ STS_XCP_RES_CTO_Byte19 : 159|8@0+ (1,0) [0|0] "" External_Tool
 SG_ STS_XCP_RES_CTO_Byte20 : 167|8@0+ (1,0) [0|0] "" External_Tool
 SG_ STS_XCP_RES_CTO_Byte21 : 175|8@0+ (1,0) [0|0] "" External_Tool
 SG_ STS_XCP_RES_CTO_Byte22 : 183|8@0+ (1,0) [0|0] "" External_Tool
 SG_ STS_XCP_RES_CTO_Byte23 : 191|8@0+ (1,0) [0|0] "" External_Tool
 SG_ STS_XCP_RES_CTO_Byte24 : 199|8@0+ (1,0) [0|0] "" External_Tool
 SG_ STS_XCP_RES_CTO_Byte25 : 207|8@0+ (1,0) [0|0] "" External_Tool
 SG_ STS_XCP_RES_CTO_Byte26 : 215|8@0+ (1,0) [0|0] "" External_Tool
 SG_ STS_XCP_RES_CTO_Byte27 : 223|8@0+ (1,0) [0|0] "" External_Tool
 SG_ STS_XCP_RES_CTO_Byte28 : 231|8@0+ (1,0) [0|0] "" External_Tool
 SG_ STS_XCP_RES_CTO_Byte29 : 239|8@0+ (1,0) [0|0] "" External_Tool
 SG_ STS_XCP_RES_CTO_Byte30 : 247|8@0+ (1,0) [0|0] "" External_Tool
 SG_ STS_XCP_RES_CTO_Byte31 : 255|8@0+ (1,0) [0|0] "" External_Tool
 SG_ STS_XCP_RES_CTO_Byte32 : 263|8@0+ (1,0) [0|0] "" External_Tool
 SG_ STS_XCP_RES_CTO_Byte33 : 271|8@0+ (1,0) [0|0] "" External_Tool
 SG_ STS_XCP_RES_CTO_Byte34 : 279|8@0+ (1,0) [0|0] "" External_Tool
 SG_ STS_XCP_RES_CTO_Byte35 : 287|8@0+ (1,0) [0|0] "" External_Tool
 SG_ STS_XCP_RES_CTO_Byte36 : 295|8@0+ (1,0) [0|0] "" External_Tool
 SG_ STS_XCP_RES_CTO_Byte37 : 303|8@0+ (1,0) [0|0] "" External_Tool
 SG_ STS_XCP_RES_CTO_Byte38 : 311|8@0+ (1,0) [0|0] "" External_Tool
 SG_ STS_XCP_RES_CTO_Byte39 : 319|8@0+ (1,0) [0|0] "" External_Tool
 SG_ STS_XCP_RES_CTO_Byte40 : 327|8@0+ (1,0) [0|0] "" External_Tool
 SG_ STS_XCP_RES_CTO_Byte41 : 335|8@0+ (1,0) [0|0] "" External_Tool
 SG_ STS_XCP_RES_CTO_Byte42 : 343|8@0+ (1,0) [0|0] "" External_Tool
 SG_ STS_XCP_RES_CTO_Byte43 : 351|8@0+ (1,0) [0|0] "" External_Tool
 SG_ STS_XCP_RES_CTO_Byte44 : 359|8@0+ (1,0) [0|0] "" External_Tool
 SG_ STS_XCP_RES_CTO_Byte45 : 367|8@0+ (1,0) [0|0] "" External_Tool
 SG_ STS_XCP_RES_CTO_Byte46 : 375|8@0+ (1,0) [0|0] "" External_Tool
 SG_ STS_XCP_RES_CTO_Byte47 : 383|8@0+ (1,0) [0|0] "" External_Tool
 SG_ STS_XCP_RES_CTO_Byte48 : 391|8@0+ (1,0) [0|0] "" External_Tool
 SG_ STS_XCP_RES_CTO_Byte49 : 399|8@0+ (1,0) [0|0] "" External_Tool
 SG_ STS_XCP_RES_CTO_Byte50 : 407|8@0+ (1,0) [0|0] "" External_Tool
 SG_ STS_XCP_RES_CTO_Byte51 : 415|8@0+ (1,0) [0|0] "" External_Tool
 SG_ STS_XCP_RES_CTO_Byte52 : 423|8@0+ (1,0) [0|0] "" External_Tool
 SG_ STS_XCP_RES_CTO_Byte53 : 431|8@0+ (1,0) [0|0] "" External_Tool
 SG_ STS_XCP_RES_CTO_Byte54 : 439|8@0+ (1,0) [0|0] "" External_Tool
 SG_ STS_XCP_RES_CTO_Byte55 : 447|8@0+ (1,0) [0|0] "" External_Tool
 SG_ STS_XCP_RES_CTO_Byte56 : 455|8@0+ (1,0) [0|0] "" External_Tool
 SG_ STS_XCP_RES_CTO_Byte57 : 463|8@0+ (1,0) [0|0] "" External_Tool
 SG_ STS_XCP_RES_CTO_Byte58 : 471|8@0+ (1,0) [0|0] "" External_Tool
 SG_ STS_XCP_RES_CTO_Byte59 : 479|8@0+ (1,0) [0|0] "" External_Tool
 SG_ STS_XCP_RES_CTO_Byte60 : 487|8@0+ (1,0) [0|0] "" External_Tool
 SG_ STS_XCP_RES_CTO_Byte61 : 495|8@0+ (1,0) [0|0] "" External_Tool
 SG_ STS_XCP_RES_CTO_Byte62 : 503|8@0+ (1,0) [0|0] "" External_Tool
 SG_ STS_XCP_RES_CTO_Byte63 : 511|8@0+ (1,0) [0|0] "" External_Tool

BO_ 26 RDR_XCP_DAQ_RESP: 64 G5_RDR02
 SG_ STS_XCP_RES_DAQ_Byte0 : 7|8@0+ (1,0) [0|0] "" External_Tool
 SG_ STS_XCP_RES_DAQ_Byte1 : 15|8@0+ (1,0) [0|0] "" External_Tool
 SG_ STS_XCP_RES_DAQ_Byte2 : 23|8@0+ (1,0) [0|0] "" External_Tool
 SG_ STS_XCP_RES_DAQ_Byte3 : 31|8@0+ (1,0) [0|0] "" External_Tool
 SG_ STS_XCP_RES_DAQ_Byte4 : 39|8@0+ (1,0) [0|0] "" External_Tool
 SG_ STS_XCP_RES_DAQ_Byte5 : 47|8@0+ (1,0) [0|0] "" External_Tool
 SG_ STS_XCP_RES_DAQ_Byte6 : 55|8@0+ (1,0) [0|0] "" External_Tool
 SG_ STS_XCP_RES_DAQ_Byte7 : 63|8@0+ (1,0) [0|0] "" External_Tool
 SG_ STS_XCP_RES_DAQ_Byte8 : 71|8@0+ (1,0) [0|0] "" External_Tool
 SG_ STS_XCP_RES_DAQ_Byte9 : 79|8@0+ (1,0) [0|0] "" External_Tool
 SG_ STS_XCP_RES_DAQ_Byte10 : 87|8@0+ (1,0) [0|0] "" External_Tool
 SG_ STS_XCP_RES_DAQ_Byte11 : 95|8@0+ (1,0) [0|0] "" External_Tool
 SG_ STS_XCP_RES_DAQ_Byte12 : 103|8@0+ (1,0) [0|0] "" External_Tool
 SG_ STS_XCP_RES_DAQ_Byte13 : 111|8@0+ (1,0) [0|0] "" External_Tool
 SG_ STS_XCP_RES_DAQ_Byte14 : 119|8@0+ (1,0) [0|0] "" External_Tool
 SG_ STS_XCP_RES_DAQ_Byte15 : 127|8@0+ (1,0) [0|0] "" External_Tool
 SG_ STS_XCP_RES_DAQ_Byte16 : 135|8@0+ (1,0) [0|0] "" External_Tool
 SG_ STS_XCP_RES_DAQ_Byte17 : 143|8@0+ (1,0) [0|0] "" External_Tool
 SG_ STS_XCP_RES_DAQ_Byte18 : 151|8@0+ (1,0) [0|0] "" External_Tool
 SG_ STS_XCP_RES_DAQ_Byte19 : 159|8@0+ (1,0) [0|0] "" External_Tool
 SG_ STS_XCP_RES_DAQ_Byte20 : 167|8@0+ (1,0) [0|0] "" External_Tool
 SG_ STS_XCP_RES_DAQ_Byte21 : 175|8@0+ (1,0) [0|0] "" External_Tool
 SG_ STS_XCP_RES_DAQ_Byte22 : 183|8@0+ (1,0) [0|0] "" External_Tool
 SG_ STS_XCP_RES_DAQ_Byte23 : 191|8@0+ (1,0) [0|0] "" External_Tool
 SG_ STS_XCP_RES_DAQ_Byte24 : 199|8@0+ (1,0) [0|0] "" External_Tool
 SG_ STS_XCP_RES_DAQ_Byte25 : 207|8@0+ (1,0) [0|0] "" External_Tool
 SG_ STS_XCP_RES_DAQ_Byte26 : 215|8@0+ (1,0) [0|0] "" External_Tool
 SG_ STS_XCP_RES_DAQ_Byte27 : 223|8@0+ (1,0) [0|0] "" External_Tool
 SG_ STS_XCP_RES_DAQ_Byte28 : 231|8@0+ (1,0) [0|0] "" External_Tool
 SG_ STS_XCP_RES_DAQ_Byte29 : 239|8@0+ (1,0) [0|0] "" External_Tool
 SG_ STS_XCP_RES_DAQ_Byte30 : 247|8@0+ (1,0) [0|0] "" External_Tool
 SG_ STS_XCP_RES_DAQ_Byte31 : 255|8@0+ (1,0) [0|0] "" External_Tool
 SG_ STS_XCP_RES_DAQ_Byte32 : 263|8@0+ (1,0) [0|0] "" External_Tool
 SG_ STS_XCP_RES_DAQ_Byte33 : 271|8@0+ (1,0) [0|0] "" External_Tool
 SG_ STS_XCP_RES_DAQ_Byte34 : 279|8@0+ (1,0) [0|0] "" External_Tool
 SG_ STS_XCP_RES_DAQ_Byte35 : 287|8@0+ (1,0) [0|0] "" External_Tool
 SG_ STS_XCP_RES_DAQ_Byte36 : 295|8@0+ (1,0) [0|0] "" External_Tool
 SG_ STS_XCP_RES_DAQ_Byte37 : 303|8@0+ (1,0) [0|0] "" External_Tool
 SG_ STS_XCP_RES_DAQ_Byte38 : 311|8@0+ (1,0) [0|0] "" External_Tool
 SG_ STS_XCP_RES_DAQ_Byte39 : 319|8@0+ (1,0) [0|0] "" External_Tool
 SG_ STS_XCP_RES_DAQ_Byte40 : 327|8@0+ (1,0) [0|0] "" External_Tool
 SG_ STS_XCP_RES_DAQ_Byte41 : 335|8@0+ (1,0) [0|0] "" External_Tool
 SG_ STS_XCP_RES_DAQ_Byte42 : 343|8@0+ (1,0) [0|0] "" External_Tool
 SG_ STS_XCP_RES_DAQ_Byte43 : 351|8@0+ (1,0) [0|0] "" External_Tool
 SG_ STS_XCP_RES_DAQ_Byte44 : 359|8@0+ (1,0) [0|0] "" External_Tool
 SG_ STS_XCP_RES_DAQ_Byte45 : 367|8@0+ (1,0) [0|0] "" External_Tool
 SG_ STS_XCP_RES_DAQ_Byte46 : 375|8@0+ (1,0) [0|0] "" External_Tool
 SG_ STS_XCP_RES_DAQ_Byte47 : 383|8@0+ (1,0) [0|0] "" External_Tool
 SG_ STS_XCP_RES_DAQ_Byte48 : 391|8@0+ (1,0) [0|0] "" External_Tool
 SG_ STS_XCP_RES_DAQ_Byte49 : 399|8@0+ (1,0) [0|0] "" External_Tool
 SG_ STS_XCP_RES_DAQ_Byte50 : 407|8@0+ (1,0) [0|0] "" External_Tool
 SG_ STS_XCP_RES_DAQ_Byte51 : 415|8@0+ (1,0) [0|0] "" External_Tool
 SG_ STS_XCP_RES_DAQ_Byte52 : 423|8@0+ (1,0) [0|0] "" External_Tool
 SG_ STS_XCP_RES_DAQ_Byte53 : 431|8@0+ (1,0) [0|0] "" External_Tool
 SG_ STS_XCP_RES_DAQ_Byte54 : 439|8@0+ (1,0) [0|0] "" External_Tool
 SG_ STS_XCP_RES_DAQ_Byte55 : 447|8@0+ (1,0) [0|0] "" External_Tool
 SG_ STS_XCP_RES_DAQ_Byte56 : 455|8@0+ (1,0) [0|0] "" External_Tool
 SG_ STS_XCP_RES_DAQ_Byte57 : 463|8@0+ (1,0) [0|0] "" External_Tool
 SG_ STS_XCP_RES_DAQ_Byte58 : 471|8@0+ (1,0) [0|0] "" External_Tool
 SG_ STS_XCP_RES_DAQ_Byte59 : 479|8@0+ (1,0) [0|0] "" External_Tool
 SG_ STS_XCP_RES_DAQ_Byte60 : 487|8@0+ (1,0) [0|0] "" External_Tool
 SG_ STS_XCP_RES_DAQ_Byte61 : 495|8@0+ (1,0) [0|0] "" External_Tool
 SG_ STS_XCP_RES_DAQ_Byte62 : 503|8@0+ (1,0) [0|0] "" External_Tool
 SG_ STS_XCP_RES_DAQ_Byte63 : 511|8@0+ (1,0) [0|0] "" External_Tool

BO_ 448 RDR_TRACKER_OBJ_001: 64 G5_RDR02
 SG_ OBJ_ALIVE_TIME_001 : 255|16@0+ (1,0) [0|65535] "ms" ASDM
 SG_ OBJ_ACCELERATION_LONG_ERR_001 : 215|8@0+ (0.025,0) [0|6.375] "m/s^2" ASDM
 SG_ OBJ_ACCELERATION_LAT_ERR_001 : 223|8@0+ (0.025,0) [0|6.375] "m/s^2" ASDM
 SG_ OBJ_VELOCITY_LONG_ERR_001 : 143|8@0+ (0.05,0) [0|12.75] "m/s" ASDM
 SG_ OBJ_VELOCITY_LAT_ERR_001 : 151|8@0+ (0.05,0) [0|12.75] "m/s" ASDM
 SG_ OBJ_POS_LONG_ERR_001 : 95|8@0+ (0.025,0) [0|6.375] "m" ASDM
 SG_ OBJ_POS_LAT_ERR_001 : 103|8@0+ (0.025,0) [0|6.375] "m" ASDM
 SG_ OBJ_TRACK_MOTION_MODEL_001 : 9|2@0+ (1,0) [1|3] "NA" ASDM
 SG_ OBJ_DIMENSION_WIDTH_001 : 17|10@0+ (0.01,0) [0|10.23] "m" ASDM
 SG_ OBJ_DIMENSION_LENGTH_001 : 37|12@0+ (0.01,0) [0|40.95] "m" ASDM
 SG_ OBJ_EXISTENCE_PROB_001 : 229|14@0+ (0.0001,0) [0|1] "NA" ASDM
 SG_ OBJ_YAW_ANGLE_001 : 155|12@0+ (0.005,-10) [-10|10.475] "rad" ASDM
 SG_ OBJ_YAW_ANGLE_ERR_001 : 175|7@0+ (0.01,0) [0|1.27] "rad" ASDM
 SG_ OBJ_ID_001 : 7|8@0+ (1,0) [0|255] "NA" ASDM
 SG_ OBJ_MOVEMENT_STATUS_001 : 196|3@0+ (1,0) [0|3] "NA" ASDM
 SG_ OBJ_MEASUREMENT_STATUS_001 : 14|3@0+ (1,0) [0|7] "NA" ASDM
 SG_ OBJ_POS_LONG_001 : 63|16@0+ (0.01,-327) [-327|327] "m" ASDM
 SG_ OBJ_POS_LAT_001 : 79|16@0+ (0.01,-327) [-327|327] "m" ASDM
 SG_ OBJ_VELOCITY_LONG_001 : 110|15@0+ (0.01,-163) [-163|163] "m/s" ASDM
 SG_ OBJ_VELOCITY_LAT_001 : 126|15@0+ (0.01,-163) [-163|163] "m/s" ASDM
 SG_ OBJ_ACCELERATION_LONG_001 : 193|10@0+ (0.05,-20) [-20|20] "m/s^2" ASDM
 SG_ OBJ_ACCELERATION_LAT_001 : 177|10@0+ (0.05,-20) [-20|20] "m/s^2" ASDM
 SG_ OBJ_VEH_TRACK_FLAG_001 : 10|1@0+ (1,0) [0|1] "NA" ASDM
 SG_ OBJ_MH_CYCLE_COUNTER_001 : 487|8@0+ (1,0) [0|255] "NA" ASDM
 SG_ OBJ_MH_CRC16_001 : 495|16@0+ (1,0) [0|65535] "NA" ASDM
 SG_ OBJ_TIMESTAMP_OFFSET_001 : 247|8@0+ (1,-127) [-127|128] "ms" ASDM
 SG_ OBJ_DIMENSION_WIDTH_ERR_001 : 23|6@0+ (0.01,0) [0|0.63] "m" ASDM
 SG_ OBJ_DIMENSION_LENGTH_ERR_001 : 41|10@0+ (0.01,0) [0|10.23] "m" ASDM
 SG_ OBJ_CLS_TYPE1_001 : 271|4@0+ (1,0) [0|15] "NA" ASDM
 SG_ OBJ_CLS_TYPE1_PROB_001 : 303|8@0+ (0.004,0) [0|1] "NA" ASDM
 SG_ OBJ_CLS_TYPE2_001 : 267|4@0+ (1,0) [0|15] "NA" ASDM
 SG_ OBJ_CLS_TYPE2_PROB_001 : 311|8@0+ (0.004,0) [0|1] "NA" ASDM
 SG_ OBJ_CLS_TYPE3_001 : 279|4@0+ (1,0) [0|15] "NA" ASDM
 SG_ OBJ_CLS_TYPE3_PROB_001 : 319|8@0+ (0.004,0) [0|1] "NA" ASDM
 SG_ OBJ_CLS_TYPE4_001 : 275|4@0+ (1,0) [0|15] "NA" ASDM
 SG_ OBJ_CLS_TYPE4_PROB_001 : 327|8@0+ (0.004,0) [0|1] "NA" ASDM
 SG_ OBJ_CLS_TYPE5_001 : 287|4@0+ (1,0) [0|15] "NA" ASDM
 SG_ OBJ_CLS_TYPE5_PROB_001 : 335|8@0+ (0.004,0) [0|1] "NA" ASDM
 SG_ OBJ_CLS_TYPE6_001 : 282|4@0+ (1,0) [0|15] "NA" ASDM
 SG_ OBJ_CLS_TYPE6_PROB_001 : 343|8@0+ (0.004,0) [0|1] "NA" ASDM
 SG_ OBJ_RCS_001 : 351|7@0+ (1,-64) [-64|63] "dBsm" ASDM
 SG_ OBJ_REF_PT_LONG_OFFSET_001 : 357|14@0+ (0.0001,0) [0|1] "NA" ASDM
 SG_ OBJ_REF_PT_LAT_OFFSET_001 : 370|14@0+ (0.0001,0) [0|1] "NA" ASDM
 SG_ OBJ_YAW_RATE_001 : 399|10@0+ (0.005,-2.24) [-2.24|2.24] "rad/s" ASDM
 SG_ OBJ_YAW_RATE_ERR_001 : 388|5@0+ (0.025,0) [0|0.775] "rad/s" ASDM
 SG_ OBJ_GROUP_ID_001 : 405|6@0+ (1,0) [0|63] "NA" ASDM
 SG_ OBJ_POS_ERR_CRR_COEF_001 : 415|8@0+ (0.01,-1.2) [-1.2|1] "NA" ASDM
 SG_ OBJ_VELOCITY_ERR_CRR_COEF_001 : 423|8@0+ (0.01,-1.2) [-1.2|1] "NA" ASDM
 SG_ OBJ_ACCEL_ERR_CRR_COEF_001 : 431|8@0+ (0.01,-1.2) [-1.2|1] "NA" ASDM

BO_ 137 RDR_HEADER_002: 64 G5_RDR02
 SG_ HED_TRKR_VEHICLE_IDX : 23|16@0+ (1,0) [0|65535] "" ASDM
 SG_ HED_MH_002_CYCLE_COUNTER : 159|8@0+ (1,0) [0|255] "" ASDM
 SG_ HED_MH_002_CRC16 : 143|16@0+ (1,0) [0|65535] "" ASDM
 SG_ HED_TRKR_IDX : 7|16@0+ (1,0) [0|65535] "" ASDM
 SG_ HED_TRKR_TIME_PEAK : 71|8@0+ (0.5,0) [0|127.5] "ms" ASDM
 SG_ HED_TRKR_TIME_INST : 63|8@0+ (0.5,0) [0|127.5] "ms" ASDM
 SG_ HED_TRKR_OBJLST_TIME_STAMP_NS : 111|32@0+ (1,0) [0|4294967295] "ns" ASDM
 SG_ HED_TRKR_OBJLST_TIME_STAMP_SC : 79|32@0+ (1,0) [0|4294967295] "s" ASDM
 SG_ HED_TRKR_VEH_COORD_TYPE : 32|1@0+ (1,0) [0|1] "" ASDM
 SG_ HED_TRKR_NUM_OF_ACTIV_OBJS : 55|8@0+ (1,0) [0|255] "" ASDM
 SG_ HED_TRKR_DATA_QUALIFIER : 42|3@0+ (1,0) [0|7] "" ASDM

BO_ 143 RDR_STATUS_003: 64 G5_RDR02
 SG_ STS_TRKR_PATCH_VERSION : 23|8@0+ (1,0) [0|255] "" ASDM
 SG_ STS_TRKR_MINOR_VERSION : 15|8@0+ (1,0) [0|255] "" ASDM
 SG_ STS_TRKR_MAJOR_VERSION : 7|8@0+ (1,0) [0|255] "" ASDM
 SG_ STS_PERCEPTION_MODULE_ID : 31|16@0+ (1,0) [0|65535] "" ASDM
 SG_ STS_OBJ_DBC_BASE_VER_MINOR : 79|8@0+ (1,0) [0|255] "" ASDM
 SG_ STS_OBJ_DBC_BASE_VER_MAJOR : 71|8@0+ (1,0) [0|255] "" ASDM
 SG_ STS_MH_003_CRC16 : 87|16@0+ (1,0) [0|65535] "" ASDM
 SG_ STS_MH_003_CYCLE_COUNTER : 103|8@0+ (1,0) [0|255] "" ASDM

BO_ 385 RDR_DETECTION_005_008: 64 G5_RDR02
 SG_ DET_RANGE_005 : 7|15@0+ (0.015625,0) [0|500] "m" ASDM
 SG_ DET_RANGE_ERR_005 : 8|7@0+ (0.0075,0) [0|0.9525] "m" ASDM
 SG_ DET_RANGE_VELOCITY_005 : 17|15@0+ (0.0078125,-128) [-128|127.9921875] "m/s" ASDM
 SG_ DET_RANGE_VELOCITY_ERR_005 : 34|8@0+ (0.003,0) [0|0.765] "m/s" ASDM
 SG_ DET_AZIMUTH_005 : 60|13@0+ (0.0004,-1.5708) [-1.5708|1.5708] "rad" ASDM
 SG_ DET_AZIMUTH_ERR_005 : 78|7@0+ (0.00087267,0) [0|0.11082909] "rad" ASDM
 SG_ DET_ELEVATION_005 : 42|8@0+ (0.00275,-0.34925) [-0.34925|0.34925] "rad" ASDM
 SG_ DET_ELEVATION_ERR_005 : 50|6@0+ (0.00174533,0) [0|0.10995579] "rad" ASDM
 SG_ DET_RCS_005 : 119|8@0+ (0.5,-64) [-64|63.5] "dBsm" ASDM
 SG_ DET_VALID_FLAG_005 : 100|1@0+ (1,0) [0|1] "" ASDM
 SG_ DET_BI_STATIC_FLAG_005 : 487|1@0+ (1,0) [0|1] "" ASDM
 SG_ DET_SUPER_RES_TARGET_005 : 79|1@0+ (1,0) [0|1] "" ASDM
 SG_ DET_SNR_005 : 111|8@0+ (0.35156,0) [0|89.6478] "dB" ASDM
 SG_ DET_POINT_TARGET_PROB_005 : 95|4@0+ (6.67,0) [0|100] "%" ASDM
 SG_ DET_EXISTENCE_PROB_005 : 91|6@0+ (1.588,0) [0|100] "%" ASDM
 SG_ DET_OUTSIDE_SECTOR_005 : 101|1@0+ (1,0) [0|1] "" ASDM
 SG_ DET_HVC_FLAG_005 : 87|1@0+ (1,0) [0|1] "" ASDM
 SG_ DET_CONFD_AZIMUTH_005 : 97|2@0+ (1,0) [0|3] "" ASDM
 SG_ DET_CONFD_ELEVATION_005 : 99|2@0+ (1,0) [0|3] "" ASDM
 SG_ DET_AZIMUTH_AMB_ID_005 : 82|3@0+ (1,0) [0|7] "" ASDM
 SG_ DET_AMBG_AZIMUTH_PROB_005 : 86|4@0+ (6.67,0) [0|100] "%" ASDM
 SG_ DET_RANGE_006 : 127|15@0+ (0.015625,0) [0|500] "m" ASDM
 SG_ DET_RANGE_ERR_006 : 128|7@0+ (0.0075,0) [0|0.9525] "m" ASDM
 SG_ DET_RANGE_VELOCITY_006 : 137|15@0+ (0.0078125,-128) [-128|127.9921875] "m/s" ASDM
 SG_ DET_RANGE_VELOCITY_ERR_006 : 154|8@0+ (0.003,0) [0|0.765] "m/s" ASDM
 SG_ DET_AZIMUTH_006 : 180|13@0+ (0.0004,-1.5708) [-1.5708|1.5708] "rad" ASDM
 SG_ DET_AZIMUTH_ERR_006 : 198|7@0+ (0.00087267,0) [0|0.11082909] "rad" ASDM
 SG_ DET_ELEVATION_006 : 162|8@0+ (0.00275,-0.34925) [-0.34925|0.34925] "rad" ASDM
 SG_ DET_ELEVATION_ERR_006 : 170|6@0+ (0.00174533,0) [0|0.10995579] "rad" ASDM
 SG_ DET_RCS_006 : 239|8@0+ (0.5,-64) [-64|63.5] "dBsm" ASDM
 SG_ DET_VALID_FLAG_006 : 220|1@0+ (1,0) [0|1] "" ASDM
 SG_ DET_BI_STATIC_FLAG_006 : 486|1@0+ (1,0) [0|1] "" ASDM
 SG_ DET_SUPER_RES_TARGET_006 : 199|1@0+ (1,0) [0|1] "" ASDM
 SG_ DET_SNR_006 : 231|8@0+ (0.35156,0) [0|89.6478] "dB" ASDM
 SG_ DET_POINT_TARGET_PROB_006 : 215|4@0+ (6.67,0) [0|100] "%" ASDM
 SG_ DET_EXISTENCE_PROB_006 : 211|6@0+ (1.588,0) [0|100] "%" ASDM
 SG_ DET_OUTSIDE_SECTOR_006 : 221|1@0+ (1,0) [0|1] "" ASDM
 SG_ DET_HVC_FLAG_006 : 207|1@0+ (1,0) [0|1] "" ASDM
 SG_ DET_CONFD_AZIMUTH_006 : 217|2@0+ (1,0) [0|3] "" ASDM
 SG_ DET_CONFD_ELEVATION_006 : 219|2@0+ (1,0) [0|3] "" ASDM
 SG_ DET_AZIMUTH_AMB_ID_006 : 202|3@0+ (1,0) [0|7] "" ASDM
 SG_ DET_AMBG_AZIMUTH_PROB_006 : 206|4@0+ (6.67,0) [0|100] "%" ASDM
 SG_ DET_RANGE_007 : 247|15@0+ (0.015625,0) [0|500] "m" ASDM
 SG_ DET_RANGE_ERR_007 : 248|7@0+ (0.0075,0) [0|0.9525] "m" ASDM
 SG_ DET_RANGE_VELOCITY_007 : 257|15@0+ (0.0078125,-128) [-128|127.9921875] "m/s" ASDM
 SG_ DET_RANGE_VELOCITY_ERR_007 : 274|8@0+ (0.003,0) [0|0.765] "m/s" ASDM
 SG_ DET_AZIMUTH_007 : 300|13@0+ (0.0004,-1.5708) [-1.5708|1.5708] "rad" ASDM
 SG_ DET_AZIMUTH_ERR_007 : 318|7@0+ (0.00087267,0) [0|0.11082909] "rad" ASDM
 SG_ DET_ELEVATION_007 : 282|8@0+ (0.00275,-0.34925) [-0.34925|0.34925] "rad" ASDM
 SG_ DET_ELEVATION_ERR_007 : 290|6@0+ (0.00174533,0) [0|0.10995579] "rad" ASDM
 SG_ DET_RCS_007 : 359|8@0+ (0.5,-64) [-64|63.5] "dBsm" ASDM
 SG_ DET_VALID_FLAG_007 : 340|1@0+ (1,0) [0|1] "" ASDM
 SG_ DET_BI_STATIC_FLAG_007 : 485|1@0+ (1,0) [0|1] "" ASDM
 SG_ DET_SUPER_RES_TARGET_007 : 319|1@0+ (1,0) [0|1] "" ASDM
 SG_ DET_SNR_007 : 351|8@0+ (0.35156,0) [0|89.6478] "dB" ASDM
 SG_ DET_POINT_TARGET_PROB_007 : 335|4@0+ (6.67,0) [0|100] "%" ASDM
 SG_ DET_EXISTENCE_PROB_007 : 331|6@0+ (1.588,0) [0|100] "%" ASDM
 SG_ DET_OUTSIDE_SECTOR_007 : 341|1@0+ (1,0) [0|1] "" ASDM
 SG_ DET_HVC_FLAG_007 : 327|1@0+ (1,0) [0|1] "" ASDM
 SG_ DET_CONFD_AZIMUTH_007 : 337|2@0+ (1,0) [0|3] "" ASDM
 SG_ DET_CONFD_ELEVATION_007 : 339|2@0+ (1,0) [0|3] "" ASDM
 SG_ DET_AZIMUTH_AMB_ID_007 : 322|3@0+ (1,0) [0|7] "" ASDM
 SG_ DET_AMBG_AZIMUTH_PROB_007 : 326|4@0+ (6.67,0) [0|100] "%" ASDM
 SG_ DET_RANGE_008 : 367|15@0+ (0.015625,0) [0|500] "m" ASDM
 SG_ DET_RANGE_ERR_008 : 368|7@0+ (0.0075,0) [0|0.9525] "m" ASDM
 SG_ DET_RANGE_VELOCITY_008 : 377|15@0+ (0.0078125,-128) [-128|127.9921875] "m/s" ASDM
 SG_ DET_RANGE_VELOCITY_ERR_008 : 394|8@0+ (0.003,0) [0|0.765] "m/s" ASDM
 SG_ DET_AZIMUTH_008 : 420|13@0+ (0.0004,-1.5708) [-1.5708|1.5708] "rad" ASDM
 SG_ DET_AZIMUTH_ERR_008 : 438|7@0+ (0.00087267,0) [0|0.11082909] "rad" ASDM
 SG_ DET_ELEVATION_008 : 402|8@0+ (0.00275,-0.34925) [-0.34925|0.34925] "rad" ASDM
 SG_ DET_ELEVATION_ERR_008 : 410|6@0+ (0.00174533,0) [0|0.10995579] "rad" ASDM
 SG_ DET_RCS_008 : 479|8@0+ (0.5,-64) [-64|63.5] "dBsm" ASDM
 SG_ DET_VALID_FLAG_008 : 460|1@0+ (1,0) [0|1] "" ASDM
 SG_ DET_BI_STATIC_FLAG_008 : 484|1@0+ (1,0) [0|1] "" ASDM
 SG_ DET_SUPER_RES_TARGET_008 : 439|1@0+ (1,0) [0|1] "" ASDM
 SG_ DET_SNR_008 : 471|8@0+ (0.35156,0) [0|89.6478] "dB" ASDM
 SG_ DET_POINT_TARGET_PROB_008 : 455|4@0+ (6.67,0) [0|100] "%" ASDM
 SG_ DET_EXISTENCE_PROB_008 : 451|6@0+ (1.588,0) [0|100] "%" ASDM
 SG_ DET_OUTSIDE_SECTOR_008 : 461|1@0+ (1,0) [0|1] "" ASDM
 SG_ DET_HVC_FLAG_008 : 447|1@0+ (1,0) [0|1] "" ASDM
 SG_ DET_CONFD_AZIMUTH_008 : 457|2@0+ (1,0) [0|3] "" ASDM
 SG_ DET_CONFD_ELEVATION_008 : 459|2@0+ (1,0) [0|3] "" ASDM
 SG_ DET_AZIMUTH_AMB_ID_008 : 442|3@0+ (1,0) [0|7] "" ASDM
 SG_ DET_AMBG_AZIMUTH_PROB_008 : 446|4@0+ (6.67,0) [0|100] "%" ASDM
 SG_ DET_MH_SCAN_INDEX_4LSB_005_008 : 483|4@0+ (1,0) [0|15] "" ASDM
 SG_ DET_MH_CYCLE_COUNTER_005_008 : 495|8@0+ (1,0) [0|255] "" ASDM
 SG_ DET_MH_CRC16_005_008 : 503|16@0+ (1,0) [0|65535] "" ASDM

BO_ 386 RDR_DETECTION_009_012: 64 G5_RDR02
 SG_ DET_RANGE_009 : 7|15@0+ (0.015625,0) [0|500] "m" ASDM
 SG_ DET_RANGE_ERR_009 : 8|7@0+ (0.0075,0) [0|0.9525] "m" ASDM
 SG_ DET_RANGE_VELOCITY_009 : 17|15@0+ (0.0078125,-128) [-128|127.9921875] "m/s" ASDM
 SG_ DET_RANGE_VELOCITY_ERR_009 : 34|8@0+ (0.003,0) [0|0.765] "m/s" ASDM
 SG_ DET_AZIMUTH_009 : 60|13@0+ (0.0004,-1.5708) [-1.5708|1.5708] "rad" ASDM
 SG_ DET_AZIMUTH_ERR_009 : 78|7@0+ (0.00087267,0) [0|0.11082909] "rad" ASDM
 SG_ DET_ELEVATION_009 : 42|8@0+ (0.00275,-0.34925) [-0.34925|0.34925] "rad" ASDM
 SG_ DET_ELEVATION_ERR_009 : 50|6@0+ (0.00174533,0) [0|0.10995579] "rad" ASDM
 SG_ DET_RCS_009 : 119|8@0+ (0.5,-64) [-64|63.5] "dBsm" ASDM
 SG_ DET_VALID_FLAG_009 : 100|1@0+ (1,0) [0|1] "" ASDM
 SG_ DET_BI_STATIC_FLAG_009 : 487|1@0+ (1,0) [0|1] "" ASDM
 SG_ DET_SUPER_RES_TARGET_009 : 79|1@0+ (1,0) [0|1] "" ASDM
 SG_ DET_SNR_009 : 111|8@0+ (0.35156,0) [0|89.6478] "dB" ASDM
 SG_ DET_POINT_TARGET_PROB_009 : 95|4@0+ (6.67,0) [0|100] "%" ASDM
 SG_ DET_EXISTENCE_PROB_009 : 91|6@0+ (1.588,0) [0|100] "%" ASDM
 SG_ DET_OUTSIDE_SECTOR_009 : 101|1@0+ (1,0) [0|1] "" ASDM
 SG_ DET_HVC_FLAG_009 : 87|1@0+ (1,0) [0|1] "" ASDM
 SG_ DET_CONFD_AZIMUTH_009 : 97|2@0+ (1,0) [0|3] "" ASDM
 SG_ DET_CONFD_ELEVATION_009 : 99|2@0+ (1,0) [0|3] "" ASDM
 SG_ DET_AZIMUTH_AMB_ID_009 : 82|3@0+ (1,0) [0|7] "" ASDM
 SG_ DET_AMBG_AZIMUTH_PROB_009 : 86|4@0+ (6.67,0) [0|100] "%" ASDM
 SG_ DET_RANGE_010 : 127|15@0+ (0.015625,0) [0|500] "m" ASDM
 SG_ DET_RANGE_ERR_010 : 128|7@0+ (0.0075,0) [0|0.9525] "m" ASDM
 SG_ DET_RANGE_VELOCITY_010 : 137|15@0+ (0.0078125,-128) [-128|127.9921875] "m/s" ASDM
 SG_ DET_RANGE_VELOCITY_ERR_010 : 154|8@0+ (0.003,0) [0|0.765] "m/s" ASDM
 SG_ DET_AZIMUTH_010 : 180|13@0+ (0.0004,-1.5708) [-1.5708|1.5708] "rad" ASDM
 SG_ DET_AZIMUTH_ERR_010 : 198|7@0+ (0.00087267,0) [0|0.11082909] "rad" ASDM
 SG_ DET_ELEVATION_010 : 162|8@0+ (0.00275,-0.34925) [-0.34925|0.34925] "rad" ASDM
 SG_ DET_ELEVATION_ERR_010 : 170|6@0+ (0.00174533,0) [0|0.10995579] "rad" ASDM
 SG_ DET_RCS_010 : 239|8@0+ (0.5,-64) [-64|63.5] "dBsm" ASDM
 SG_ DET_VALID_FLAG_010 : 220|1@0+ (1,0) [0|1] "" ASDM
 SG_ DET_BI_STATIC_FLAG_010 : 486|1@0+ (1,0) [0|1] "" ASDM
 SG_ DET_SUPER_RES_TARGET_010 : 199|1@0+ (1,0) [0|1] "" ASDM
 SG_ DET_SNR_010 : 231|8@0+ (0.35156,0) [0|89.6478] "dB" ASDM
 SG_ DET_POINT_TARGET_PROB_010 : 215|4@0+ (6.67,0) [0|100] "%" ASDM
 SG_ DET_EXISTENCE_PROB_010 : 211|6@0+ (1.588,0) [0|100] "%" ASDM
 SG_ DET_OUTSIDE_SECTOR_010 : 221|1@0+ (1,0) [0|1] "" ASDM
 SG_ DET_HVC_FLAG_010 : 207|1@0+ (1,0) [0|1] "" ASDM
 SG_ DET_CONFD_AZIMUTH_010 : 217|2@0+ (1,0) [0|3] "" ASDM
 SG_ DET_CONFD_ELEVATION_010 : 219|2@0+ (1,0) [0|3] "" ASDM
 SG_ DET_AZIMUTH_AMB_ID_010 : 202|3@0+ (1,0) [0|7] "" ASDM
 SG_ DET_AMBG_AZIMUTH_PROB_010 : 206|4@0+ (6.67,0) [0|100] "%" ASDM
 SG_ DET_RANGE_011 : 247|15@0+ (0.015625,0) [0|500] "m" ASDM
 SG_ DET_RANGE_ERR_011 : 248|7@0+ (0.0075,0) [0|0.9525] "m" ASDM
 SG_ DET_RANGE_VELOCITY_011 : 257|15@0+ (0.0078125,-128) [-128|127.9921875] "m/s" ASDM
 SG_ DET_RANGE_VELOCITY_ERR_011 : 274|8@0+ (0.003,0) [0|0.765] "m/s" ASDM
 SG_ DET_AZIMUTH_011 : 300|13@0+ (0.0004,-1.5708) [-1.5708|1.5708] "rad" ASDM
 SG_ DET_AZIMUTH_ERR_011 : 318|7@0+ (0.00087267,0) [0|0.11082909] "rad" ASDM
 SG_ DET_ELEVATION_011 : 282|8@0+ (0.00275,-0.34925) [-0.34925|0.34925] "rad" ASDM
 SG_ DET_ELEVATION_ERR_011 : 290|6@0+ (0.00174533,0) [0|0.10995579] "rad" ASDM
 SG_ DET_RCS_011 : 359|8@0+ (0.5,-64) [-64|63.5] "dBsm" ASDM
 SG_ DET_VALID_FLAG_011 : 340|1@0+ (1,0) [0|1] "" ASDM
 SG_ DET_BI_STATIC_FLAG_011 : 485|1@0+ (1,0) [0|1] "" ASDM
 SG_ DET_SUPER_RES_TARGET_011 : 319|1@0+ (1,0) [0|1] "" ASDM
 SG_ DET_SNR_011 : 351|8@0+ (0.35156,0) [0|89.6478] "dB" ASDM
 SG_ DET_POINT_TARGET_PROB_011 : 335|4@0+ (6.67,0) [0|100] "%" ASDM
 SG_ DET_EXISTENCE_PROB_011 : 331|6@0+ (1.588,0) [0|100] "%" ASDM
 SG_ DET_OUTSIDE_SECTOR_011 : 341|1@0+ (1,0) [0|1] "" ASDM
 SG_ DET_HVC_FLAG_011 : 327|1@0+ (1,0) [0|1] "" ASDM
 SG_ DET_CONFD_AZIMUTH_011 : 337|2@0+ (1,0) [0|3] "" ASDM
 SG_ DET_CONFD_ELEVATION_011 : 339|2@0+ (1,0) [0|3] "" ASDM
 SG_ DET_AZIMUTH_AMB_ID_011 : 322|3@0+ (1,0) [0|7] "" ASDM
 SG_ DET_AMBG_AZIMUTH_PROB_011 : 326|4@0+ (6.67,0) [0|100] "%" ASDM
 SG_ DET_RANGE_012 : 367|15@0+ (0.015625,0) [0|500] "m" ASDM
 SG_ DET_RANGE_ERR_012 : 368|7@0+ (0.0075,0) [0|0.9525] "m" ASDM
 SG_ DET_RANGE_VELOCITY_012 : 377|15@0+ (0.0078125,-128) [-128|127.9921875] "m/s" ASDM
 SG_ DET_RANGE_VELOCITY_ERR_012 : 394|8@0+ (0.003,0) [0|0.765] "m/s" ASDM
 SG_ DET_AZIMUTH_012 : 420|13@0+ (0.0004,-1.5708) [-1.5708|1.5708] "rad" ASDM
 SG_ DET_AZIMUTH_ERR_012 : 438|7@0+ (0.00087267,0) [0|0.11082909] "rad" ASDM
 SG_ DET_ELEVATION_012 : 402|8@0+ (0.00275,-0.34925) [-0.34925|0.34925] "rad" ASDM
 SG_ DET_ELEVATION_ERR_012 : 410|6@0+ (0.00174533,0) [0|0.10995579] "rad" ASDM
 SG_ DET_RCS_012 : 479|8@0+ (0.5,-64) [-64|63.5] "dBsm" ASDM
 SG_ DET_VALID_FLAG_012 : 460|1@0+ (1,0) [0|1] "" ASDM
 SG_ DET_BI_STATIC_FLAG_012 : 484|1@0+ (1,0) [0|1] "" ASDM
 SG_ DET_SUPER_RES_TARGET_012 : 439|1@0+ (1,0) [0|1] "" ASDM
 SG_ DET_SNR_012 : 471|8@0+ (0.35156,0) [0|89.6478] "dB" ASDM
 SG_ DET_POINT_TARGET_PROB_012 : 455|4@0+ (6.67,0) [0|100] "%" ASDM
 SG_ DET_EXISTENCE_PROB_012 : 451|6@0+ (1.588,0) [0|100] "%" ASDM
 SG_ DET_OUTSIDE_SECTOR_012 : 461|1@0+ (1,0) [0|1] "" ASDM
 SG_ DET_HVC_FLAG_012 : 447|1@0+ (1,0) [0|1] "" ASDM
 SG_ DET_CONFD_AZIMUTH_012 : 457|2@0+ (1,0) [0|3] "" ASDM
 SG_ DET_CONFD_ELEVATION_012 : 459|2@0+ (1,0) [0|3] "" ASDM
 SG_ DET_AZIMUTH_AMB_ID_012 : 442|3@0+ (1,0) [0|7] "" ASDM
 SG_ DET_AMBG_AZIMUTH_PROB_012 : 446|4@0+ (6.67,0) [0|100] "%" ASDM
 SG_ DET_MH_SCAN_INDEX_4LSB_009_012 : 483|4@0+ (1,0) [0|15] "" ASDM
 SG_ DET_MH_CYCLE_COUNTER_009_012 : 495|8@0+ (1,0) [0|255] "" ASDM
 SG_ DET_MH_CRC16_009_012 : 503|16@0+ (1,0) [0|65535] "" ASDM

BO_ 387 RDR_DETECTION_013_016: 64 G5_RDR02
 SG_ DET_RANGE_013 : 7|15@0+ (0.015625,0) [0|500] "m" ASDM
 SG_ DET_RANGE_ERR_013 : 8|7@0+ (0.0075,0) [0|0.9525] "m" ASDM
 SG_ DET_RANGE_VELOCITY_013 : 17|15@0+ (0.0078125,-128) [-128|127.9921875] "m/s" ASDM
 SG_ DET_RANGE_VELOCITY_ERR_013 : 34|8@0+ (0.003,0) [0|0.765] "m/s" ASDM
 SG_ DET_AZIMUTH_013 : 60|13@0+ (0.0004,-1.5708) [-1.5708|1.5708] "rad" ASDM
 SG_ DET_AZIMUTH_ERR_013 : 78|7@0+ (0.00087267,0) [0|0.11082909] "rad" ASDM
 SG_ DET_ELEVATION_013 : 42|8@0+ (0.00275,-0.34925) [-0.34925|0.34925] "rad" ASDM
 SG_ DET_ELEVATION_ERR_013 : 50|6@0+ (0.00174533,0) [0|0.10995579] "rad" ASDM
 SG_ DET_RCS_013 : 119|8@0+ (0.5,-64) [-64|63.5] "dBsm" ASDM
 SG_ DET_VALID_FLAG_013 : 100|1@0+ (1,0) [0|1] "" ASDM
 SG_ DET_BI_STATIC_FLAG_013 : 487|1@0+ (1,0) [0|1] "" ASDM
 SG_ DET_SUPER_RES_TARGET_013 : 79|1@0+ (1,0) [0|1] "" ASDM
 SG_ DET_SNR_013 : 111|8@0+ (0.35156,0) [0|89.6478] "dB" ASDM
 SG_ DET_POINT_TARGET_PROB_013 : 95|4@0+ (6.67,0) [0|100] "%" ASDM
 SG_ DET_EXISTENCE_PROB_013 : 91|6@0+ (1.588,0) [0|100] "%" ASDM
 SG_ DET_OUTSIDE_SECTOR_013 : 101|1@0+ (1,0) [0|1] "" ASDM
 SG_ DET_HVC_FLAG_013 : 87|1@0+ (1,0) [0|1] "" ASDM
 SG_ DET_CONFD_AZIMUTH_013 : 97|2@0+ (1,0) [0|3] "" ASDM
 SG_ DET_CONFD_ELEVATION_013 : 99|2@0+ (1,0) [0|3] "" ASDM
 SG_ DET_AZIMUTH_AMB_ID_013 : 82|3@0+ (1,0) [0|7] "" ASDM
 SG_ DET_AMBG_AZIMUTH_PROB_013 : 86|4@0+ (6.67,0) [0|100] "%" ASDM
 SG_ DET_RANGE_014 : 127|15@0+ (0.015625,0) [0|500] "m" ASDM
 SG_ DET_RANGE_ERR_014 : 128|7@0+ (0.0075,0) [0|0.9525] "m" ASDM
 SG_ DET_RANGE_VELOCITY_014 : 137|15@0+ (0.0078125,-128) [-128|127.9921875] "m/s" ASDM
 SG_ DET_RANGE_VELOCITY_ERR_014 : 154|8@0+ (0.003,0) [0|0.765] "m/s" ASDM
 SG_ DET_AZIMUTH_014 : 180|13@0+ (0.0004,-1.5708) [-1.5708|1.5708] "rad" ASDM
 SG_ DET_AZIMUTH_ERR_014 : 198|7@0+ (0.00087267,0) [0|0.11082909] "rad" ASDM
 SG_ DET_ELEVATION_014 : 162|8@0+ (0.00275,-0.34925) [-0.34925|0.34925] "rad" ASDM
 SG_ DET_ELEVATION_ERR_014 : 170|6@0+ (0.00174533,0) [0|0.10995579] "rad" ASDM
 SG_ DET_RCS_014 : 239|8@0+ (0.5,-64) [-64|63.5] "dBsm" ASDM
 SG_ DET_VALID_FLAG_014 : 220|1@0+ (1,0) [0|1] "" ASDM
 SG_ DET_BI_STATIC_FLAG_014 : 486|1@0+ (1,0) [0|1] "" ASDM
 SG_ DET_SUPER_RES_TARGET_014 : 199|1@0+ (1,0) [0|1] "" ASDM
 SG_ DET_SNR_014 : 231|8@0+ (0.35156,0) [0|89.6478] "dB" ASDM
 SG_ DET_POINT_TARGET_PROB_014 : 215|4@0+ (6.67,0) [0|100] "%" ASDM
 SG_ DET_EXISTENCE_PROB_014 : 211|6@0+ (1.588,0) [0|100] "%" ASDM
 SG_ DET_OUTSIDE_SECTOR_014 : 221|1@0+ (1,0) [0|1] "" ASDM
 SG_ DET_HVC_FLAG_014 : 207|1@0+ (1,0) [0|1] "" ASDM
 SG_ DET_CONFD_AZIMUTH_014 : 217|2@0+ (1,0) [0|3] "" ASDM
 SG_ DET_CONFD_ELEVATION_014 : 219|2@0+ (1,0) [0|3] "" ASDM
 SG_ DET_AZIMUTH_AMB_ID_014 : 202|3@0+ (1,0) [0|7] "" ASDM
 SG_ DET_AMBG_AZIMUTH_PROB_014 : 206|4@0+ (6.67,0) [0|100] "%" ASDM
 SG_ DET_RANGE_015 : 247|15@0+ (0.015625,0) [0|500] "m" ASDM
 SG_ DET_RANGE_ERR_015 : 248|7@0+ (0.0075,0) [0|0.9525] "m" ASDM
 SG_ DET_RANGE_VELOCITY_015 : 257|15@0+ (0.0078125,-128) [-128|127.9921875] "m/s" ASDM
 SG_ DET_RANGE_VELOCITY_ERR_015 : 274|8@0+ (0.003,0) [0|0.765] "m/s" ASDM
 SG_ DET_AZIMUTH_015 : 300|13@0+ (0.0004,-1.5708) [-1.5708|1.5708] "rad" ASDM
 SG_ DET_AZIMUTH_ERR_015 : 318|7@0+ (0.00087267,0) [0|0.11082909] "rad" ASDM
 SG_ DET_ELEVATION_015 : 282|8@0+ (0.00275,-0.34925) [-0.34925|0.34925] "rad" ASDM
 SG_ DET_ELEVATION_ERR_015 : 290|6@0+ (0.00174533,0) [0|0.10995579] "rad" ASDM
 SG_ DET_RCS_015 : 359|8@0+ (0.5,-64) [-64|63.5] "dBsm" ASDM
 SG_ DET_VALID_FLAG_015 : 340|1@0+ (1,0) [0|1] "" ASDM
 SG_ DET_BI_STATIC_FLAG_015 : 485|1@0+ (1,0) [0|1] "" ASDM
 SG_ DET_SUPER_RES_TARGET_015 : 319|1@0+ (1,0) [0|1] "" ASDM
 SG_ DET_SNR_015 : 351|8@0+ (0.35156,0) [0|89.6478] "dB" ASDM
 SG_ DET_POINT_TARGET_PROB_015 : 335|4@0+ (6.67,0) [0|100] "%" ASDM
 SG_ DET_EXISTENCE_PROB_015 : 331|6@0+ (1.588,0) [0|100] "%" ASDM
 SG_ DET_OUTSIDE_SECTOR_015 : 341|1@0+ (1,0) [0|1] "" ASDM
 SG_ DET_HVC_FLAG_015 : 327|1@0+ (1,0) [0|1] "" ASDM
 SG_ DET_CONFD_AZIMUTH_015 : 337|2@0+ (1,0) [0|3] "" ASDM
 SG_ DET_CONFD_ELEVATION_015 : 339|2@0+ (1,0) [0|3] "" ASDM
 SG_ DET_AZIMUTH_AMB_ID_015 : 322|3@0+ (1,0) [0|7] "" ASDM
 SG_ DET_AMBG_AZIMUTH_PROB_015 : 326|4@0+ (6.67,0) [0|100] "%" ASDM
 SG_ DET_RANGE_016 : 367|15@0+ (0.015625,0) [0|500] "m" ASDM
 SG_ DET_RANGE_ERR_016 : 368|7@0+ (0.0075,0) [0|0.9525] "m" ASDM
 SG_ DET_RANGE_VELOCITY_016 : 377|15@0+ (0.0078125,-128) [-128|127.9921875] "m/s" ASDM
 SG_ DET_RANGE_VELOCITY_ERR_016 : 394|8@0+ (0.003,0) [0|0.765] "m/s" ASDM
 SG_ DET_AZIMUTH_016 : 420|13@0+ (0.0004,-1.5708) [-1.5708|1.5708] "rad" ASDM
 SG_ DET_AZIMUTH_ERR_016 : 438|7@0+ (0.00087267,0) [0|0.11082909] "rad" ASDM
 SG_ DET_ELEVATION_016 : 402|8@0+ (0.00275,-0.34925) [-0.34925|0.34925] "rad" ASDM
 SG_ DET_ELEVATION_ERR_016 : 410|6@0+ (0.00174533,0) [0|0.10995579] "rad" ASDM
 SG_ DET_RCS_016 : 479|8@0+ (0.5,-64) [-64|63.5] "dBsm" ASDM
 SG_ DET_VALID_FLAG_016 : 460|1@0+ (1,0) [0|1] "" ASDM
 SG_ DET_BI_STATIC_FLAG_016 : 484|1@0+ (1,0) [0|1] "" ASDM
 SG_ DET_SUPER_RES_TARGET_016 : 439|1@0+ (1,0) [0|1] "" ASDM
 SG_ DET_SNR_016 : 471|8@0+ (0.35156,0) [0|89.6478] "dB" ASDM
 SG_ DET_POINT_TARGET_PROB_016 : 455|4@0+ (6.67,0) [0|100] "%" ASDM
 SG_ DET_EXISTENCE_PROB_016 : 451|6@0+ (1.588,0) [0|100] "%" ASDM
 SG_ DET_OUTSIDE_SECTOR_016 : 461|1@0+ (1,0) [0|1] "" ASDM
 SG_ DET_HVC_FLAG_016 : 447|1@0+ (1,0) [0|1] "" ASDM
 SG_ DET_CONFD_AZIMUTH_016 : 457|2@0+ (1,0) [0|3] "" ASDM
 SG_ DET_CONFD_ELEVATION_016 : 459|2@0+ (1,0) [0|3] "" ASDM
 SG_ DET_AZIMUTH_AMB_ID_016 : 442|3@0+ (1,0) [0|7] "" ASDM
 SG_ DET_AMBG_AZIMUTH_PROB_016 : 446|4@0+ (6.67,0) [0|100] "%" ASDM
 SG_ DET_MH_SCAN_INDEX_4LSB_013_016 : 483|4@0+ (1,0) [0|15] "" ASDM
 SG_ DET_MH_CYCLE_COUNTER_013_016 : 495|8@0+ (1,0) [0|255] "" ASDM
 SG_ DET_MH_CRC16_013_016 : 503|16@0+ (1,0) [0|65535] "" ASDM

BO_ 388 RDR_DETECTION_017_020: 64 G5_RDR02
 SG_ DET_RANGE_017 : 7|15@0+ (0.015625,0) [0|500] "m" ASDM
 SG_ DET_RANGE_ERR_017 : 8|7@0+ (0.0075,0) [0|0.9525] "m" ASDM
 SG_ DET_RANGE_VELOCITY_017 : 17|15@0+ (0.0078125,-128) [-128|127.9921875] "m/s" ASDM
 SG_ DET_RANGE_VELOCITY_ERR_017 : 34|8@0+ (0.003,0) [0|0.765] "m/s" ASDM
 SG_ DET_AZIMUTH_017 : 60|13@0+ (0.0004,-1.5708) [-1.5708|1.5708] "rad" ASDM
 SG_ DET_AZIMUTH_ERR_017 : 78|7@0+ (0.00087267,0) [0|0.11082909] "rad" ASDM
 SG_ DET_ELEVATION_017 : 42|8@0+ (0.00275,-0.34925) [-0.34925|0.34925] "rad" ASDM
 SG_ DET_ELEVATION_ERR_017 : 50|6@0+ (0.00174533,0) [0|0.10995579] "rad" ASDM
 SG_ DET_RCS_017 : 119|8@0+ (0.5,-64) [-64|63.5] "dBsm" ASDM
 SG_ DET_VALID_FLAG_017 : 100|1@0+ (1,0) [0|1] "" ASDM
 SG_ DET_BI_STATIC_FLAG_017 : 487|1@0+ (1,0) [0|1] "" ASDM
 SG_ DET_SUPER_RES_TARGET_017 : 79|1@0+ (1,0) [0|1] "" ASDM
 SG_ DET_SNR_017 : 111|8@0+ (0.35156,0) [0|89.6478] "dB" ASDM
 SG_ DET_POINT_TARGET_PROB_017 : 95|4@0+ (6.67,0) [0|100] "%" ASDM
 SG_ DET_EXISTENCE_PROB_017 : 91|6@0+ (1.588,0) [0|100] "%" ASDM
 SG_ DET_OUTSIDE_SECTOR_017 : 101|1@0+ (1,0) [0|1] "" ASDM
 SG_ DET_HVC_FLAG_017 : 87|1@0+ (1,0) [0|1] "" ASDM
 SG_ DET_CONFD_AZIMUTH_017 : 97|2@0+ (1,0) [0|3] "" ASDM
 SG_ DET_CONFD_ELEVATION_017 : 99|2@0+ (1,0) [0|3] "" ASDM
 SG_ DET_AZIMUTH_AMB_ID_017 : 82|3@0+ (1,0) [0|7] "" ASDM
 SG_ DET_AMBG_AZIMUTH_PROB_017 : 86|4@0+ (6.67,0) [0|100] "%" ASDM
 SG_ DET_RANGE_018 : 127|15@0+ (0.015625,0) [0|500] "m" ASDM
 SG_ DET_RANGE_ERR_018 : 128|7@0+ (0.0075,0) [0|0.9525] "m" ASDM
 SG_ DET_RANGE_VELOCITY_018 : 137|15@0+ (0.0078125,-128) [-128|127.9921875] "m/s" ASDM
 SG_ DET_RANGE_VELOCITY_ERR_018 : 154|8@0+ (0.003,0) [0|0.765] "m/s" ASDM
 SG_ DET_AZIMUTH_018 : 180|13@0+ (0.0004,-1.5708) [-1.5708|1.5708] "rad" ASDM
 SG_ DET_AZIMUTH_ERR_018 : 198|7@0+ (0.00087267,0) [0|0.11082909] "rad" ASDM
 SG_ DET_ELEVATION_018 : 162|8@0+ (0.00275,-0.34925) [-0.34925|0.34925] "rad" ASDM
 SG_ DET_ELEVATION_ERR_018 : 170|6@0+ (0.00174533,0) [0|0.10995579] "rad" ASDM
 SG_ DET_RCS_018 : 239|8@0+ (0.5,-64) [-64|63.5] "dBsm" ASDM
 SG_ DET_VALID_FLAG_018 : 220|1@0+ (1,0) [0|1] "" ASDM
 SG_ DET_BI_STATIC_FLAG_018 : 486|1@0+ (1,0) [0|1] "" ASDM
 SG_ DET_SUPER_RES_TARGET_018 : 199|1@0+ (1,0) [0|1] "" ASDM
 SG_ DET_SNR_018 : 231|8@0+ (0.35156,0) [0|89.6478] "dB" ASDM
 SG_ DET_POINT_TARGET_PROB_018 : 215|4@0+ (6.67,0) [0|100] "%" ASDM
 SG_ DET_EXISTENCE_PROB_018 : 211|6@0+ (1.588,0) [0|100] "%" ASDM
 SG_ DET_OUTSIDE_SECTOR_018 : 221|1@0+ (1,0) [0|1] "" ASDM
 SG_ DET_HVC_FLAG_018 : 207|1@0+ (1,0) [0|1] "" ASDM
 SG_ DET_CONFD_AZIMUTH_018 : 217|2@0+ (1,0) [0|3] "" ASDM
 SG_ DET_CONFD_ELEVATION_018 : 219|2@0+ (1,0) [0|3] "" ASDM
 SG_ DET_AZIMUTH_AMB_ID_018 : 202|3@0+ (1,0) [0|7] "" ASDM
 SG_ DET_AMBG_AZIMUTH_PROB_018 : 206|4@0+ (6.67,0) [0|100] "%" ASDM
 SG_ DET_RANGE_019 : 247|15@0+ (0.015625,0) [0|500] "m" ASDM
 SG_ DET_RANGE_ERR_019 : 248|7@0+ (0.0075,0) [0|0.9525] "m" ASDM
 SG_ DET_RANGE_VELOCITY_019 : 257|15@0+ (0.0078125,-128) [-128|127.9921875] "m/s" ASDM
 SG_ DET_RANGE_VELOCITY_ERR_019 : 274|8@0+ (0.003,0) [0|0.765] "m/s" ASDM
 SG_ DET_AZIMUTH_019 : 300|13@0+ (0.0004,-1.5708) [-1.5708|1.5708] "rad" ASDM
 SG_ DET_AZIMUTH_ERR_019 : 318|7@0+ (0.00087267,0) [0|0.11082909] "rad" ASDM
 SG_ DET_ELEVATION_019 : 282|8@0+ (0.00275,-0.34925) [-0.34925|0.34925] "rad" ASDM
 SG_ DET_ELEVATION_ERR_019 : 290|6@0+ (0.00174533,0) [0|0.10995579] "rad" ASDM
 SG_ DET_RCS_019 : 359|8@0+ (0.5,-64) [-64|63.5] "dBsm" ASDM
 SG_ DET_VALID_FLAG_019 : 340|1@0+ (1,0) [0|1] "" ASDM
 SG_ DET_BI_STATIC_FLAG_019 : 485|1@0+ (1,0) [0|1] "" ASDM
 SG_ DET_SUPER_RES_TARGET_019 : 319|1@0+ (1,0) [0|1] "" ASDM
 SG_ DET_SNR_019 : 351|8@0+ (0.35156,0) [0|89.6478] "dB" ASDM
 SG_ DET_POINT_TARGET_PROB_019 : 335|4@0+ (6.67,0) [0|100] "%" ASDM
 SG_ DET_EXISTENCE_PROB_019 : 331|6@0+ (1.588,0) [0|100] "%" ASDM
 SG_ DET_OUTSIDE_SECTOR_019 : 341|1@0+ (1,0) [0|1] "" ASDM
 SG_ DET_HVC_FLAG_019 : 327|1@0+ (1,0) [0|1] "" ASDM
 SG_ DET_CONFD_AZIMUTH_019 : 337|2@0+ (1,0) [0|3] "" ASDM
 SG_ DET_CONFD_ELEVATION_019 : 339|2@0+ (1,0) [0|3] "" ASDM
 SG_ DET_AZIMUTH_AMB_ID_019 : 322|3@0+ (1,0) [0|7] "" ASDM
 SG_ DET_AMBG_AZIMUTH_PROB_019 : 326|4@0+ (6.67,0) [0|100] "%" ASDM
 SG_ DET_RANGE_020 : 367|15@0+ (0.015625,0) [0|500] "m" ASDM
 SG_ DET_RANGE_ERR_020 : 368|7@0+ (0.0075,0) [0|0.9525] "m" ASDM
 SG_ DET_RANGE_VELOCITY_020 : 377|15@0+ (0.0078125,-128) [-128|127.9921875] "m/s" ASDM
 SG_ DET_RANGE_VELOCITY_ERR_020 : 394|8@0+ (0.003,0) [0|0.765] "m/s" ASDM
 SG_ DET_AZIMUTH_020 : 420|13@0+ (0.0004,-1.5708) [-1.5708|1.5708] "rad" ASDM
 SG_ DET_AZIMUTH_ERR_020 : 438|7@0+ (0.00087267,0) [0|0.11082909] "rad" ASDM
 SG_ DET_ELEVATION_020 : 402|8@0+ (0.00275,-0.34925) [-0.34925|0.34925] "rad" ASDM
 SG_ DET_ELEVATION_ERR_020 : 410|6@0+ (0.00174533,0) [0|0.10995579] "rad" ASDM
 SG_ DET_RCS_020 : 479|8@0+ (0.5,-64) [-64|63.5] "dBsm" ASDM
 SG_ DET_VALID_FLAG_020 : 460|1@0+ (1,0) [0|1] "" ASDM
 SG_ DET_BI_STATIC_FLAG_020 : 484|1@0+ (1,0) [0|1] "" ASDM
 SG_ DET_SUPER_RES_TARGET_020 : 439|1@0+ (1,0) [0|1] "" ASDM
 SG_ DET_SNR_020 : 471|8@0+ (0.35156,0) [0|89.6478] "dB" ASDM
 SG_ DET_POINT_TARGET_PROB_020 : 455|4@0+ (6.67,0) [0|100] "%" ASDM
 SG_ DET_EXISTENCE_PROB_020 : 451|6@0+ (1.588,0) [0|100] "%" ASDM
 SG_ DET_OUTSIDE_SECTOR_020 : 461|1@0+ (1,0) [0|1] "" ASDM
 SG_ DET_HVC_FLAG_020 : 447|1@0+ (1,0) [0|1] "" ASDM
 SG_ DET_CONFD_AZIMUTH_020 : 457|2@0+ (1,0) [0|3] "" ASDM
 SG_ DET_CONFD_ELEVATION_020 : 459|2@0+ (1,0) [0|3] "" ASDM
 SG_ DET_AZIMUTH_AMB_ID_020 : 442|3@0+ (1,0) [0|7] "" ASDM
 SG_ DET_AMBG_AZIMUTH_PROB_020 : 446|4@0+ (6.67,0) [0|100] "%" ASDM
 SG_ DET_MH_SCAN_INDEX_4LSB_017_020 : 483|4@0+ (1,0) [0|15] "" ASDM
 SG_ DET_MH_CYCLE_COUNTER_017_020 : 495|8@0+ (1,0) [0|255] "" ASDM
 SG_ DET_MH_CRC16_017_020 : 503|16@0+ (1,0) [0|65535] "" ASDM

BO_ 389 RDR_DETECTION_021_024: 64 G5_RDR02
 SG_ DET_RANGE_021 : 7|15@0+ (0.015625,0) [0|500] "m" ASDM
 SG_ DET_RANGE_ERR_021 : 8|7@0+ (0.0075,0) [0|0.9525] "m" ASDM
 SG_ DET_RANGE_VELOCITY_021 : 17|15@0+ (0.0078125,-128) [-128|127.9921875] "m/s" ASDM
 SG_ DET_RANGE_VELOCITY_ERR_021 : 34|8@0+ (0.003,0) [0|0.765] "m/s" ASDM
 SG_ DET_AZIMUTH_021 : 60|13@0+ (0.0004,-1.5708) [-1.5708|1.5708] "rad" ASDM
 SG_ DET_AZIMUTH_ERR_021 : 78|7@0+ (0.00087267,0) [0|0.11082909] "rad" ASDM
 SG_ DET_ELEVATION_021 : 42|8@0+ (0.00275,-0.34925) [-0.34925|0.34925] "rad" ASDM
 SG_ DET_ELEVATION_ERR_021 : 50|6@0+ (0.00174533,0) [0|0.10995579] "rad" ASDM
 SG_ DET_RCS_021 : 119|8@0+ (0.5,-64) [-64|63.5] "dBsm" ASDM
 SG_ DET_VALID_FLAG_021 : 100|1@0+ (1,0) [0|1] "" ASDM
 SG_ DET_BI_STATIC_FLAG_021 : 487|1@0+ (1,0) [0|1] "" ASDM
 SG_ DET_SUPER_RES_TARGET_021 : 79|1@0+ (1,0) [0|1] "" ASDM
 SG_ DET_SNR_021 : 111|8@0+ (0.35156,0) [0|89.6478] "dB" ASDM
 SG_ DET_POINT_TARGET_PROB_021 : 95|4@0+ (6.67,0) [0|100] "%" ASDM
 SG_ DET_EXISTENCE_PROB_021 : 91|6@0+ (1.588,0) [0|100] "%" ASDM
 SG_ DET_OUTSIDE_SECTOR_021 : 101|1@0+ (1,0) [0|1] "" ASDM
 SG_ DET_HVC_FLAG_021 : 87|1@0+ (1,0) [0|1] "" ASDM
 SG_ DET_CONFD_AZIMUTH_021 : 97|2@0+ (1,0) [0|3] "" ASDM
 SG_ DET_CONFD_ELEVATION_021 : 99|2@0+ (1,0) [0|3] "" ASDM
 SG_ DET_AZIMUTH_AMB_ID_021 : 82|3@0+ (1,0) [0|7] "" ASDM
 SG_ DET_AMBG_AZIMUTH_PROB_021 : 86|4@0+ (6.67,0) [0|100] "%" ASDM
 SG_ DET_RANGE_022 : 127|15@0+ (0.015625,0) [0|500] "m" ASDM
 SG_ DET_RANGE_ERR_022 : 128|7@0+ (0.0075,0) [0|0.9525] "m" ASDM
 SG_ DET_RANGE_VELOCITY_022 : 137|15@0+ (0.0078125,-128) [-128|127.9921875] "m/s" ASDM
 SG_ DET_RANGE_VELOCITY_ERR_022 : 154|8@0+ (0.003,0) [0|0.765] "m/s" ASDM
 SG_ DET_AZIMUTH_022 : 180|13@0+ (0.0004,-1.5708) [-1.5708|1.5708] "rad" ASDM
 SG_ DET_AZIMUTH_ERR_022 : 198|7@0+ (0.00087267,0) [0|0.11082909] "rad" ASDM
 SG_ DET_ELEVATION_022 : 162|8@0+ (0.00275,-0.34925) [-0.34925|0.34925] "rad" ASDM
 SG_ DET_ELEVATION_ERR_022 : 170|6@0+ (0.00174533,0) [0|0.10995579] "rad" ASDM
 SG_ DET_RCS_022 : 239|8@0+ (0.5,-64) [-64|63.5] "dBsm" ASDM
 SG_ DET_VALID_FLAG_022 : 220|1@0+ (1,0) [0|1] "" ASDM
 SG_ DET_BI_STATIC_FLAG_022 : 486|1@0+ (1,0) [0|1] "" ASDM
 SG_ DET_SUPER_RES_TARGET_022 : 199|1@0+ (1,0) [0|1] "" ASDM
 SG_ DET_SNR_022 : 231|8@0+ (0.35156,0) [0|89.6478] "dB" ASDM
 SG_ DET_POINT_TARGET_PROB_022 : 215|4@0+ (6.67,0) [0|100] "%" ASDM
 SG_ DET_EXISTENCE_PROB_022 : 211|6@0+ (1.588,0) [0|100] "%" ASDM
 SG_ DET_OUTSIDE_SECTOR_022 : 221|1@0+ (1,0) [0|1] "" ASDM
 SG_ DET_HVC_FLAG_022 : 207|1@0+ (1,0) [0|1] "" ASDM
 SG_ DET_CONFD_AZIMUTH_022 : 217|2@0+ (1,0) [0|3] "" ASDM
 SG_ DET_CONFD_ELEVATION_022 : 219|2@0+ (1,0) [0|3] "" ASDM
 SG_ DET_AZIMUTH_AMB_ID_022 : 202|3@0+ (1,0) [0|7] "" ASDM
 SG_ DET_AMBG_AZIMUTH_PROB_022 : 206|4@0+ (6.67,0) [0|100] "%" ASDM
 SG_ DET_RANGE_023 : 247|15@0+ (0.015625,0) [0|500] "m" ASDM
 SG_ DET_RANGE_ERR_023 : 248|7@0+ (0.0075,0) [0|0.9525] "m" ASDM
 SG_ DET_RANGE_VELOCITY_023 : 257|15@0+ (0.0078125,-128) [-128|127.9921875] "m/s" ASDM
 SG_ DET_RANGE_VELOCITY_ERR_023 : 274|8@0+ (0.003,0) [0|0.765] "m/s" ASDM
 SG_ DET_AZIMUTH_023 : 300|13@0+ (0.0004,-1.5708) [-1.5708|1.5708] "rad" ASDM
 SG_ DET_AZIMUTH_ERR_023 : 318|7@0+ (0.00087267,0) [0|0.11082909] "rad" ASDM
 SG_ DET_ELEVATION_023 : 282|8@0+ (0.00275,-0.34925) [-0.34925|0.34925] "rad" ASDM
 SG_ DET_ELEVATION_ERR_023 : 290|6@0+ (0.00174533,0) [0|0.10995579] "rad" ASDM
 SG_ DET_RCS_023 : 359|8@0+ (0.5,-64) [-64|63.5] "dBsm" ASDM
 SG_ DET_VALID_FLAG_023 : 340|1@0+ (1,0) [0|1] "" ASDM
 SG_ DET_BI_STATIC_FLAG_023 : 485|1@0+ (1,0) [0|1] "" ASDM
 SG_ DET_SUPER_RES_TARGET_023 : 319|1@0+ (1,0) [0|1] "" ASDM
 SG_ DET_SNR_023 : 351|8@0+ (0.35156,0) [0|89.6478] "dB" ASDM
 SG_ DET_POINT_TARGET_PROB_023 : 335|4@0+ (6.67,0) [0|100] "%" ASDM
 SG_ DET_EXISTENCE_PROB_023 : 331|6@0+ (1.588,0) [0|100] "%" ASDM
 SG_ DET_OUTSIDE_SECTOR_023 : 341|1@0+ (1,0) [0|1] "" ASDM
 SG_ DET_HVC_FLAG_023 : 327|1@0+ (1,0) [0|1] "" ASDM
 SG_ DET_CONFD_AZIMUTH_023 : 337|2@0+ (1,0) [0|3] "" ASDM
 SG_ DET_CONFD_ELEVATION_023 : 339|2@0+ (1,0) [0|3] "" ASDM
 SG_ DET_AZIMUTH_AMB_ID_023 : 322|3@0+ (1,0) [0|7] "" ASDM
 SG_ DET_AMBG_AZIMUTH_PROB_023 : 326|4@0+ (6.67,0) [0|100] "%" ASDM
 SG_ DET_RANGE_024 : 367|15@0+ (0.015625,0) [0|500] "m" ASDM
 SG_ DET_RANGE_ERR_024 : 368|7@0+ (0.0075,0) [0|0.9525] "m" ASDM
 SG_ DET_RANGE_VELOCITY_024 : 377|15@0+ (0.0078125,-128) [-128|127.9921875] "m/s" ASDM
 SG_ DET_RANGE_VELOCITY_ERR_024 : 394|8@0+ (0.003,0) [0|0.765] "m/s" ASDM
 SG_ DET_AZIMUTH_024 : 420|13@0+ (0.0004,-1.5708) [-1.5708|1.5708] "rad" ASDM
 SG_ DET_AZIMUTH_ERR_024 : 438|7@0+ (0.00087267,0) [0|0.11082909] "rad" ASDM
 SG_ DET_ELEVATION_024 : 402|8@0+ (0.00275,-0.34925) [-0.34925|0.34925] "rad" ASDM
 SG_ DET_ELEVATION_ERR_024 : 410|6@0+ (0.00174533,0) [0|0.10995579] "rad" ASDM
 SG_ DET_RCS_024 : 479|8@0+ (0.5,-64) [-64|63.5] "dBsm" ASDM
 SG_ DET_VALID_FLAG_024 : 460|1@0+ (1,0) [0|1] "" ASDM
 SG_ DET_BI_STATIC_FLAG_024 : 484|1@0+ (1,0) [0|1] "" ASDM
 SG_ DET_SUPER_RES_TARGET_024 : 439|1@0+ (1,0) [0|1] "" ASDM
 SG_ DET_SNR_024 : 471|8@0+ (0.35156,0) [0|89.6478] "dB" ASDM
 SG_ DET_POINT_TARGET_PROB_024 : 455|4@0+ (6.67,0) [0|100] "%" ASDM
 SG_ DET_EXISTENCE_PROB_024 : 451|6@0+ (1.588,0) [0|100] "%" ASDM
 SG_ DET_OUTSIDE_SECTOR_024 : 461|1@0+ (1,0) [0|1] "" ASDM
 SG_ DET_HVC_FLAG_024 : 447|1@0+ (1,0) [0|1] "" ASDM
 SG_ DET_CONFD_AZIMUTH_024 : 457|2@0+ (1,0) [0|3] "" ASDM
 SG_ DET_CONFD_ELEVATION_024 : 459|2@0+ (1,0) [0|3] "" ASDM
 SG_ DET_AZIMUTH_AMB_ID_024 : 442|3@0+ (1,0) [0|7] "" ASDM
 SG_ DET_AMBG_AZIMUTH_PROB_024 : 446|4@0+ (6.67,0) [0|100] "%" ASDM
 SG_ DET_MH_SCAN_INDEX_4LSB_021_024 : 483|4@0+ (1,0) [0|15] "" ASDM
 SG_ DET_MH_CYCLE_COUNTER_021_024 : 495|8@0+ (1,0) [0|255] "" ASDM
 SG_ DET_MH_CRC16_021_024 : 503|16@0+ (1,0) [0|65535] "" ASDM

BO_ 390 RDR_DETECTION_025_028: 64 G5_RDR02
 SG_ DET_RANGE_025 : 7|15@0+ (0.015625,0) [0|500] "m" ASDM
 SG_ DET_RANGE_ERR_025 : 8|7@0+ (0.0075,0) [0|0.9525] "m" ASDM
 SG_ DET_RANGE_VELOCITY_025 : 17|15@0+ (0.0078125,-128) [-128|127.9921875] "m/s" ASDM
 SG_ DET_RANGE_VELOCITY_ERR_025 : 34|8@0+ (0.003,0) [0|0.765] "m/s" ASDM
 SG_ DET_AZIMUTH_025 : 60|13@0+ (0.0004,-1.5708) [-1.5708|1.5708] "rad" ASDM
 SG_ DET_AZIMUTH_ERR_025 : 78|7@0+ (0.00087267,0) [0|0.11082909] "rad" ASDM
 SG_ DET_ELEVATION_025 : 42|8@0+ (0.00275,-0.34925) [-0.34925|0.34925] "rad" ASDM
 SG_ DET_ELEVATION_ERR_025 : 50|6@0+ (0.00174533,0) [0|0.10995579] "rad" ASDM
 SG_ DET_RCS_025 : 119|8@0+ (0.5,-64) [-64|63.5] "dBsm" ASDM
 SG_ DET_VALID_FLAG_025 : 100|1@0+ (1,0) [0|1] "" ASDM
 SG_ DET_BI_STATIC_FLAG_025 : 487|1@0+ (1,0) [0|1] "" ASDM
 SG_ DET_SUPER_RES_TARGET_025 : 79|1@0+ (1,0) [0|1] "" ASDM
 SG_ DET_SNR_025 : 111|8@0+ (0.35156,0) [0|89.6478] "dB" ASDM
 SG_ DET_POINT_TARGET_PROB_025 : 95|4@0+ (6.67,0) [0|100] "%" ASDM
 SG_ DET_EXISTENCE_PROB_025 : 91|6@0+ (1.588,0) [0|100] "%" ASDM
 SG_ DET_OUTSIDE_SECTOR_025 : 101|1@0+ (1,0) [0|1] "" ASDM
 SG_ DET_HVC_FLAG_025 : 87|1@0+ (1,0) [0|1] "" ASDM
 SG_ DET_CONFD_AZIMUTH_025 : 97|2@0+ (1,0) [0|3] "" ASDM
 SG_ DET_CONFD_ELEVATION_025 : 99|2@0+ (1,0) [0|3] "" ASDM
 SG_ DET_AZIMUTH_AMB_ID_025 : 82|3@0+ (1,0) [0|7] "" ASDM
 SG_ DET_AMBG_AZIMUTH_PROB_025 : 86|4@0+ (6.67,0) [0|100] "%" ASDM
 SG_ DET_RANGE_026 : 127|15@0+ (0.015625,0) [0|500] "m" ASDM
 SG_ DET_RANGE_ERR_026 : 128|7@0+ (0.0075,0) [0|0.9525] "m" ASDM
 SG_ DET_RANGE_VELOCITY_026 : 137|15@0+ (0.0078125,-128) [-128|127.9921875] "m/s" ASDM
 SG_ DET_RANGE_VELOCITY_ERR_026 : 154|8@0+ (0.003,0) [0|0.765] "m/s" ASDM
 SG_ DET_AZIMUTH_026 : 180|13@0+ (0.0004,-1.5708) [-1.5708|1.5708] "rad" ASDM
 SG_ DET_AZIMUTH_ERR_026 : 198|7@0+ (0.00087267,0) [0|0.11082909] "rad" ASDM
 SG_ DET_ELEVATION_026 : 162|8@0+ (0.00275,-0.34925) [-0.34925|0.34925] "rad" ASDM
 SG_ DET_ELEVATION_ERR_026 : 170|6@0+ (0.00174533,0) [0|0.10995579] "rad" ASDM
 SG_ DET_RCS_026 : 239|8@0+ (0.5,-64) [-64|63.5] "dBsm" ASDM
 SG_ DET_VALID_FLAG_026 : 220|1@0+ (1,0) [0|1] "" ASDM
 SG_ DET_BI_STATIC_FLAG_026 : 486|1@0+ (1,0) [0|1] "" ASDM
 SG_ DET_SUPER_RES_TARGET_026 : 199|1@0+ (1,0) [0|1] "" ASDM
 SG_ DET_SNR_026 : 231|8@0+ (0.35156,0) [0|89.6478] "dB" ASDM
 SG_ DET_POINT_TARGET_PROB_026 : 215|4@0+ (6.67,0) [0|100] "%" ASDM
 SG_ DET_EXISTENCE_PROB_026 : 211|6@0+ (1.588,0) [0|100] "%" ASDM
 SG_ DET_OUTSIDE_SECTOR_026 : 221|1@0+ (1,0) [0|1] "" ASDM
 SG_ DET_HVC_FLAG_026 : 207|1@0+ (1,0) [0|1] "" ASDM
 SG_ DET_CONFD_AZIMUTH_026 : 217|2@0+ (1,0) [0|3] "" ASDM
 SG_ DET_CONFD_ELEVATION_026 : 219|2@0+ (1,0) [0|3] "" ASDM
 SG_ DET_AZIMUTH_AMB_ID_026 : 202|3@0+ (1,0) [0|7] "" ASDM
 SG_ DET_AMBG_AZIMUTH_PROB_026 : 206|4@0+ (6.67,0) [0|100] "%" ASDM
 SG_ DET_RANGE_027 : 247|15@0+ (0.015625,0) [0|500] "m" ASDM
 SG_ DET_RANGE_ERR_027 : 248|7@0+ (0.0075,0) [0|0.9525] "m" ASDM
 SG_ DET_RANGE_VELOCITY_027 : 257|15@0+ (0.0078125,-128) [-128|127.9921875] "m/s" ASDM
 SG_ DET_RANGE_VELOCITY_ERR_027 : 274|8@0+ (0.003,0) [0|0.765] "m/s" ASDM
 SG_ DET_AZIMUTH_027 : 300|13@0+ (0.0004,-1.5708) [-1.5708|1.5708] "rad" ASDM
 SG_ DET_AZIMUTH_ERR_027 : 318|7@0+ (0.00087267,0) [0|0.11082909] "rad" ASDM
 SG_ DET_ELEVATION_027 : 282|8@0+ (0.00275,-0.34925) [-0.34925|0.34925] "rad" ASDM
 SG_ DET_ELEVATION_ERR_027 : 290|6@0+ (0.00174533,0) [0|0.10995579] "rad" ASDM
 SG_ DET_RCS_027 : 359|8@0+ (0.5,-64) [-64|63.5] "dBsm" ASDM
 SG_ DET_VALID_FLAG_027 : 340|1@0+ (1,0) [0|1] "" ASDM
 SG_ DET_BI_STATIC_FLAG_027 : 485|1@0+ (1,0) [0|1] "" ASDM
 SG_ DET_SUPER_RES_TARGET_027 : 319|1@0+ (1,0) [0|1] "" ASDM
 SG_ DET_SNR_027 : 351|8@0+ (0.35156,0) [0|89.6478] "dB" ASDM
 SG_ DET_POINT_TARGET_PROB_027 : 335|4@0+ (6.67,0) [0|100] "%" ASDM
 SG_ DET_EXISTENCE_PROB_027 : 331|6@0+ (1.588,0) [0|100] "%" ASDM
 SG_ DET_OUTSIDE_SECTOR_027 : 341|1@0+ (1,0) [0|1] "" ASDM
 SG_ DET_HVC_FLAG_027 : 327|1@0+ (1,0) [0|1] "" ASDM
 SG_ DET_CONFD_AZIMUTH_027 : 337|2@0+ (1,0) [0|3] "" ASDM
 SG_ DET_CONFD_ELEVATION_027 : 339|2@0+ (1,0) [0|3] "" ASDM
 SG_ DET_AZIMUTH_AMB_ID_027 : 322|3@0+ (1,0) [0|7] "" ASDM
 SG_ DET_AMBG_AZIMUTH_PROB_027 : 326|4@0+ (6.67,0) [0|100] "%" ASDM
 SG_ DET_RANGE_028 : 367|15@0+ (0.015625,0) [0|500] "m" ASDM
 SG_ DET_RANGE_ERR_028 : 368|7@0+ (0.0075,0) [0|0.9525] "m" ASDM
 SG_ DET_RANGE_VELOCITY_028 : 377|15@0+ (0.0078125,-128) [-128|127.9921875] "m/s" ASDM
 SG_ DET_RANGE_VELOCITY_ERR_028 : 394|8@0+ (0.003,0) [0|0.765] "m/s" ASDM
 SG_ DET_AZIMUTH_028 : 420|13@0+ (0.0004,-1.5708) [-1.5708|1.5708] "rad" ASDM
 SG_ DET_AZIMUTH_ERR_028 : 438|7@0+ (0.00087267,0) [0|0.11082909] "rad" ASDM
 SG_ DET_ELEVATION_028 : 402|8@0+ (0.00275,-0.34925) [-0.34925|0.34925] "rad" ASDM
 SG_ DET_ELEVATION_ERR_028 : 410|6@0+ (0.00174533,0) [0|0.10995579] "rad" ASDM
 SG_ DET_RCS_028 : 479|8@0+ (0.5,-64) [-64|63.5] "dBsm" ASDM
 SG_ DET_VALID_FLAG_028 : 460|1@0+ (1,0) [0|1] "" ASDM
 SG_ DET_BI_STATIC_FLAG_028 : 484|1@0+ (1,0) [0|1] "" ASDM
 SG_ DET_SUPER_RES_TARGET_028 : 439|1@0+ (1,0) [0|1] "" ASDM
 SG_ DET_SNR_028 : 471|8@0+ (0.35156,0) [0|89.6478] "dB" ASDM
 SG_ DET_POINT_TARGET_PROB_028 : 455|4@0+ (6.67,0) [0|100] "%" ASDM
 SG_ DET_EXISTENCE_PROB_028 : 451|6@0+ (1.588,0) [0|100] "%" ASDM
 SG_ DET_OUTSIDE_SECTOR_028 : 461|1@0+ (1,0) [0|1] "" ASDM
 SG_ DET_HVC_FLAG_028 : 447|1@0+ (1,0) [0|1] "" ASDM
 SG_ DET_CONFD_AZIMUTH_028 : 457|2@0+ (1,0) [0|3] "" ASDM
 SG_ DET_CONFD_ELEVATION_028 : 459|2@0+ (1,0) [0|3] "" ASDM
 SG_ DET_AZIMUTH_AMB_ID_028 : 442|3@0+ (1,0) [0|7] "" ASDM
 SG_ DET_AMBG_AZIMUTH_PROB_028 : 446|4@0+ (6.67,0) [0|100] "%" ASDM
 SG_ DET_MH_SCAN_INDEX_4LSB_025_028 : 483|4@0+ (1,0) [0|15] "" ASDM
 SG_ DET_MH_CYCLE_COUNTER_025_028 : 495|8@0+ (1,0) [0|255] "" ASDM
 SG_ DET_MH_CRC16_025_028 : 503|16@0+ (1,0) [0|65535] "" ASDM

BO_ 391 RDR_DETECTION_029_032: 64 G5_RDR02
 SG_ DET_RANGE_029 : 7|15@0+ (0.015625,0) [0|500] "m" ASDM
 SG_ DET_RANGE_ERR_029 : 8|7@0+ (0.0075,0) [0|0.9525] "m" ASDM
 SG_ DET_RANGE_VELOCITY_029 : 17|15@0+ (0.0078125,-128) [-128|127.9921875] "m/s" ASDM
 SG_ DET_RANGE_VELOCITY_ERR_029 : 34|8@0+ (0.003,0) [0|0.765] "m/s" ASDM
 SG_ DET_AZIMUTH_029 : 60|13@0+ (0.0004,-1.5708) [-1.5708|1.5708] "rad" ASDM
 SG_ DET_AZIMUTH_ERR_029 : 78|7@0+ (0.00087267,0) [0|0.11082909] "rad" ASDM
 SG_ DET_ELEVATION_029 : 42|8@0+ (0.00275,-0.34925) [-0.34925|0.34925] "rad" ASDM
 SG_ DET_ELEVATION_ERR_029 : 50|6@0+ (0.00174533,0) [0|0.10995579] "rad" ASDM
 SG_ DET_RCS_029 : 119|8@0+ (0.5,-64) [-64|63.5] "dBsm" ASDM
 SG_ DET_VALID_FLAG_029 : 100|1@0+ (1,0) [0|1] "" ASDM
 SG_ DET_BI_STATIC_FLAG_029 : 487|1@0+ (1,0) [0|1] "" ASDM
 SG_ DET_SUPER_RES_TARGET_029 : 79|1@0+ (1,0) [0|1] "" ASDM
 SG_ DET_SNR_029 : 111|8@0+ (0.35156,0) [0|89.6478] "dB" ASDM
 SG_ DET_POINT_TARGET_PROB_029 : 95|4@0+ (6.67,0) [0|100] "%" ASDM
 SG_ DET_EXISTENCE_PROB_029 : 91|6@0+ (1.588,0) [0|100] "%" ASDM
 SG_ DET_OUTSIDE_SECTOR_029 : 101|1@0+ (1,0) [0|1] "" ASDM
 SG_ DET_HVC_FLAG_029 : 87|1@0+ (1,0) [0|1] "" ASDM
 SG_ DET_CONFD_AZIMUTH_029 : 97|2@0+ (1,0) [0|3] "" ASDM
 SG_ DET_CONFD_ELEVATION_029 : 99|2@0+ (1,0) [0|3] "" ASDM
 SG_ DET_AZIMUTH_AMB_ID_029 : 82|3@0+ (1,0) [0|7] "" ASDM
 SG_ DET_AMBG_AZIMUTH_PROB_029 : 86|4@0+ (6.67,0) [0|100] "%" ASDM
 SG_ DET_RANGE_030 : 127|15@0+ (0.015625,0) [0|500] "m" ASDM
 SG_ DET_RANGE_ERR_030 : 128|7@0+ (0.0075,0) [0|0.9525] "m" ASDM
 SG_ DET_RANGE_VELOCITY_030 : 137|15@0+ (0.0078125,-128) [-128|127.9921875] "m/s" ASDM
 SG_ DET_RANGE_VELOCITY_ERR_030 : 154|8@0+ (0.003,0) [0|0.765] "m/s" ASDM
 SG_ DET_AZIMUTH_030 : 180|13@0+ (0.0004,-1.5708) [-1.5708|1.5708] "rad" ASDM
 SG_ DET_AZIMUTH_ERR_030 : 198|7@0+ (0.00087267,0) [0|0.11082909] "rad" ASDM
 SG_ DET_ELEVATION_030 : 162|8@0+ (0.00275,-0.34925) [-0.34925|0.34925] "rad" ASDM
 SG_ DET_ELEVATION_ERR_030 : 170|6@0+ (0.00174533,0) [0|0.10995579] "rad" ASDM
 SG_ DET_RCS_030 : 239|8@0+ (0.5,-64) [-64|63.5] "dBsm" ASDM
 SG_ DET_VALID_FLAG_030 : 220|1@0+ (1,0) [0|1] "" ASDM
 SG_ DET_BI_STATIC_FLAG_030 : 486|1@0+ (1,0) [0|1] "" ASDM
 SG_ DET_SUPER_RES_TARGET_030 : 199|1@0+ (1,0) [0|1] "" ASDM
 SG_ DET_SNR_030 : 231|8@0+ (0.35156,0) [0|89.6478] "dB" ASDM
 SG_ DET_POINT_TARGET_PROB_030 : 215|4@0+ (6.67,0) [0|100] "%" ASDM
 SG_ DET_EXISTENCE_PROB_030 : 211|6@0+ (1.588,0) [0|100] "%" ASDM
 SG_ DET_OUTSIDE_SECTOR_030 : 221|1@0+ (1,0) [0|1] "" ASDM
 SG_ DET_HVC_FLAG_030 : 207|1@0+ (1,0) [0|1] "" ASDM
 SG_ DET_CONFD_AZIMUTH_030 : 217|2@0+ (1,0) [0|3] "" ASDM
 SG_ DET_CONFD_ELEVATION_030 : 219|2@0+ (1,0) [0|3] "" ASDM
 SG_ DET_AZIMUTH_AMB_ID_030 : 202|3@0+ (1,0) [0|7] "" ASDM
 SG_ DET_AMBG_AZIMUTH_PROB_030 : 206|4@0+ (6.67,0) [0|100] "%" ASDM
 SG_ DET_RANGE_031 : 247|15@0+ (0.015625,0) [0|500] "m" ASDM
 SG_ DET_RANGE_ERR_031 : 248|7@0+ (0.0075,0) [0|0.9525] "m" ASDM
 SG_ DET_RANGE_VELOCITY_031 : 257|15@0+ (0.0078125,-128) [-128|127.9921875] "m/s" ASDM
 SG_ DET_RANGE_VELOCITY_ERR_031 : 274|8@0+ (0.003,0) [0|0.765] "m/s" ASDM
 SG_ DET_AZIMUTH_031 : 300|13@0+ (0.0004,-1.5708) [-1.5708|1.5708] "rad" ASDM
 SG_ DET_AZIMUTH_ERR_031 : 318|7@0+ (0.00087267,0) [0|0.11082909] "rad" ASDM
 SG_ DET_ELEVATION_031 : 282|8@0+ (0.00275,-0.34925) [-0.34925|0.34925] "rad" ASDM
 SG_ DET_ELEVATION_ERR_031 : 290|6@0+ (0.00174533,0) [0|0.10995579] "rad" ASDM
 SG_ DET_RCS_031 : 359|8@0+ (0.5,-64) [-64|63.5] "dBsm" ASDM
 SG_ DET_VALID_FLAG_031 : 340|1@0+ (1,0) [0|1] "" ASDM
 SG_ DET_BI_STATIC_FLAG_031 : 485|1@0+ (1,0) [0|1] "" ASDM
 SG_ DET_SUPER_RES_TARGET_031 : 319|1@0+ (1,0) [0|1] "" ASDM
 SG_ DET_SNR_031 : 351|8@0+ (0.35156,0) [0|89.6478] "dB" ASDM
 SG_ DET_POINT_TARGET_PROB_031 : 335|4@0+ (6.67,0) [0|100] "%" ASDM
 SG_ DET_EXISTENCE_PROB_031 : 331|6@0+ (1.588,0) [0|100] "%" ASDM
 SG_ DET_OUTSIDE_SECTOR_031 : 341|1@0+ (1,0) [0|1] "" ASDM
 SG_ DET_HVC_FLAG_031 : 327|1@0+ (1,0) [0|1] "" ASDM
 SG_ DET_CONFD_AZIMUTH_031 : 337|2@0+ (1,0) [0|3] "" ASDM
 SG_ DET_CONFD_ELEVATION_031 : 339|2@0+ (1,0) [0|3] "" ASDM
 SG_ DET_AZIMUTH_AMB_ID_031 : 322|3@0+ (1,0) [0|7] "" ASDM
 SG_ DET_AMBG_AZIMUTH_PROB_031 : 326|4@0+ (6.67,0) [0|100] "%" ASDM
 SG_ DET_RANGE_032 : 367|15@0+ (0.015625,0) [0|500] "m" ASDM
 SG_ DET_RANGE_ERR_032 : 368|7@0+ (0.0075,0) [0|0.9525] "m" ASDM
 SG_ DET_RANGE_VELOCITY_032 : 377|15@0+ (0.0078125,-128) [-128|127.9921875] "m/s" ASDM
 SG_ DET_RANGE_VELOCITY_ERR_032 : 394|8@0+ (0.003,0) [0|0.765] "m/s" ASDM
 SG_ DET_AZIMUTH_032 : 420|13@0+ (0.0004,-1.5708) [-1.5708|1.5708] "rad" ASDM
 SG_ DET_AZIMUTH_ERR_032 : 438|7@0+ (0.00087267,0) [0|0.11082909] "rad" ASDM
 SG_ DET_ELEVATION_032 : 402|8@0+ (0.00275,-0.34925) [-0.34925|0.34925] "rad" ASDM
 SG_ DET_ELEVATION_ERR_032 : 410|6@0+ (0.00174533,0) [0|0.10995579] "rad" ASDM
 SG_ DET_RCS_032 : 479|8@0+ (0.5,-64) [-64|63.5] "dBsm" ASDM
 SG_ DET_VALID_FLAG_032 : 460|1@0+ (1,0) [0|1] "" ASDM
 SG_ DET_BI_STATIC_FLAG_032 : 484|1@0+ (1,0) [0|1] "" ASDM
 SG_ DET_SUPER_RES_TARGET_032 : 439|1@0+ (1,0) [0|1] "" ASDM
 SG_ DET_SNR_032 : 471|8@0+ (0.35156,0) [0|89.6478] "dB" ASDM
 SG_ DET_POINT_TARGET_PROB_032 : 455|4@0+ (6.67,0) [0|100] "%" ASDM
 SG_ DET_EXISTENCE_PROB_032 : 451|6@0+ (1.588,0) [0|100] "%" ASDM
 SG_ DET_OUTSIDE_SECTOR_032 : 461|1@0+ (1,0) [0|1] "" ASDM
 SG_ DET_HVC_FLAG_032 : 447|1@0+ (1,0) [0|1] "" ASDM
 SG_ DET_CONFD_AZIMUTH_032 : 457|2@0+ (1,0) [0|3] "" ASDM
 SG_ DET_CONFD_ELEVATION_032 : 459|2@0+ (1,0) [0|3] "" ASDM
 SG_ DET_AZIMUTH_AMB_ID_032 : 442|3@0+ (1,0) [0|7] "" ASDM
 SG_ DET_AMBG_AZIMUTH_PROB_032 : 446|4@0+ (6.67,0) [0|100] "%" ASDM
 SG_ DET_MH_SCAN_INDEX_4LSB_029_032 : 483|4@0+ (1,0) [0|15] "" ASDM
 SG_ DET_MH_CYCLE_COUNTER_029_032 : 495|8@0+ (1,0) [0|255] "" ASDM
 SG_ DET_MH_CRC16_029_032 : 503|16@0+ (1,0) [0|65535] "" ASDM

BO_ 392 RDR_DETECTION_033_036: 64 G5_RDR02
 SG_ DET_RANGE_033 : 7|15@0+ (0.015625,0) [0|500] "m" ASDM
 SG_ DET_RANGE_ERR_033 : 8|7@0+ (0.0075,0) [0|0.9525] "m" ASDM
 SG_ DET_RANGE_VELOCITY_033 : 17|15@0+ (0.0078125,-128) [-128|127.9921875] "m/s" ASDM
 SG_ DET_RANGE_VELOCITY_ERR_033 : 34|8@0+ (0.003,0) [0|0.765] "m/s" ASDM
 SG_ DET_AZIMUTH_033 : 60|13@0+ (0.0004,-1.5708) [-1.5708|1.5708] "rad" ASDM
 SG_ DET_AZIMUTH_ERR_033 : 78|7@0+ (0.00087267,0) [0|0.11082909] "rad" ASDM
 SG_ DET_ELEVATION_033 : 42|8@0+ (0.00275,-0.34925) [-0.34925|0.34925] "rad" ASDM
 SG_ DET_ELEVATION_ERR_033 : 50|6@0+ (0.00174533,0) [0|0.10995579] "rad" ASDM
 SG_ DET_RCS_033 : 119|8@0+ (0.5,-64) [-64|63.5] "dBsm" ASDM
 SG_ DET_VALID_FLAG_033 : 100|1@0+ (1,0) [0|1] "" ASDM
 SG_ DET_BI_STATIC_FLAG_033 : 487|1@0+ (1,0) [0|1] "" ASDM
 SG_ DET_SUPER_RES_TARGET_033 : 79|1@0+ (1,0) [0|1] "" ASDM
 SG_ DET_SNR_033 : 111|8@0+ (0.35156,0) [0|89.6478] "dB" ASDM
 SG_ DET_POINT_TARGET_PROB_033 : 95|4@0+ (6.67,0) [0|100] "%" ASDM
 SG_ DET_EXISTENCE_PROB_033 : 91|6@0+ (1.588,0) [0|100] "%" ASDM
 SG_ DET_OUTSIDE_SECTOR_033 : 101|1@0+ (1,0) [0|1] "" ASDM
 SG_ DET_HVC_FLAG_033 : 87|1@0+ (1,0) [0|1] "" ASDM
 SG_ DET_CONFD_AZIMUTH_033 : 97|2@0+ (1,0) [0|3] "" ASDM
 SG_ DET_CONFD_ELEVATION_033 : 99|2@0+ (1,0) [0|3] "" ASDM
 SG_ DET_AZIMUTH_AMB_ID_033 : 82|3@0+ (1,0) [0|7] "" ASDM
 SG_ DET_AMBG_AZIMUTH_PROB_033 : 86|4@0+ (6.67,0) [0|100] "%" ASDM
 SG_ DET_RANGE_034 : 127|15@0+ (0.015625,0) [0|500] "m" ASDM
 SG_ DET_RANGE_ERR_034 : 128|7@0+ (0.0075,0) [0|0.9525] "m" ASDM
 SG_ DET_RANGE_VELOCITY_034 : 137|15@0+ (0.0078125,-128) [-128|127.9921875] "m/s" ASDM
 SG_ DET_RANGE_VELOCITY_ERR_034 : 154|8@0+ (0.003,0) [0|0.765] "m/s" ASDM
 SG_ DET_AZIMUTH_034 : 180|13@0+ (0.0004,-1.5708) [-1.5708|1.5708] "rad" ASDM
 SG_ DET_AZIMUTH_ERR_034 : 198|7@0+ (0.00087267,0) [0|0.11082909] "rad" ASDM
 SG_ DET_ELEVATION_034 : 162|8@0+ (0.00275,-0.34925) [-0.34925|0.34925] "rad" ASDM
 SG_ DET_ELEVATION_ERR_034 : 170|6@0+ (0.00174533,0) [0|0.10995579] "rad" ASDM
 SG_ DET_RCS_034 : 239|8@0+ (0.5,-64) [-64|63.5] "dBsm" ASDM
 SG_ DET_VALID_FLAG_034 : 220|1@0+ (1,0) [0|1] "" ASDM
 SG_ DET_BI_STATIC_FLAG_034 : 486|1@0+ (1,0) [0|1] "" ASDM
 SG_ DET_SUPER_RES_TARGET_034 : 199|1@0+ (1,0) [0|1] "" ASDM
 SG_ DET_SNR_034 : 231|8@0+ (0.35156,0) [0|89.6478] "dB" ASDM
 SG_ DET_POINT_TARGET_PROB_034 : 215|4@0+ (6.67,0) [0|100] "%" ASDM
 SG_ DET_EXISTENCE_PROB_034 : 211|6@0+ (1.588,0) [0|100] "%" ASDM
 SG_ DET_OUTSIDE_SECTOR_034 : 221|1@0+ (1,0) [0|1] "" ASDM
 SG_ DET_HVC_FLAG_034 : 207|1@0+ (1,0) [0|1] "" ASDM
 SG_ DET_CONFD_AZIMUTH_034 : 217|2@0+ (1,0) [0|3] "" ASDM
 SG_ DET_CONFD_ELEVATION_034 : 219|2@0+ (1,0) [0|3] "" ASDM
 SG_ DET_AZIMUTH_AMB_ID_034 : 202|3@0+ (1,0) [0|7] "" ASDM
 SG_ DET_AMBG_AZIMUTH_PROB_034 : 206|4@0+ (6.67,0) [0|100] "%" ASDM
 SG_ DET_RANGE_035 : 247|15@0+ (0.015625,0) [0|500] "m" ASDM
 SG_ DET_RANGE_ERR_035 : 248|7@0+ (0.0075,0) [0|0.9525] "m" ASDM
 SG_ DET_RANGE_VELOCITY_035 : 257|15@0+ (0.0078125,-128) [-128|127.9921875] "m/s" ASDM
 SG_ DET_RANGE_VELOCITY_ERR_035 : 274|8@0+ (0.003,0) [0|0.765] "m/s" ASDM
 SG_ DET_AZIMUTH_035 : 300|13@0+ (0.0004,-1.5708) [-1.5708|1.5708] "rad" ASDM
 SG_ DET_AZIMUTH_ERR_035 : 318|7@0+ (0.00087267,0) [0|0.11082909] "rad" ASDM
 SG_ DET_ELEVATION_035 : 282|8@0+ (0.00275,-0.34925) [-0.34925|0.34925] "rad" ASDM
 SG_ DET_ELEVATION_ERR_035 : 290|6@0+ (0.00174533,0) [0|0.10995579] "rad" ASDM
 SG_ DET_RCS_035 : 359|8@0+ (0.5,-64) [-64|63.5] "dBsm" ASDM
 SG_ DET_VALID_FLAG_035 : 340|1@0+ (1,0) [0|1] "" ASDM
 SG_ DET_BI_STATIC_FLAG_035 : 485|1@0+ (1,0) [0|1] "" ASDM
 SG_ DET_SUPER_RES_TARGET_035 : 319|1@0+ (1,0) [0|1] "" ASDM
 SG_ DET_SNR_035 : 351|8@0+ (0.35156,0) [0|89.6478] "dB" ASDM
 SG_ DET_POINT_TARGET_PROB_035 : 335|4@0+ (6.67,0) [0|100] "%" ASDM
 SG_ DET_EXISTENCE_PROB_035 : 331|6@0+ (1.588,0) [0|100] "%" ASDM
 SG_ DET_OUTSIDE_SECTOR_035 : 341|1@0+ (1,0) [0|1] "" ASDM
 SG_ DET_HVC_FLAG_035 : 327|1@0+ (1,0) [0|1] "" ASDM
 SG_ DET_CONFD_AZIMUTH_035 : 337|2@0+ (1,0) [0|3] "" ASDM
 SG_ DET_CONFD_ELEVATION_035 : 339|2@0+ (1,0) [0|3] "" ASDM
 SG_ DET_AZIMUTH_AMB_ID_035 : 322|3@0+ (1,0) [0|7] "" ASDM
 SG_ DET_AMBG_AZIMUTH_PROB_035 : 326|4@0+ (6.67,0) [0|100] "%" ASDM
 SG_ DET_RANGE_036 : 367|15@0+ (0.015625,0) [0|500] "m" ASDM
 SG_ DET_RANGE_ERR_036 : 368|7@0+ (0.0075,0) [0|0.9525] "m" ASDM
 SG_ DET_RANGE_VELOCITY_036 : 377|15@0+ (0.0078125,-128) [-128|127.9921875] "m/s" ASDM
 SG_ DET_RANGE_VELOCITY_ERR_036 : 394|8@0+ (0.003,0) [0|0.765] "m/s" ASDM
 SG_ DET_AZIMUTH_036 : 420|13@0+ (0.0004,-1.5708) [-1.5708|1.5708] "rad" ASDM
 SG_ DET_AZIMUTH_ERR_036 : 438|7@0+ (0.00087267,0) [0|0.11082909] "rad" ASDM
 SG_ DET_ELEVATION_036 : 402|8@0+ (0.00275,-0.34925) [-0.34925|0.34925] "rad" ASDM
 SG_ DET_ELEVATION_ERR_036 : 410|6@0+ (0.00174533,0) [0|0.10995579] "rad" ASDM
 SG_ DET_RCS_036 : 479|8@0+ (0.5,-64) [-64|63.5] "dBsm" ASDM
 SG_ DET_VALID_FLAG_036 : 460|1@0+ (1,0) [0|1] "" ASDM
 SG_ DET_BI_STATIC_FLAG_036 : 484|1@0+ (1,0) [0|1] "" ASDM
 SG_ DET_SUPER_RES_TARGET_036 : 439|1@0+ (1,0) [0|1] "" ASDM
 SG_ DET_SNR_036 : 471|8@0+ (0.35156,0) [0|89.6478] "dB" ASDM
 SG_ DET_POINT_TARGET_PROB_036 : 455|4@0+ (6.67,0) [0|100] "%" ASDM
 SG_ DET_EXISTENCE_PROB_036 : 451|6@0+ (1.588,0) [0|100] "%" ASDM
 SG_ DET_OUTSIDE_SECTOR_036 : 461|1@0+ (1,0) [0|1] "" ASDM
 SG_ DET_HVC_FLAG_036 : 447|1@0+ (1,0) [0|1] "" ASDM
 SG_ DET_CONFD_AZIMUTH_036 : 457|2@0+ (1,0) [0|3] "" ASDM
 SG_ DET_CONFD_ELEVATION_036 : 459|2@0+ (1,0) [0|3] "" ASDM
 SG_ DET_AZIMUTH_AMB_ID_036 : 442|3@0+ (1,0) [0|7] "" ASDM
 SG_ DET_AMBG_AZIMUTH_PROB_036 : 446|4@0+ (6.67,0) [0|100] "%" ASDM
 SG_ DET_MH_SCAN_INDEX_4LSB_033_036 : 483|4@0+ (1,0) [0|15] "" ASDM
 SG_ DET_MH_CYCLE_COUNTER_033_036 : 495|8@0+ (1,0) [0|255] "" ASDM
 SG_ DET_MH_CRC16_033_036 : 503|16@0+ (1,0) [0|65535] "" ASDM

CM_ BO_ 1  "The CAN message from the Time Master is a multiplexed message, viz. CAN-SYN and CAN-FUP";

CM_ SG_ 384 DET_RANGE_001 " measured position  of the detection";
CM_ SG_ 384 DET_RANGE_ERR_001 "RMSE or standard deviation of the measured angle  of the detection";
CM_ SG_ 384 DET_RANGE_VELOCITY_001 "Radial velocity of the detection positive in direction to the sensor";
CM_ SG_ 384 DET_RANGE_VELOCITY_ERR_001 "RMSE or standard deviation of the measure radial velocity of the detection";
CM_ SG_ 384 DET_AZIMUTH_001 "Measured angle  of the detection";
CM_ SG_ 384 DET_AZIMUTH_ERR_001 "RMSE or standard deviation of the measured angle  of the detection";
CM_ SG_ 384 DET_ELEVATION_001 "measured elevation of the detection";
CM_ SG_ 384 DET_ELEVATION_ERR_001 "RMSE or standard deviation of the measured elevation  of the detection";
CM_ SG_ 384 DET_RCS_001 "Radar Cross Section or Amplitude, is a measure of how detectable an object is by radar. A larger RCS indicates that an object is more easily detected.";
CM_ SG_ 384 DET_VALID_FLAG_001 "is set if the measured detection is valid";
CM_ SG_ 384 DET_BI_STATIC_FLAG_001 "1 if detection is bi-static 0 otherwise";
CM_ SG_ 384 DET_SUPER_RES_TARGET_001 "flasg is set if the detection is super resolution target";
CM_ SG_ 384 DET_SNR_001 "The signal to noise ratio (SNR) of the radar detection";
CM_ SG_ 384 DET_POINT_TARGET_PROB_001 "Describes the possibility if more than one real-world object has led to this detection. 0[%] := 100[%] Multi target probability";
CM_ SG_ 384 DET_EXISTENCE_PROB_001 "Existence probability of the detection not based on history. Value does  not depend on any past experience with similar detections.
\note Use as confidence measure where a low value means less confidence
and a high value indicates strong confidence.";
CM_ SG_ 384 DET_OUTSIDE_SECTOR_001 "Flag to indicate detections outside the sector, set if the wrong sector calibration matrix was used";
CM_ SG_ 384 DET_HVC_FLAG_001 "Core2 Vehicle clutter flag";
CM_ SG_ 384 DET_CONFD_AZIMUTH_001 "Define the Confidence of Azimuth for Detection ";
CM_ SG_ 384 DET_CONFD_ELEVATION_001 "Define the Confidence of Elevation for the Detection ";
CM_ SG_ 384 DET_AZIMUTH_AMB_ID_001 "Each ambiguous measurement generates one Ambiguity ID. Ambiguity is indicated by an identical ambiguity ID.
note Unambiguous measurements have the ambiguity ID 0.";
CM_ SG_ 384 DET_AMBG_AZIMUTH_PROB_001 "Probability for different hypothesis, sum is 100 [%] for all detections with the same Ambiguity ID. 0 means no Ambiguity";
CM_ SG_ 384 DET_BI_STATIC_FLAG_002 "1 if detection is bi-static 0 otherwise";
CM_ SG_ 384 DET_BI_STATIC_FLAG_003 "1 if detection is bi-static 0 otherwise";
CM_ SG_ 384 DET_BI_STATIC_FLAG_004 "1 if detection is bi-static 0 otherwise";
CM_ SG_ 384 DET_MH_SCAN_INDEX_4LSB_001_004 "Scan index of the measured detection";
CM_ SG_ 384 DET_MH_CYCLE_COUNTER_001_004 "Detection Alive Counter";
CM_ SG_ 1 TSYN_USERBYTE "User specific data within the time measurement and synchronization protocol";
CM_ SG_ 1 TSYN_TIMEDOMAIN "Time Domian ID";
CM_ SG_ 1 TSYN_SYNCTIME_SEC "TIme in Seconds";
CM_ SG_ 1 TSYN_SYNCTIME_NANOSEC "Time in Nano Seconds";
CM_ SG_ 1 TSYN_SGW "Sync to Global Time or Sync to Sub Domian";
CM_ SG_ 1 TSYN_SEQUENCE_COUNTER "Sequence Counter (SC) of 4 bit is representing numbers from 0 to 15 per Time
Domain";
CM_ SG_ 1 TSYN_RESERVED "resreved for future extension";
CM_ SG_ 1 TSYN_PDU "TSyn_PDU signal value of 0x20 is  CAN-SYN. and TSyn_PDU signal value of 0x28 is CAN-FUP";
CM_ SG_ 1 TSYN_OVS "Overflow of seconds. If the value calculated for TSyn_SynTimeNSec overflows";
CM_ SG_ 1 TSYNC_CRC "CRC CRC8H2F";
CM_ SG_ 2 SSTS_YAW_RATE_CALC_QF "Yaw Rate quallity factor";
CM_ SG_ 2 SSTS_VEHICLE_SPEED_CALC_QF "Speed Quality factor";
CM_ SG_ 2 SSTS_VEH_BATT_VOLT "absolute battery voltage";
CM_ SG_ 2 SSTS_PWPCKTQ_D_STAT "Indicates if the power pack is a motive (wheel torque producing) or non-motive (non-wheel torque producing) mode. It also indicates to if a transition from a non-motive to a motive mode is in progress.";
CM_ SG_ 2 SSTS_CC_STAT_D_ACTL "Status of cruise  controls.";
CM_ SG_ 2 SSTS_ElPW_D_STAT "Indicates if the power pack is supporting the 12V bus with energy, supporting but about to stop, not supporting and undergoing a large power draw (e.g. starting MHEV ICE), or in a fault limited support mode.";
CM_ SG_ 2 SSTS_VEHOVERGND_V_EST "Estimated vehicle speed over ground.";
CM_ SG_ 2 SSTS_STEERING_ANGLE_SIGN "Actual steering angle direction, from the centre position of the steering wheel.";
CM_ SG_ 2 SSTS_STEERING_ANGLE "Actual steering wheel angle. Datum (zero) of the steering wheel position is determined at the time of calibration in the factory.   This is only the magnitude of the steering wheel angle.";
CM_ SG_ 141 STS_TIME_STAMP_DELTA "Difference between last Timestamp and internal Timer";
CM_ SG_ 141 STS_SW_VERSION_FIELD1 "Release_Number is incremented for major every release";
CM_ SG_ 141 STS_SW_VERSION_FIELD2 "Promote_Revision, increment with every promote or minor release";
CM_ SG_ 141 STS_SW_VERSION_FIELD3 "Field_Revision  or Variant number";
CM_ SG_ 141 STS_SW_VERSION_FIELD4 "Increment with SW patch release";
CM_ SG_ 141 STS_PBL_VERSION_FIELD1 "Release_Number is incremented for major every release";
CM_ SG_ 141 STS_PBL_VERSION_FIELD2 "Promote_Revision, increment with every promote or minor release";
CM_ SG_ 141 STS_PBL_VERSION_FIELD3 "Field_Revision  or Variant number";
CM_ SG_ 141 STS_PBL_VERSION_FIELD4 "Increment with patch release";
CM_ SG_ 141 STS_SMC_SECTION_COMPTBLITY "Section compatiblity bits as specified in EXEC spec";
CM_ SG_ 141 STS_SMC_PLATFROM_VERSION "Variant ID";
CM_ SG_ 141 STS_SENSOR_MOUNT_POS_X "Correction of the mounting position w.r.t. the optimal position. Correction is determined by calibration";
CM_ SG_ 141 STS_SENSOR_MOUNT_ORNT_PITCH "Correction of the mounting position orientation w.r.t. the optimal orientation";
CM_ SG_ 141 STS_SENSOR_HEIGHT "Radar height from ground to center of radar elevation field-of-view";
CM_ SG_ 141 STS_DET_DBC_BASE_VER_MINOR "Detection base dbc Minor version";
CM_ SG_ 141 STS_DET_DBC_BASE_VER_MAJOR "Detection base dbc Major version";
CM_ SG_ 142 STS_TIMESYNC_JITTER "Delay between sync and FUL";
CM_ SG_ 142 STS_TIMESYNC_CORRECTION_TYP "Time adjustment type";
CM_ SG_ 142 STS_POINT_OF_TRIGGER "Delay betwen TymSyc message received and actual trigger";
CM_ SG_ 142 STS_THRESHOLD_FLAG "Set if time difference between SYNC and FLUP Time is greater than threshhold value";
CM_ SG_ 142 STS_BRR_STATUS "Current status of BRR , active/inactive/fault";
CM_ SG_ 142 STS_VEH_CRD_SYS_TYPE "Defines the reference vehicle coordinate system for the interface of a sensor.";
CM_ SG_ 142 STS_NUM_VALID_FOV_RR "The current number of valid field of view reduction reasons";
CM_ SG_ 142 STS_NUM_VALID_FOV_RR_TYPE "Field of view reduction reason ";
CM_ SG_ 142 STS_NUM_VALID_FOV_RR_PROB "Field of view reduction reason probability";
CM_ SG_ 142 STS_BOARD_THERMISTOR "On Board Thermistor Temperature";
CM_ SG_ 142 STS_MMIC0_TEMP_TX1 "Internal MMIC Temperature #1";
CM_ SG_ 142 STS_PROCESSOR_Temp1 "Internal Micro Temperature #1";
CM_ SG_ 142 STS_XCVR_OPERATIONAL "Indication that the transceiver is operational";
CM_ SG_ 142 STS_VEH_SPEED_DIRECTION "Provides indication of vehicle direction of travel";
CM_ SG_ 142 STS_RADIUS_CURVATURE "vehicle turning radius";
CM_ SG_ 142 STS_STEERING_ANGLE_SIGN "Actual steering angle direction, from the centre position of the steering wheel.";
CM_ SG_ 142 STS_STEERING_ANGLE "Actual steering wheel angle. Datum (zero) of the steering wheel position is determined at the time of calibration in the factory.   This is only the magnitude of the steering wheel angle.";
CM_ SG_ 142 STS_YAW_RATE_CALC "yawrate";
CM_ SG_ 142 STS_VEHICLE_SPEED_CALC "Vehicle speed";
CM_ SG_ 142 STS_TIME_SYNC_OFFSET "Current offset from desired Time Sync Sync point";
CM_ SG_ 136 HED_NUM_OF_VALID_DETECTIONS "The current number of valid detections in the detections list";
CM_ SG_ 136 HED_INTRFC_VERSION_ID_MAJOR "Version number for major";
CM_ SG_ 136 HED_INTRFC_VERSION_ID_MINOR "Version number for minor";
CM_ SG_ 136 HED_INTRFC_VERSION_ID_PATCH "Version number for patch";
CM_ SG_ 136 HED_LOOK_ID "Indicates the look type values 1 to 4 base on medium/long look and near/far look. Each radar scan is a look.";
CM_ SG_ 136 HED_CAN_SCAN_INDEX "Scan index";
CM_ SG_ 136 HED_MH_CYCLE_COUNTER "ALIVE counter";
CM_ SG_ 136 HED_DATA_QUALIFIER "Data qualifier communicates the overall availability of the interface or expresses to what extent the content of this event can be relied on ";
CM_ SG_ 136 HED_DET_RANGE_MAX "Detection range max is the farthest possible detection with respect to the sensor origin.";
CM_ SG_ 136 HED_DET_SPEED_RANGE_MAX "Describes the relative radial speed range in the sensor coordinate system. Range is defined by
two range values: negative values indicate lower speed than the ego-vehicle, positive values
indicate higher velocity than ego-vehicle";
CM_ SG_ 136 HED_FOV_HOR_MAX "Field of view defined by opening angles in sensor XY-plane.";
CM_ SG_ 136 HED_FOV_VER_MAX "Field of view defined by opening angles in sensor XZ-plane.";
CM_ SG_ 136 HED_DET_RANGE_MIN "Detection range max is the Closest possible detection with respect to the sensor origin.";
CM_ SG_ 136 HED_DET_SPEED_RANGE_MIN "Describes the relative radial speed range in the sensor coordinate system. Range is defined by
two range values: negative values indicate lower speed than the ego-vehicle, positive values
indicate higher velocity than ego-vehicle";
CM_ SG_ 136 HED_FOV_HOR_MIN "Field of view defined by opening angles in sensor XY-plane.";
CM_ SG_ 136 HED_FOV_VER_MIN "Field of view defined by opening angles in sensor XZ-plane.";
CM_ SG_ 136 HED_ALIGN_VER_ANGLE "Alighnment vertical angle";
CM_ SG_ 136 HED_ALIGN_HOR_ANGLE "Alighnment horizontal angle";
CM_ SG_ 136 HED_ALIGN_HOR_REF "Alignment horizontal reference";
CM_ SG_ 136 HED_ALIGN_HOR_QF "Alignment horizontal calibration status";
CM_ SG_ 136 HED_AF_TIME_PEAK "Angle Finding Latency peak";
CM_ SG_ 136 HED_AF_TIME_INST "Angle Finding Latency instantaneous";
CM_ SG_ 136 HED_SENSOR_TIME_STAMP_NS "sensor absolute time when the radar measurement was taken";
CM_ SG_ 136 HED_MEASUREMENT_LATENCY "Relative time from when the radar measurement was taken until the detection data is sent on CAN";
CM_ SG_ 136 HED_TIME_SYNC_SRC_MASTER "Indicate if sensor is synch to global master or local master";
CM_ SG_ 136 HED_TIME_SYNC_VALIDITY_FLAG "indicates the validity of Time Sync message data";
CM_ SG_ 136 HED_DET_SINGLE_TGT_FFT_HI_AF "Number of detections exectuted case_2_Single_Tgt_FFT_Response_high";
CM_ SG_ 136 HED_DET_ESPRIT_7x7_VALID "Number of detections exectuted  case_6_num_esprit_7x7_valid";
CM_ SG_ 136 HED_DET_ESPRIT_7x7_INVALID "Number of detections exectuted case_7_num_esprit_7x7_invalid";
CM_ SG_ 136 HED_DET_NLS "Number of detections exectuted  case_8_num_NLS";
CM_ SG_ 136 HED_DET_WTO_ESPRIT_FFT "Number of detections exectuted  case_10_without_esprit_elbyACS_FFT";
CM_ SG_ 136 HED_DET_ESPRIT_MTAZ "Number of detections exectuted  case_11_num_esprit_MTAZ";
CM_ SG_ 136 HED_DET_SINGLE_TGT_FFT_MH_AF "Number of detections exectuted case_2_Single_Tgt_FFT_Response_mid_high";
CM_ SG_ 136 HED_DET_PHASE_CMP_FFT_AF "Number of detections exectuted  case_1_phase_comp_without_fft path";
CM_ SG_ 136 HED_TRIGGER_TIME "Data Acquisition start time";
CM_ SG_ 448 OBJ_ALIVE_TIME_001 "Time since object initialization in msec. Tracker internal may have bigger values. On the output interface, we should saturate the signal in that case.";
CM_ SG_ 448 OBJ_ACCELERATION_LONG_ERR_001 "acceleration along Longi  direction";
CM_ SG_ 448 OBJ_ACCELERATION_LAT_ERR_001 "acceleration along Lat direction error";
CM_ SG_ 448 OBJ_POS_LONG_ERR_001 "Lat-position error of object track's centroid in VCS coordinate";
CM_ SG_ 448 OBJ_POS_LAT_ERR_001 "Lat-position error of object track's centroid in VCS coordinate";
CM_ SG_ 448 OBJ_TRACK_MOTION_MODEL_001 "Object tracking uses a motion model for tracking moving items";
CM_ SG_ 448 OBJ_DIMENSION_WIDTH_001 "Lat distance from centroid to edge of bounding box.";
CM_ SG_ 448 OBJ_DIMENSION_LENGTH_001 "Longi distance from centroid to edge of bounding box.";
CM_ SG_ 448 OBJ_EXISTENCE_PROB_001 "Probability that the target is an actual target";
CM_ SG_ 448 OBJ_YAW_ANGLE_001 "Orientation of track's bounding box in VCS coordinate";
CM_ SG_ 448 OBJ_ID_001 "ID of object tracks, zero-ID represents an inactive track";
CM_ SG_ 448 OBJ_MOVEMENT_STATUS_001 "Information about a possible movement of the object during tracking";
CM_ SG_ 448 OBJ_MEASUREMENT_STATUS_001 "Objects should be sent out as fast as possible, even if not all statuses are observed and the object’s
signals might not be fully filled.";
CM_ SG_ 448 OBJ_POS_LONG_001 "Long-position of object track's centroid in VCS coordinate";
CM_ SG_ 448 OBJ_POS_LAT_001 "Lat-position of object track's centroid in VCS coordinate";
CM_ SG_ 448 OBJ_VELOCITY_LONG_001 "Over-the-ground velocity of object track's centroid along Long direction (in VCS coordinate)";
CM_ SG_ 448 OBJ_VELOCITY_LAT_001 "Over-the-ground velocity of object track's centroid along Lat direction (in VCS coordinate)";
CM_ SG_ 448 OBJ_ACCELERATION_LONG_001 "Over-the-ground track acceleration along Longi direction (in VCS coordinate)";
CM_ SG_ 448 OBJ_ACCELERATION_LAT_001 "Over-the-ground track acceleration along Lat direction (in VCS coordinate)";
CM_ SG_ 448 OBJ_VEH_TRACK_FLAG_001 "Indicates if current track is a vehicle";
CM_ SG_ 448 OBJ_TIMESTAMP_OFFSET_001 "A timestamp offset from the object list header timestamp for each object as we have different timestamps from different sensors leading to different timestamps on each object";
CM_ SG_ 448 OBJ_DIMENSION_WIDTH_ERR_001 "Lat distance or length error";
CM_ SG_ 448 OBJ_DIMENSION_LENGTH_ERR_001 "Longi distance or length error";
CM_ SG_ 448 OBJ_CLS_TYPE1_001 "Classification Type 1(Highest Prob), selected from ENUM list";
CM_ SG_ 448 OBJ_CLS_TYPE1_PROB_001 "Classification Type 1 probablity";
CM_ SG_ 448 OBJ_CLS_TYPE6_001 "Classification Type 6(Lowest Prob), selected from ENUM list";
CM_ SG_ 448 OBJ_CLS_TYPE6_PROB_001 "Classification Type 1 probablity";
CM_ SG_ 448 OBJ_RCS_001 "Representative RCS of the complete recognized object, Not implemented";
CM_ SG_ 448 OBJ_REF_PT_LONG_OFFSET_001 "Outer edges of the recognized object’s bounding box in Y axis";
CM_ SG_ 448 OBJ_REF_PT_LAT_OFFSET_001 "Outer edges of the recognized object’s bounding box in X axis";
CM_ SG_ 448 OBJ_YAW_RATE_001 "Orientation rate of track's bounding box in VCS coordinate";
CM_ SG_ 448 OBJ_GROUP_ID_001 "Objects which are linked together shall have same group ID";
CM_ SG_ 448 OBJ_POS_ERR_CRR_COEF_001 "vx-vy correlation due to small error in radial direction and big in cross radial - position Correlation Coefficient Error";
CM_ SG_ 448 OBJ_VELOCITY_ERR_CRR_COEF_001 "vx-vy correlation due to small error in radial direction and big in cross radial - velocity Correlation Coefficient Error";
CM_ SG_ 448 OBJ_ACCEL_ERR_CRR_COEF_001 "vx-vy correlation due to small error in radial direction and big in cross radial - Acceleration Correlation Coefficient Error";
CM_ SG_ 137 HED_TRKR_TIME_PEAK "Time of single tracker peak execution (difference between tracker execution time start and end)'";
CM_ SG_ 137 HED_TRKR_TIME_INST "Time of single tracker instance execution (difference between tracker execution time start and end)";
CM_ SG_ 137 HED_TRKR_VEH_COORD_TYPE "Vehicle Coordination type";
CM_ SG_ 143 STS_OBJ_DBC_BASE_VER_MINOR "Object Tracker Base dbc version Minor";
CM_ SG_ 143 STS_OBJ_DBC_BASE_VER_MAJOR "Object Tracker Base dbc version Major";
CM_ SG_ 385 DET_RANGE_005 " measured position  of the detection";
CM_ SG_ 385 DET_RANGE_ERR_005 "RMSE or standard deviation of the measured angle  of the detection";
CM_ SG_ 385 DET_RANGE_VELOCITY_005 "Radial velocity of the detection positive in direction to the sensor";
CM_ SG_ 385 DET_RANGE_VELOCITY_ERR_005 "RMSE or standard deviation of the measure radial velocity of the detection";
CM_ SG_ 385 DET_AZIMUTH_005 "Measured angle  of the detection";
CM_ SG_ 385 DET_AZIMUTH_ERR_005 "RMSE or standard deviation of the measured angle  of the detection";
CM_ SG_ 385 DET_ELEVATION_005 "measured elevation of the detection";
CM_ SG_ 385 DET_ELEVATION_ERR_005 "RMSE or standard deviation of the measured elevation  of the detection";
CM_ SG_ 385 DET_RCS_005 "Radar Cross Section or Amplitude, is a measure of how detectable an object is by radar. A larger RCS indicates that an object is more easily detected.";
CM_ SG_ 385 DET_VALID_FLAG_005 "is set if the measured detection is valid";
CM_ SG_ 385 DET_BI_STATIC_FLAG_005 "1 if detection is bi-static 0 otherwise";
CM_ SG_ 385 DET_SUPER_RES_TARGET_005 "flasg is set if the detection is super resolution target";
CM_ SG_ 385 DET_SNR_005 "The signal to noise ratio (SNR) of the radar detection";
CM_ SG_ 385 DET_POINT_TARGET_PROB_005 "Describes the possibility if more than one real-world object has led to this detection. 0[%] := 100[%] Multi target probability";
CM_ SG_ 385 DET_EXISTENCE_PROB_005 "Existence probability of the detection not based on history. Value does  not depend on any past experience with similar detections.
\note Use as confidence measure where a low value means less confidence
and a high value indicates strong confidence.";
CM_ SG_ 385 DET_OUTSIDE_SECTOR_005 "Flag to indicate detections outside the sector, set if the wrong sector calibration matrix was used";
CM_ SG_ 385 DET_HVC_FLAG_005 "Core2 Vehicle clutter flag";
CM_ SG_ 385 DET_CONFD_AZIMUTH_005 "Define the Confidence of Azimuth for Detection ";
CM_ SG_ 385 DET_CONFD_ELEVATION_005 "Define the Confidence of Elevation for the Detection ";
CM_ SG_ 385 DET_AZIMUTH_AMB_ID_005 "Each ambiguous measurement generates one Ambiguity ID. Ambiguity is indicated by an identical ambiguity ID.
note Unambiguous measurements have the ambiguity ID 0.";
CM_ SG_ 385 DET_AMBG_AZIMUTH_PROB_005 "Probability for different hypothesis, sum is 100 [%] for all detections with the same Ambiguity ID. 0 means no Ambiguity";
CM_ SG_ 385 DET_BI_STATIC_FLAG_006 "1 if detection is bi-static 0 otherwise";
CM_ SG_ 385 DET_BI_STATIC_FLAG_007 "1 if detection is bi-static 0 otherwise";
CM_ SG_ 385 DET_BI_STATIC_FLAG_008 "1 if detection is bi-static 0 otherwise";
CM_ SG_ 385 DET_MH_SCAN_INDEX_4LSB_005_008 "Scan index of the measured detection";
CM_ SG_ 385 DET_MH_CYCLE_COUNTER_005_008 "Detection Alive Counter";
CM_ SG_ 386 DET_RANGE_009 " measured position  of the detection";
CM_ SG_ 386 DET_RANGE_ERR_009 "RMSE or standard deviation of the measured angle  of the detection";
CM_ SG_ 386 DET_RANGE_VELOCITY_009 "Radial velocity of the detection positive in direction to the sensor";
CM_ SG_ 386 DET_RANGE_VELOCITY_ERR_009 "RMSE or standard deviation of the measure radial velocity of the detection";
CM_ SG_ 386 DET_AZIMUTH_009 "Measured angle  of the detection";
CM_ SG_ 386 DET_AZIMUTH_ERR_009 "RMSE or standard deviation of the measured angle  of the detection";
CM_ SG_ 386 DET_ELEVATION_009 "measured elevation of the detection";
CM_ SG_ 386 DET_ELEVATION_ERR_009 "RMSE or standard deviation of the measured elevation  of the detection";
CM_ SG_ 386 DET_RCS_009 "Radar Cross Section or Amplitude, is a measure of how detectable an object is by radar. A larger RCS indicates that an object is more easily detected.";
CM_ SG_ 386 DET_VALID_FLAG_009 "is set if the measured detection is valid";
CM_ SG_ 386 DET_BI_STATIC_FLAG_009 "1 if detection is bi-static 0 otherwise";
CM_ SG_ 386 DET_SUPER_RES_TARGET_009 "flasg is set if the detection is super resolution target";
CM_ SG_ 386 DET_SNR_009 "The signal to noise ratio (SNR) of the radar detection";
CM_ SG_ 386 DET_POINT_TARGET_PROB_009 "Describes the possibility if more than one real-world object has led to this detection. 0[%] := 100[%] Multi target probability";
CM_ SG_ 386 DET_EXISTENCE_PROB_009 "Existence probability of the detection not based on history. Value does  not depend on any past experience with similar detections.
\note Use as confidence measure where a low value means less confidence
and a high value indicates strong confidence.";
CM_ SG_ 386 DET_OUTSIDE_SECTOR_009 "Flag to indicate detections outside the sector, set if the wrong sector calibration matrix was used";
CM_ SG_ 386 DET_HVC_FLAG_009 "Core2 Vehicle clutter flag";
CM_ SG_ 386 DET_CONFD_AZIMUTH_009 "Define the Confidence of Azimuth for Detection ";
CM_ SG_ 386 DET_CONFD_ELEVATION_009 "Define the Confidence of Elevation for the Detection ";
CM_ SG_ 386 DET_AZIMUTH_AMB_ID_009 "Each ambiguous measurement generates one Ambiguity ID. Ambiguity is indicated by an identical ambiguity ID.
note Unambiguous measurements have the ambiguity ID 0.";
CM_ SG_ 386 DET_AMBG_AZIMUTH_PROB_009 "Probability for different hypothesis, sum is 100 [%] for all detections with the same Ambiguity ID. 0 means no Ambiguity";
CM_ SG_ 386 DET_BI_STATIC_FLAG_010 "1 if detection is bi-static 0 otherwise";
CM_ SG_ 386 DET_BI_STATIC_FLAG_011 "1 if detection is bi-static 0 otherwise";
CM_ SG_ 386 DET_BI_STATIC_FLAG_012 "1 if detection is bi-static 0 otherwise";
CM_ SG_ 386 DET_MH_SCAN_INDEX_4LSB_009_012 "Scan index of the measured detection";
CM_ SG_ 386 DET_MH_CYCLE_COUNTER_009_012 "Detection Alive Counter";
CM_ SG_ 387 DET_RANGE_013 " measured position  of the detection";
CM_ SG_ 387 DET_RANGE_ERR_013 "RMSE or standard deviation of the measured angle  of the detection";
CM_ SG_ 387 DET_RANGE_VELOCITY_013 "Radial velocity of the detection positive in direction to the sensor";
CM_ SG_ 387 DET_RANGE_VELOCITY_ERR_013 "RMSE or standard deviation of the measure radial velocity of the detection";
CM_ SG_ 387 DET_AZIMUTH_013 "Measured angle  of the detection";
CM_ SG_ 387 DET_AZIMUTH_ERR_013 "RMSE or standard deviation of the measured angle  of the detection";
CM_ SG_ 387 DET_ELEVATION_013 "measured elevation of the detection";
CM_ SG_ 387 DET_ELEVATION_ERR_013 "RMSE or standard deviation of the measured elevation  of the detection";
CM_ SG_ 387 DET_RCS_013 "Radar Cross Section or Amplitude, is a measure of how detectable an object is by radar. A larger RCS indicates that an object is more easily detected.";
CM_ SG_ 387 DET_VALID_FLAG_013 "is set if the measured detection is valid";
CM_ SG_ 387 DET_BI_STATIC_FLAG_013 "1 if detection is bi-static 0 otherwise";
CM_ SG_ 387 DET_SUPER_RES_TARGET_013 "flasg is set if the detection is super resolution target";
CM_ SG_ 387 DET_SNR_013 "The signal to noise ratio (SNR) of the radar detection";
CM_ SG_ 387 DET_POINT_TARGET_PROB_013 "Describes the possibility if more than one real-world object has led to this detection. 0[%] := 100[%] Multi target probability";
CM_ SG_ 387 DET_EXISTENCE_PROB_013 "Existence probability of the detection not based on history. Value does  not depend on any past experience with similar detections.
\note Use as confidence measure where a low value means less confidence
and a high value indicates strong confidence.";
CM_ SG_ 387 DET_OUTSIDE_SECTOR_013 "Flag to indicate detections outside the sector, set if the wrong sector calibration matrix was used";
CM_ SG_ 387 DET_HVC_FLAG_013 "Core2 Vehicle clutter flag";
CM_ SG_ 387 DET_CONFD_AZIMUTH_013 "Define the Confidence of Azimuth for Detection ";
CM_ SG_ 387 DET_CONFD_ELEVATION_013 "Define the Confidence of Elevation for the Detection ";
CM_ SG_ 387 DET_AZIMUTH_AMB_ID_013 "Each ambiguous measurement generates one Ambiguity ID. Ambiguity is indicated by an identical ambiguity ID.
note Unambiguous measurements have the ambiguity ID 0.";
CM_ SG_ 387 DET_AMBG_AZIMUTH_PROB_013 "Probability for different hypothesis, sum is 100 [%] for all detections with the same Ambiguity ID. 0 means no Ambiguity";
CM_ SG_ 387 DET_BI_STATIC_FLAG_014 "1 if detection is bi-static 0 otherwise";
CM_ SG_ 387 DET_BI_STATIC_FLAG_015 "1 if detection is bi-static 0 otherwise";
CM_ SG_ 387 DET_BI_STATIC_FLAG_016 "1 if detection is bi-static 0 otherwise";
CM_ SG_ 387 DET_MH_SCAN_INDEX_4LSB_013_016 "Scan index of the measured detection";
CM_ SG_ 387 DET_MH_CYCLE_COUNTER_013_016 "Detection Alive Counter";
CM_ SG_ 388 DET_RANGE_017 " measured position  of the detection";
CM_ SG_ 388 DET_RANGE_ERR_017 "RMSE or standard deviation of the measured angle  of the detection";
CM_ SG_ 388 DET_RANGE_VELOCITY_017 "Radial velocity of the detection positive in direction to the sensor";
CM_ SG_ 388 DET_RANGE_VELOCITY_ERR_017 "RMSE or standard deviation of the measure radial velocity of the detection";
CM_ SG_ 388 DET_AZIMUTH_017 "Measured angle  of the detection";
CM_ SG_ 388 DET_AZIMUTH_ERR_017 "RMSE or standard deviation of the measured angle  of the detection";
CM_ SG_ 388 DET_ELEVATION_017 "measured elevation of the detection";
CM_ SG_ 388 DET_ELEVATION_ERR_017 "RMSE or standard deviation of the measured elevation  of the detection";
CM_ SG_ 388 DET_RCS_017 "Radar Cross Section or Amplitude, is a measure of how detectable an object is by radar. A larger RCS indicates that an object is more easily detected.";
CM_ SG_ 388 DET_VALID_FLAG_017 "is set if the measured detection is valid";
CM_ SG_ 388 DET_BI_STATIC_FLAG_017 "1 if detection is bi-static 0 otherwise";
CM_ SG_ 388 DET_SUPER_RES_TARGET_017 "flasg is set if the detection is super resolution target";
CM_ SG_ 388 DET_SNR_017 "The signal to noise ratio (SNR) of the radar detection";
CM_ SG_ 388 DET_POINT_TARGET_PROB_017 "Describes the possibility if more than one real-world object has led to this detection. 0[%] := 100[%] Multi target probability";
CM_ SG_ 388 DET_EXISTENCE_PROB_017 "Existence probability of the detection not based on history. Value does  not depend on any past experience with similar detections.
\note Use as confidence measure where a low value means less confidence
and a high value indicates strong confidence.";
CM_ SG_ 388 DET_OUTSIDE_SECTOR_017 "Flag to indicate detections outside the sector, set if the wrong sector calibration matrix was used";
CM_ SG_ 388 DET_HVC_FLAG_017 "Core2 Vehicle clutter flag";
CM_ SG_ 388 DET_CONFD_AZIMUTH_017 "Define the Confidence of Azimuth for Detection ";
CM_ SG_ 388 DET_CONFD_ELEVATION_017 "Define the Confidence of Elevation for the Detection ";
CM_ SG_ 388 DET_AZIMUTH_AMB_ID_017 "Each ambiguous measurement generates one Ambiguity ID. Ambiguity is indicated by an identical ambiguity ID.
note Unambiguous measurements have the ambiguity ID 0.";
CM_ SG_ 388 DET_AMBG_AZIMUTH_PROB_017 "Probability for different hypothesis, sum is 100 [%] for all detections with the same Ambiguity ID. 0 means no Ambiguity";
CM_ SG_ 388 DET_BI_STATIC_FLAG_018 "1 if detection is bi-static 0 otherwise";
CM_ SG_ 388 DET_BI_STATIC_FLAG_019 "1 if detection is bi-static 0 otherwise";
CM_ SG_ 388 DET_BI_STATIC_FLAG_020 "1 if detection is bi-static 0 otherwise";
CM_ SG_ 388 DET_MH_SCAN_INDEX_4LSB_017_020 "Scan index of the measured detection";
CM_ SG_ 388 DET_MH_CYCLE_COUNTER_017_020 "Detection Alive Counter";
CM_ SG_ 389 DET_RANGE_021 " measured position  of the detection";
CM_ SG_ 389 DET_RANGE_ERR_021 "RMSE or standard deviation of the measured angle  of the detection";
CM_ SG_ 389 DET_RANGE_VELOCITY_021 "Radial velocity of the detection positive in direction to the sensor";
CM_ SG_ 389 DET_RANGE_VELOCITY_ERR_021 "RMSE or standard deviation of the measure radial velocity of the detection";
CM_ SG_ 389 DET_AZIMUTH_021 "Measured angle  of the detection";
CM_ SG_ 389 DET_AZIMUTH_ERR_021 "RMSE or standard deviation of the measured angle  of the detection";
CM_ SG_ 389 DET_ELEVATION_021 "measured elevation of the detection";
CM_ SG_ 389 DET_ELEVATION_ERR_021 "RMSE or standard deviation of the measured elevation  of the detection";
CM_ SG_ 389 DET_RCS_021 "Radar Cross Section or Amplitude, is a measure of how detectable an object is by radar. A larger RCS indicates that an object is more easily detected.";
CM_ SG_ 389 DET_VALID_FLAG_021 "is set if the measured detection is valid";
CM_ SG_ 389 DET_BI_STATIC_FLAG_021 "1 if detection is bi-static 0 otherwise";
CM_ SG_ 389 DET_SUPER_RES_TARGET_021 "flasg is set if the detection is super resolution target";
CM_ SG_ 389 DET_SNR_021 "The signal to noise ratio (SNR) of the radar detection";
CM_ SG_ 389 DET_POINT_TARGET_PROB_021 "Describes the possibility if more than one real-world object has led to this detection. 0[%] := 100[%] Multi target probability";
CM_ SG_ 389 DET_EXISTENCE_PROB_021 "Existence probability of the detection not based on history. Value does  not depend on any past experience with similar detections.
\note Use as confidence measure where a low value means less confidence
and a high value indicates strong confidence.";
CM_ SG_ 389 DET_OUTSIDE_SECTOR_021 "Flag to indicate detections outside the sector, set if the wrong sector calibration matrix was used";
CM_ SG_ 389 DET_HVC_FLAG_021 "Core2 Vehicle clutter flag";
CM_ SG_ 389 DET_CONFD_AZIMUTH_021 "Define the Confidence of Azimuth for Detection ";
CM_ SG_ 389 DET_CONFD_ELEVATION_021 "Define the Confidence of Elevation for the Detection ";
CM_ SG_ 389 DET_AZIMUTH_AMB_ID_021 "Each ambiguous measurement generates one Ambiguity ID. Ambiguity is indicated by an identical ambiguity ID.
note Unambiguous measurements have the ambiguity ID 0.";
CM_ SG_ 389 DET_AMBG_AZIMUTH_PROB_021 "Probability for different hypothesis, sum is 100 [%] for all detections with the same Ambiguity ID. 0 means no Ambiguity";
CM_ SG_ 389 DET_BI_STATIC_FLAG_022 "1 if detection is bi-static 0 otherwise";
CM_ SG_ 389 DET_BI_STATIC_FLAG_023 "1 if detection is bi-static 0 otherwise";
CM_ SG_ 389 DET_BI_STATIC_FLAG_024 "1 if detection is bi-static 0 otherwise";
CM_ SG_ 389 DET_MH_SCAN_INDEX_4LSB_021_024 "Scan index of the measured detection";
CM_ SG_ 389 DET_MH_CYCLE_COUNTER_021_024 "Detection Alive Counter";
CM_ SG_ 390 DET_RANGE_025 " measured position  of the detection";
CM_ SG_ 390 DET_RANGE_ERR_025 "RMSE or standard deviation of the measured angle  of the detection";
CM_ SG_ 390 DET_RANGE_VELOCITY_025 "Radial velocity of the detection positive in direction to the sensor";
CM_ SG_ 390 DET_RANGE_VELOCITY_ERR_025 "RMSE or standard deviation of the measure radial velocity of the detection";
CM_ SG_ 390 DET_AZIMUTH_025 "Measured angle  of the detection";
CM_ SG_ 390 DET_AZIMUTH_ERR_025 "RMSE or standard deviation of the measured angle  of the detection";
CM_ SG_ 390 DET_ELEVATION_025 "measured elevation of the detection";
CM_ SG_ 390 DET_ELEVATION_ERR_025 "RMSE or standard deviation of the measured elevation  of the detection";
CM_ SG_ 390 DET_RCS_025 "Radar Cross Section or Amplitude, is a measure of how detectable an object is by radar. A larger RCS indicates that an object is more easily detected.";
CM_ SG_ 390 DET_VALID_FLAG_025 "is set if the measured detection is valid";
CM_ SG_ 390 DET_BI_STATIC_FLAG_025 "1 if detection is bi-static 0 otherwise";
CM_ SG_ 390 DET_SUPER_RES_TARGET_025 "flasg is set if the detection is super resolution target";
CM_ SG_ 390 DET_SNR_025 "The signal to noise ratio (SNR) of the radar detection";
CM_ SG_ 390 DET_POINT_TARGET_PROB_025 "Describes the possibility if more than one real-world object has led to this detection. 0[%] := 100[%] Multi target probability";
CM_ SG_ 390 DET_EXISTENCE_PROB_025 "Existence probability of the detection not based on history. Value does  not depend on any past experience with similar detections.
\note Use as confidence measure where a low value means less confidence
and a high value indicates strong confidence.";
CM_ SG_ 390 DET_OUTSIDE_SECTOR_025 "Flag to indicate detections outside the sector, set if the wrong sector calibration matrix was used";
CM_ SG_ 390 DET_HVC_FLAG_025 "Core2 Vehicle clutter flag";
CM_ SG_ 390 DET_CONFD_AZIMUTH_025 "Define the Confidence of Azimuth for Detection ";
CM_ SG_ 390 DET_CONFD_ELEVATION_025 "Define the Confidence of Elevation for the Detection ";
CM_ SG_ 390 DET_AZIMUTH_AMB_ID_025 "Each ambiguous measurement generates one Ambiguity ID. Ambiguity is indicated by an identical ambiguity ID.
note Unambiguous measurements have the ambiguity ID 0.";
CM_ SG_ 390 DET_AMBG_AZIMUTH_PROB_025 "Probability for different hypothesis, sum is 100 [%] for all detections with the same Ambiguity ID. 0 means no Ambiguity";
CM_ SG_ 390 DET_BI_STATIC_FLAG_026 "1 if detection is bi-static 0 otherwise";
CM_ SG_ 390 DET_BI_STATIC_FLAG_027 "1 if detection is bi-static 0 otherwise";
CM_ SG_ 390 DET_BI_STATIC_FLAG_028 "1 if detection is bi-static 0 otherwise";
CM_ SG_ 390 DET_MH_SCAN_INDEX_4LSB_025_028 "Scan index of the measured detection";
CM_ SG_ 390 DET_MH_CYCLE_COUNTER_025_028 "Detection Alive Counter";
CM_ SG_ 391 DET_RANGE_029 " measured position  of the detection";
CM_ SG_ 391 DET_RANGE_ERR_029 "RMSE or standard deviation of the measured angle  of the detection";
CM_ SG_ 391 DET_RANGE_VELOCITY_029 "Radial velocity of the detection positive in direction to the sensor";
CM_ SG_ 391 DET_RANGE_VELOCITY_ERR_029 "RMSE or standard deviation of the measure radial velocity of the detection";
CM_ SG_ 391 DET_AZIMUTH_029 "Measured angle  of the detection";
CM_ SG_ 391 DET_AZIMUTH_ERR_029 "RMSE or standard deviation of the measured angle  of the detection";
CM_ SG_ 391 DET_ELEVATION_029 "measured elevation of the detection";
CM_ SG_ 391 DET_ELEVATION_ERR_029 "RMSE or standard deviation of the measured elevation  of the detection";
CM_ SG_ 391 DET_RCS_029 "Radar Cross Section or Amplitude, is a measure of how detectable an object is by radar. A larger RCS indicates that an object is more easily detected.";
CM_ SG_ 391 DET_VALID_FLAG_029 "is set if the measured detection is valid";
CM_ SG_ 391 DET_BI_STATIC_FLAG_029 "1 if detection is bi-static 0 otherwise";
CM_ SG_ 391 DET_SUPER_RES_TARGET_029 "flasg is set if the detection is super resolution target";
CM_ SG_ 391 DET_SNR_029 "The signal to noise ratio (SNR) of the radar detection";
CM_ SG_ 391 DET_POINT_TARGET_PROB_029 "Describes the possibility if more than one real-world object has led to this detection. 0[%] := 100[%] Multi target probability";
CM_ SG_ 391 DET_EXISTENCE_PROB_029 "Existence probability of the detection not based on history. Value does  not depend on any past experience with similar detections.
\note Use as confidence measure where a low value means less confidence
and a high value indicates strong confidence.";
CM_ SG_ 391 DET_OUTSIDE_SECTOR_029 "Flag to indicate detections outside the sector, set if the wrong sector calibration matrix was used";
CM_ SG_ 391 DET_HVC_FLAG_029 "Core2 Vehicle clutter flag";
CM_ SG_ 391 DET_CONFD_AZIMUTH_029 "Define the Confidence of Azimuth for Detection ";
CM_ SG_ 391 DET_CONFD_ELEVATION_029 "Define the Confidence of Elevation for the Detection ";
CM_ SG_ 391 DET_AZIMUTH_AMB_ID_029 "Each ambiguous measurement generates one Ambiguity ID. Ambiguity is indicated by an identical ambiguity ID.
note Unambiguous measurements have the ambiguity ID 0.";
CM_ SG_ 391 DET_AMBG_AZIMUTH_PROB_029 "Probability for different hypothesis, sum is 100 [%] for all detections with the same Ambiguity ID. 0 means no Ambiguity";
CM_ SG_ 391 DET_BI_STATIC_FLAG_030 "1 if detection is bi-static 0 otherwise";
CM_ SG_ 391 DET_BI_STATIC_FLAG_031 "1 if detection is bi-static 0 otherwise";
CM_ SG_ 391 DET_BI_STATIC_FLAG_032 "1 if detection is bi-static 0 otherwise";
CM_ SG_ 391 DET_MH_SCAN_INDEX_4LSB_029_032 "Scan index of the measured detection";
CM_ SG_ 391 DET_MH_CYCLE_COUNTER_029_032 "Detection Alive Counter";
CM_ SG_ 392 DET_RANGE_033 " measured position  of the detection";
CM_ SG_ 392 DET_RANGE_ERR_033 "RMSE or standard deviation of the measured angle  of the detection";
CM_ SG_ 392 DET_RANGE_VELOCITY_033 "Radial velocity of the detection positive in direction to the sensor";
CM_ SG_ 392 DET_RANGE_VELOCITY_ERR_033 "RMSE or standard deviation of the measure radial velocity of the detection";
CM_ SG_ 392 DET_AZIMUTH_033 "Measured angle  of the detection";
CM_ SG_ 392 DET_AZIMUTH_ERR_033 "RMSE or standard deviation of the measured angle  of the detection";
CM_ SG_ 392 DET_ELEVATION_033 "measured elevation of the detection";
CM_ SG_ 392 DET_ELEVATION_ERR_033 "RMSE or standard deviation of the measured elevation  of the detection";
CM_ SG_ 392 DET_RCS_033 "Radar Cross Section or Amplitude, is a measure of how detectable an object is by radar. A larger RCS indicates that an object is more easily detected.";
CM_ SG_ 392 DET_VALID_FLAG_033 "is set if the measured detection is valid";
CM_ SG_ 392 DET_BI_STATIC_FLAG_033 "1 if detection is bi-static 0 otherwise";
CM_ SG_ 392 DET_SUPER_RES_TARGET_033 "flasg is set if the detection is super resolution target";
CM_ SG_ 392 DET_SNR_033 "The signal to noise ratio (SNR) of the radar detection";
CM_ SG_ 392 DET_POINT_TARGET_PROB_033 "Describes the possibility if more than one real-world object has led to this detection. 0[%] := 100[%] Multi target probability";
CM_ SG_ 392 DET_EXISTENCE_PROB_033 "Existence probability of the detection not based on history. Value does  not depend on any past experience with similar detections.
\note Use as confidence measure where a low value means less confidence
and a high value indicates strong confidence.";
CM_ SG_ 392 DET_OUTSIDE_SECTOR_033 "Flag to indicate detections outside the sector, set if the wrong sector calibration matrix was used";
CM_ SG_ 392 DET_HVC_FLAG_033 "Core2 Vehicle clutter flag";
CM_ SG_ 392 DET_CONFD_AZIMUTH_033 "Define the Confidence of Azimuth for Detection ";
CM_ SG_ 392 DET_CONFD_ELEVATION_033 "Define the Confidence of Elevation for the Detection ";
CM_ SG_ 392 DET_AZIMUTH_AMB_ID_033 "Each ambiguous measurement generates one Ambiguity ID. Ambiguity is indicated by an identical ambiguity ID.
note Unambiguous measurements have the ambiguity ID 0.";
CM_ SG_ 392 DET_AMBG_AZIMUTH_PROB_033 "Probability for different hypothesis, sum is 100 [%] for all detections with the same Ambiguity ID. 0 means no Ambiguity";
CM_ SG_ 392 DET_BI_STATIC_FLAG_034 "1 if detection is bi-static 0 otherwise";
CM_ SG_ 392 DET_BI_STATIC_FLAG_035 "1 if detection is bi-static 0 otherwise";
CM_ SG_ 392 DET_BI_STATIC_FLAG_036 "1 if detection is bi-static 0 otherwise";
CM_ SG_ 392 DET_MH_SCAN_INDEX_4LSB_033_036 "Scan index of the measured detection";
CM_ SG_ 392 DET_MH_CYCLE_COUNTER_033_036 "Detection Alive Counter";

BA_DEF_ BO_ "CanTpBs" INT 0 255;
BA_DEF_ BO_ "EventRateOfChange" INT 10 10000;
BA_DEF_ BO_ "GenMsgCycleTime" INT 0 100000;
BA_DEF_ BO_ "GenMsgILSupport" ENUM  "No","Yes";
BA_DEF_ BO_ "GenMsgNrOfRepetition" INT 0 100;
BA_DEF_ BO_ "GenMsgSendType" ENUM  "FixedPeriodic","Event","EnabledPeriodic","NotUsed","NotUsed","EventPeriodic","NotUsed","NotUsed","NoMsgSendType";
BA_DEF_ BO_ "NetworkInitialization" ENUM  "No","Yes";
BA_DEF_ BO_ "VFrameFormat" ENUM  "StandardCAN","ExtendedCAN","reserved","reserved","reserved","reserved","reserved","reserved","reserved","reserved","reserved","reserved","reserved","reserved","StandardCAN_FD","ExtendedCAN_FD";
BA_DEF_ SG_ "GenSigCmt" STRING;
BA_DEF_ SG_ "GenSigCycleTime" INT 0 0;
BA_DEF_ SG_ "GenSigSendType" ENUM  "Cyclic","OnWrite","vector_leerstring","OnChange","vector_leerstring","IfActive","vector_leerstring","NoSigSendType";
BA_DEF_ SG_ "GenSigStartValue" INT 0 1000000000;
BA_DEF_ SG_ "GenSigTimeoutTime" INT 0 0;
BA_DEF_ SG_ "GenSigVtEn" STRING;
BA_DEF_ SG_ "GenSigVtName" STRING;
BA_DEF_ BU_ "NmAsrNodeIdentifier" HEX 128 255;
BA_DEF_ BU_ "NmStationAddress" HEX 0 0;
BA_DEF_ BU_ "NodeLayerModules" STRING;
BA_DEF_ BU_ "NodeStartUpTime" INT 0 10000;
BA_DEF_ BU_ "NodeWakeUpTime" INT 0 10000;
BA_DEF_ BU_ "PowerType" ENUM  "Switched","Latched","Sleep","vector_leerstring","vector_leerstring";
BA_DEF_ BU_ "TpOwnSystemEcuNumber" HEX 0 255;
BA_DEF_  "BusType" STRING;
BA_DEF_  "DBName" STRING;
BA_DEF_  "GenAuthor" STRING;
BA_DEF_  "GenCompany" STRING;
BA_DEF_  "GenDescription" STRING;
BA_DEF_  "GenNetworkBaudrate" STRING;
BA_DEF_  "GenNetworkMuxEn" STRING;
BA_DEF_  "GenNetworkName" STRING;
BA_DEF_  "GenRevision" STRING;
BA_DEF_  "GenRevisionDate" STRING;
BA_DEF_  "Manufacturer" STRING;
BA_DEF_  "NetworkSpeed" ENUM  "500kBits/s","125kBit/s","2MBits/s";
BA_DEF_  "NmAsrBaseAddress" HEX 1408 1408;
BA_DEF_  "NmAsrMessageCount" INT 64 128;
BA_DEF_  "NmBaseAddress" HEX 1280 1280;
BA_DEF_  "NmMessageCount" INT 0 128;
BA_DEF_  "NmType" STRING;
BA_DEF_  "VersionDay" INT 1 31;
BA_DEF_  "VersionMonth" INT 1 12;
BA_DEF_  "VersionYear" INT 2000 3000;
BA_DEF_DEF_ "BusType" "CAN";
BA_DEF_DEF_ "CanTpBs" 255;
BA_DEF_DEF_ "DBName" "";
BA_DEF_DEF_ "EventRateOfChange" 10000;
BA_DEF_DEF_ "GenAuthor" "xx";
BA_DEF_DEF_ "GenCompany" "APTIV";
BA_DEF_DEF_ "GenDescription" "CAN bus that communicates the radars";
BA_DEF_DEF_ "GenMsgCycleTime" 0;
BA_DEF_DEF_ "GenMsgILSupport" "Yes";
BA_DEF_DEF_ "GenMsgNrOfRepetition" 0;
BA_DEF_DEF_ "GenMsgSendType" "NoMsgSendType";
BA_DEF_DEF_ "GenNetworkBaudrate" "500 kbps";
BA_DEF_DEF_ "GenNetworkMuxEn" "FALSE";
BA_DEF_DEF_ "GenNetworkName" "PCAN";
BA_DEF_DEF_ "GenRevision" "v1.00";
BA_DEF_DEF_ "GenRevisionDate" "March 30, 2021";
BA_DEF_DEF_ "GenSigCmt" "";
BA_DEF_DEF_ "GenSigCycleTime" 0;
BA_DEF_DEF_ "GenSigSendType" "NoSigSendType";
BA_DEF_DEF_ "GenSigStartValue" 0;
BA_DEF_DEF_ "GenSigTimeoutTime" 0;
BA_DEF_DEF_ "GenSigVtEn" "";
BA_DEF_DEF_ "GenSigVtName" "";
BA_DEF_DEF_ "Manufacturer" "Ford";
BA_DEF_DEF_ "NetworkInitialization" "Yes";
BA_DEF_DEF_ "NetworkSpeed" "2MBits/s";
BA_DEF_DEF_ "NmAsrBaseAddress" 1408;
BA_DEF_DEF_ "NmAsrMessageCount" 64;
BA_DEF_DEF_ "NmAsrNodeIdentifier" 128;
BA_DEF_DEF_ "NmBaseAddress" 1280;
BA_DEF_DEF_ "NmMessageCount" 128;
BA_DEF_DEF_ "NmStationAddress" 0;
BA_DEF_DEF_ "NmType" "NmAsr";
BA_DEF_DEF_ "NodeLayerModules" "CANoeILNLFord.dll";
BA_DEF_DEF_ "NodeStartUpTime" 250;
BA_DEF_DEF_ "NodeWakeUpTime" 10;
BA_DEF_DEF_ "PowerType" "Switched";
BA_DEF_DEF_ "TpOwnSystemEcuNumber" 0;
BA_DEF_DEF_ "VFrameFormat" "StandardCAN_FD";
BA_DEF_DEF_ "VersionDay" 2;
BA_DEF_DEF_ "VersionMonth" 1;
BA_DEF_DEF_ "VersionYear" 2021;

BA_ "BusType"   "CAN FD";
BA_ "DBName"   "PCAN_RADAR";
BA_ "GenCompany"   "Aptiv";
BA_ "GenNetworkBaudrate"   "500000";
BA_ "GenRevision"   "V01.07";
BA_ "Manufacturer"   "";
BA_ "VersionDay"   30;
BA_ "VersionMonth"   3;

BA_ "GenMsgSendType" BO_ 384 1;
BA_ "GenMsgSendType" BO_ 27 1;
BA_ "GenMsgSendType" BO_ 28 1;
BA_ "GenMsgCycleTime" BO_ 1 1000;
BA_ "GenMsgSendType" BO_ 1 0;
BA_ "GenMsgCycleTime" BO_ 2 25;
BA_ "GenMsgSendType" BO_ 2 0;
BA_ "GenMsgCycleTime" BO_ 141 1000;
BA_ "GenMsgSendType" BO_ 141 0;
BA_ "GenMsgCycleTime" BO_ 142 50;
BA_ "GenMsgSendType" BO_ 142 0;
BA_ "GenMsgCycleTime" BO_ 139 100;
BA_ "GenMsgSendType" BO_ 139 0;
BA_ "GenMsgSendType" BO_ 136 1;
BA_ "GenMsgSendType" BO_ 15 1;
BA_ "GenMsgSendType" BO_ 24 1;
BA_ "GenMsgSendType" BO_ 25 1;
BA_ "GenMsgSendType" BO_ 26 1;
BA_ "GenMsgSendType" BO_ 448 1;
BA_ "GenMsgSendType" BO_ 137 1;
BA_ "GenMsgCycleTime" BO_ 143 1000;
BA_ "GenMsgSendType" BO_ 143 0;
BA_ "GenMsgSendType" BO_ 385 1;
BA_ "GenMsgSendType" BO_ 386 1;
BA_ "GenMsgSendType" BO_ 387 1;
BA_ "GenMsgSendType" BO_ 388 1;
BA_ "GenMsgSendType" BO_ 389 1;
BA_ "GenMsgSendType" BO_ 390 1;
BA_ "GenMsgSendType" BO_ 391 1;
BA_ "GenMsgSendType" BO_ 392 1;

BA_ "GenSigStartValue" SG_ 384 DET_RANGE_VELOCITY_001 16384;
BA_ "GenSigStartValue" SG_ 384 DET_RCS_001 128;
BA_ "GenSigStartValue" SG_ 384 DET_RANGE_VELOCITY_002 16384;
BA_ "GenSigStartValue" SG_ 384 DET_RCS_002 128;
BA_ "GenSigStartValue" SG_ 384 DET_RANGE_VELOCITY_003 16384;
BA_ "GenSigStartValue" SG_ 384 DET_RCS_003 128;
BA_ "GenSigStartValue" SG_ 384 DET_RANGE_VELOCITY_004 16384;
BA_ "GenSigStartValue" SG_ 384 DET_RCS_004 128;
BA_ "GenSigCmt" SG_ 2 SSTS_YAW_RATE_CALC_QF "Quality factor of the CAN_YAW_RATE_CALC signal";
BA_ "GenSigVtEn" SG_ 2 SSTS_YAW_RATE_CALC_QF "TRUE";
BA_ "GenSigVtName" SG_ 2 SSTS_YAW_RATE_CALC_QF "VtSig_CAN_YAW_RATE_CALC_QF";
BA_ "GenSigCmt" SG_ 2 SSTS_YAW_RATE_BIAS "Yaw rate bias";
BA_ "GenSigCmt" SG_ 2 SSTS_YAW_RATE_CALC "Contains the bias-compensated yaw rate";
BA_ "GenSigStartValue" SG_ 2 SSTS_YAW_RATE_CALC 448;
BA_ "GenSigCmt" SG_ 2 SSTS_VEH_SPD_COMP_FACTOR "Compensated vehicle speed factor";
BA_ "GenSigCmt" SG_ 2 SSTS_VEHICLE_SPEED_CALC_QF "Quality factor of the CAN_VEHICLE_SPEED_CALC";
BA_ "GenSigVtEn" SG_ 2 SSTS_VEHICLE_SPEED_CALC_QF "TRUE";
BA_ "GenSigVtName" SG_ 2 SSTS_VEHICLE_SPEED_CALC_QF "VtSig_CAN_VEHICLE_SPEED_CALC_QF";
BA_ "GenSigCmt" SG_ 2 SSTS_VEHICLE_SPEED_CALC "Contains the compensated vehicle speed used within the FCR";
BA_ "GenSigCmt" SG_ 2 SSTS_GEAR_POSITION "Gear Position";
BA_ "GenSigVtEn" SG_ 2 SSTS_GEAR_POSITION "TRUE";
BA_ "GenSigVtName" SG_ 2 SSTS_GEAR_POSITION "VtSig_CAN_GEAR_POSITION";
BA_ "GenSigCycleTime" SG_ 141 STS_PCAN_PROTOCOL_VER_MINOR 50;
BA_ "GenSigSendType" SG_ 141 STS_PCAN_PROTOCOL_VER_MINOR 0;
BA_ "GenSigTimeoutTime" SG_ 141 STS_PCAN_PROTOCOL_VER_MINOR 150;
BA_ "GenSigCycleTime" SG_ 141 STS_PCAN_PROTOCOL_VER_MAJOR 50;
BA_ "GenSigSendType" SG_ 141 STS_PCAN_PROTOCOL_VER_MAJOR 0;
BA_ "GenSigTimeoutTime" SG_ 141 STS_PCAN_PROTOCOL_VER_MAJOR 150;
BA_ "GenSigCycleTime" SG_ 141 STS_SERIAL_NUMBER_SEQUENCE 50;
BA_ "GenSigSendType" SG_ 141 STS_SERIAL_NUMBER_SEQUENCE 0;
BA_ "GenSigTimeoutTime" SG_ 141 STS_SERIAL_NUMBER_SEQUENCE 150;
BA_ "GenSigCycleTime" SG_ 141 STS_SERIAL_NUM_JULIAN_YEAR 50;
BA_ "GenSigSendType" SG_ 141 STS_SERIAL_NUM_JULIAN_YEAR 0;
BA_ "GenSigTimeoutTime" SG_ 141 STS_SERIAL_NUM_JULIAN_YEAR 150;
BA_ "GenSigCycleTime" SG_ 141 STS_SERIAL_NUM_JULIAN_DAY 50;
BA_ "GenSigSendType" SG_ 141 STS_SERIAL_NUM_JULIAN_DAY 0;
BA_ "GenSigTimeoutTime" SG_ 141 STS_SERIAL_NUM_JULIAN_DAY 150;
BA_ "GenSigStartValue" SG_ 141 STS_SENSOR_MOUNT_ORNT_YAW 3927;
BA_ "GenSigStartValue" SG_ 141 STS_SENSOR_MOUNT_ORNT_PITCH 3927;
BA_ "GenSigStartValue" SG_ 141 STS_SENSOR_MOUNT_ORNT_ROLL 3927;
BA_ "GenSigCycleTime" SG_ 142 STS_VEH_SPD_COMP_FACTOR 50;
BA_ "GenSigSendType" SG_ 142 STS_VEH_SPD_COMP_FACTOR 0;
BA_ "GenSigTimeoutTime" SG_ 142 STS_VEH_SPD_COMP_FACTOR 150;
BA_ "GenSigCycleTime" SG_ 142 STS_USC_LOAD_ERROR 50;
BA_ "GenSigSendType" SG_ 142 STS_USC_LOAD_ERROR 0;
BA_ "GenSigTimeoutTime" SG_ 142 STS_USC_LOAD_ERROR 150;
BA_ "GenSigCycleTime" SG_ 142 STS_SMC_LOAD_ERROR 50;
BA_ "GenSigSendType" SG_ 142 STS_SMC_LOAD_ERROR 0;
BA_ "GenSigTimeoutTime" SG_ 142 STS_SMC_LOAD_ERROR 150;
BA_ "GenSigCycleTime" SG_ 142 STS_UNIT_CL_BLK_CKSM_ERR 50;
BA_ "GenSigSendType" SG_ 142 STS_UNIT_CL_BLK_CKSM_ERR 0;
BA_ "GenSigTimeoutTime" SG_ 142 STS_UNIT_CL_BLK_CKSM_ERR 150;
BA_ "GenSigCycleTime" SG_ 142 STS_UNIT_CAL_CHKSM_ERROR 50;
BA_ "GenSigSendType" SG_ 142 STS_UNIT_CAL_CHKSM_ERROR 0;
BA_ "GenSigTimeoutTime" SG_ 142 STS_UNIT_CAL_CHKSM_ERROR 150;
BA_ "GenSigCycleTime" SG_ 142 STS_VER_MISALIGNMENT_ERR 50;
BA_ "GenSigSendType" SG_ 142 STS_VER_MISALIGNMENT_ERR 0;
BA_ "GenSigTimeoutTime" SG_ 142 STS_VER_MISALIGNMENT_ERR 150;
BA_ "GenSigCycleTime" SG_ 142 STS_LINEARIZER_SPI_TX_ERR 50;
BA_ "GenSigSendType" SG_ 142 STS_LINEARIZER_SPI_TX_ERR 0;
BA_ "GenSigTimeoutTime" SG_ 142 STS_LINEARIZER_SPI_TX_ERR 150;
BA_ "GenSigCycleTime" SG_ 142 STS_ADC_SPI_TRANSFER_ERROR 50;
BA_ "GenSigSendType" SG_ 142 STS_ADC_SPI_TRANSFER_ERROR 0;
BA_ "GenSigTimeoutTime" SG_ 142 STS_ADC_SPI_TRANSFER_ERROR 150;
BA_ "GenSigCycleTime" SG_ 142 STS_TRANSMITTER_ID_ERROR 50;
BA_ "GenSigSendType" SG_ 142 STS_TRANSMITTER_ID_ERROR 0;
BA_ "GenSigTimeoutTime" SG_ 142 STS_TRANSMITTER_ID_ERROR 150;
BA_ "GenSigCycleTime" SG_ 142 STS_SATURATED_TUNING_FREQ_ERR 50;
BA_ "GenSigSendType" SG_ 142 STS_SATURATED_TUNING_FREQ_ERR 0;
BA_ "GenSigTimeoutTime" SG_ 142 STS_SATURATED_TUNING_FREQ_ERR 150;
BA_ "GenSigCycleTime" SG_ 142 STS_RADAR_DATA_SYNC_ERROR 50;
BA_ "GenSigSendType" SG_ 142 STS_RADAR_DATA_SYNC_ERROR 0;
BA_ "GenSigTimeoutTime" SG_ 142 STS_RADAR_DATA_SYNC_ERROR 150;
BA_ "GenSigCycleTime" SG_ 142 STS_RADAR_LO_PWR_ERROR 50;
BA_ "GenSigSendType" SG_ 142 STS_RADAR_LO_PWR_ERROR 0;
BA_ "GenSigTimeoutTime" SG_ 142 STS_RADAR_LO_PWR_ERROR 150;
BA_ "GenSigCycleTime" SG_ 142 STS_RADAR_TX_POWER_ERROR 50;
BA_ "GenSigSendType" SG_ 142 STS_RADAR_TX_POWER_ERROR 0;
BA_ "GenSigTimeoutTime" SG_ 142 STS_RADAR_TX_POWER_ERROR 150;
BA_ "GenSigCycleTime" SG_ 142 STS_TIMER_CREATE_ERROR 50;
BA_ "GenSigSendType" SG_ 142 STS_TIMER_CREATE_ERROR 0;
BA_ "GenSigTimeoutTime" SG_ 142 STS_TIMER_CREATE_ERROR 150;
BA_ "GenSigCycleTime" SG_ 142 STS_CALIBRATION_ERROR 50;
BA_ "GenSigSendType" SG_ 142 STS_CALIBRATION_ERROR 0;
BA_ "GenSigTimeoutTime" SG_ 142 STS_CALIBRATION_ERROR 150;
BA_ "GenSigCycleTime" SG_ 142 STS_SPI_FEE_ERROR 50;
BA_ "GenSigSendType" SG_ 142 STS_SPI_FEE_ERROR 0;
BA_ "GenSigTimeoutTime" SG_ 142 STS_SPI_FEE_ERROR 150;
BA_ "GenSigCycleTime" SG_ 142 STS_SPI_COOMM_ERROR 50;
BA_ "GenSigSendType" SG_ 142 STS_SPI_COOMM_ERROR 0;
BA_ "GenSigTimeoutTime" SG_ 142 STS_SPI_COOMM_ERROR 150;
BA_ "GenSigCycleTime" SG_ 142 STS_HOR_MISALIGNMENT_ERR 50;
BA_ "GenSigSendType" SG_ 142 STS_HOR_MISALIGNMENT_ERR 0;
BA_ "GenSigTimeoutTime" SG_ 142 STS_HOR_MISALIGNMENT_ERR 150;
BA_ "GenSigCycleTime" SG_ 142 STS_SIGNAL_WAIT_ERROR 50;
BA_ "GenSigSendType" SG_ 142 STS_SIGNAL_WAIT_ERROR 0;
BA_ "GenSigTimeoutTime" SG_ 142 STS_SIGNAL_WAIT_ERROR 150;
BA_ "GenSigCycleTime" SG_ 142 STS_SIGNAL_SEND_ERROR 50;
BA_ "GenSigSendType" SG_ 142 STS_SIGNAL_SEND_ERROR 0;
BA_ "GenSigTimeoutTime" SG_ 142 STS_SIGNAL_SEND_ERROR 150;
BA_ "GenSigCycleTime" SG_ 142 STS_SIGNAL_CREATE_ERROR 50;
BA_ "GenSigSendType" SG_ 142 STS_SIGNAL_CREATE_ERROR 0;
BA_ "GenSigTimeoutTime" SG_ 142 STS_SIGNAL_CREATE_ERROR 150;
BA_ "GenSigCycleTime" SG_ 142 STS_SHARED_MEM_WRITE_ERROR 50;
BA_ "GenSigSendType" SG_ 142 STS_SHARED_MEM_WRITE_ERROR 0;
BA_ "GenSigTimeoutTime" SG_ 142 STS_SHARED_MEM_WRITE_ERROR 150;
BA_ "GenSigCycleTime" SG_ 142 STS_SHARED_MEM_READ_ERROR 50;
BA_ "GenSigSendType" SG_ 142 STS_SHARED_MEM_READ_ERROR 0;
BA_ "GenSigTimeoutTime" SG_ 142 STS_SHARED_MEM_READ_ERROR 150;
BA_ "GenSigCycleTime" SG_ 142 STS_SHARED_MEM_CONFIG_ERROR 50;
BA_ "GenSigSendType" SG_ 142 STS_SHARED_MEM_CONFIG_ERROR 0;
BA_ "GenSigTimeoutTime" SG_ 142 STS_SHARED_MEM_CONFIG_ERROR 150;
BA_ "GenSigCycleTime" SG_ 142 STS_SHARE_MEM_INIT_ERROR 50;
BA_ "GenSigSendType" SG_ 142 STS_SHARE_MEM_INIT_ERROR 0;
BA_ "GenSigTimeoutTime" SG_ 142 STS_SHARE_MEM_INIT_ERROR 150;
BA_ "GenSigCycleTime" SG_ 142 STS_RAM_TEST_ERROR 50;
BA_ "GenSigSendType" SG_ 142 STS_RAM_TEST_ERROR 0;
BA_ "GenSigTimeoutTime" SG_ 142 STS_RAM_TEST_ERROR 150;
BA_ "GenSigCycleTime" SG_ 142 STS_MMAP_MEMORY_ERROR 50;
BA_ "GenSigSendType" SG_ 142 STS_MMAP_MEMORY_ERROR 0;
BA_ "GenSigTimeoutTime" SG_ 142 STS_MMAP_MEMORY_ERROR 150;
BA_ "GenSigCycleTime" SG_ 142 STS_ISR_ATTACH_ERROR 50;
BA_ "GenSigSendType" SG_ 142 STS_ISR_ATTACH_ERROR 0;
BA_ "GenSigTimeoutTime" SG_ 142 STS_ISR_ATTACH_ERROR 150;
BA_ "GenSigCycleTime" SG_ 142 STS_IPC_DRV_WRITE_ERROR 50;
BA_ "GenSigSendType" SG_ 142 STS_IPC_DRV_WRITE_ERROR 0;
BA_ "GenSigTimeoutTime" SG_ 142 STS_IPC_DRV_WRITE_ERROR 150;
BA_ "GenSigCycleTime" SG_ 142 STS_IPC_DRV_TRIGGER_ERROR 50;
BA_ "GenSigSendType" SG_ 142 STS_IPC_DRV_TRIGGER_ERROR 0;
BA_ "GenSigTimeoutTime" SG_ 142 STS_IPC_DRV_TRIGGER_ERROR 150;
BA_ "GenSigCycleTime" SG_ 142 STS_IPC_DRV_SYNC_ERROR 50;
BA_ "GenSigSendType" SG_ 142 STS_IPC_DRV_SYNC_ERROR 0;
BA_ "GenSigTimeoutTime" SG_ 142 STS_IPC_DRV_SYNC_ERROR 150;
BA_ "GenSigCycleTime" SG_ 142 STS_IPC_DRV_READ_ERROR 50;
BA_ "GenSigSendType" SG_ 142 STS_IPC_DRV_READ_ERROR 0;
BA_ "GenSigTimeoutTime" SG_ 142 STS_IPC_DRV_READ_ERROR 150;
BA_ "GenSigCycleTime" SG_ 142 STS_IPC_DRV_INIT_ERROR 50;
BA_ "GenSigSendType" SG_ 142 STS_IPC_DRV_INIT_ERROR 0;
BA_ "GenSigTimeoutTime" SG_ 142 STS_IPC_DRV_INIT_ERROR 150;
BA_ "GenSigCycleTime" SG_ 142 STS_INTERRUPT_ENABLE_ERROR 50;
BA_ "GenSigSendType" SG_ 142 STS_INTERRUPT_ENABLE_ERROR 0;
BA_ "GenSigTimeoutTime" SG_ 142 STS_INTERRUPT_ENABLE_ERROR 150;
BA_ "GenSigCycleTime" SG_ 142 STS_HIL_FORMAT_ERROR 50;
BA_ "GenSigSendType" SG_ 142 STS_HIL_FORMAT_ERROR 0;
BA_ "GenSigTimeoutTime" SG_ 142 STS_HIL_FORMAT_ERROR 150;
BA_ "GenSigCycleTime" SG_ 142 STS_FLASH_FILESYSTEM_ERROR 50;
BA_ "GenSigSendType" SG_ 142 STS_FLASH_FILESYSTEM_ERROR 0;
BA_ "GenSigTimeoutTime" SG_ 142 STS_FLASH_FILESYSTEM_ERROR 150;
BA_ "GenSigCycleTime" SG_ 142 STS_IPC_INIT 50;
BA_ "GenSigSendType" SG_ 142 STS_IPC_INIT 0;
BA_ "GenSigTimeoutTime" SG_ 142 STS_IPC_INIT 150;
BA_ "GenSigCycleTime" SG_ 142 STS_INIT_ERROR 50;
BA_ "GenSigSendType" SG_ 142 STS_INIT_ERROR 0;
BA_ "GenSigTimeoutTime" SG_ 142 STS_INIT_ERROR 150;
BA_ "GenSigCycleTime" SG_ 142 STS_CAN_XMT_ERROR 50;
BA_ "GenSigSendType" SG_ 142 STS_CAN_XMT_ERROR 0;
BA_ "GenSigTimeoutTime" SG_ 142 STS_CAN_XMT_ERROR 150;
BA_ "GenSigCycleTime" SG_ 142 STS_CAN_RCV_ERROR 50;
BA_ "GenSigSendType" SG_ 142 STS_CAN_RCV_ERROR 0;
BA_ "GenSigTimeoutTime" SG_ 142 STS_CAN_RCV_ERROR 150;
BA_ "GenSigCycleTime" SG_ 142 STS_CAN_HARDWARE_ERROR 50;
BA_ "GenSigSendType" SG_ 142 STS_CAN_HARDWARE_ERROR 0;
BA_ "GenSigTimeoutTime" SG_ 142 STS_CAN_HARDWARE_ERROR 150;
BA_ "GenSigCycleTime" SG_ 142 STS_MAIN_CORE_THROUGHPUT 50;
BA_ "GenSigSendType" SG_ 142 STS_MAIN_CORE_THROUGHPUT 0;
BA_ "GenSigTimeoutTime" SG_ 142 STS_MAIN_CORE_THROUGHPUT 150;
BA_ "GenSigCycleTime" SG_ 142 STS_SYSTEM_STATUS 50;
BA_ "GenSigSendType" SG_ 142 STS_SYSTEM_STATUS 0;
BA_ "GenSigTimeoutTime" SG_ 142 STS_SYSTEM_STATUS 150;
BA_ "GenSigCycleTime" SG_ 142 STS_SCAN_TYPE 50;
BA_ "GenSigSendType" SG_ 142 STS_SCAN_TYPE 0;
BA_ "GenSigTimeoutTime" SG_ 142 STS_SCAN_TYPE 150;
BA_ "GenSigCycleTime" SG_ 142 STS_OVERHEAT_ERROR 50;
BA_ "GenSigSendType" SG_ 142 STS_OVERHEAT_ERROR 0;
BA_ "GenSigTimeoutTime" SG_ 142 STS_OVERHEAT_ERROR 150;
BA_ "GenSigCycleTime" SG_ 142 STS_RANGE_PERF_ERROR 50;
BA_ "GenSigSendType" SG_ 142 STS_RANGE_PERF_ERROR 0;
BA_ "GenSigTimeoutTime" SG_ 142 STS_RANGE_PERF_ERROR 150;
BA_ "GenSigCycleTime" SG_ 142 STS_COMM_ERROR 50;
BA_ "GenSigSendType" SG_ 142 STS_COMM_ERROR 0;
BA_ "GenSigTimeoutTime" SG_ 142 STS_COMM_ERROR 150;
BA_ "GenSigCycleTime" SG_ 142 STS_XCVR_OPERATIONAL 50;
BA_ "GenSigSendType" SG_ 142 STS_XCVR_OPERATIONAL 0;
BA_ "GenSigTimeoutTime" SG_ 142 STS_XCVR_OPERATIONAL 150;
BA_ "GenSigCycleTime" SG_ 142 STS_DRIVING_ENVIRONMENT 50;
BA_ "GenSigSendType" SG_ 142 STS_DRIVING_ENVIRONMENT 0;
BA_ "GenSigTimeoutTime" SG_ 142 STS_DRIVING_ENVIRONMENT 150;
BA_ "GenSigCycleTime" SG_ 142 STS_SCAN_IDX_ROLLING_COUNT_2 50;
BA_ "GenSigSendType" SG_ 142 STS_SCAN_IDX_ROLLING_COUNT_2 0;
BA_ "GenSigTimeoutTime" SG_ 142 STS_SCAN_IDX_ROLLING_COUNT_2 150;
BA_ "GenSigCycleTime" SG_ 142 STS_YAW_RATE_BIAS 50;
BA_ "GenSigSendType" SG_ 142 STS_YAW_RATE_BIAS 0;
BA_ "GenSigTimeoutTime" SG_ 142 STS_YAW_RATE_BIAS 150;
BA_ "GenSigCycleTime" SG_ 142 STS_AUTO_ALIGN_QUA_FACTOR 50;
BA_ "GenSigSendType" SG_ 142 STS_AUTO_ALIGN_QUA_FACTOR 0;
BA_ "GenSigTimeoutTime" SG_ 142 STS_AUTO_ALIGN_QUA_FACTOR 150;
BA_ "GenSigCycleTime" SG_ 142 STS_ALIGNMENT_MODE 50;
BA_ "GenSigSendType" SG_ 142 STS_ALIGNMENT_MODE 0;
BA_ "GenSigTimeoutTime" SG_ 142 STS_ALIGNMENT_MODE 150;
BA_ "GenSigCycleTime" SG_ 142 STS_CURRENT_MISALIGN_ANGLE 50;
BA_ "GenSigSendType" SG_ 142 STS_CURRENT_MISALIGN_ANGLE 0;
BA_ "GenSigTimeoutTime" SG_ 142 STS_CURRENT_MISALIGN_ANGLE 150;
BA_ "GenSigCycleTime" SG_ 142 STS_SAVED_MISALIGN_ANGLE 50;
BA_ "GenSigSendType" SG_ 142 STS_SAVED_MISALIGN_ANGLE 0;
BA_ "GenSigTimeoutTime" SG_ 142 STS_SAVED_MISALIGN_ANGLE 150;
BA_ "GenSigCmt" SG_ 142 STS_VRTCL_ALIGN_UPDATES_NBR "Number of alignment updates done.";
BA_ "GenSigSendType" SG_ 142 STS_VRTCL_ALIGN_UPDATES_NBR 0;
BA_ "GenSigCmt" SG_ 142 STS_HRZNTL_ALIGN_UPDATES_NBR "Number of alignment updates done.";
BA_ "GenSigSendType" SG_ 142 STS_HRZNTL_ALIGN_UPDATES_NBR 0;
BA_ "GenSigCmt" SG_ 142 STS_ACTIVE_FAULTS "Active faults";
BA_ "GenSigCmt" SG_ 142 STS_LATCH_FAULTS "Active Latch Faults";
BA_ "GenSigCycleTime" SG_ 142 STS_SCAN_INDEX 50;
BA_ "GenSigSendType" SG_ 142 STS_SCAN_INDEX 0;
BA_ "GenSigTimeoutTime" SG_ 142 STS_SCAN_INDEX 150;
BA_ "GenSigCycleTime" SG_ 142 STS_VEH_SPEED_DIRECTION 50;
BA_ "GenSigSendType" SG_ 142 STS_VEH_SPEED_DIRECTION 0;
BA_ "GenSigTimeoutTime" SG_ 142 STS_VEH_SPEED_DIRECTION 150;
BA_ "GenSigCycleTime" SG_ 142 STS_RADIUS_CURVATURE 50;
BA_ "GenSigSendType" SG_ 142 STS_RADIUS_CURVATURE 0;
BA_ "GenSigTimeoutTime" SG_ 142 STS_RADIUS_CURVATURE 150;
BA_ "GenSigCycleTime" SG_ 142 STS_STEERING_ANGLE_SIGN 50;
BA_ "GenSigSendType" SG_ 142 STS_STEERING_ANGLE_SIGN 0;
BA_ "GenSigTimeoutTime" SG_ 142 STS_STEERING_ANGLE_SIGN 150;
BA_ "GenSigCycleTime" SG_ 142 STS_STEERING_ANGLE 50;
BA_ "GenSigSendType" SG_ 142 STS_STEERING_ANGLE 0;
BA_ "GenSigTimeoutTime" SG_ 142 STS_STEERING_ANGLE 150;
BA_ "GenSigCycleTime" SG_ 142 STS_YAW_RATE_CALC 50;
BA_ "GenSigSendType" SG_ 142 STS_YAW_RATE_CALC 0;
BA_ "GenSigStartValue" SG_ 142 STS_YAW_RATE_CALC 448;
BA_ "GenSigTimeoutTime" SG_ 142 STS_YAW_RATE_CALC 150;
BA_ "GenSigCycleTime" SG_ 142 STS_VEHICLE_SPEED_CALC 50;
BA_ "GenSigSendType" SG_ 142 STS_VEHICLE_SPEED_CALC 0;
BA_ "GenSigTimeoutTime" SG_ 142 STS_VEHICLE_SPEED_CALC 150;
BA_ "GenSigCmt" SG_ 136 HED_NUM_OF_VALID_DETECTIONS "Number of detections sent";
BA_ "GenSigCmt" SG_ 136 HED_LOOK_ID "Indicates the look type values 1 to 4 base on medium/long look and near/far look";
BA_ "GenSigCmt" SG_ 136 HED_CAN_SCAN_INDEX "Scan index for SODFL";
BA_ "GenSigCmt" SG_ 136 HED_DET_RANGE_MAX "CAN range coverage";
BA_ "GenSigCmt" SG_ 136 HED_DET_SPEED_RANGE_MAX "CAN range coverage";
BA_ "GenSigStartValue" SG_ 136 HED_DET_SPEED_RANGE_MAX 32768;
BA_ "GenSigCmt" SG_ 136 HED_FOV_HOR_MAX "CAN range coverage";
BA_ "GenSigCmt" SG_ 136 HED_FOV_VER_MAX "CAN range coverage";
BA_ "GenSigStartValue" SG_ 136 HED_DET_SPEED_RANGE_MIN 32768;
BA_ "GenSigStartValue" SG_ 448 OBJ_YAW_ANGLE_001 2000;
BA_ "GenSigStartValue" SG_ 448 OBJ_POS_LONG_001 32700;
BA_ "GenSigStartValue" SG_ 448 OBJ_POS_LAT_001 32700;
BA_ "GenSigStartValue" SG_ 448 OBJ_VELOCITY_LONG_001 16300;
BA_ "GenSigStartValue" SG_ 448 OBJ_VELOCITY_LAT_001 16300;
BA_ "GenSigStartValue" SG_ 448 OBJ_ACCELERATION_LONG_001 400;
BA_ "GenSigStartValue" SG_ 448 OBJ_ACCELERATION_LAT_001 400;
BA_ "GenSigStartValue" SG_ 448 OBJ_TIMESTAMP_OFFSET_001 127;
BA_ "GenSigStartValue" SG_ 448 OBJ_RCS_001 64;
BA_ "GenSigStartValue" SG_ 448 OBJ_YAW_RATE_001 448;
BA_ "GenSigStartValue" SG_ 448 OBJ_POS_ERR_CRR_COEF_001 120;
BA_ "GenSigStartValue" SG_ 448 OBJ_VELOCITY_ERR_CRR_COEF_001 120;
BA_ "GenSigStartValue" SG_ 448 OBJ_ACCEL_ERR_CRR_COEF_001 120;
BA_ "GenSigStartValue" SG_ 385 DET_RANGE_VELOCITY_005 16384;
BA_ "GenSigStartValue" SG_ 385 DET_RCS_005 128;
BA_ "GenSigStartValue" SG_ 385 DET_RANGE_VELOCITY_006 16384;
BA_ "GenSigStartValue" SG_ 385 DET_RCS_006 128;
BA_ "GenSigStartValue" SG_ 385 DET_RANGE_VELOCITY_007 16384;
BA_ "GenSigStartValue" SG_ 385 DET_RCS_007 128;
BA_ "GenSigStartValue" SG_ 385 DET_RANGE_VELOCITY_008 16384;
BA_ "GenSigStartValue" SG_ 385 DET_RCS_008 128;
BA_ "GenSigStartValue" SG_ 386 DET_RANGE_VELOCITY_009 16384;
BA_ "GenSigStartValue" SG_ 386 DET_RCS_009 128;
BA_ "GenSigStartValue" SG_ 386 DET_RANGE_VELOCITY_010 16384;
BA_ "GenSigStartValue" SG_ 386 DET_RCS_010 128;
BA_ "GenSigStartValue" SG_ 386 DET_RANGE_VELOCITY_011 16384;
BA_ "GenSigStartValue" SG_ 386 DET_RCS_011 128;
BA_ "GenSigStartValue" SG_ 386 DET_RANGE_VELOCITY_012 16384;
BA_ "GenSigStartValue" SG_ 386 DET_RCS_012 128;
BA_ "GenSigStartValue" SG_ 387 DET_RANGE_VELOCITY_013 16384;
BA_ "GenSigStartValue" SG_ 387 DET_RCS_013 128;
BA_ "GenSigStartValue" SG_ 387 DET_RANGE_VELOCITY_014 16384;
BA_ "GenSigStartValue" SG_ 387 DET_RCS_014 128;
BA_ "GenSigStartValue" SG_ 387 DET_RANGE_VELOCITY_015 16384;
BA_ "GenSigStartValue" SG_ 387 DET_RCS_015 128;
BA_ "GenSigStartValue" SG_ 387 DET_RANGE_VELOCITY_016 16384;
BA_ "GenSigStartValue" SG_ 387 DET_RCS_016 128;
BA_ "GenSigStartValue" SG_ 388 DET_RANGE_VELOCITY_017 16384;
BA_ "GenSigStartValue" SG_ 388 DET_RCS_017 128;
BA_ "GenSigStartValue" SG_ 388 DET_RANGE_VELOCITY_018 16384;
BA_ "GenSigStartValue" SG_ 388 DET_RCS_018 128;
BA_ "GenSigStartValue" SG_ 388 DET_RANGE_VELOCITY_019 16384;
BA_ "GenSigStartValue" SG_ 388 DET_RCS_019 128;
BA_ "GenSigStartValue" SG_ 388 DET_RANGE_VELOCITY_020 16384;
BA_ "GenSigStartValue" SG_ 388 DET_RCS_020 128;
BA_ "GenSigStartValue" SG_ 389 DET_RANGE_VELOCITY_021 16384;
BA_ "GenSigStartValue" SG_ 389 DET_RCS_021 128;
BA_ "GenSigStartValue" SG_ 389 DET_RANGE_VELOCITY_022 16384;
BA_ "GenSigStartValue" SG_ 389 DET_RCS_022 128;
BA_ "GenSigStartValue" SG_ 389 DET_RANGE_VELOCITY_023 16384;
BA_ "GenSigStartValue" SG_ 389 DET_RCS_023 128;
BA_ "GenSigStartValue" SG_ 389 DET_RANGE_VELOCITY_024 16384;
BA_ "GenSigStartValue" SG_ 389 DET_RCS_024 128;
BA_ "GenSigStartValue" SG_ 390 DET_RANGE_VELOCITY_025 16384;
BA_ "GenSigStartValue" SG_ 390 DET_RCS_025 128;
BA_ "GenSigStartValue" SG_ 390 DET_RANGE_VELOCITY_026 16384;
BA_ "GenSigStartValue" SG_ 390 DET_RCS_026 128;
BA_ "GenSigStartValue" SG_ 390 DET_RANGE_VELOCITY_027 16384;
BA_ "GenSigStartValue" SG_ 390 DET_RCS_027 128;
BA_ "GenSigStartValue" SG_ 390 DET_RANGE_VELOCITY_028 16384;
BA_ "GenSigStartValue" SG_ 390 DET_RCS_028 128;
BA_ "GenSigStartValue" SG_ 391 DET_RANGE_VELOCITY_029 16384;
BA_ "GenSigStartValue" SG_ 391 DET_RCS_029 128;
BA_ "GenSigStartValue" SG_ 391 DET_RANGE_VELOCITY_030 16384;
BA_ "GenSigStartValue" SG_ 391 DET_RCS_030 128;
BA_ "GenSigStartValue" SG_ 391 DET_RANGE_VELOCITY_031 16384;
BA_ "GenSigStartValue" SG_ 391 DET_RCS_031 128;
BA_ "GenSigStartValue" SG_ 391 DET_RANGE_VELOCITY_032 16384;
BA_ "GenSigStartValue" SG_ 391 DET_RCS_032 128;
BA_ "GenSigStartValue" SG_ 392 DET_RANGE_VELOCITY_033 16384;
BA_ "GenSigStartValue" SG_ 392 DET_RCS_033 128;
BA_ "GenSigStartValue" SG_ 392 DET_RANGE_VELOCITY_034 16384;
BA_ "GenSigStartValue" SG_ 392 DET_RCS_034 128;
BA_ "GenSigStartValue" SG_ 392 DET_RANGE_VELOCITY_035 16384;
BA_ "GenSigStartValue" SG_ 392 DET_RCS_035 128;
BA_ "GenSigStartValue" SG_ 392 DET_RANGE_VELOCITY_036 16384;
BA_ "GenSigStartValue" SG_ 392 DET_RCS_036 128;

VAL_ 384 DET_CONFD_AZIMUTH_001 0 "High" 1 "MidHigh" 2 "MidLow" 3 "Low";
VAL_ 384 DET_CONFD_ELEVATION_001 0 "High" 1 "MidHigh" 2 "MidLow" 3 "Low";
VAL_ 384 DET_CONFD_AZIMUTH_002 0 "High" 1 "MidHigh" 2 "MidLow" 3 "Low";
VAL_ 384 DET_CONFD_ELEVATION_002 0 "High" 1 "MidHigh" 2 "MidLow" 3 "Low";
VAL_ 384 DET_CONFD_AZIMUTH_003 0 "High" 1 "MidHigh" 2 "MidLow" 3 "Low";
VAL_ 384 DET_CONFD_ELEVATION_003 0 "High" 1 "MidHigh" 2 "MidLow" 3 "Low";
VAL_ 1 TSYN_SGW 0 "SyncToGTM" 1 "SyncToSubDomain";
VAL_ 2 SSTS_YAW_RATE_CALC_QF 0 "Undefined" 1 "Temporarily Undefined" 2 "Innaccurate" 3 "Accurate";
VAL_ 2 SSTS_VEHICLE_SPEED_CALC_QF 0 "Undefined" 1 "Temporarily Undefined" 2 "Innaccurate" 3 "Accurate";
VAL_ 2 SSTS_VEH_BATT_VOLT 255 "Fault";
VAL_ 2 SSTS_IGN_STATUS 0 "Unknown" 1 "Off" 2 "Accessory" 4 "Run" 8 "Start" 15 "Invalid";
VAL_ 2 SSTS_GEAR_POSITION 0 "Park" 1 "Reverse" 2 "Neutral" 3 "Drive" 4 "Sport_DriveSport" 5 "Low" 6 "first" 7 "second" 8 "third" 9 "fourth" 10 "fifth" 11 "sixth" 12 "NotUsed_1" 13 "NotUsed_2" 14 "Unknown_Position" 15 "Fault";
VAL_ 2 SSTS_WIPER_STATUS 0 "Off" 1 "On";
VAL_ 2 SSTS_PWPCKTQ_D_STAT 0 "PwPckOff_TqNotAvailable" 1 "PwPckOn_TqNotAvailable" 2 "StartInPrgrss_TqNotAvail" 3 "PwPckOn_TqAvailable";
VAL_ 2 SSTS_CC_STAT_D_ACTL 0 "Off" 1 "Denied" 2 "Standby_Denied" 3 "Standby" 4 "Active_Que_Assist" 5 "Active" 6 "Undefined_1" 7 "Undefined_2";
VAL_ 2 SSTS_ElPW_D_STAT 0 "Not_Supported" 1 "Supported" 2 "Not_Supported_Imminent" 3 "LV_Event_In_Progress" 4 "Fault_Limited" 5 "NotUsed_1" 6 "NotUsed_2" 7 "NotUsed_3";
VAL_ 2 SSTS_VEHOVERGND_V_EST 65534 "Unknown" 65535 "Invalid";
VAL_ 2 SSTS_LROS_DRIVE_DIR 0 "Unknown" 1 "Backward" 2 "Forward" 4 "-";
VAL_ 2 SSTS_LROS_DRIVE_REVERSE 0 "Not_Reverse" 1 "Reverse";
VAL_ 2 SSTS_LEFT_BLINK 0 "Off" 1 "On";
VAL_ 2 SSTS_RIGHT_BLINK 0 "Off" 1 "On";
VAL_ 141 STS_PLATFORM_VARIANT 0 "VARIANT_INVALID" 1 "VARIANT_MRR3" 2 "VARIANT_SRR5" 3 "VARIANT_RACAM" 4 "VARIANT_MRR360" 5 "VARIANT_MRR3LLP" 6 "VARIANT_MRR3LLP_STD" 7 "VARIANT_MRR3LLP_AMOD" 8 "VARIANT_SRRAD" 9 "VARIANT_FLR4" 10 "VARIANT_FLR4PLUS" 11 "VARIANT_SRR6" 12 "VARIANT_SRR6PLUS";
VAL_ 141 STS_HARDWARE_VERSION 0 "UNKNOWN" 1 "RCM" 2 "RCM_RDI3_LOG" 3 "RCM_RDI3_HIL" 4 "RESERVED1" 5 "RESERVED2";
VAL_ 141 STS_SMC_PLATFROM_VERSION 0 "INVALID" 1 "MRR3" 2 "SRR5" 3 "RACAM" 4 "MRR360" 5 "MRR3LLP" 6 "MRRLLP_STD" 7 "MRRLLP_AMOD" 8 "SRRAD" 9 "FLR4" 10 "FLR4PLUS" 11 "SRR6" 12 "SRR6PLUS";
VAL_ 141 STS_SENSOR_MOUNT_LOCATION 0 "UNKNOWN" 1 "LEFT_FORWARD" 2 "LEFT_REAR" 3 "CENTER_FORWARD" 4 "CENTER_REAR" 5 "RIGHT_FORWARD" 6 "RIGHT_REAR";
VAL_ 142 STS_TIMESYNC_CORRECTION_TYP 0 "INVALID" 1 "Up Correction One Step" 2 "Up Correction Several" 3 "Down Step";
VAL_ 142 STS_BRR_STATUS 0 "INACTIVE" 1 "ACTIVE" 2 "FAULT";
VAL_ 142 STS_VEH_CRD_SYS_TYPE 0 "UNKNOWN" 1 "SystemType_RearAxle" 2 "SystemType_RoadLevel" 3 "Low";
VAL_ 142 STS_BLOCKAGE_STATUS 0 "UNKNOWN" 1 "NONE" 2 "Defect" 4 "PartialBlockageLowImpac" 5 "PartialBlockageMediumImpact" 6 "PartialBlockageHighImpact" 7 "FullBlockage";
VAL_ 142 STS_NUM_VALID_FOV_RR_TYPE 0 "Snow" 1 "Rain" 2 "Clutter" 4 "FlyingLeaves" 5 "Shades" 6 "ContrastIssues" 7 "Jamming" 8 "DeviceInterference" 9 "Sand" 10 "WetRoads" 11 "SnowOnSensorSurface" 12 "WaterOnSensorSurface" 13 "SoilOnSensorSurface" 14 "ScratchesOnSensorSurface" 15 "Unknown";
VAL_ 142 STS_SCAN_TYPE 0 "MEDIUM_LOOK" 1 "LONG_LOOK";
VAL_ 136 HED_LOOK_ID 0 "LOOK_A" 1 "LOOK_B" 2 "LOOK_C" 3 "LOOK_D";
VAL_ 136 HED_DATA_QUALIFIER 0 "UNKNOWN" 1 "OTHER" 2 "AVAILABLE" 3 "AVAILABLE_REDUCED" 4 "NOT_AVAILABLE" 5 "AVAILABLE_REDUCED_IN_COVERAGE" 6 "AVAILABLE_REDUCED_IN_PERFORMANCE" 7 "INVALID";
VAL_ 136 HED_HOR_ALIGNMENT_STATUS 0 "Off" 1 "Busy" 2 "Success" 3 "Fail No Target" 4 "Fail Deviation Too Large" 5 "Fail Variance Too Large" 6 "Fail Only Left Target Found" 7 "Fail Only Right Target Found" 8 "Fail Time Out" 9 "Fail Horizontal Align OutOfRange" 10 "Fail Vertical Align OutOfRange" 11 "Fail Ver and Hor OutOfRange" 12 "No Peak (Flat-plate only)" 13 "Low Amplitude (Flat-plate only)" 14 "Undefined" 15 "Undefined";
VAL_ 136 HED_VER_ALIGNMENT_STATUS 0 "Off" 1 "Busy" 2 "Success" 3 "Fail No Target" 4 "Fail Deviation Too Large" 5 "Fail Variance Too Large" 6 "Fail Only Left Target Found" 7 "Fail Only Right Target Found" 8 "Fail Time Out" 9 "Fail Horizontal Align OutOfRange" 10 "Fail Vertical Align OutOfRange" 11 "Fail Ver and Hor OutOfRange" 12 "No Peak (Flat-plate only)" 13 "Low Amplitude (Flat-plate only)" 14 "Undefined" 15 "Undefined";
VAL_ 136 HED_VER_ALIGNMENT_STATE 0 "Off" 1 "Auto alignment" 2 "Short track alignment" 3 "Service alignment" 4 "Static alignment 1-target" 5 "Static alignment 2-target" 6 "Static alignment flat-plate";
VAL_ 136 HED_HOR_ALIGNMENT_STATE 0 "Off" 1 "Auto alignment" 2 "Short track alignment" 3 "Service alignment" 4 "Static alignment 1-target" 5 "Static alignment 2-target" 6 "Static alignment flat-plate";
VAL_ 136 HED_ALIGN_VER_QF 0 "Undefined" 1 "Temporarily undefined (Faulty)" 2 "Innacurate" 3 "Accurate";
VAL_ 136 HED_ALIGN_HOR_QF 0 "Undefined" 1 "Temporarily undefined (Faulty)" 2 "Innacurate" 3 "Accurate";
VAL_ 136 HED_TIME_SYNC_SRC_MASTER 0 "LOCAL" 1 "GLOBAL";
VAL_ 448 OBJ_TRACK_MOTION_MODEL_001 0 "INVALID" 1 "CCV" 2 "CTCA" 3 "CCA";
VAL_ 448 OBJ_MOVEMENT_STATUS_001 0 "UNKNOWN" 1 "MOVING" 2 "SLOW_MOVING" 3 "FAST_MOVING" 4 "STATIONARY" 5 "STOPPED" 6 "RESERVED1" 7 "RESERVED2";
VAL_ 448 OBJ_MEASUREMENT_STATUS_001 0 "Invalid" 1 "New" 2 "Predicted" 3 "PartlyMeasured" 4 "Measured" 5 "Occluded";
VAL_ 448 OBJ_CLS_TYPE1_001 0 "UNKNOWN_MOVING_OBJ" 1 "CAR" 2 "TRUCK" 3 "MOTOR_BIKE" 4 "BICYCLE" 5 "PEDESTRIAN" 6 "ROAD_BOUNDRY" 7 "STATIC_OBJECT" 8 "TRAFFIC_LIGHT" 9 "TRAFFIC_SIGN" 10 "TWO_WHEELERS" 11 "RESERVED" 12 "RESERVED" 14 "OBJECT_UNDETERMIND" 15 "VEHICLE_UNDETERMIND";
VAL_ 448 OBJ_CLS_TYPE2_001 0 "UNKNOWN_MOVING_OBJ" 1 "CAR" 2 "TRUCK" 3 "MOTOR_BIKE" 4 "BICYCLE" 5 "PEDESTRIAN" 6 "ROAD_BOUNDRY" 7 "STATIC_OBJECT" 8 "TRAFFIC_LIGHT" 9 "TRAFFIC_SIGN" 10 "TWO_WHEELERS" 11 "RESERVED" 12 "RESERVED" 14 "OBJECT_UNDETERMIND" 15 "VEHICLE_UNDETERMIND";
VAL_ 448 OBJ_CLS_TYPE3_001 0 "UNKNOWN_MOVING_OBJ" 1 "CAR" 2 "TRUCK" 3 "MOTOR_BIKE" 4 "BICYCLE" 5 "PEDESTRIAN" 6 "ROAD_BOUNDRY" 7 "STATIC_OBJECT" 8 "TRAFFIC_LIGHT" 9 "TRAFFIC_SIGN" 10 "TWO_WHEELERS" 11 "RESERVED" 12 "RESERVED" 14 "OBJECT_UNDETERMIND" 15 "VEHICLE_UNDETERMIND";
VAL_ 448 OBJ_CLS_TYPE4_001 0 "UNKNOWN_MOVING_OBJ" 1 "CAR" 2 "TRUCK" 3 "MOTOR_BIKE" 4 "BICYCLE" 5 "PEDESTRIAN" 6 "ROAD_BOUNDRY" 7 "STATIC_OBJECT" 8 "TRAFFIC_LIGHT" 9 "TRAFFIC_SIGN" 10 "TWO_WHEELERS" 11 "RESERVED" 12 "RESERVED" 14 "OBJECT_UNDETERMIND" 15 "VEHICLE_UNDETERMIND";
VAL_ 448 OBJ_CLS_TYPE5_001 0 "UNKNOWN_MOVING_OBJ" 1 "CAR" 2 "TRUCK" 3 "MOTOR_BIKE" 4 "BICYCLE" 5 "PEDESTRIAN" 6 "ROAD_BOUNDRY" 7 "STATIC_OBJECT" 8 "TRAFFIC_LIGHT" 9 "TRAFFIC_SIGN" 10 "TWO_WHEELERS" 11 "RESERVED" 12 "RESERVED" 14 "OBJECT_UNDETERMIND" 15 "VEHICLE_UNDETERMIND";
VAL_ 448 OBJ_CLS_TYPE6_001 0 "UNKNOWN_MOVING_OBJ" 1 "CAR" 2 "TRUCK" 3 "MOTOR_BIKE" 4 "BICYCLE" 5 "PEDESTRIAN" 6 "ROAD_BOUNDRY" 7 "STATIC_OBJECT" 8 "TRAFFIC_LIGHT" 9 "TRAFFIC_SIGN" 10 "TWO_WHEELERS" 11 "RESERVED" 12 "RESERVED" 14 "OBJECT_UNDETERMIND" 15 "VEHICLE_UNDETERMIND";
VAL_ 137 HED_TRKR_VEH_COORD_TYPE 0 "RearAxle" 1 "RoadLevel";
VAL_ 137 HED_TRKR_DATA_QUALIFIER 0 "UNKNOWN" 1 "OTHER" 2 "AVAILABLE" 3 "AVAILABLE_REDUCED" 4 "NOT_AVAILABLE" 5 "AVAILABLE_REDUCED_IN_COVERAGE" 6 "AVAILABLE_REDUCED_IN_PERFORMANCE" 7 "INVALID";
VAL_ 385 DET_CONFD_AZIMUTH_005 0 "High" 1 "MidHigh" 2 "MidLow" 3 "Low";
VAL_ 385 DET_CONFD_ELEVATION_005 0 "High" 1 "MidHigh" 2 "MidLow" 3 "Low";
VAL_ 385 DET_CONFD_AZIMUTH_006 0 "High" 1 "MidHigh" 2 "MidLow" 3 "Low";
VAL_ 385 DET_CONFD_ELEVATION_006 0 "High" 1 "MidHigh" 2 "MidLow" 3 "Low";
VAL_ 385 DET_CONFD_AZIMUTH_007 0 "High" 1 "MidHigh" 2 "MidLow" 3 "Low";
VAL_ 385 DET_CONFD_ELEVATION_007 0 "High" 1 "MidHigh" 2 "MidLow" 3 "Low";
VAL_ 386 DET_CONFD_AZIMUTH_009 0 "High" 1 "MidHigh" 2 "MidLow" 3 "Low";
VAL_ 386 DET_CONFD_ELEVATION_009 0 "High" 1 "MidHigh" 2 "MidLow" 3 "Low";
VAL_ 386 DET_CONFD_AZIMUTH_010 0 "High" 1 "MidHigh" 2 "MidLow" 3 "Low";
VAL_ 386 DET_CONFD_ELEVATION_010 0 "High" 1 "MidHigh" 2 "MidLow" 3 "Low";
VAL_ 386 DET_CONFD_AZIMUTH_011 0 "High" 1 "MidHigh" 2 "MidLow" 3 "Low";
VAL_ 386 DET_CONFD_ELEVATION_011 0 "High" 1 "MidHigh" 2 "MidLow" 3 "Low";
VAL_ 387 DET_CONFD_AZIMUTH_013 0 "High" 1 "MidHigh" 2 "MidLow" 3 "Low";
VAL_ 387 DET_CONFD_ELEVATION_013 0 "High" 1 "MidHigh" 2 "MidLow" 3 "Low";
VAL_ 387 DET_CONFD_AZIMUTH_014 0 "High" 1 "MidHigh" 2 "MidLow" 3 "Low";
VAL_ 387 DET_CONFD_ELEVATION_014 0 "High" 1 "MidHigh" 2 "MidLow" 3 "Low";
VAL_ 387 DET_CONFD_AZIMUTH_015 0 "High" 1 "MidHigh" 2 "MidLow" 3 "Low";
VAL_ 387 DET_CONFD_ELEVATION_015 0 "High" 1 "MidHigh" 2 "MidLow" 3 "Low";
VAL_ 388 DET_CONFD_AZIMUTH_017 0 "High" 1 "MidHigh" 2 "MidLow" 3 "Low";
VAL_ 388 DET_CONFD_ELEVATION_017 0 "High" 1 "MidHigh" 2 "MidLow" 3 "Low";
VAL_ 388 DET_CONFD_AZIMUTH_018 0 "High" 1 "MidHigh" 2 "MidLow" 3 "Low";
VAL_ 388 DET_CONFD_ELEVATION_018 0 "High" 1 "MidHigh" 2 "MidLow" 3 "Low";
VAL_ 388 DET_CONFD_AZIMUTH_019 0 "High" 1 "MidHigh" 2 "MidLow" 3 "Low";
VAL_ 388 DET_CONFD_ELEVATION_019 0 "High" 1 "MidHigh" 2 "MidLow" 3 "Low";
VAL_ 389 DET_CONFD_AZIMUTH_021 0 "High" 1 "MidHigh" 2 "MidLow" 3 "Low";
VAL_ 389 DET_CONFD_ELEVATION_021 0 "High" 1 "MidHigh" 2 "MidLow" 3 "Low";
VAL_ 389 DET_CONFD_AZIMUTH_022 0 "High" 1 "MidHigh" 2 "MidLow" 3 "Low";
VAL_ 389 DET_CONFD_ELEVATION_022 0 "High" 1 "MidHigh" 2 "MidLow" 3 "Low";
VAL_ 389 DET_CONFD_AZIMUTH_023 0 "High" 1 "MidHigh" 2 "MidLow" 3 "Low";
VAL_ 389 DET_CONFD_ELEVATION_023 0 "High" 1 "MidHigh" 2 "MidLow" 3 "Low";
VAL_ 390 DET_CONFD_AZIMUTH_025 0 "High" 1 "MidHigh" 2 "MidLow" 3 "Low";
VAL_ 390 DET_CONFD_ELEVATION_025 0 "High" 1 "MidHigh" 2 "MidLow" 3 "Low";
VAL_ 390 DET_CONFD_AZIMUTH_026 0 "High" 1 "MidHigh" 2 "MidLow" 3 "Low";
VAL_ 390 DET_CONFD_ELEVATION_026 0 "High" 1 "MidHigh" 2 "MidLow" 3 "Low";
VAL_ 390 DET_CONFD_AZIMUTH_027 0 "High" 1 "MidHigh" 2 "MidLow" 3 "Low";
VAL_ 390 DET_CONFD_ELEVATION_027 0 "High" 1 "MidHigh" 2 "MidLow" 3 "Low";
VAL_ 391 DET_CONFD_AZIMUTH_029 0 "High" 1 "MidHigh" 2 "MidLow" 3 "Low";
VAL_ 391 DET_CONFD_ELEVATION_029 0 "High" 1 "MidHigh" 2 "MidLow" 3 "Low";
VAL_ 391 DET_CONFD_AZIMUTH_030 0 "High" 1 "MidHigh" 2 "MidLow" 3 "Low";
VAL_ 391 DET_CONFD_ELEVATION_030 0 "High" 1 "MidHigh" 2 "MidLow" 3 "Low";
VAL_ 391 DET_CONFD_AZIMUTH_031 0 "High" 1 "MidHigh" 2 "MidLow" 3 "Low";
VAL_ 391 DET_CONFD_ELEVATION_031 0 "High" 1 "MidHigh" 2 "MidLow" 3 "Low";
VAL_ 392 DET_CONFD_AZIMUTH_033 0 "High" 1 "MidHigh" 2 "MidLow" 3 "Low";
VAL_ 392 DET_CONFD_ELEVATION_033 0 "High" 1 "MidHigh" 2 "MidLow" 3 "Low";
VAL_ 392 DET_CONFD_AZIMUTH_034 0 "High" 1 "MidHigh" 2 "MidLow" 3 "Low";
VAL_ 392 DET_CONFD_ELEVATION_034 0 "High" 1 "MidHigh" 2 "MidLow" 3 "Low";
VAL_ 392 DET_CONFD_AZIMUTH_035 0 "High" 1 "MidHigh" 2 "MidLow" 3 "Low";
VAL_ 392 DET_CONFD_ELEVATION_035 0 "High" 1 "MidHigh" 2 "MidLow" 3 "Low";
SIG_GROUP_ 384 Detection001 1 : DET_BI_STATIC_FLAG_001 DET_AMBG_AZIMUTH_PROB_001 DET_AZIMUTH_AMB_ID_001 DET_CONFD_ELEVATION_001 DET_CONFD_AZIMUTH_001 DET_HVC_FLAG_001 DET_OUTSIDE_SECTOR_001 DET_AZIMUTH_ERR_001 DET_ELEVATION_ERR_001 DET_RANGE_ERR_001 DET_RANGE_VELOCITY_ERR_001 DET_EXISTENCE_PROB_001 DET_POINT_TARGET_PROB_001 DET_SNR_001 DET_SUPER_RES_TARGET_001 DET_VALID_FLAG_001 DET_RCS_001 DET_ELEVATION_001 DET_AZIMUTH_001 DET_RANGE_VELOCITY_001 DET_RANGE_001;
SIG_GROUP_ 384 Detection002 1 : DET_BI_STATIC_FLAG_002 DET_AMBG_AZIMUTH_PROB_002 DET_AZIMUTH_AMB_ID_002 DET_CONFD_ELEVATION_002 DET_CONFD_AZIMUTH_002 DET_HVC_FLAG_002 DET_OUTSIDE_SECTOR_002 DET_AZIMUTH_ERR_002 DET_ELEVATION_ERR_002 DET_RANGE_ERR_002 DET_RANGE_VELOCITY_ERR_002 DET_EXISTENCE_PROB_002 DET_POINT_TARGET_PROB_002 DET_SNR_002 DET_SUPER_RES_TARGET_002 DET_VALID_FLAG_002 DET_RCS_002 DET_ELEVATION_002 DET_AZIMUTH_002 DET_RANGE_VELOCITY_002 DET_RANGE_002;
SIG_GROUP_ 384 Detection003 1 : DET_BI_STATIC_FLAG_003 DET_AMBG_AZIMUTH_PROB_003 DET_AZIMUTH_AMB_ID_003 DET_CONFD_ELEVATION_003 DET_CONFD_AZIMUTH_003 DET_HVC_FLAG_003 DET_OUTSIDE_SECTOR_003 DET_AZIMUTH_ERR_003 DET_ELEVATION_ERR_003 DET_RANGE_ERR_003 DET_RANGE_VELOCITY_ERR_003 DET_EXISTENCE_PROB_003 DET_POINT_TARGET_PROB_003 DET_SNR_003 DET_SUPER_RES_TARGET_003 DET_VALID_FLAG_003 DET_RCS_003 DET_ELEVATION_003 DET_AZIMUTH_003 DET_RANGE_VELOCITY_003 DET_RANGE_003;
SIG_GROUP_ 384 Detection004 1 : DET_BI_STATIC_FLAG_004 DET_AMBG_AZIMUTH_PROB_004 DET_AZIMUTH_AMB_ID_004 DET_CONFD_ELEVATION_004 DET_CONFD_AZIMUTH_004 DET_HVC_FLAG_004 DET_OUTSIDE_SECTOR_004 DET_EXISTENCE_PROB_004 DET_POINT_TARGET_PROB_004 DET_SNR_004 DET_SUPER_RES_TARGET_004 DET_VALID_FLAG_004 DET_RCS_004 DET_ELEVATION_ERR_004 DET_ELEVATION_004 DET_AZIMUTH_ERR_004 DET_AZIMUTH_004 DET_RANGE_VELOCITY_ERR_004 DET_RANGE_VELOCITY_004 DET_RANGE_ERR_004 DET_RANGE_004;
SIG_GROUP_ 2 SystemStatusVehicle 1 : SSTS_STEERING_ANGLE SSTS_STEERING_ANGLE_SIGN SSTS_VEHICLE_SPEED_CALC SSTS_VEHICLE_SPEED_CALC_QF SSTS_VEH_SPD_COMP_FACTOR SSTS_YAW_RATE_CALC SSTS_YAW_RATE_BIAS SSTS_YAW_RATE_CALC_QF;
SIG_GROUP_ 2 SystemStatusVehicleState 1 : SSTS_RIGHT_BLINK SSTS_LEFT_BLINK SSTS_LROS_DRIVE_REVERSE SSTS_LROS_DRIVE_DIR SSTS_VEHOVERGND_V_EST SSTS_ElPW_D_STAT SSTS_CC_STAT_D_ACTL SSTS_PWPCKTQ_D_STAT SSTS_WIPER_STATUS SSTS_GEAR_POSITION SSTS_IGN_STATUS SSTS_VEH_BATT_VOLT;
SIG_GROUP_ 2 SytemStatus_ASDMVersion 1 : SSTS_CAN_PCAN_MAJOR_ASDM SSTS_CAN_PCAN_MINOR_ASDM SSTS_SW_VERSION_ASDM;
SIG_GROUP_ 141 Status_SystemTime 1 : STS_TIME_SINCE_POWER_ON STS_TIME_STAMP_DELTA;
SIG_GROUP_ 141 Status_HW_CAN_Version 1 : STS_DET_DBC_BASE_VER_MAJOR STS_DET_DBC_BASE_VER_MINOR STS_HARDWARE_VERSION STS_SERIAL_NUMBER_SEQUENCE STS_SERIAL_NUM_JULIAN_YEAR STS_SERIAL_NUM_JULIAN_DAY STS_PLATFORM_VARIANT STS_PCAN_PROTOCOL_VER_MAJOR STS_PCAN_PROTOCOL_VER_MINOR;
SIG_GROUP_ 141 Status_SwVersion 1 : STS_PBL_VERSION_FIELD4 STS_PBL_VERSION_FIELD3 STS_PBL_VERSION_FIELD2 STS_SW_VERSION_FIELD4 STS_SW_VERSION_FIELD3 STS_SW_VERSION_FIELD2 STS_PBL_VERSION_FIELD1 STS_SW_VERSION_FIELD1;
SIG_GROUP_ 141 Status_MountingPos 1 : STS_SENSOR_POSITION STS_SENSOR_MOUNT_ORNT_ROLL STS_SENSOR_MOUNT_ORNT_PITCH STS_SENSOR_MOUNT_POS_Z STS_SENSOR_HEIGHT STS_SENSOR_MOUNT_LOCATION STS_SENSOR_MOUNT_ORNT_YAW STS_SENSOR_MOUNT_POS_Y STS_SENSOR_MOUNT_POS_X STS_SENSOR_POLARITY;
SIG_GROUP_ 141 Status_CalibrationVersion 1 : STS_USC_SECTION_COMPTBLITY STS_USC_CAL_VER_MINOR STS_USC_CAL_VER_MAJOR STS_SMC_PLATFROM_VERSION STS_SMC_SECTION_COMPTBLITY STS_SMC_CAL_VER_MINOR STS_SMC_CAL_VER_MAJOR;
SIG_GROUP_ 142 Status_Vehicle 1 : STS_VEH_SPD_COMP_FACTOR STS_YAW_RATE_BIAS STS_SCAN_INDEX STS_VEHICLE_SPEED_CALC STS_YAW_RATE_CALC STS_STEERING_ANGLE STS_STEERING_ANGLE_SIGN STS_RADIUS_CURVATURE STS_VEH_SPEED_DIRECTION;
SIG_GROUP_ 142 Status_Radar 1 : STS_AF_OVERRUN_FLAG STS_RDD_OVERRUN_FLAG STS_DOPPLER_OVERRUN_FLAG STS_RANGE_OVERRUN_FLAG STS_MMIC_RE_INIT_COUNT STS_AF_CORE_THROUGHPUT STS_AUTO_ALIGN_VER_ANGLE STS_AUTO_ALIGN_HOR_ANGLE STS_RDD_CORE_THROUGHPUT STS_HRZNTL_ALIGN_UPDATES_NBR STS_VRTCL_ALIGN_UPDATES_NBR STS_XCVR_OPERATIONAL STS_SCAN_TYPE STS_SYSTEM_STATUS STS_MAIN_CORE_THROUGHPUT STS_SAVED_MISALIGN_ANGLE STS_CURRENT_MISALIGN_ANGLE STS_ALIGNMENT_MODE STS_AUTO_ALIGN_QUA_FACTOR STS_SCAN_IDX_ROLLING_COUNT_2 STS_DRIVING_ENVIRONMENT;
SIG_GROUP_ 142 Status_Faults 1 : STS_LATCH_FAULTS STS_ACTIVE_FAULTS;
SIG_GROUP_ 142 Status_Error 1 : STS_RANGE_PERF_ERROR STS_OVERHEAT_ERROR STS_COMM_ERROR STS_CAN_HARDWARE_ERROR STS_CAN_RCV_ERROR STS_CAN_XMT_ERROR STS_INIT_ERROR STS_IPC_INIT STS_FLASH_FILESYSTEM_ERROR STS_HIL_FORMAT_ERROR STS_INTERRUPT_ENABLE_ERROR STS_IPC_DRV_INIT_ERROR STS_IPC_DRV_READ_ERROR STS_IPC_DRV_SYNC_ERROR STS_IPC_DRV_TRIGGER_ERROR STS_IPC_DRV_WRITE_ERROR STS_ISR_ATTACH_ERROR STS_MMAP_MEMORY_ERROR STS_RAM_TEST_ERROR STS_SHARE_MEM_INIT_ERROR STS_SHARED_MEM_CONFIG_ERROR STS_SHARED_MEM_READ_ERROR STS_SHARED_MEM_WRITE_ERROR STS_SIGNAL_CREATE_ERROR STS_SIGNAL_SEND_ERROR STS_SIGNAL_WAIT_ERROR STS_HOR_MISALIGNMENT_ERR STS_SPI_COOMM_ERROR STS_SPI_FEE_ERROR STS_CALIBRATION_ERROR STS_TIMER_CREATE_ERROR STS_RADAR_TX_POWER_ERROR STS_RADAR_LO_PWR_ERROR STS_RADAR_DATA_SYNC_ERROR STS_SATURATED_TUNING_FREQ_ERR STS_TRANSMITTER_ID_ERROR STS_ADC_SPI_TRANSFER_ERROR STS_LINEARIZER_SPI_TX_ERR STS_VER_MISALIGNMENT_ERR STS_UNIT_CAL_CHKSM_ERROR STS_UNIT_CL_BLK_CKSM_ERR STS_SMC_LOAD_ERROR STS_USC_LOAD_ERROR;
SIG_GROUP_ 142 Status_Temprature 1 : STS_MMIC_MAX_TEMP STS_MMIC1_TEMP_CHIRP STS_MMIC1_TEMP_TX3 STS_MMIC1_TEMP_TX2 STS_MMIC1_TEMP_TX1 STS_MMIC_SELECT STS_BOARD_THERMISTOR STS_PROCESSOR_Temp3 STS_PROCESSOR_Temp2 STS_PROCESSOR_Temp1 STS_MMIC0_TEMP_TX1 STS_MMIC0_TEMP_TX2 STS_MMIC0_TEMP_TX3 STS_MMIC0_TEMP_CHIRP;
SIG_GROUP_ 142 Status_Supply_Volts 1 : STS_SUPPLY_VOLTS_0_82_V STS_SUPPLY_VOLTS_1_1_V STS_SUPPLY_VOLTS_3_3_V STS_SUPPLY_VOLTS_1_8_V STS_SUPPLY_VOLTS_2_3_V STS_SUPPLY_VOLTS_5_V;
SIG_GROUP_ 142 Status_SensorPerformance 1 : STS_NUM_VALID_FOV_RR_PROB STS_NUM_OF_VALID_FOV_SGMNTS STS_NUM_VALID_FOV_RR_TYPE STS_NUM_VALID_FOV_RR STS_VEH_CRD_SYS_TYPE STS_BLOCKAGE_STATUS STS_BRR_STATUS;
SIG_GROUP_ 142 Status_TimeSyncStatus 1 : STS_TIME_SYNC_OFFSET STS_THRESHOLD_FLAG STS_FUP_NSEC_OUT_OF_RANGE STS_SYN_SEC_OUT_OF_RANGE STS_FUP_SEQ_CNT_ERROR STS_SYN_SEQ_CNT_ERROR STS_FUP_CRC_ERROR STS_SYN_CRC_ERROR STS_INVALID_PDU STS_NO_TSYN_ERROR STS_POINT_OF_TRIGGER STS_TIMESYNC_CORRECTION_TYP STS_TIMESYNC_JITTER;
SIG_GROUP_ 139 Status_MMIC_error 1 : STC_SCAN_INDEX STC_MMIC0_ISM_ERR_COUNTER STC_MMIC0_ISM_ERR_STATUS_REG STC_MMIC0_ISM_MODULE_ERR_REG STC_MMIC0_ISM_WARN_COUNTER STC_MMIC0_ISM_WARN_REG STC_MMIC0_T_K_UNUSED_6 STC_MMIC0_T_K_UNUSED_7 STC_MMIC1_ISM_ERR_COUNTER STC_MMIC1_ISM_ERR_STATUS_REG STC_MMIC1_ISM_MODULE_ERR_REG STC_MMIC1_ISM_WARN_COUNTER STC_MMIC1_ISM_WARN_REG STC_MMIC1_T_K_UNUSED_6 STC_MMIC1_T_K_UNUSED_7 STC_MMIC_SELECT STC_MMIC1_DRIVER_ERR_FLAG1 STC_MMIC1_DRIVER_ERR_FLAG2 STC_MMIC1_DRIVER_ERR_COUNTER STC_MIPI1_ERR_COUNTER STC_MMIC1_ERR_CODE STC_MIPI0_ERR_COUNTER STC_MMIC0_DRIVER_ERR_COUNTER STC_MMIC0_DRIVER_ERR_FLAG2 STC_MMIC0_DRIVER_ERR_FLAG1 STC_MMIC0_ERR_CODE;
SIG_GROUP_ 136 Header_Interface_Version 1 : HED_INTRFC_VERSION_ID_MINOR HED_INTRFC_VERSION_ID_PATCH HED_INTRFC_VERSION_ID_MAJOR;
SIG_GROUP_ 136 Header_InfoDetection 1 : HED_DET_AF_PLATFORM_SELECT HED_DET_ELP_AF HED_DET_FOURIER_AF HED_DET_VALID_2PASS_AF HED_DET_ESPRIT_AF HED_DET_SUPER_FAST_AF HED_DET_BI_STATIC_COUNT HED_DET_ESPRIT_MTAZ HED_DET_WTO_ESPRIT_FFT HED_DET_NLS HED_DET_ESPRIT_7x7_INVALID HED_DET_NUM_OF_2PASS HED_DET_NUM_OF_1PASS HED_DET_PHASE_CMP_FFT_AF HED_DET_SINGLE_TGT_FFT_MH_AF HED_DET_ESPRIT_7x7_VALID HED_DET_SINGLE_TGT_FFT_HI_AF HED_NUM_OF_RESTBINS_USED;
SIG_GROUP_ 136 Header_TimeStamp 1 : HED_TRIGGER_TIME HED_TIME_SYNC_VALIDITY_FLAG HED_TIME_SYNC_SRC_MASTER HED_MEASUREMENT_LATENCY HED_SENSOR_TIME_STAMP_NS HED_SENSOR_TIME_STAMP_SEC;
SIG_GROUP_ 136 Header_Cores_TimingMeasure 1 : HED_MAIN_CORE_TIME_INST HED_MAIN_CORE_TIME_PEAK HED_AF_TIME_INST HED_AF_TIME_PEAK HED_RDD_CORE_TIME_INST HED_RDD_CORE_TIME_PEAK HED_SP_CORE_TIME_INST HED_SP_CORE_TIME_PEAK;
SIG_GROUP_ 136 Header_Alignment 1 : HED_HOR_ALIGNMENT_STATUS HED_VER_ALIGNMENT_STATUS HED_VER_ALIGNMENT_STATE HED_HOR_ALIGNMENT_STATE HED_ALIGN_VER_REF HED_ALIGN_VER_QF HED_ALIGN_VER_ANGLE HED_ALIGN_HOR_ANGLE HED_ALIGN_HOR_REF HED_ALIGN_HOR_QF;
SIG_GROUP_ 136 Header_RadarState 1 : HED_DATA_QUALIFIER HED_NUM_OF_VALID_DETECTIONS HED_CAN_SCAN_INDEX HED_LOOK_ID;
SIG_GROUP_ 136 Header_SensorCoverage 1 : HED_FOV_VER_MIN HED_FOV_HOR_MIN HED_DET_SPEED_RANGE_MIN HED_DET_RANGE_MIN HED_FOV_VER_MAX HED_FOV_HOR_MAX HED_DET_SPEED_RANGE_MAX HED_DET_RANGE_MAX;
SIG_GROUP_ 24 XcpCTOReq 1 : STS_XCP_REQ_CTO_Byte63 STS_XCP_REQ_CTO_Byte62 STS_XCP_REQ_CTO_Byte61 STS_XCP_REQ_CTO_Byte60 STS_XCP_REQ_CTO_Byte59 STS_XCP_REQ_CTO_Byte58 STS_XCP_REQ_CTO_Byte57 STS_XCP_REQ_CTO_Byte56 STS_XCP_REQ_CTO_Byte55 STS_XCP_REQ_CTO_Byte54 STS_XCP_REQ_CTO_Byte53 STS_XCP_REQ_CTO_Byte52 STS_XCP_REQ_CTO_Byte51 STS_XCP_REQ_CTO_Byte50 STS_XCP_REQ_CTO_Byte49 STS_XCP_REQ_CTO_Byte48 STS_XCP_REQ_CTO_Byte47 STS_XCP_REQ_CTO_Byte46 STS_XCP_REQ_CTO_Byte45 STS_XCP_REQ_CTO_Byte44 STS_XCP_REQ_CTO_Byte43 STS_XCP_REQ_CTO_Byte42 STS_XCP_REQ_CTO_Byte41 STS_XCP_REQ_CTO_Byte40 STS_XCP_REQ_CTO_Byte39 STS_XCP_REQ_CTO_Byte38 STS_XCP_REQ_CTO_Byte37 STS_XCP_REQ_CTO_Byte36 STS_XCP_REQ_CTO_Byte35 STS_XCP_REQ_CTO_Byte34 STS_XCP_REQ_CTO_Byte33 STS_XCP_REQ_CTO_Byte32 STS_PID STS_XCP_REQ_CTO_Byte1 STS_XCP_REQ_CTO_Byte2 STS_XCP_REQ_CTO_Byte3 STS_XCP_REQ_CTO_Byte4 STS_XCP_REQ_CTO_Byte5 STS_XCP_REQ_CTO_Byte6 STS_XCP_REQ_CTO_Byte7 STS_XCP_REQ_CTO_Byte8 STS_XCP_REQ_CTO_Byte9 STS_XCP_REQ_CTO_Byte10 STS_XCP_REQ_CTO_Byte11 STS_XCP_REQ_CTO_Byte12 STS_XCP_REQ_CTO_Byte13 STS_XCP_REQ_CTO_Byte14 STS_XCP_REQ_CTO_Byte15 STS_XCP_REQ_CTO_Byte16 STS_XCP_REQ_CTO_Byte17 STS_XCP_REQ_CTO_Byte18 STS_XCP_REQ_CTO_Byte19 STS_XCP_REQ_CTO_Byte20 STS_XCP_REQ_CTO_Byte21 STS_XCP_REQ_CTO_Byte22 STS_XCP_REQ_CTO_Byte23 STS_XCP_REQ_CTO_Byte24 STS_XCP_REQ_CTO_Byte25 STS_XCP_REQ_CTO_Byte26 STS_XCP_REQ_CTO_Byte27 STS_XCP_REQ_CTO_Byte28 STS_XCP_REQ_CTO_Byte29 STS_XCP_REQ_CTO_Byte30 STS_XCP_REQ_CTO_Byte31;
SIG_GROUP_ 25 XcpCTOResp 1 : STS_XCP_RES_CTO_Byte63 STS_XCP_RES_CTO_Byte62 STS_XCP_RES_CTO_Byte61 STS_XCP_RES_CTO_Byte60 STS_XCP_RES_CTO_Byte59 STS_XCP_RES_CTO_Byte58 STS_XCP_RES_CTO_Byte57 STS_XCP_RES_CTO_Byte56 STS_XCP_RES_CTO_Byte55 STS_XCP_RES_CTO_Byte54 STS_XCP_RES_CTO_Byte53 STS_XCP_RES_CTO_Byte52 STS_XCP_RES_CTO_Byte51 STS_XCP_RES_CTO_Byte50 STS_XCP_RES_CTO_Byte49 STS_XCP_RES_CTO_Byte48 STS_XCP_RES_CTO_Byte47 STS_XCP_RES_CTO_Byte46 STS_XCP_RES_CTO_Byte45 STS_XCP_RES_CTO_Byte44 STS_XCP_RES_CTO_Byte43 STS_XCP_RES_CTO_Byte42 STS_XCP_RES_CTO_Byte41 STS_XCP_RES_CTO_Byte40 STS_XCP_RES_CTO_Byte39 STS_XCP_RES_CTO_Byte38 STS_XCP_RES_CTO_Byte37 STS_XCP_RES_CTO_Byte36 STS_XCP_RES_CTO_Byte35 STS_XCP_RES_CTO_Byte34 STS_XCP_RES_CTO_Byte33 STS_XCP_RES_CTO_Byte32 STS_XCP_RES_CTO_Byte0 STS_XCP_RES_CTO_Byte1 STS_XCP_RES_CTO_Byte2 STS_XCP_RES_CTO_Byte3 STS_XCP_RES_CTO_Byte4 STS_XCP_RES_CTO_Byte5 STS_XCP_RES_CTO_Byte6 STS_XCP_RES_CTO_Byte7 STS_XCP_RES_CTO_Byte8 STS_XCP_RES_CTO_Byte9 STS_XCP_RES_CTO_Byte10 STS_XCP_RES_CTO_Byte11 STS_XCP_RES_CTO_Byte12 STS_XCP_RES_CTO_Byte13 STS_XCP_RES_CTO_Byte14 STS_XCP_RES_CTO_Byte15 STS_XCP_RES_CTO_Byte16 STS_XCP_RES_CTO_Byte17 STS_XCP_RES_CTO_Byte18 STS_XCP_RES_CTO_Byte19 STS_XCP_RES_CTO_Byte20 STS_XCP_RES_CTO_Byte21 STS_XCP_RES_CTO_Byte22 STS_XCP_RES_CTO_Byte23 STS_XCP_RES_CTO_Byte24 STS_XCP_RES_CTO_Byte25 STS_XCP_RES_CTO_Byte26 STS_XCP_RES_CTO_Byte27 STS_XCP_RES_CTO_Byte28 STS_XCP_RES_CTO_Byte29 STS_XCP_RES_CTO_Byte30 STS_XCP_RES_CTO_Byte31;
SIG_GROUP_ 26 XcpDAQResp 1 : STS_XCP_RES_DAQ_Byte63 STS_XCP_RES_DAQ_Byte62 STS_XCP_RES_DAQ_Byte61 STS_XCP_RES_DAQ_Byte60 STS_XCP_RES_DAQ_Byte59 STS_XCP_RES_DAQ_Byte58 STS_XCP_RES_DAQ_Byte57 STS_XCP_RES_DAQ_Byte56 STS_XCP_RES_DAQ_Byte55 STS_XCP_RES_DAQ_Byte54 STS_XCP_RES_DAQ_Byte53 STS_XCP_RES_DAQ_Byte52 STS_XCP_RES_DAQ_Byte51 STS_XCP_RES_DAQ_Byte50 STS_XCP_RES_DAQ_Byte49 STS_XCP_RES_DAQ_Byte48 STS_XCP_RES_DAQ_Byte47 STS_XCP_RES_DAQ_Byte46 STS_XCP_RES_DAQ_Byte45 STS_XCP_RES_DAQ_Byte44 STS_XCP_RES_DAQ_Byte43 STS_XCP_RES_DAQ_Byte42 STS_XCP_RES_DAQ_Byte41 STS_XCP_RES_DAQ_Byte40 STS_XCP_RES_DAQ_Byte39 STS_XCP_RES_DAQ_Byte38 STS_XCP_RES_DAQ_Byte37 STS_XCP_RES_DAQ_Byte36 STS_XCP_RES_DAQ_Byte35 STS_XCP_RES_DAQ_Byte34 STS_XCP_RES_DAQ_Byte33 STS_XCP_RES_DAQ_Byte32 STS_XCP_RES_DAQ_Byte31 STS_XCP_RES_DAQ_Byte30 STS_XCP_RES_DAQ_Byte29 STS_XCP_RES_DAQ_Byte28 STS_XCP_RES_DAQ_Byte27 STS_XCP_RES_DAQ_Byte26 STS_XCP_RES_DAQ_Byte25 STS_XCP_RES_DAQ_Byte24 STS_XCP_RES_DAQ_Byte23 STS_XCP_RES_DAQ_Byte22 STS_XCP_RES_DAQ_Byte21 STS_XCP_RES_DAQ_Byte20 STS_XCP_RES_DAQ_Byte19 STS_XCP_RES_DAQ_Byte18 STS_XCP_RES_DAQ_Byte17 STS_XCP_RES_DAQ_Byte16 STS_XCP_RES_DAQ_Byte15 STS_XCP_RES_DAQ_Byte14 STS_XCP_RES_DAQ_Byte13 STS_XCP_RES_DAQ_Byte12 STS_XCP_RES_DAQ_Byte11 STS_XCP_RES_DAQ_Byte10 STS_XCP_RES_DAQ_Byte9 STS_XCP_RES_DAQ_Byte8 STS_XCP_RES_DAQ_Byte7 STS_XCP_RES_DAQ_Byte6 STS_XCP_RES_DAQ_Byte5 STS_XCP_RES_DAQ_Byte4 STS_XCP_RES_DAQ_Byte3 STS_XCP_RES_DAQ_Byte2 STS_XCP_RES_DAQ_Byte1 STS_XCP_RES_DAQ_Byte0;
SIG_GROUP_ 448 TrackerObject001 1 : OBJ_ACCEL_ERR_CRR_COEF_001 OBJ_VELOCITY_ERR_CRR_COEF_001 OBJ_POS_ERR_CRR_COEF_001 OBJ_YAW_RATE_001 OBJ_YAW_RATE_ERR_001 OBJ_GROUP_ID_001 OBJ_REF_PT_LAT_OFFSET_001 OBJ_REF_PT_LONG_OFFSET_001 OBJ_RCS_001 OBJ_YAW_ANGLE_ERR_001 OBJ_CLS_TYPE6_001 OBJ_CLS_TYPE6_PROB_001 OBJ_CLS_TYPE5_PROB_001 OBJ_CLS_TYPE5_001 OBJ_CLS_TYPE4_PROB_001 OBJ_CLS_TYPE4_001 OBJ_CLS_TYPE3_PROB_001 OBJ_CLS_TYPE3_001 OBJ_CLS_TYPE2_PROB_001 OBJ_CLS_TYPE2_001 OBJ_DIMENSION_WIDTH_ERR_001 OBJ_DIMENSION_LENGTH_ERR_001 OBJ_TIMESTAMP_OFFSET_001 OBJ_CLS_TYPE1_PROB_001 OBJ_VEH_TRACK_FLAG_001 OBJ_ACCELERATION_LAT_001 OBJ_ACCELERATION_LONG_001 OBJ_VELOCITY_LAT_001 OBJ_VELOCITY_LONG_001 OBJ_POS_LAT_001 OBJ_POS_LONG_001 OBJ_MEASUREMENT_STATUS_001 OBJ_MOVEMENT_STATUS_001 OBJ_CLS_TYPE1_001 OBJ_ID_001 OBJ_YAW_ANGLE_001 OBJ_EXISTENCE_PROB_001 OBJ_DIMENSION_LENGTH_001 OBJ_DIMENSION_WIDTH_001 OBJ_TRACK_MOTION_MODEL_001 OBJ_POS_LAT_ERR_001 OBJ_POS_LONG_ERR_001 OBJ_VELOCITY_LAT_ERR_001 OBJ_VELOCITY_LONG_ERR_001 OBJ_ACCELERATION_LAT_ERR_001 OBJ_ACCELERATION_LONG_ERR_001 OBJ_ALIVE_TIME_001;
SIG_GROUP_ 137 Header_Tracker_Info 1 : HED_TRKR_DATA_QUALIFIER HED_TRKR_NUM_OF_ACTIV_OBJS HED_TRKR_VEH_COORD_TYPE HED_TRKR_OBJLST_TIME_STAMP_NS HED_TRKR_OBJLST_TIME_STAMP_SC HED_TRKR_VEHICLE_IDX HED_TRKR_TIME_INST HED_TRKR_TIME_PEAK HED_TRKR_IDX;
SIG_GROUP_ 143 Status_TrackerVersion 1 : STS_OBJ_DBC_BASE_VER_MAJOR STS_OBJ_DBC_BASE_VER_MINOR STS_PERCEPTION_MODULE_ID STS_TRKR_MAJOR_VERSION STS_TRKR_MINOR_VERSION STS_TRKR_PATCH_VERSION;
SIG_GROUP_ 385 Detection005 1 : DET_BI_STATIC_FLAG_005 DET_AMBG_AZIMUTH_PROB_005 DET_AZIMUTH_AMB_ID_005 DET_CONFD_ELEVATION_005 DET_CONFD_AZIMUTH_005 DET_HVC_FLAG_005 DET_OUTSIDE_SECTOR_005 DET_AZIMUTH_ERR_005 DET_ELEVATION_ERR_005 DET_RANGE_ERR_005 DET_RANGE_VELOCITY_ERR_005 DET_EXISTENCE_PROB_005 DET_POINT_TARGET_PROB_005 DET_SNR_005 DET_SUPER_RES_TARGET_005 DET_VALID_FLAG_005 DET_RCS_005 DET_ELEVATION_005 DET_AZIMUTH_005 DET_RANGE_VELOCITY_005 DET_RANGE_005;
SIG_GROUP_ 385 Detection006 1 : DET_BI_STATIC_FLAG_006 DET_AMBG_AZIMUTH_PROB_006 DET_AZIMUTH_AMB_ID_006 DET_CONFD_ELEVATION_006 DET_CONFD_AZIMUTH_006 DET_HVC_FLAG_006 DET_OUTSIDE_SECTOR_006 DET_AZIMUTH_ERR_006 DET_ELEVATION_ERR_006 DET_RANGE_ERR_006 DET_RANGE_VELOCITY_ERR_006 DET_EXISTENCE_PROB_006 DET_POINT_TARGET_PROB_006 DET_SNR_006 DET_SUPER_RES_TARGET_006 DET_VALID_FLAG_006 DET_RCS_006 DET_ELEVATION_006 DET_AZIMUTH_006 DET_RANGE_VELOCITY_006 DET_RANGE_006;
SIG_GROUP_ 385 Detection007 1 : DET_BI_STATIC_FLAG_007 DET_AMBG_AZIMUTH_PROB_007 DET_AZIMUTH_AMB_ID_007 DET_CONFD_ELEVATION_007 DET_CONFD_AZIMUTH_007 DET_HVC_FLAG_007 DET_OUTSIDE_SECTOR_007 DET_AZIMUTH_ERR_007 DET_ELEVATION_ERR_007 DET_RANGE_ERR_007 DET_RANGE_VELOCITY_ERR_007 DET_EXISTENCE_PROB_007 DET_POINT_TARGET_PROB_007 DET_SNR_007 DET_SUPER_RES_TARGET_007 DET_VALID_FLAG_007 DET_RCS_007 DET_ELEVATION_007 DET_AZIMUTH_007 DET_RANGE_VELOCITY_007 DET_RANGE_007;
SIG_GROUP_ 385 Detection008 1 : DET_BI_STATIC_FLAG_008 DET_AMBG_AZIMUTH_PROB_008 DET_AZIMUTH_AMB_ID_008 DET_CONFD_ELEVATION_008 DET_CONFD_AZIMUTH_008 DET_HVC_FLAG_008 DET_OUTSIDE_SECTOR_008 DET_EXISTENCE_PROB_008 DET_POINT_TARGET_PROB_008 DET_SNR_008 DET_SUPER_RES_TARGET_008 DET_VALID_FLAG_008 DET_RCS_008 DET_ELEVATION_ERR_008 DET_ELEVATION_008 DET_AZIMUTH_ERR_008 DET_AZIMUTH_008 DET_RANGE_VELOCITY_ERR_008 DET_RANGE_VELOCITY_008 DET_RANGE_ERR_008 DET_RANGE_008;
SIG_GROUP_ 386 Detection009 1 : DET_BI_STATIC_FLAG_009 DET_AMBG_AZIMUTH_PROB_009 DET_AZIMUTH_AMB_ID_009 DET_CONFD_ELEVATION_009 DET_CONFD_AZIMUTH_009 DET_HVC_FLAG_009 DET_OUTSIDE_SECTOR_009 DET_AZIMUTH_ERR_009 DET_ELEVATION_ERR_009 DET_RANGE_ERR_009 DET_RANGE_VELOCITY_ERR_009 DET_EXISTENCE_PROB_009 DET_POINT_TARGET_PROB_009 DET_SNR_009 DET_SUPER_RES_TARGET_009 DET_VALID_FLAG_009 DET_RCS_009 DET_ELEVATION_009 DET_AZIMUTH_009 DET_RANGE_VELOCITY_009 DET_RANGE_009;
SIG_GROUP_ 386 Detection010 1 : DET_BI_STATIC_FLAG_010 DET_AMBG_AZIMUTH_PROB_010 DET_AZIMUTH_AMB_ID_010 DET_CONFD_ELEVATION_010 DET_CONFD_AZIMUTH_010 DET_HVC_FLAG_010 DET_OUTSIDE_SECTOR_010 DET_AZIMUTH_ERR_010 DET_ELEVATION_ERR_010 DET_RANGE_ERR_010 DET_RANGE_VELOCITY_ERR_010 DET_EXISTENCE_PROB_010 DET_POINT_TARGET_PROB_010 DET_SNR_010 DET_SUPER_RES_TARGET_010 DET_VALID_FLAG_010 DET_RCS_010 DET_ELEVATION_010 DET_AZIMUTH_010 DET_RANGE_VELOCITY_010 DET_RANGE_010;
SIG_GROUP_ 386 Detection011 1 : DET_BI_STATIC_FLAG_011 DET_AMBG_AZIMUTH_PROB_011 DET_AZIMUTH_AMB_ID_011 DET_CONFD_ELEVATION_011 DET_CONFD_AZIMUTH_011 DET_HVC_FLAG_011 DET_OUTSIDE_SECTOR_011 DET_AZIMUTH_ERR_011 DET_ELEVATION_ERR_011 DET_RANGE_ERR_011 DET_RANGE_VELOCITY_ERR_011 DET_EXISTENCE_PROB_011 DET_POINT_TARGET_PROB_011 DET_SNR_011 DET_SUPER_RES_TARGET_011 DET_VALID_FLAG_011 DET_RCS_011 DET_ELEVATION_011 DET_AZIMUTH_011 DET_RANGE_VELOCITY_011 DET_RANGE_011;
SIG_GROUP_ 386 Detection012 1 : DET_BI_STATIC_FLAG_012 DET_AMBG_AZIMUTH_PROB_012 DET_AZIMUTH_AMB_ID_012 DET_CONFD_ELEVATION_012 DET_CONFD_AZIMUTH_012 DET_HVC_FLAG_012 DET_OUTSIDE_SECTOR_012 DET_EXISTENCE_PROB_012 DET_POINT_TARGET_PROB_012 DET_SNR_012 DET_SUPER_RES_TARGET_012 DET_VALID_FLAG_012 DET_RCS_012 DET_ELEVATION_ERR_012 DET_ELEVATION_012 DET_AZIMUTH_ERR_012 DET_AZIMUTH_012 DET_RANGE_VELOCITY_ERR_012 DET_RANGE_VELOCITY_012 DET_RANGE_ERR_012 DET_RANGE_012;
SIG_GROUP_ 387 Detection013 1 : DET_BI_STATIC_FLAG_013 DET_AMBG_AZIMUTH_PROB_013 DET_AZIMUTH_AMB_ID_013 DET_CONFD_ELEVATION_013 DET_CONFD_AZIMUTH_013 DET_HVC_FLAG_013 DET_OUTSIDE_SECTOR_013 DET_AZIMUTH_ERR_013 DET_ELEVATION_ERR_013 DET_RANGE_ERR_013 DET_RANGE_VELOCITY_ERR_013 DET_EXISTENCE_PROB_013 DET_POINT_TARGET_PROB_013 DET_SNR_013 DET_SUPER_RES_TARGET_013 DET_VALID_FLAG_013 DET_RCS_013 DET_ELEVATION_013 DET_AZIMUTH_013 DET_RANGE_VELOCITY_013 DET_RANGE_013;
SIG_GROUP_ 387 Detection014 1 : DET_BI_STATIC_FLAG_014 DET_AMBG_AZIMUTH_PROB_014 DET_AZIMUTH_AMB_ID_014 DET_CONFD_ELEVATION_014 DET_CONFD_AZIMUTH_014 DET_HVC_FLAG_014 DET_OUTSIDE_SECTOR_014 DET_AZIMUTH_ERR_014 DET_ELEVATION_ERR_014 DET_RANGE_ERR_014 DET_RANGE_VELOCITY_ERR_014 DET_EXISTENCE_PROB_014 DET_POINT_TARGET_PROB_014 DET_SNR_014 DET_SUPER_RES_TARGET_014 DET_VALID_FLAG_014 DET_RCS_014 DET_ELEVATION_014 DET_AZIMUTH_014 DET_RANGE_VELOCITY_014 DET_RANGE_014;
SIG_GROUP_ 387 Detection015 1 : DET_BI_STATIC_FLAG_015 DET_AMBG_AZIMUTH_PROB_015 DET_AZIMUTH_AMB_ID_015 DET_CONFD_ELEVATION_015 DET_CONFD_AZIMUTH_015 DET_HVC_FLAG_015 DET_OUTSIDE_SECTOR_015 DET_AZIMUTH_ERR_015 DET_ELEVATION_ERR_015 DET_RANGE_ERR_015 DET_RANGE_VELOCITY_ERR_015 DET_EXISTENCE_PROB_015 DET_POINT_TARGET_PROB_015 DET_SNR_015 DET_SUPER_RES_TARGET_015 DET_VALID_FLAG_015 DET_RCS_015 DET_ELEVATION_015 DET_AZIMUTH_015 DET_RANGE_VELOCITY_015 DET_RANGE_015;
SIG_GROUP_ 387 Detection016 1 : DET_BI_STATIC_FLAG_016 DET_AMBG_AZIMUTH_PROB_016 DET_AZIMUTH_AMB_ID_016 DET_CONFD_ELEVATION_016 DET_CONFD_AZIMUTH_016 DET_HVC_FLAG_016 DET_OUTSIDE_SECTOR_016 DET_EXISTENCE_PROB_016 DET_POINT_TARGET_PROB_016 DET_SNR_016 DET_SUPER_RES_TARGET_016 DET_VALID_FLAG_016 DET_RCS_016 DET_ELEVATION_ERR_016 DET_ELEVATION_016 DET_AZIMUTH_ERR_016 DET_AZIMUTH_016 DET_RANGE_VELOCITY_ERR_016 DET_RANGE_VELOCITY_016 DET_RANGE_ERR_016 DET_RANGE_016;
SIG_GROUP_ 388 Detection017 1 : DET_BI_STATIC_FLAG_017 DET_AMBG_AZIMUTH_PROB_017 DET_AZIMUTH_AMB_ID_017 DET_CONFD_ELEVATION_017 DET_CONFD_AZIMUTH_017 DET_HVC_FLAG_017 DET_OUTSIDE_SECTOR_017 DET_AZIMUTH_ERR_017 DET_ELEVATION_ERR_017 DET_RANGE_ERR_017 DET_RANGE_VELOCITY_ERR_017 DET_EXISTENCE_PROB_017 DET_POINT_TARGET_PROB_017 DET_SNR_017 DET_SUPER_RES_TARGET_017 DET_VALID_FLAG_017 DET_RCS_017 DET_ELEVATION_017 DET_AZIMUTH_017 DET_RANGE_VELOCITY_017 DET_RANGE_017;
SIG_GROUP_ 388 Detection018 1 : DET_BI_STATIC_FLAG_018 DET_AMBG_AZIMUTH_PROB_018 DET_AZIMUTH_AMB_ID_018 DET_CONFD_ELEVATION_018 DET_CONFD_AZIMUTH_018 DET_HVC_FLAG_018 DET_OUTSIDE_SECTOR_018 DET_AZIMUTH_ERR_018 DET_ELEVATION_ERR_018 DET_RANGE_ERR_018 DET_RANGE_VELOCITY_ERR_018 DET_EXISTENCE_PROB_018 DET_POINT_TARGET_PROB_018 DET_SNR_018 DET_SUPER_RES_TARGET_018 DET_VALID_FLAG_018 DET_RCS_018 DET_ELEVATION_018 DET_AZIMUTH_018 DET_RANGE_VELOCITY_018 DET_RANGE_018;
SIG_GROUP_ 388 Detection019 1 : DET_BI_STATIC_FLAG_019 DET_AMBG_AZIMUTH_PROB_019 DET_AZIMUTH_AMB_ID_019 DET_CONFD_ELEVATION_019 DET_CONFD_AZIMUTH_019 DET_HVC_FLAG_019 DET_OUTSIDE_SECTOR_019 DET_AZIMUTH_ERR_019 DET_ELEVATION_ERR_019 DET_RANGE_ERR_019 DET_RANGE_VELOCITY_ERR_019 DET_EXISTENCE_PROB_019 DET_POINT_TARGET_PROB_019 DET_SNR_019 DET_SUPER_RES_TARGET_019 DET_VALID_FLAG_019 DET_RCS_019 DET_ELEVATION_019 DET_AZIMUTH_019 DET_RANGE_VELOCITY_019 DET_RANGE_019;
SIG_GROUP_ 388 Detection020 1 : DET_BI_STATIC_FLAG_020 DET_AMBG_AZIMUTH_PROB_020 DET_AZIMUTH_AMB_ID_020 DET_CONFD_ELEVATION_020 DET_CONFD_AZIMUTH_020 DET_HVC_FLAG_020 DET_OUTSIDE_SECTOR_020 DET_EXISTENCE_PROB_020 DET_POINT_TARGET_PROB_020 DET_SNR_020 DET_SUPER_RES_TARGET_020 DET_VALID_FLAG_020 DET_RCS_020 DET_ELEVATION_ERR_020 DET_ELEVATION_020 DET_AZIMUTH_ERR_020 DET_AZIMUTH_020 DET_RANGE_VELOCITY_ERR_020 DET_RANGE_VELOCITY_020 DET_RANGE_ERR_020 DET_RANGE_020;
SIG_GROUP_ 389 Detection021 1 : DET_BI_STATIC_FLAG_021 DET_AMBG_AZIMUTH_PROB_021 DET_AZIMUTH_AMB_ID_021 DET_CONFD_ELEVATION_021 DET_CONFD_AZIMUTH_021 DET_HVC_FLAG_021 DET_OUTSIDE_SECTOR_021 DET_AZIMUTH_ERR_021 DET_ELEVATION_ERR_021 DET_RANGE_ERR_021 DET_RANGE_VELOCITY_ERR_021 DET_EXISTENCE_PROB_021 DET_POINT_TARGET_PROB_021 DET_SNR_021 DET_SUPER_RES_TARGET_021 DET_VALID_FLAG_021 DET_RCS_021 DET_ELEVATION_021 DET_AZIMUTH_021 DET_RANGE_VELOCITY_021 DET_RANGE_021;
SIG_GROUP_ 389 Detection022 1 : DET_BI_STATIC_FLAG_022 DET_AMBG_AZIMUTH_PROB_022 DET_AZIMUTH_AMB_ID_022 DET_CONFD_ELEVATION_022 DET_CONFD_AZIMUTH_022 DET_HVC_FLAG_022 DET_OUTSIDE_SECTOR_022 DET_AZIMUTH_ERR_022 DET_ELEVATION_ERR_022 DET_RANGE_ERR_022 DET_RANGE_VELOCITY_ERR_022 DET_EXISTENCE_PROB_022 DET_POINT_TARGET_PROB_022 DET_SNR_022 DET_SUPER_RES_TARGET_022 DET_VALID_FLAG_022 DET_RCS_022 DET_ELEVATION_022 DET_AZIMUTH_022 DET_RANGE_VELOCITY_022 DET_RANGE_022;
SIG_GROUP_ 389 Detection023 1 : DET_BI_STATIC_FLAG_023 DET_AMBG_AZIMUTH_PROB_023 DET_AZIMUTH_AMB_ID_023 DET_CONFD_ELEVATION_023 DET_CONFD_AZIMUTH_023 DET_HVC_FLAG_023 DET_OUTSIDE_SECTOR_023 DET_AZIMUTH_ERR_023 DET_ELEVATION_ERR_023 DET_RANGE_ERR_023 DET_RANGE_VELOCITY_ERR_023 DET_EXISTENCE_PROB_023 DET_POINT_TARGET_PROB_023 DET_SNR_023 DET_SUPER_RES_TARGET_023 DET_VALID_FLAG_023 DET_RCS_023 DET_ELEVATION_023 DET_AZIMUTH_023 DET_RANGE_VELOCITY_023 DET_RANGE_023;
SIG_GROUP_ 389 Detection024 1 : DET_BI_STATIC_FLAG_024 DET_AMBG_AZIMUTH_PROB_024 DET_AZIMUTH_AMB_ID_024 DET_CONFD_ELEVATION_024 DET_CONFD_AZIMUTH_024 DET_HVC_FLAG_024 DET_OUTSIDE_SECTOR_024 DET_EXISTENCE_PROB_024 DET_POINT_TARGET_PROB_024 DET_SNR_024 DET_SUPER_RES_TARGET_024 DET_VALID_FLAG_024 DET_RCS_024 DET_ELEVATION_ERR_024 DET_ELEVATION_024 DET_AZIMUTH_ERR_024 DET_AZIMUTH_024 DET_RANGE_VELOCITY_ERR_024 DET_RANGE_VELOCITY_024 DET_RANGE_ERR_024 DET_RANGE_024;
SIG_GROUP_ 390 Detection025 1 : DET_BI_STATIC_FLAG_025 DET_AMBG_AZIMUTH_PROB_025 DET_AZIMUTH_AMB_ID_025 DET_CONFD_ELEVATION_025 DET_CONFD_AZIMUTH_025 DET_HVC_FLAG_025 DET_OUTSIDE_SECTOR_025 DET_AZIMUTH_ERR_025 DET_ELEVATION_ERR_025 DET_RANGE_ERR_025 DET_RANGE_VELOCITY_ERR_025 DET_EXISTENCE_PROB_025 DET_POINT_TARGET_PROB_025 DET_SNR_025 DET_SUPER_RES_TARGET_025 DET_VALID_FLAG_025 DET_RCS_025 DET_ELEVATION_025 DET_AZIMUTH_025 DET_RANGE_VELOCITY_025 DET_RANGE_025;
SIG_GROUP_ 390 Detection026 1 : DET_BI_STATIC_FLAG_026 DET_AMBG_AZIMUTH_PROB_026 DET_AZIMUTH_AMB_ID_026 DET_CONFD_ELEVATION_026 DET_CONFD_AZIMUTH_026 DET_HVC_FLAG_026 DET_OUTSIDE_SECTOR_026 DET_AZIMUTH_ERR_026 DET_ELEVATION_ERR_026 DET_RANGE_ERR_026 DET_RANGE_VELOCITY_ERR_026 DET_EXISTENCE_PROB_026 DET_POINT_TARGET_PROB_026 DET_SNR_026 DET_SUPER_RES_TARGET_026 DET_VALID_FLAG_026 DET_RCS_026 DET_ELEVATION_026 DET_AZIMUTH_026 DET_RANGE_VELOCITY_026 DET_RANGE_026;
SIG_GROUP_ 390 Detection027 1 : DET_BI_STATIC_FLAG_027 DET_AMBG_AZIMUTH_PROB_027 DET_AZIMUTH_AMB_ID_027 DET_CONFD_ELEVATION_027 DET_CONFD_AZIMUTH_027 DET_HVC_FLAG_027 DET_OUTSIDE_SECTOR_027 DET_AZIMUTH_ERR_027 DET_ELEVATION_ERR_027 DET_RANGE_ERR_027 DET_RANGE_VELOCITY_ERR_027 DET_EXISTENCE_PROB_027 DET_POINT_TARGET_PROB_027 DET_SNR_027 DET_SUPER_RES_TARGET_027 DET_VALID_FLAG_027 DET_RCS_027 DET_ELEVATION_027 DET_AZIMUTH_027 DET_RANGE_VELOCITY_027 DET_RANGE_027;
SIG_GROUP_ 390 Detection028 1 : DET_BI_STATIC_FLAG_028 DET_AMBG_AZIMUTH_PROB_028 DET_AZIMUTH_AMB_ID_028 DET_CONFD_ELEVATION_028 DET_CONFD_AZIMUTH_028 DET_HVC_FLAG_028 DET_OUTSIDE_SECTOR_028 DET_EXISTENCE_PROB_028 DET_POINT_TARGET_PROB_028 DET_SNR_028 DET_SUPER_RES_TARGET_028 DET_VALID_FLAG_028 DET_RCS_028 DET_ELEVATION_ERR_028 DET_ELEVATION_028 DET_AZIMUTH_ERR_028 DET_AZIMUTH_028 DET_RANGE_VELOCITY_ERR_028 DET_RANGE_VELOCITY_028 DET_RANGE_ERR_028 DET_RANGE_028;
SIG_GROUP_ 391 Detection029 1 : DET_BI_STATIC_FLAG_029 DET_AMBG_AZIMUTH_PROB_029 DET_AZIMUTH_AMB_ID_029 DET_CONFD_ELEVATION_029 DET_CONFD_AZIMUTH_029 DET_HVC_FLAG_029 DET_OUTSIDE_SECTOR_029 DET_AZIMUTH_ERR_029 DET_ELEVATION_ERR_029 DET_RANGE_ERR_029 DET_RANGE_VELOCITY_ERR_029 DET_EXISTENCE_PROB_029 DET_POINT_TARGET_PROB_029 DET_SNR_029 DET_SUPER_RES_TARGET_029 DET_VALID_FLAG_029 DET_RCS_029 DET_ELEVATION_029 DET_AZIMUTH_029 DET_RANGE_VELOCITY_029 DET_RANGE_029;
SIG_GROUP_ 391 Detection030 1 : DET_BI_STATIC_FLAG_030 DET_AMBG_AZIMUTH_PROB_030 DET_AZIMUTH_AMB_ID_030 DET_CONFD_ELEVATION_030 DET_CONFD_AZIMUTH_030 DET_HVC_FLAG_030 DET_OUTSIDE_SECTOR_030 DET_AZIMUTH_ERR_030 DET_ELEVATION_ERR_030 DET_RANGE_ERR_030 DET_RANGE_VELOCITY_ERR_030 DET_EXISTENCE_PROB_030 DET_POINT_TARGET_PROB_030 DET_SNR_030 DET_SUPER_RES_TARGET_030 DET_VALID_FLAG_030 DET_RCS_030 DET_ELEVATION_030 DET_AZIMUTH_030 DET_RANGE_VELOCITY_030 DET_RANGE_030;
SIG_GROUP_ 391 Detection031 1 : DET_BI_STATIC_FLAG_031 DET_AMBG_AZIMUTH_PROB_031 DET_AZIMUTH_AMB_ID_031 DET_CONFD_ELEVATION_031 DET_CONFD_AZIMUTH_031 DET_HVC_FLAG_031 DET_OUTSIDE_SECTOR_031 DET_AZIMUTH_ERR_031 DET_ELEVATION_ERR_031 DET_RANGE_ERR_031 DET_RANGE_VELOCITY_ERR_031 DET_EXISTENCE_PROB_031 DET_POINT_TARGET_PROB_031 DET_SNR_031 DET_SUPER_RES_TARGET_031 DET_VALID_FLAG_031 DET_RCS_031 DET_ELEVATION_031 DET_AZIMUTH_031 DET_RANGE_VELOCITY_031 DET_RANGE_031;
SIG_GROUP_ 391 Detection032 1 : DET_BI_STATIC_FLAG_032 DET_AMBG_AZIMUTH_PROB_032 DET_AZIMUTH_AMB_ID_032 DET_CONFD_ELEVATION_032 DET_CONFD_AZIMUTH_032 DET_HVC_FLAG_032 DET_OUTSIDE_SECTOR_032 DET_EXISTENCE_PROB_032 DET_POINT_TARGET_PROB_032 DET_SNR_032 DET_SUPER_RES_TARGET_032 DET_VALID_FLAG_032 DET_RCS_032 DET_ELEVATION_ERR_032 DET_ELEVATION_032 DET_AZIMUTH_ERR_032 DET_AZIMUTH_032 DET_RANGE_VELOCITY_ERR_032 DET_RANGE_VELOCITY_032 DET_RANGE_ERR_032 DET_RANGE_032;
SIG_GROUP_ 392 Detection033 1 : DET_BI_STATIC_FLAG_033 DET_AMBG_AZIMUTH_PROB_033 DET_AZIMUTH_AMB_ID_033 DET_CONFD_ELEVATION_033 DET_CONFD_AZIMUTH_033 DET_HVC_FLAG_033 DET_OUTSIDE_SECTOR_033 DET_AZIMUTH_ERR_033 DET_ELEVATION_ERR_033 DET_RANGE_ERR_033 DET_RANGE_VELOCITY_ERR_033 DET_EXISTENCE_PROB_033 DET_POINT_TARGET_PROB_033 DET_SNR_033 DET_SUPER_RES_TARGET_033 DET_VALID_FLAG_033 DET_RCS_033 DET_ELEVATION_033 DET_AZIMUTH_033 DET_RANGE_VELOCITY_033 DET_RANGE_033;
SIG_GROUP_ 392 Detection034 1 : DET_BI_STATIC_FLAG_034 DET_AMBG_AZIMUTH_PROB_034 DET_AZIMUTH_AMB_ID_034 DET_CONFD_ELEVATION_034 DET_CONFD_AZIMUTH_034 DET_HVC_FLAG_034 DET_OUTSIDE_SECTOR_034 DET_AZIMUTH_ERR_034 DET_ELEVATION_ERR_034 DET_RANGE_ERR_034 DET_RANGE_VELOCITY_ERR_034 DET_EXISTENCE_PROB_034 DET_POINT_TARGET_PROB_034 DET_SNR_034 DET_SUPER_RES_TARGET_034 DET_VALID_FLAG_034 DET_RCS_034 DET_ELEVATION_034 DET_AZIMUTH_034 DET_RANGE_VELOCITY_034 DET_RANGE_034;
SIG_GROUP_ 392 Detection035 1 : DET_BI_STATIC_FLAG_035 DET_AMBG_AZIMUTH_PROB_035 DET_AZIMUTH_AMB_ID_035 DET_CONFD_ELEVATION_035 DET_CONFD_AZIMUTH_035 DET_HVC_FLAG_035 DET_OUTSIDE_SECTOR_035 DET_AZIMUTH_ERR_035 DET_ELEVATION_ERR_035 DET_RANGE_ERR_035 DET_RANGE_VELOCITY_ERR_035 DET_EXISTENCE_PROB_035 DET_POINT_TARGET_PROB_035 DET_SNR_035 DET_SUPER_RES_TARGET_035 DET_VALID_FLAG_035 DET_RCS_035 DET_ELEVATION_035 DET_AZIMUTH_035 DET_RANGE_VELOCITY_035 DET_RANGE_035;
SIG_GROUP_ 392 Detection036 1 : DET_BI_STATIC_FLAG_036 DET_AMBG_AZIMUTH_PROB_036 DET_AZIMUTH_AMB_ID_036 DET_CONFD_ELEVATION_036 DET_CONFD_AZIMUTH_036 DET_HVC_FLAG_036 DET_OUTSIDE_SECTOR_036 DET_EXISTENCE_PROB_036 DET_POINT_TARGET_PROB_036 DET_SNR_036 DET_SUPER_RES_TARGET_036 DET_VALID_FLAG_036 DET_RCS_036 DET_ELEVATION_ERR_036 DET_ELEVATION_036 DET_AZIMUTH_ERR_036 DET_AZIMUTH_036 DET_RANGE_VELOCITY_ERR_036 DET_RANGE_VELOCITY_036 DET_RANGE_ERR_036 DET_RANGE_036;

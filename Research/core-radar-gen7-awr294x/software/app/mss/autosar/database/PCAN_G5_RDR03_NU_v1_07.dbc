VERSION "created by canmatrix"

NS_ :

BS_:

BU_: External_Tool ASDM G5_RDR03

BO_ 538 RDR_DETECTION_105_108: 64 G5_RDR03
 SG_ DET_RANGE_105 : 7|15@0+ (0.015625,0) [0|500] "m" ASDM
 SG_ DET_RANGE_ERR_105 : 8|7@0+ (0.0075,0) [0|0.9525] "m" ASDM
 SG_ DET_RANGE_VELOCITY_105 : 17|15@0+ (0.0078125,-128) [-128|127.9921875] "m/s" ASDM
 SG_ DET_RANGE_VELOCITY_ERR_105 : 34|8@0+ (0.003,0) [0|0.765] "m/s" ASDM
 SG_ DET_AZIMUTH_105 : 60|13@0+ (0.0004,-1.5708) [-1.5708|1.5708] "rad" ASDM
 SG_ DET_AZIMUTH_ERR_105 : 78|7@0+ (0.00087267,0) [0|0.11082909] "rad" ASDM
 SG_ DET_ELEVATION_105 : 42|8@0+ (0.00275,-0.34925) [-0.34925|0.34925] "rad" ASDM
 SG_ DET_ELEVATION_ERR_105 : 50|6@0+ (0.00174533,0) [0|0.10995579] "rad" ASDM
 SG_ DET_RCS_105 : 119|8@0+ (0.5,-64) [-64|63.5] "dBsm" ASDM
 SG_ DET_VALID_FLAG_105 : 100|1@0+ (1,0) [0|1] "" ASDM
 SG_ DET_BI_STATIC_FLAG_105 : 487|1@0+ (1,0) [0|1] "" ASDM
 SG_ DET_SUPER_RES_TARGET_105 : 79|1@0+ (1,0) [0|1] "" ASDM
 SG_ DET_SNR_105 : 111|8@0+ (0.35156,0) [0|89.6478] "dB" ASDM
 SG_ DET_POINT_TARGET_PROB_105 : 95|4@0+ (6.67,0) [0|100] "%" ASDM
 SG_ DET_EXISTENCE_PROB_105 : 91|6@0+ (1.588,0) [0|100] "%" ASDM
 SG_ DET_OUTSIDE_SECTOR_105 : 101|1@0+ (1,0) [0|1] "" ASDM
 SG_ DET_HVC_FLAG_105 : 87|1@0+ (1,0) [0|1] "" ASDM
 SG_ DET_CONFD_AZIMUTH_105 : 97|2@0+ (1,0) [0|3] "" ASDM
 SG_ DET_CONFD_ELEVATION_105 : 99|2@0+ (1,0) [0|3] "" ASDM
 SG_ DET_AZIMUTH_AMB_ID_105 : 82|3@0+ (1,0) [0|7] "" ASDM
 SG_ DET_AMBG_AZIMUTH_PROB_105 : 86|4@0+ (6.67,0) [0|100] "%" ASDM
 SG_ DET_RANGE_106 : 127|15@0+ (0.015625,0) [0|500] "m" ASDM
 SG_ DET_RANGE_ERR_106 : 128|7@0+ (0.0075,0) [0|0.9525] "m" ASDM
 SG_ DET_RANGE_VELOCITY_106 : 137|15@0+ (0.0078125,-128) [-128|127.9921875] "m/s" ASDM
 SG_ DET_RANGE_VELOCITY_ERR_106 : 154|8@0+ (0.003,0) [0|0.765] "m/s" ASDM
 SG_ DET_AZIMUTH_106 : 180|13@0+ (0.0004,-1.5708) [-1.5708|1.5708] "rad" ASDM
 SG_ DET_AZIMUTH_ERR_106 : 198|7@0+ (0.00087267,0) [0|0.11082909] "rad" ASDM
 SG_ DET_ELEVATION_106 : 162|8@0+ (0.00275,-0.34925) [-0.34925|0.34925] "rad" ASDM
 SG_ DET_ELEVATION_ERR_106 : 170|6@0+ (0.00174533,0) [0|0.10995579] "rad" ASDM
 SG_ DET_RCS_106 : 239|8@0+ (0.5,-64) [-64|63.5] "dBsm" ASDM
 SG_ DET_VALID_FLAG_106 : 220|1@0+ (1,0) [0|1] "" ASDM
 SG_ DET_BI_STATIC_FLAG_106 : 486|1@0+ (1,0) [0|1] "" ASDM
 SG_ DET_SUPER_RES_TARGET_106 : 199|1@0+ (1,0) [0|1] "" ASDM
 SG_ DET_SNR_106 : 231|8@0+ (0.35156,0) [0|89.6478] "dB" ASDM
 SG_ DET_POINT_TARGET_PROB_106 : 215|4@0+ (6.67,0) [0|100] "%" ASDM
 SG_ DET_EXISTENCE_PROB_106 : 211|6@0+ (1.588,0) [0|100] "%" ASDM
 SG_ DET_OUTSIDE_SECTOR_106 : 221|1@0+ (1,0) [0|1] "" ASDM
 SG_ DET_HVC_FLAG_106 : 207|1@0+ (1,0) [0|1] "" ASDM
 SG_ DET_CONFD_AZIMUTH_106 : 217|2@0+ (1,0) [0|3] "" ASDM
 SG_ DET_CONFD_ELEVATION_106 : 219|2@0+ (1,0) [0|3] "" ASDM
 SG_ DET_AZIMUTH_AMB_ID_106 : 202|3@0+ (1,0) [0|7] "" ASDM
 SG_ DET_AMBG_AZIMUTH_PROB_106 : 206|4@0+ (6.67,0) [0|100] "%" ASDM
 SG_ DET_RANGE_107 : 247|15@0+ (0.015625,0) [0|500] "m" ASDM
 SG_ DET_RANGE_ERR_107 : 248|7@0+ (0.0075,0) [0|0.9525] "m" ASDM
 SG_ DET_RANGE_VELOCITY_107 : 257|15@0+ (0.0078125,-128) [-128|127.9921875] "m/s" ASDM
 SG_ DET_RANGE_VELOCITY_ERR_107 : 274|8@0+ (0.003,0) [0|0.765] "m/s" ASDM
 SG_ DET_AZIMUTH_107 : 300|13@0+ (0.0004,-1.5708) [-1.5708|1.5708] "rad" ASDM
 SG_ DET_AZIMUTH_ERR_107 : 318|7@0+ (0.00087267,0) [0|0.11082909] "rad" ASDM
 SG_ DET_ELEVATION_107 : 282|8@0+ (0.00275,-0.34925) [-0.34925|0.34925] "rad" ASDM
 SG_ DET_ELEVATION_ERR_107 : 290|6@0+ (0.00174533,0) [0|0.10995579] "rad" ASDM
 SG_ DET_RCS_107 : 359|8@0+ (0.5,-64) [-64|63.5] "dBsm" ASDM
 SG_ DET_VALID_FLAG_107 : 340|1@0+ (1,0) [0|1] "" ASDM
 SG_ DET_BI_STATIC_FLAG_107 : 485|1@0+ (1,0) [0|1] "" ASDM
 SG_ DET_SUPER_RES_TARGET_107 : 319|1@0+ (1,0) [0|1] "" ASDM
 SG_ DET_SNR_107 : 351|8@0+ (0.35156,0) [0|89.6478] "dB" ASDM
 SG_ DET_POINT_TARGET_PROB_107 : 335|4@0+ (6.67,0) [0|100] "%" ASDM
 SG_ DET_EXISTENCE_PROB_107 : 331|6@0+ (1.588,0) [0|100] "%" ASDM
 SG_ DET_OUTSIDE_SECTOR_107 : 341|1@0+ (1,0) [0|1] "" ASDM
 SG_ DET_HVC_FLAG_107 : 327|1@0+ (1,0) [0|1] "" ASDM
 SG_ DET_CONFD_AZIMUTH_107 : 337|2@0+ (1,0) [0|3] "" ASDM
 SG_ DET_CONFD_ELEVATION_107 : 339|2@0+ (1,0) [0|3] "" ASDM
 SG_ DET_AZIMUTH_AMB_ID_107 : 322|3@0+ (1,0) [0|7] "" ASDM
 SG_ DET_AMBG_AZIMUTH_PROB_107 : 326|4@0+ (6.67,0) [0|100] "%" ASDM
 SG_ DET_RANGE_108 : 367|15@0+ (0.015625,0) [0|500] "m" ASDM
 SG_ DET_RANGE_ERR_108 : 368|7@0+ (0.0075,0) [0|0.9525] "m" ASDM
 SG_ DET_RANGE_VELOCITY_108 : 377|15@0+ (0.0078125,-128) [-128|127.9921875] "m/s" ASDM
 SG_ DET_RANGE_VELOCITY_ERR_108 : 394|8@0+ (0.003,0) [0|0.765] "m/s" ASDM
 SG_ DET_AZIMUTH_108 : 420|13@0+ (0.0004,-1.5708) [-1.5708|1.5708] "rad" ASDM
 SG_ DET_AZIMUTH_ERR_108 : 438|7@0+ (0.00087267,0) [0|0.11082909] "rad" ASDM
 SG_ DET_ELEVATION_108 : 402|8@0+ (0.00275,-0.34925) [-0.34925|0.34925] "rad" ASDM
 SG_ DET_ELEVATION_ERR_108 : 410|6@0+ (0.00174533,0) [0|0.10995579] "rad" ASDM
 SG_ DET_RCS_108 : 479|8@0+ (0.5,-64) [-64|63.5] "dBsm" ASDM
 SG_ DET_VALID_FLAG_108 : 460|1@0+ (1,0) [0|1] "" ASDM
 SG_ DET_BI_STATIC_FLAG_108 : 484|1@0+ (1,0) [0|1] "" ASDM
 SG_ DET_SUPER_RES_TARGET_108 : 439|1@0+ (1,0) [0|1] "" ASDM
 SG_ DET_SNR_108 : 471|8@0+ (0.35156,0) [0|89.6478] "dB" ASDM
 SG_ DET_POINT_TARGET_PROB_108 : 455|4@0+ (6.67,0) [0|100] "%" ASDM
 SG_ DET_EXISTENCE_PROB_108 : 451|6@0+ (1.588,0) [0|100] "%" ASDM
 SG_ DET_OUTSIDE_SECTOR_108 : 461|1@0+ (1,0) [0|1] "" ASDM
 SG_ DET_HVC_FLAG_108 : 447|1@0+ (1,0) [0|1] "" ASDM
 SG_ DET_CONFD_AZIMUTH_108 : 457|2@0+ (1,0) [0|3] "" ASDM
 SG_ DET_CONFD_ELEVATION_108 : 459|2@0+ (1,0) [0|3] "" ASDM
 SG_ DET_AZIMUTH_AMB_ID_108 : 442|3@0+ (1,0) [0|7] "" ASDM
 SG_ DET_AMBG_AZIMUTH_PROB_108 : 446|4@0+ (6.67,0) [0|100] "%" ASDM
 SG_ DET_MH_SCAN_INDEX_4LSB_105_108 : 483|4@0+ (1,0) [0|15] "" ASDM
 SG_ DET_MH_CYCLE_COUNTER_105_108 : 495|8@0+ (1,0) [0|255] "" ASDM
 SG_ DET_MH_CRC16_105_108 : 503|16@0+ (1,0) [0|65535] "" ASDM

BO_ 539 RDR_DETECTION_109_112: 64 G5_RDR03
 SG_ DET_RANGE_109 : 7|15@0+ (0.015625,0) [0|500] "m" ASDM
 SG_ DET_RANGE_ERR_109 : 8|7@0+ (0.0075,0) [0|0.9525] "m" ASDM
 SG_ DET_RANGE_VELOCITY_109 : 17|15@0+ (0.0078125,-128) [-128|127.9921875] "m/s" ASDM
 SG_ DET_RANGE_VELOCITY_ERR_109 : 34|8@0+ (0.003,0) [0|0.765] "m/s" ASDM
 SG_ DET_AZIMUTH_109 : 60|13@0+ (0.0004,-1.5708) [-1.5708|1.5708] "rad" ASDM
 SG_ DET_AZIMUTH_ERR_109 : 78|7@0+ (0.00087267,0) [0|0.11082909] "rad" ASDM
 SG_ DET_ELEVATION_109 : 42|8@0+ (0.00275,-0.34925) [-0.34925|0.34925] "rad" ASDM
 SG_ DET_ELEVATION_ERR_109 : 50|6@0+ (0.00174533,0) [0|0.10995579] "rad" ASDM
 SG_ DET_RCS_109 : 119|8@0+ (0.5,-64) [-64|63.5] "dBsm" ASDM
 SG_ DET_VALID_FLAG_109 : 100|1@0+ (1,0) [0|1] "" ASDM
 SG_ DET_BI_STATIC_FLAG_109 : 487|1@0+ (1,0) [0|1] "" ASDM
 SG_ DET_SUPER_RES_TARGET_109 : 79|1@0+ (1,0) [0|1] "" ASDM
 SG_ DET_SNR_109 : 111|8@0+ (0.35156,0) [0|89.6478] "dB" ASDM
 SG_ DET_POINT_TARGET_PROB_109 : 95|4@0+ (6.67,0) [0|100] "%" ASDM
 SG_ DET_EXISTENCE_PROB_109 : 91|6@0+ (1.588,0) [0|100] "%" ASDM
 SG_ DET_OUTSIDE_SECTOR_109 : 101|1@0+ (1,0) [0|1] "" ASDM
 SG_ DET_HVC_FLAG_109 : 87|1@0+ (1,0) [0|1] "" ASDM
 SG_ DET_CONFD_AZIMUTH_109 : 97|2@0+ (1,0) [0|3] "" ASDM
 SG_ DET_CONFD_ELEVATION_109 : 99|2@0+ (1,0) [0|3] "" ASDM
 SG_ DET_AZIMUTH_AMB_ID_109 : 82|3@0+ (1,0) [0|7] "" ASDM
 SG_ DET_AMBG_AZIMUTH_PROB_109 : 86|4@0+ (6.67,0) [0|100] "%" ASDM
 SG_ DET_RANGE_110 : 127|15@0+ (0.015625,0) [0|500] "m" ASDM
 SG_ DET_RANGE_ERR_110 : 128|7@0+ (0.0075,0) [0|0.9525] "m" ASDM
 SG_ DET_RANGE_VELOCITY_110 : 137|15@0+ (0.0078125,-128) [-128|127.9921875] "m/s" ASDM
 SG_ DET_RANGE_VELOCITY_ERR_110 : 154|8@0+ (0.003,0) [0|0.765] "m/s" ASDM
 SG_ DET_AZIMUTH_110 : 180|13@0+ (0.0004,-1.5708) [-1.5708|1.5708] "rad" ASDM
 SG_ DET_AZIMUTH_ERR_110 : 198|7@0+ (0.00087267,0) [0|0.11082909] "rad" ASDM
 SG_ DET_ELEVATION_110 : 162|8@0+ (0.00275,-0.34925) [-0.34925|0.34925] "rad" ASDM
 SG_ DET_ELEVATION_ERR_110 : 170|6@0+ (0.00174533,0) [0|0.10995579] "rad" ASDM
 SG_ DET_RCS_110 : 239|8@0+ (0.5,-64) [-64|63.5] "dBsm" ASDM
 SG_ DET_VALID_FLAG_110 : 220|1@0+ (1,0) [0|1] "" ASDM
 SG_ DET_BI_STATIC_FLAG_110 : 486|1@0+ (1,0) [0|1] "" ASDM
 SG_ DET_SUPER_RES_TARGET_110 : 199|1@0+ (1,0) [0|1] "" ASDM
 SG_ DET_SNR_110 : 231|8@0+ (0.35156,0) [0|89.6478] "dB" ASDM
 SG_ DET_POINT_TARGET_PROB_110 : 215|4@0+ (6.67,0) [0|100] "%" ASDM
 SG_ DET_EXISTENCE_PROB_110 : 211|6@0+ (1.588,0) [0|100] "%" ASDM
 SG_ DET_OUTSIDE_SECTOR_110 : 221|1@0+ (1,0) [0|1] "" ASDM
 SG_ DET_HVC_FLAG_110 : 207|1@0+ (1,0) [0|1] "" ASDM
 SG_ DET_CONFD_AZIMUTH_110 : 217|2@0+ (1,0) [0|3] "" ASDM
 SG_ DET_CONFD_ELEVATION_110 : 219|2@0+ (1,0) [0|3] "" ASDM
 SG_ DET_AZIMUTH_AMB_ID_110 : 202|3@0+ (1,0) [0|7] "" ASDM
 SG_ DET_AMBG_AZIMUTH_PROB_110 : 206|4@0+ (6.67,0) [0|100] "%" ASDM
 SG_ DET_RANGE_111 : 247|15@0+ (0.015625,0) [0|500] "m" ASDM
 SG_ DET_RANGE_ERR_111 : 248|7@0+ (0.0075,0) [0|0.9525] "m" ASDM
 SG_ DET_RANGE_VELOCITY_111 : 257|15@0+ (0.0078125,-128) [-128|127.9921875] "m/s" ASDM
 SG_ DET_RANGE_VELOCITY_ERR_111 : 274|8@0+ (0.003,0) [0|0.765] "m/s" ASDM
 SG_ DET_AZIMUTH_111 : 300|13@0+ (0.0004,-1.5708) [-1.5708|1.5708] "rad" ASDM
 SG_ DET_AZIMUTH_ERR_111 : 318|7@0+ (0.00087267,0) [0|0.11082909] "rad" ASDM
 SG_ DET_ELEVATION_111 : 282|8@0+ (0.00275,-0.34925) [-0.34925|0.34925] "rad" ASDM
 SG_ DET_ELEVATION_ERR_111 : 290|6@0+ (0.00174533,0) [0|0.10995579] "rad" ASDM
 SG_ DET_RCS_111 : 359|8@0+ (0.5,-64) [-64|63.5] "dBsm" ASDM
 SG_ DET_VALID_FLAG_111 : 340|1@0+ (1,0) [0|1] "" ASDM
 SG_ DET_BI_STATIC_FLAG_111 : 485|1@0+ (1,0) [0|1] "" ASDM
 SG_ DET_SUPER_RES_TARGET_111 : 319|1@0+ (1,0) [0|1] "" ASDM
 SG_ DET_SNR_111 : 351|8@0+ (0.35156,0) [0|89.6478] "dB" ASDM
 SG_ DET_POINT_TARGET_PROB_111 : 335|4@0+ (6.67,0) [0|100] "%" ASDM
 SG_ DET_EXISTENCE_PROB_111 : 331|6@0+ (1.588,0) [0|100] "%" ASDM
 SG_ DET_OUTSIDE_SECTOR_111 : 341|1@0+ (1,0) [0|1] "" ASDM
 SG_ DET_HVC_FLAG_111 : 327|1@0+ (1,0) [0|1] "" ASDM
 SG_ DET_CONFD_AZIMUTH_111 : 337|2@0+ (1,0) [0|3] "" ASDM
 SG_ DET_CONFD_ELEVATION_111 : 339|2@0+ (1,0) [0|3] "" ASDM
 SG_ DET_AZIMUTH_AMB_ID_111 : 322|3@0+ (1,0) [0|7] "" ASDM
 SG_ DET_AMBG_AZIMUTH_PROB_111 : 326|4@0+ (6.67,0) [0|100] "%" ASDM
 SG_ DET_RANGE_112 : 367|15@0+ (0.015625,0) [0|500] "m" ASDM
 SG_ DET_RANGE_ERR_112 : 368|7@0+ (0.0075,0) [0|0.9525] "m" ASDM
 SG_ DET_RANGE_VELOCITY_112 : 377|15@0+ (0.0078125,-128) [-128|127.9921875] "m/s" ASDM
 SG_ DET_RANGE_VELOCITY_ERR_112 : 394|8@0+ (0.003,0) [0|0.765] "m/s" ASDM
 SG_ DET_AZIMUTH_112 : 420|13@0+ (0.0004,-1.5708) [-1.5708|1.5708] "rad" ASDM
 SG_ DET_AZIMUTH_ERR_112 : 438|7@0+ (0.00087267,0) [0|0.11082909] "rad" ASDM
 SG_ DET_ELEVATION_112 : 402|8@0+ (0.00275,-0.34925) [-0.34925|0.34925] "rad" ASDM
 SG_ DET_ELEVATION_ERR_112 : 410|6@0+ (0.00174533,0) [0|0.10995579] "rad" ASDM
 SG_ DET_RCS_112 : 479|8@0+ (0.5,-64) [-64|63.5] "dBsm" ASDM
 SG_ DET_VALID_FLAG_112 : 460|1@0+ (1,0) [0|1] "" ASDM
 SG_ DET_BI_STATIC_FLAG_112 : 484|1@0+ (1,0) [0|1] "" ASDM
 SG_ DET_SUPER_RES_TARGET_112 : 439|1@0+ (1,0) [0|1] "" ASDM
 SG_ DET_SNR_112 : 471|8@0+ (0.35156,0) [0|89.6478] "dB" ASDM
 SG_ DET_POINT_TARGET_PROB_112 : 455|4@0+ (6.67,0) [0|100] "%" ASDM
 SG_ DET_EXISTENCE_PROB_112 : 451|6@0+ (1.588,0) [0|100] "%" ASDM
 SG_ DET_OUTSIDE_SECTOR_112 : 461|1@0+ (1,0) [0|1] "" ASDM
 SG_ DET_HVC_FLAG_112 : 447|1@0+ (1,0) [0|1] "" ASDM
 SG_ DET_CONFD_AZIMUTH_112 : 457|2@0+ (1,0) [0|3] "" ASDM
 SG_ DET_CONFD_ELEVATION_112 : 459|2@0+ (1,0) [0|3] "" ASDM
 SG_ DET_AZIMUTH_AMB_ID_112 : 442|3@0+ (1,0) [0|7] "" ASDM
 SG_ DET_AMBG_AZIMUTH_PROB_112 : 446|4@0+ (6.67,0) [0|100] "%" ASDM
 SG_ DET_MH_SCAN_INDEX_4LSB_109_112 : 483|4@0+ (1,0) [0|15] "" ASDM
 SG_ DET_MH_CYCLE_COUNTER_109_112 : 495|8@0+ (1,0) [0|255] "" ASDM
 SG_ DET_MH_CRC16_109_112 : 503|16@0+ (1,0) [0|65535] "" ASDM

BO_ 540 RDR_DETECTION_113_116: 64 G5_RDR03
 SG_ DET_RANGE_113 : 7|15@0+ (0.015625,0) [0|500] "m" ASDM
 SG_ DET_RANGE_ERR_113 : 8|7@0+ (0.0075,0) [0|0.9525] "m" ASDM
 SG_ DET_RANGE_VELOCITY_113 : 17|15@0+ (0.0078125,-128) [-128|127.9921875] "m/s" ASDM
 SG_ DET_RANGE_VELOCITY_ERR_113 : 34|8@0+ (0.003,0) [0|0.765] "m/s" ASDM
 SG_ DET_AZIMUTH_113 : 60|13@0+ (0.0004,-1.5708) [-1.5708|1.5708] "rad" ASDM
 SG_ DET_AZIMUTH_ERR_113 : 78|7@0+ (0.00087267,0) [0|0.11082909] "rad" ASDM
 SG_ DET_ELEVATION_113 : 42|8@0+ (0.00275,-0.34925) [-0.34925|0.34925] "rad" ASDM
 SG_ DET_ELEVATION_ERR_113 : 50|6@0+ (0.00174533,0) [0|0.10995579] "rad" ASDM
 SG_ DET_RCS_113 : 119|8@0+ (0.5,-64) [-64|63.5] "dBsm" ASDM
 SG_ DET_VALID_FLAG_113 : 100|1@0+ (1,0) [0|1] "" ASDM
 SG_ DET_BI_STATIC_FLAG_113 : 487|1@0+ (1,0) [0|1] "" ASDM
 SG_ DET_SUPER_RES_TARGET_113 : 79|1@0+ (1,0) [0|1] "" ASDM
 SG_ DET_SNR_113 : 111|8@0+ (0.35156,0) [0|89.6478] "dB" ASDM
 SG_ DET_POINT_TARGET_PROB_113 : 95|4@0+ (6.67,0) [0|100] "%" ASDM
 SG_ DET_EXISTENCE_PROB_113 : 91|6@0+ (1.588,0) [0|100] "%" ASDM
 SG_ DET_OUTSIDE_SECTOR_113 : 101|1@0+ (1,0) [0|1] "" ASDM
 SG_ DET_HVC_FLAG_113 : 87|1@0+ (1,0) [0|1] "" ASDM
 SG_ DET_CONFD_AZIMUTH_113 : 97|2@0+ (1,0) [0|3] "" ASDM
 SG_ DET_CONFD_ELEVATION_113 : 99|2@0+ (1,0) [0|3] "" ASDM
 SG_ DET_AZIMUTH_AMB_ID_113 : 82|3@0+ (1,0) [0|7] "" ASDM
 SG_ DET_AMBG_AZIMUTH_PROB_113 : 86|4@0+ (6.67,0) [0|100] "%" ASDM
 SG_ DET_RANGE_114 : 127|15@0+ (0.015625,0) [0|500] "m" ASDM
 SG_ DET_RANGE_ERR_114 : 128|7@0+ (0.0075,0) [0|0.9525] "m" ASDM
 SG_ DET_RANGE_VELOCITY_114 : 137|15@0+ (0.0078125,-128) [-128|127.9921875] "m/s" ASDM
 SG_ DET_RANGE_VELOCITY_ERR_114 : 154|8@0+ (0.003,0) [0|0.765] "m/s" ASDM
 SG_ DET_AZIMUTH_114 : 180|13@0+ (0.0004,-1.5708) [-1.5708|1.5708] "rad" ASDM
 SG_ DET_AZIMUTH_ERR_114 : 198|7@0+ (0.00087267,0) [0|0.11082909] "rad" ASDM
 SG_ DET_ELEVATION_114 : 162|8@0+ (0.00275,-0.34925) [-0.34925|0.34925] "rad" ASDM
 SG_ DET_ELEVATION_ERR_114 : 170|6@0+ (0.00174533,0) [0|0.10995579] "rad" ASDM
 SG_ DET_RCS_114 : 239|8@0+ (0.5,-64) [-64|63.5] "dBsm" ASDM
 SG_ DET_VALID_FLAG_114 : 220|1@0+ (1,0) [0|1] "" ASDM
 SG_ DET_BI_STATIC_FLAG_114 : 486|1@0+ (1,0) [0|1] "" ASDM
 SG_ DET_SUPER_RES_TARGET_114 : 199|1@0+ (1,0) [0|1] "" ASDM
 SG_ DET_SNR_114 : 231|8@0+ (0.35156,0) [0|89.6478] "dB" ASDM
 SG_ DET_POINT_TARGET_PROB_114 : 215|4@0+ (6.67,0) [0|100] "%" ASDM
 SG_ DET_EXISTENCE_PROB_114 : 211|6@0+ (1.588,0) [0|100] "%" ASDM
 SG_ DET_OUTSIDE_SECTOR_114 : 221|1@0+ (1,0) [0|1] "" ASDM
 SG_ DET_HVC_FLAG_114 : 207|1@0+ (1,0) [0|1] "" ASDM
 SG_ DET_CONFD_AZIMUTH_114 : 217|2@0+ (1,0) [0|3] "" ASDM
 SG_ DET_CONFD_ELEVATION_114 : 219|2@0+ (1,0) [0|3] "" ASDM
 SG_ DET_AZIMUTH_AMB_ID_114 : 202|3@0+ (1,0) [0|7] "" ASDM
 SG_ DET_AMBG_AZIMUTH_PROB_114 : 206|4@0+ (6.67,0) [0|100] "%" ASDM
 SG_ DET_RANGE_115 : 247|15@0+ (0.015625,0) [0|500] "m" ASDM
 SG_ DET_RANGE_ERR_115 : 248|7@0+ (0.0075,0) [0|0.9525] "m" ASDM
 SG_ DET_RANGE_VELOCITY_115 : 257|15@0+ (0.0078125,-128) [-128|127.9921875] "m/s" ASDM
 SG_ DET_RANGE_VELOCITY_ERR_115 : 274|8@0+ (0.003,0) [0|0.765] "m/s" ASDM
 SG_ DET_AZIMUTH_115 : 300|13@0+ (0.0004,-1.5708) [-1.5708|1.5708] "rad" ASDM
 SG_ DET_AZIMUTH_ERR_115 : 318|7@0+ (0.00087267,0) [0|0.11082909] "rad" ASDM
 SG_ DET_ELEVATION_115 : 282|8@0+ (0.00275,-0.34925) [-0.34925|0.34925] "rad" ASDM
 SG_ DET_ELEVATION_ERR_115 : 290|6@0+ (0.00174533,0) [0|0.10995579] "rad" ASDM
 SG_ DET_RCS_115 : 359|8@0+ (0.5,-64) [-64|63.5] "dBsm" ASDM
 SG_ DET_VALID_FLAG_115 : 340|1@0+ (1,0) [0|1] "" ASDM
 SG_ DET_BI_STATIC_FLAG_115 : 485|1@0+ (1,0) [0|1] "" ASDM
 SG_ DET_SUPER_RES_TARGET_115 : 319|1@0+ (1,0) [0|1] "" ASDM
 SG_ DET_SNR_115 : 351|8@0+ (0.35156,0) [0|89.6478] "dB" ASDM
 SG_ DET_POINT_TARGET_PROB_115 : 335|4@0+ (6.67,0) [0|100] "%" ASDM
 SG_ DET_EXISTENCE_PROB_115 : 331|6@0+ (1.588,0) [0|100] "%" ASDM
 SG_ DET_OUTSIDE_SECTOR_115 : 341|1@0+ (1,0) [0|1] "" ASDM
 SG_ DET_HVC_FLAG_115 : 327|1@0+ (1,0) [0|1] "" ASDM
 SG_ DET_CONFD_AZIMUTH_115 : 337|2@0+ (1,0) [0|3] "" ASDM
 SG_ DET_CONFD_ELEVATION_115 : 339|2@0+ (1,0) [0|3] "" ASDM
 SG_ DET_AZIMUTH_AMB_ID_115 : 322|3@0+ (1,0) [0|7] "" ASDM
 SG_ DET_AMBG_AZIMUTH_PROB_115 : 326|4@0+ (6.67,0) [0|100] "%" ASDM
 SG_ DET_RANGE_116 : 367|15@0+ (0.015625,0) [0|500] "m" ASDM
 SG_ DET_RANGE_ERR_116 : 368|7@0+ (0.0075,0) [0|0.9525] "m" ASDM
 SG_ DET_RANGE_VELOCITY_116 : 377|15@0+ (0.0078125,-128) [-128|127.9921875] "m/s" ASDM
 SG_ DET_RANGE_VELOCITY_ERR_116 : 394|8@0+ (0.003,0) [0|0.765] "m/s" ASDM
 SG_ DET_AZIMUTH_116 : 420|13@0+ (0.0004,-1.5708) [-1.5708|1.5708] "rad" ASDM
 SG_ DET_AZIMUTH_ERR_116 : 438|7@0+ (0.00087267,0) [0|0.11082909] "rad" ASDM
 SG_ DET_ELEVATION_116 : 402|8@0+ (0.00275,-0.34925) [-0.34925|0.34925] "rad" ASDM
 SG_ DET_ELEVATION_ERR_116 : 410|6@0+ (0.00174533,0) [0|0.10995579] "rad" ASDM
 SG_ DET_RCS_116 : 479|8@0+ (0.5,-64) [-64|63.5] "dBsm" ASDM
 SG_ DET_VALID_FLAG_116 : 460|1@0+ (1,0) [0|1] "" ASDM
 SG_ DET_BI_STATIC_FLAG_116 : 484|1@0+ (1,0) [0|1] "" ASDM
 SG_ DET_SUPER_RES_TARGET_116 : 439|1@0+ (1,0) [0|1] "" ASDM
 SG_ DET_SNR_116 : 471|8@0+ (0.35156,0) [0|89.6478] "dB" ASDM
 SG_ DET_POINT_TARGET_PROB_116 : 455|4@0+ (6.67,0) [0|100] "%" ASDM
 SG_ DET_EXISTENCE_PROB_116 : 451|6@0+ (1.588,0) [0|100] "%" ASDM
 SG_ DET_OUTSIDE_SECTOR_116 : 461|1@0+ (1,0) [0|1] "" ASDM
 SG_ DET_HVC_FLAG_116 : 447|1@0+ (1,0) [0|1] "" ASDM
 SG_ DET_CONFD_AZIMUTH_116 : 457|2@0+ (1,0) [0|3] "" ASDM
 SG_ DET_CONFD_ELEVATION_116 : 459|2@0+ (1,0) [0|3] "" ASDM
 SG_ DET_AZIMUTH_AMB_ID_116 : 442|3@0+ (1,0) [0|7] "" ASDM
 SG_ DET_AMBG_AZIMUTH_PROB_116 : 446|4@0+ (6.67,0) [0|100] "%" ASDM
 SG_ DET_MH_SCAN_INDEX_4LSB_113_116 : 483|4@0+ (1,0) [0|15] "" ASDM
 SG_ DET_MH_CYCLE_COUNTER_113_116 : 495|8@0+ (1,0) [0|255] "" ASDM
 SG_ DET_MH_CRC16_113_116 : 503|16@0+ (1,0) [0|65535] "" ASDM

BO_ 541 RDR_DETECTION_117_120: 64 G5_RDR03
 SG_ DET_RANGE_117 : 7|15@0+ (0.015625,0) [0|500] "m" ASDM
 SG_ DET_RANGE_ERR_117 : 8|7@0+ (0.0075,0) [0|0.9525] "m" ASDM
 SG_ DET_RANGE_VELOCITY_117 : 17|15@0+ (0.0078125,-128) [-128|127.9921875] "m/s" ASDM
 SG_ DET_RANGE_VELOCITY_ERR_117 : 34|8@0+ (0.003,0) [0|0.765] "m/s" ASDM
 SG_ DET_AZIMUTH_117 : 60|13@0+ (0.0004,-1.5708) [-1.5708|1.5708] "rad" ASDM
 SG_ DET_AZIMUTH_ERR_117 : 78|7@0+ (0.00087267,0) [0|0.11082909] "rad" ASDM
 SG_ DET_ELEVATION_117 : 42|8@0+ (0.00275,-0.34925) [-0.34925|0.34925] "rad" ASDM
 SG_ DET_ELEVATION_ERR_117 : 50|6@0+ (0.00174533,0) [0|0.10995579] "rad" ASDM
 SG_ DET_RCS_117 : 119|8@0+ (0.5,-64) [-64|63.5] "dBsm" ASDM
 SG_ DET_VALID_FLAG_117 : 100|1@0+ (1,0) [0|1] "" ASDM
 SG_ DET_BI_STATIC_FLAG_117 : 487|1@0+ (1,0) [0|1] "" ASDM
 SG_ DET_SUPER_RES_TARGET_117 : 79|1@0+ (1,0) [0|1] "" ASDM
 SG_ DET_SNR_117 : 111|8@0+ (0.35156,0) [0|89.6478] "dB" ASDM
 SG_ DET_POINT_TARGET_PROB_117 : 95|4@0+ (6.67,0) [0|100] "%" ASDM
 SG_ DET_EXISTENCE_PROB_117 : 91|6@0+ (1.588,0) [0|100] "%" ASDM
 SG_ DET_OUTSIDE_SECTOR_117 : 101|1@0+ (1,0) [0|1] "" ASDM
 SG_ DET_HVC_FLAG_117 : 87|1@0+ (1,0) [0|1] "" ASDM
 SG_ DET_CONFD_AZIMUTH_117 : 97|2@0+ (1,0) [0|3] "" ASDM
 SG_ DET_CONFD_ELEVATION_117 : 99|2@0+ (1,0) [0|3] "" ASDM
 SG_ DET_AZIMUTH_AMB_ID_117 : 82|3@0+ (1,0) [0|7] "" ASDM
 SG_ DET_AMBG_AZIMUTH_PROB_117 : 86|4@0+ (6.67,0) [0|100] "%" ASDM
 SG_ DET_RANGE_118 : 127|15@0+ (0.015625,0) [0|500] "m" ASDM
 SG_ DET_RANGE_ERR_118 : 128|7@0+ (0.0075,0) [0|0.9525] "m" ASDM
 SG_ DET_RANGE_VELOCITY_118 : 137|15@0+ (0.0078125,-128) [-128|127.9921875] "m/s" ASDM
 SG_ DET_RANGE_VELOCITY_ERR_118 : 154|8@0+ (0.003,0) [0|0.765] "m/s" ASDM
 SG_ DET_AZIMUTH_118 : 180|13@0+ (0.0004,-1.5708) [-1.5708|1.5708] "rad" ASDM
 SG_ DET_AZIMUTH_ERR_118 : 198|7@0+ (0.00087267,0) [0|0.11082909] "rad" ASDM
 SG_ DET_ELEVATION_118 : 162|8@0+ (0.00275,-0.34925) [-0.34925|0.34925] "rad" ASDM
 SG_ DET_ELEVATION_ERR_118 : 170|6@0+ (0.00174533,0) [0|0.10995579] "rad" ASDM
 SG_ DET_RCS_118 : 239|8@0+ (0.5,-64) [-64|63.5] "dBsm" ASDM
 SG_ DET_VALID_FLAG_118 : 220|1@0+ (1,0) [0|1] "" ASDM
 SG_ DET_BI_STATIC_FLAG_118 : 486|1@0+ (1,0) [0|1] "" ASDM
 SG_ DET_SUPER_RES_TARGET_118 : 199|1@0+ (1,0) [0|1] "" ASDM
 SG_ DET_SNR_118 : 231|8@0+ (0.35156,0) [0|89.6478] "dB" ASDM
 SG_ DET_POINT_TARGET_PROB_118 : 215|4@0+ (6.67,0) [0|100] "%" ASDM
 SG_ DET_EXISTENCE_PROB_118 : 211|6@0+ (1.588,0) [0|100] "%" ASDM
 SG_ DET_OUTSIDE_SECTOR_118 : 221|1@0+ (1,0) [0|1] "" ASDM
 SG_ DET_HVC_FLAG_118 : 207|1@0+ (1,0) [0|1] "" ASDM
 SG_ DET_CONFD_AZIMUTH_118 : 217|2@0+ (1,0) [0|3] "" ASDM
 SG_ DET_CONFD_ELEVATION_118 : 219|2@0+ (1,0) [0|3] "" ASDM
 SG_ DET_AZIMUTH_AMB_ID_118 : 202|3@0+ (1,0) [0|7] "" ASDM
 SG_ DET_AMBG_AZIMUTH_PROB_118 : 206|4@0+ (6.67,0) [0|100] "%" ASDM
 SG_ DET_RANGE_119 : 247|15@0+ (0.015625,0) [0|500] "m" ASDM
 SG_ DET_RANGE_ERR_119 : 248|7@0+ (0.0075,0) [0|0.9525] "m" ASDM
 SG_ DET_RANGE_VELOCITY_119 : 257|15@0+ (0.0078125,-128) [-128|127.9921875] "m/s" ASDM
 SG_ DET_RANGE_VELOCITY_ERR_119 : 274|8@0+ (0.003,0) [0|0.765] "m/s" ASDM
 SG_ DET_AZIMUTH_119 : 300|13@0+ (0.0004,-1.5708) [-1.5708|1.5708] "rad" ASDM
 SG_ DET_AZIMUTH_ERR_119 : 318|7@0+ (0.00087267,0) [0|0.11082909] "rad" ASDM
 SG_ DET_ELEVATION_119 : 282|8@0+ (0.00275,-0.34925) [-0.34925|0.34925] "rad" ASDM
 SG_ DET_ELEVATION_ERR_119 : 290|6@0+ (0.00174533,0) [0|0.10995579] "rad" ASDM
 SG_ DET_RCS_119 : 359|8@0+ (0.5,-64) [-64|63.5] "dBsm" ASDM
 SG_ DET_VALID_FLAG_119 : 340|1@0+ (1,0) [0|1] "" ASDM
 SG_ DET_BI_STATIC_FLAG_119 : 485|1@0+ (1,0) [0|1] "" ASDM
 SG_ DET_SUPER_RES_TARGET_119 : 319|1@0+ (1,0) [0|1] "" ASDM
 SG_ DET_SNR_119 : 351|8@0+ (0.35156,0) [0|89.6478] "dB" ASDM
 SG_ DET_POINT_TARGET_PROB_119 : 335|4@0+ (6.67,0) [0|100] "%" ASDM
 SG_ DET_EXISTENCE_PROB_119 : 331|6@0+ (1.588,0) [0|100] "%" ASDM
 SG_ DET_OUTSIDE_SECTOR_119 : 341|1@0+ (1,0) [0|1] "" ASDM
 SG_ DET_HVC_FLAG_119 : 327|1@0+ (1,0) [0|1] "" ASDM
 SG_ DET_CONFD_AZIMUTH_119 : 337|2@0+ (1,0) [0|3] "" ASDM
 SG_ DET_CONFD_ELEVATION_119 : 339|2@0+ (1,0) [0|3] "" ASDM
 SG_ DET_AZIMUTH_AMB_ID_119 : 322|3@0+ (1,0) [0|7] "" ASDM
 SG_ DET_AMBG_AZIMUTH_PROB_119 : 326|4@0+ (6.67,0) [0|100] "%" ASDM
 SG_ DET_RANGE_120 : 367|15@0+ (0.015625,0) [0|500] "m" ASDM
 SG_ DET_RANGE_ERR_120 : 368|7@0+ (0.0075,0) [0|0.9525] "m" ASDM
 SG_ DET_RANGE_VELOCITY_120 : 377|15@0+ (0.0078125,-128) [-128|127.9921875] "m/s" ASDM
 SG_ DET_RANGE_VELOCITY_ERR_120 : 394|8@0+ (0.003,0) [0|0.765] "m/s" ASDM
 SG_ DET_AZIMUTH_120 : 420|13@0+ (0.0004,-1.5708) [-1.5708|1.5708] "rad" ASDM
 SG_ DET_AZIMUTH_ERR_120 : 438|7@0+ (0.00087267,0) [0|0.11082909] "rad" ASDM
 SG_ DET_ELEVATION_120 : 402|8@0+ (0.00275,-0.34925) [-0.34925|0.34925] "rad" ASDM
 SG_ DET_ELEVATION_ERR_120 : 410|6@0+ (0.00174533,0) [0|0.10995579] "rad" ASDM
 SG_ DET_RCS_120 : 479|8@0+ (0.5,-64) [-64|63.5] "dBsm" ASDM
 SG_ DET_VALID_FLAG_120 : 460|1@0+ (1,0) [0|1] "" ASDM
 SG_ DET_BI_STATIC_FLAG_120 : 484|1@0+ (1,0) [0|1] "" ASDM
 SG_ DET_SUPER_RES_TARGET_120 : 439|1@0+ (1,0) [0|1] "" ASDM
 SG_ DET_SNR_120 : 471|8@0+ (0.35156,0) [0|89.6478] "dB" ASDM
 SG_ DET_POINT_TARGET_PROB_120 : 455|4@0+ (6.67,0) [0|100] "%" ASDM
 SG_ DET_EXISTENCE_PROB_120 : 451|6@0+ (1.588,0) [0|100] "%" ASDM
 SG_ DET_OUTSIDE_SECTOR_120 : 461|1@0+ (1,0) [0|1] "" ASDM
 SG_ DET_HVC_FLAG_120 : 447|1@0+ (1,0) [0|1] "" ASDM
 SG_ DET_CONFD_AZIMUTH_120 : 457|2@0+ (1,0) [0|3] "" ASDM
 SG_ DET_CONFD_ELEVATION_120 : 459|2@0+ (1,0) [0|3] "" ASDM
 SG_ DET_AZIMUTH_AMB_ID_120 : 442|3@0+ (1,0) [0|7] "" ASDM
 SG_ DET_AMBG_AZIMUTH_PROB_120 : 446|4@0+ (6.67,0) [0|100] "%" ASDM
 SG_ DET_MH_SCAN_INDEX_4LSB_117_120 : 483|4@0+ (1,0) [0|15] "" ASDM
 SG_ DET_MH_CYCLE_COUNTER_117_120 : 495|8@0+ (1,0) [0|255] "" ASDM
 SG_ DET_MH_CRC16_117_120 : 503|16@0+ (1,0) [0|65535] "" ASDM

BO_ 542 RDR_DETECTION_121_124: 64 G5_RDR03
 SG_ DET_RANGE_121 : 7|15@0+ (0.015625,0) [0|500] "m" ASDM
 SG_ DET_RANGE_ERR_121 : 8|7@0+ (0.0075,0) [0|0.9525] "m" ASDM
 SG_ DET_RANGE_VELOCITY_121 : 17|15@0+ (0.0078125,-128) [-128|127.9921875] "m/s" ASDM
 SG_ DET_RANGE_VELOCITY_ERR_121 : 34|8@0+ (0.003,0) [0|0.765] "m/s" ASDM
 SG_ DET_AZIMUTH_121 : 60|13@0+ (0.0004,-1.5708) [-1.5708|1.5708] "rad" ASDM
 SG_ DET_AZIMUTH_ERR_121 : 78|7@0+ (0.00087267,0) [0|0.11082909] "rad" ASDM
 SG_ DET_ELEVATION_121 : 42|8@0+ (0.00275,-0.34925) [-0.34925|0.34925] "rad" ASDM
 SG_ DET_ELEVATION_ERR_121 : 50|6@0+ (0.00174533,0) [0|0.10995579] "rad" ASDM
 SG_ DET_RCS_121 : 119|8@0+ (0.5,-64) [-64|63.5] "dBsm" ASDM
 SG_ DET_VALID_FLAG_121 : 100|1@0+ (1,0) [0|1] "" ASDM
 SG_ DET_BI_STATIC_FLAG_121 : 487|1@0+ (1,0) [0|1] "" ASDM
 SG_ DET_SUPER_RES_TARGET_121 : 79|1@0+ (1,0) [0|1] "" ASDM
 SG_ DET_SNR_121 : 111|8@0+ (0.35156,0) [0|89.6478] "dB" ASDM
 SG_ DET_POINT_TARGET_PROB_121 : 95|4@0+ (6.67,0) [0|100] "%" ASDM
 SG_ DET_EXISTENCE_PROB_121 : 91|6@0+ (1.588,0) [0|100] "%" ASDM
 SG_ DET_OUTSIDE_SECTOR_121 : 101|1@0+ (1,0) [0|1] "" ASDM
 SG_ DET_HVC_FLAG_121 : 87|1@0+ (1,0) [0|1] "" ASDM
 SG_ DET_CONFD_AZIMUTH_121 : 97|2@0+ (1,0) [0|3] "" ASDM
 SG_ DET_CONFD_ELEVATION_121 : 99|2@0+ (1,0) [0|3] "" ASDM
 SG_ DET_AZIMUTH_AMB_ID_121 : 82|3@0+ (1,0) [0|7] "" ASDM
 SG_ DET_AMBG_AZIMUTH_PROB_121 : 86|4@0+ (6.67,0) [0|100] "%" ASDM
 SG_ DET_RANGE_122 : 127|15@0+ (0.015625,0) [0|500] "m" ASDM
 SG_ DET_RANGE_ERR_122 : 128|7@0+ (0.0075,0) [0|0.9525] "m" ASDM
 SG_ DET_RANGE_VELOCITY_122 : 137|15@0+ (0.0078125,-128) [-128|127.9921875] "m/s" ASDM
 SG_ DET_RANGE_VELOCITY_ERR_122 : 154|8@0+ (0.003,0) [0|0.765] "m/s" ASDM
 SG_ DET_AZIMUTH_122 : 180|13@0+ (0.0004,-1.5708) [-1.5708|1.5708] "rad" ASDM
 SG_ DET_AZIMUTH_ERR_122 : 198|7@0+ (0.00087267,0) [0|0.11082909] "rad" ASDM
 SG_ DET_ELEVATION_122 : 162|8@0+ (0.00275,-0.34925) [-0.34925|0.34925] "rad" ASDM
 SG_ DET_ELEVATION_ERR_122 : 170|6@0+ (0.00174533,0) [0|0.10995579] "rad" ASDM
 SG_ DET_RCS_122 : 239|8@0+ (0.5,-64) [-64|63.5] "dBsm" ASDM
 SG_ DET_VALID_FLAG_122 : 220|1@0+ (1,0) [0|1] "" ASDM
 SG_ DET_BI_STATIC_FLAG_122 : 486|1@0+ (1,0) [0|1] "" ASDM
 SG_ DET_SUPER_RES_TARGET_122 : 199|1@0+ (1,0) [0|1] "" ASDM
 SG_ DET_SNR_122 : 231|8@0+ (0.35156,0) [0|89.6478] "dB" ASDM
 SG_ DET_POINT_TARGET_PROB_122 : 215|4@0+ (6.67,0) [0|100] "%" ASDM
 SG_ DET_EXISTENCE_PROB_122 : 211|6@0+ (1.588,0) [0|100] "%" ASDM
 SG_ DET_OUTSIDE_SECTOR_122 : 221|1@0+ (1,0) [0|1] "" ASDM
 SG_ DET_HVC_FLAG_122 : 207|1@0+ (1,0) [0|1] "" ASDM
 SG_ DET_CONFD_AZIMUTH_122 : 217|2@0+ (1,0) [0|3] "" ASDM
 SG_ DET_CONFD_ELEVATION_122 : 219|2@0+ (1,0) [0|3] "" ASDM
 SG_ DET_AZIMUTH_AMB_ID_122 : 202|3@0+ (1,0) [0|7] "" ASDM
 SG_ DET_AMBG_AZIMUTH_PROB_122 : 206|4@0+ (6.67,0) [0|100] "%" ASDM
 SG_ DET_RANGE_123 : 247|15@0+ (0.015625,0) [0|500] "m" ASDM
 SG_ DET_RANGE_ERR_123 : 248|7@0+ (0.0075,0) [0|0.9525] "m" ASDM
 SG_ DET_RANGE_VELOCITY_123 : 257|15@0+ (0.0078125,-128) [-128|127.9921875] "m/s" ASDM
 SG_ DET_RANGE_VELOCITY_ERR_123 : 274|8@0+ (0.003,0) [0|0.765] "m/s" ASDM
 SG_ DET_AZIMUTH_123 : 300|13@0+ (0.0004,-1.5708) [-1.5708|1.5708] "rad" ASDM
 SG_ DET_AZIMUTH_ERR_123 : 318|7@0+ (0.00087267,0) [0|0.11082909] "rad" ASDM
 SG_ DET_ELEVATION_123 : 282|8@0+ (0.00275,-0.34925) [-0.34925|0.34925] "rad" ASDM
 SG_ DET_ELEVATION_ERR_123 : 290|6@0+ (0.00174533,0) [0|0.10995579] "rad" ASDM
 SG_ DET_RCS_123 : 359|8@0+ (0.5,-64) [-64|63.5] "dBsm" ASDM
 SG_ DET_VALID_FLAG_123 : 340|1@0+ (1,0) [0|1] "" ASDM
 SG_ DET_BI_STATIC_FLAG_123 : 485|1@0+ (1,0) [0|1] "" ASDM
 SG_ DET_SUPER_RES_TARGET_123 : 319|1@0+ (1,0) [0|1] "" ASDM
 SG_ DET_SNR_123 : 351|8@0+ (0.35156,0) [0|89.6478] "dB" ASDM
 SG_ DET_POINT_TARGET_PROB_123 : 335|4@0+ (6.67,0) [0|100] "%" ASDM
 SG_ DET_EXISTENCE_PROB_123 : 331|6@0+ (1.588,0) [0|100] "%" ASDM
 SG_ DET_OUTSIDE_SECTOR_123 : 341|1@0+ (1,0) [0|1] "" ASDM
 SG_ DET_HVC_FLAG_123 : 327|1@0+ (1,0) [0|1] "" ASDM
 SG_ DET_CONFD_AZIMUTH_123 : 337|2@0+ (1,0) [0|3] "" ASDM
 SG_ DET_CONFD_ELEVATION_123 : 339|2@0+ (1,0) [0|3] "" ASDM
 SG_ DET_AZIMUTH_AMB_ID_123 : 322|3@0+ (1,0) [0|7] "" ASDM
 SG_ DET_AMBG_AZIMUTH_PROB_123 : 326|4@0+ (6.67,0) [0|100] "%" ASDM
 SG_ DET_RANGE_124 : 367|15@0+ (0.015625,0) [0|500] "m" ASDM
 SG_ DET_RANGE_ERR_124 : 368|7@0+ (0.0075,0) [0|0.9525] "m" ASDM
 SG_ DET_RANGE_VELOCITY_124 : 377|15@0+ (0.0078125,-128) [-128|127.9921875] "m/s" ASDM
 SG_ DET_RANGE_VELOCITY_ERR_124 : 394|8@0+ (0.003,0) [0|0.765] "m/s" ASDM
 SG_ DET_AZIMUTH_124 : 420|13@0+ (0.0004,-1.5708) [-1.5708|1.5708] "rad" ASDM
 SG_ DET_AZIMUTH_ERR_124 : 438|7@0+ (0.00087267,0) [0|0.11082909] "rad" ASDM
 SG_ DET_ELEVATION_124 : 402|8@0+ (0.00275,-0.34925) [-0.34925|0.34925] "rad" ASDM
 SG_ DET_ELEVATION_ERR_124 : 410|6@0+ (0.00174533,0) [0|0.10995579] "rad" ASDM
 SG_ DET_RCS_124 : 479|8@0+ (0.5,-64) [-64|63.5] "dBsm" ASDM
 SG_ DET_VALID_FLAG_124 : 460|1@0+ (1,0) [0|1] "" ASDM
 SG_ DET_BI_STATIC_FLAG_124 : 484|1@0+ (1,0) [0|1] "" ASDM
 SG_ DET_SUPER_RES_TARGET_124 : 439|1@0+ (1,0) [0|1] "" ASDM
 SG_ DET_SNR_124 : 471|8@0+ (0.35156,0) [0|89.6478] "dB" ASDM
 SG_ DET_POINT_TARGET_PROB_124 : 455|4@0+ (6.67,0) [0|100] "%" ASDM
 SG_ DET_EXISTENCE_PROB_124 : 451|6@0+ (1.588,0) [0|100] "%" ASDM
 SG_ DET_OUTSIDE_SECTOR_124 : 461|1@0+ (1,0) [0|1] "" ASDM
 SG_ DET_HVC_FLAG_124 : 447|1@0+ (1,0) [0|1] "" ASDM
 SG_ DET_CONFD_AZIMUTH_124 : 457|2@0+ (1,0) [0|3] "" ASDM
 SG_ DET_CONFD_ELEVATION_124 : 459|2@0+ (1,0) [0|3] "" ASDM
 SG_ DET_AZIMUTH_AMB_ID_124 : 442|3@0+ (1,0) [0|7] "" ASDM
 SG_ DET_AMBG_AZIMUTH_PROB_124 : 446|4@0+ (6.67,0) [0|100] "%" ASDM
 SG_ DET_MH_SCAN_INDEX_4LSB_121_124 : 483|4@0+ (1,0) [0|15] "" ASDM
 SG_ DET_MH_CYCLE_COUNTER_121_124 : 495|8@0+ (1,0) [0|255] "" ASDM
 SG_ DET_MH_CRC16_121_124 : 503|16@0+ (1,0) [0|65535] "" ASDM

BO_ 543 RDR_DETECTION_125_128: 64 G5_RDR03
 SG_ DET_RANGE_125 : 7|15@0+ (0.015625,0) [0|500] "m" ASDM
 SG_ DET_RANGE_ERR_125 : 8|7@0+ (0.0075,0) [0|0.9525] "m" ASDM
 SG_ DET_RANGE_VELOCITY_125 : 17|15@0+ (0.0078125,-128) [-128|127.9921875] "m/s" ASDM
 SG_ DET_RANGE_VELOCITY_ERR_125 : 34|8@0+ (0.003,0) [0|0.765] "m/s" ASDM
 SG_ DET_AZIMUTH_125 : 60|13@0+ (0.0004,-1.5708) [-1.5708|1.5708] "rad" ASDM
 SG_ DET_AZIMUTH_ERR_125 : 78|7@0+ (0.00087267,0) [0|0.11082909] "rad" ASDM
 SG_ DET_ELEVATION_125 : 42|8@0+ (0.00275,-0.34925) [-0.34925|0.34925] "rad" ASDM
 SG_ DET_ELEVATION_ERR_125 : 50|6@0+ (0.00174533,0) [0|0.10995579] "rad" ASDM
 SG_ DET_RCS_125 : 119|8@0+ (0.5,-64) [-64|63.5] "dBsm" ASDM
 SG_ DET_VALID_FLAG_125 : 100|1@0+ (1,0) [0|1] "" ASDM
 SG_ DET_BI_STATIC_FLAG_125 : 487|1@0+ (1,0) [0|1] "" ASDM
 SG_ DET_SUPER_RES_TARGET_125 : 79|1@0+ (1,0) [0|1] "" ASDM
 SG_ DET_SNR_125 : 111|8@0+ (0.35156,0) [0|89.6478] "dB" ASDM
 SG_ DET_POINT_TARGET_PROB_125 : 95|4@0+ (6.67,0) [0|100] "%" ASDM
 SG_ DET_EXISTENCE_PROB_125 : 91|6@0+ (1.588,0) [0|100] "%" ASDM
 SG_ DET_OUTSIDE_SECTOR_125 : 101|1@0+ (1,0) [0|1] "" ASDM
 SG_ DET_HVC_FLAG_125 : 87|1@0+ (1,0) [0|1] "" ASDM
 SG_ DET_CONFD_AZIMUTH_125 : 97|2@0+ (1,0) [0|3] "" ASDM
 SG_ DET_CONFD_ELEVATION_125 : 99|2@0+ (1,0) [0|3] "" ASDM
 SG_ DET_AZIMUTH_AMB_ID_125 : 82|3@0+ (1,0) [0|7] "" ASDM
 SG_ DET_AMBG_AZIMUTH_PROB_125 : 86|4@0+ (6.67,0) [0|100] "%" ASDM
 SG_ DET_RANGE_126 : 127|15@0+ (0.015625,0) [0|500] "m" ASDM
 SG_ DET_RANGE_ERR_126 : 128|7@0+ (0.0075,0) [0|0.9525] "m" ASDM
 SG_ DET_RANGE_VELOCITY_126 : 137|15@0+ (0.0078125,-128) [-128|127.9921875] "m/s" ASDM
 SG_ DET_RANGE_VELOCITY_ERR_126 : 154|8@0+ (0.003,0) [0|0.765] "m/s" ASDM
 SG_ DET_AZIMUTH_126 : 180|13@0+ (0.0004,-1.5708) [-1.5708|1.5708] "rad" ASDM
 SG_ DET_AZIMUTH_ERR_126 : 198|7@0+ (0.00087267,0) [0|0.11082909] "rad" ASDM
 SG_ DET_ELEVATION_126 : 162|8@0+ (0.00275,-0.34925) [-0.34925|0.34925] "rad" ASDM
 SG_ DET_ELEVATION_ERR_126 : 170|6@0+ (0.00174533,0) [0|0.10995579] "rad" ASDM
 SG_ DET_RCS_126 : 239|8@0+ (0.5,-64) [-64|63.5] "dBsm" ASDM
 SG_ DET_VALID_FLAG_126 : 220|1@0+ (1,0) [0|1] "" ASDM
 SG_ DET_BI_STATIC_FLAG_126 : 486|1@0+ (1,0) [0|1] "" ASDM
 SG_ DET_SUPER_RES_TARGET_126 : 199|1@0+ (1,0) [0|1] "" ASDM
 SG_ DET_SNR_126 : 231|8@0+ (0.35156,0) [0|89.6478] "dB" ASDM
 SG_ DET_POINT_TARGET_PROB_126 : 215|4@0+ (6.67,0) [0|100] "%" ASDM
 SG_ DET_EXISTENCE_PROB_126 : 211|6@0+ (1.588,0) [0|100] "%" ASDM
 SG_ DET_OUTSIDE_SECTOR_126 : 221|1@0+ (1,0) [0|1] "" ASDM
 SG_ DET_HVC_FLAG_126 : 207|1@0+ (1,0) [0|1] "" ASDM
 SG_ DET_CONFD_AZIMUTH_126 : 217|2@0+ (1,0) [0|3] "" ASDM
 SG_ DET_CONFD_ELEVATION_126 : 219|2@0+ (1,0) [0|3] "" ASDM
 SG_ DET_AZIMUTH_AMB_ID_126 : 202|3@0+ (1,0) [0|7] "" ASDM
 SG_ DET_AMBG_AZIMUTH_PROB_126 : 206|4@0+ (6.67,0) [0|100] "%" ASDM
 SG_ DET_RANGE_127 : 247|15@0+ (0.015625,0) [0|500] "m" ASDM
 SG_ DET_RANGE_ERR_127 : 248|7@0+ (0.0075,0) [0|0.9525] "m" ASDM
 SG_ DET_RANGE_VELOCITY_127 : 257|15@0+ (0.0078125,-128) [-128|127.9921875] "m/s" ASDM
 SG_ DET_RANGE_VELOCITY_ERR_127 : 274|8@0+ (0.003,0) [0|0.765] "m/s" ASDM
 SG_ DET_AZIMUTH_127 : 300|13@0+ (0.0004,-1.5708) [-1.5708|1.5708] "rad" ASDM
 SG_ DET_AZIMUTH_ERR_127 : 318|7@0+ (0.00087267,0) [0|0.11082909] "rad" ASDM
 SG_ DET_ELEVATION_127 : 282|8@0+ (0.00275,-0.34925) [-0.34925|0.34925] "rad" ASDM
 SG_ DET_ELEVATION_ERR_127 : 290|6@0+ (0.00174533,0) [0|0.10995579] "rad" ASDM
 SG_ DET_RCS_127 : 359|8@0+ (0.5,-64) [-64|63.5] "dBsm" ASDM
 SG_ DET_VALID_FLAG_127 : 340|1@0+ (1,0) [0|1] "" ASDM
 SG_ DET_BI_STATIC_FLAG_127 : 485|1@0+ (1,0) [0|1] "" ASDM
 SG_ DET_SUPER_RES_TARGET_127 : 319|1@0+ (1,0) [0|1] "" ASDM
 SG_ DET_SNR_127 : 351|8@0+ (0.35156,0) [0|89.6478] "dB" ASDM
 SG_ DET_POINT_TARGET_PROB_127 : 335|4@0+ (6.67,0) [0|100] "%" ASDM
 SG_ DET_EXISTENCE_PROB_127 : 331|6@0+ (1.588,0) [0|100] "%" ASDM
 SG_ DET_OUTSIDE_SECTOR_127 : 341|1@0+ (1,0) [0|1] "" ASDM
 SG_ DET_HVC_FLAG_127 : 327|1@0+ (1,0) [0|1] "" ASDM
 SG_ DET_CONFD_AZIMUTH_127 : 337|2@0+ (1,0) [0|3] "" ASDM
 SG_ DET_CONFD_ELEVATION_127 : 339|2@0+ (1,0) [0|3] "" ASDM
 SG_ DET_AZIMUTH_AMB_ID_127 : 322|3@0+ (1,0) [0|7] "" ASDM
 SG_ DET_AMBG_AZIMUTH_PROB_127 : 326|4@0+ (6.67,0) [0|100] "%" ASDM
 SG_ DET_RANGE_128 : 367|15@0+ (0.015625,0) [0|500] "m" ASDM
 SG_ DET_RANGE_ERR_128 : 368|7@0+ (0.0075,0) [0|0.9525] "m" ASDM
 SG_ DET_RANGE_VELOCITY_128 : 377|15@0+ (0.0078125,-128) [-128|127.9921875] "m/s" ASDM
 SG_ DET_RANGE_VELOCITY_ERR_128 : 394|8@0+ (0.003,0) [0|0.765] "m/s" ASDM
 SG_ DET_AZIMUTH_128 : 420|13@0+ (0.0004,-1.5708) [-1.5708|1.5708] "rad" ASDM
 SG_ DET_AZIMUTH_ERR_128 : 438|7@0+ (0.00087267,0) [0|0.11082909] "rad" ASDM
 SG_ DET_ELEVATION_128 : 402|8@0+ (0.00275,-0.34925) [-0.34925|0.34925] "rad" ASDM
 SG_ DET_ELEVATION_ERR_128 : 410|6@0+ (0.00174533,0) [0|0.10995579] "rad" ASDM
 SG_ DET_RCS_128 : 479|8@0+ (0.5,-64) [-64|63.5] "dBsm" ASDM
 SG_ DET_VALID_FLAG_128 : 460|1@0+ (1,0) [0|1] "" ASDM
 SG_ DET_BI_STATIC_FLAG_128 : 484|1@0+ (1,0) [0|1] "" ASDM
 SG_ DET_SUPER_RES_TARGET_128 : 439|1@0+ (1,0) [0|1] "" ASDM
 SG_ DET_SNR_128 : 471|8@0+ (0.35156,0) [0|89.6478] "dB" ASDM
 SG_ DET_POINT_TARGET_PROB_128 : 455|4@0+ (6.67,0) [0|100] "%" ASDM
 SG_ DET_EXISTENCE_PROB_128 : 451|6@0+ (1.588,0) [0|100] "%" ASDM
 SG_ DET_OUTSIDE_SECTOR_128 : 461|1@0+ (1,0) [0|1] "" ASDM
 SG_ DET_HVC_FLAG_128 : 447|1@0+ (1,0) [0|1] "" ASDM
 SG_ DET_CONFD_AZIMUTH_128 : 457|2@0+ (1,0) [0|3] "" ASDM
 SG_ DET_CONFD_ELEVATION_128 : 459|2@0+ (1,0) [0|3] "" ASDM
 SG_ DET_AZIMUTH_AMB_ID_128 : 442|3@0+ (1,0) [0|7] "" ASDM
 SG_ DET_AMBG_AZIMUTH_PROB_128 : 446|4@0+ (6.67,0) [0|100] "%" ASDM
 SG_ DET_MH_SCAN_INDEX_4LSB_125_128 : 483|4@0+ (1,0) [0|15] "" ASDM
 SG_ DET_MH_CYCLE_COUNTER_125_128 : 495|8@0+ (1,0) [0|255] "" ASDM
 SG_ DET_MH_CRC16_125_128 : 503|16@0+ (1,0) [0|65535] "" ASDM

BO_ 544 RDR_DETECTION_129_132: 64 G5_RDR03
 SG_ DET_RANGE_129 : 7|15@0+ (0.015625,0) [0|500] "m" ASDM
 SG_ DET_RANGE_ERR_129 : 8|7@0+ (0.0075,0) [0|0.9525] "m" ASDM
 SG_ DET_RANGE_VELOCITY_129 : 17|15@0+ (0.0078125,-128) [-128|127.9921875] "m/s" ASDM
 SG_ DET_RANGE_VELOCITY_ERR_129 : 34|8@0+ (0.003,0) [0|0.765] "m/s" ASDM
 SG_ DET_AZIMUTH_129 : 60|13@0+ (0.0004,-1.5708) [-1.5708|1.5708] "rad" ASDM
 SG_ DET_AZIMUTH_ERR_129 : 78|7@0+ (0.00087267,0) [0|0.11082909] "rad" ASDM
 SG_ DET_ELEVATION_129 : 42|8@0+ (0.00275,-0.34925) [-0.34925|0.34925] "rad" ASDM
 SG_ DET_ELEVATION_ERR_129 : 50|6@0+ (0.00174533,0) [0|0.10995579] "rad" ASDM
 SG_ DET_RCS_129 : 119|8@0+ (0.5,-64) [-64|63.5] "dBsm" ASDM
 SG_ DET_VALID_FLAG_129 : 100|1@0+ (1,0) [0|1] "" ASDM
 SG_ DET_BI_STATIC_FLAG_129 : 487|1@0+ (1,0) [0|1] "" ASDM
 SG_ DET_SUPER_RES_TARGET_129 : 79|1@0+ (1,0) [0|1] "" ASDM
 SG_ DET_SNR_129 : 111|8@0+ (0.35156,0) [0|89.6478] "dB" ASDM
 SG_ DET_POINT_TARGET_PROB_129 : 95|4@0+ (6.67,0) [0|100] "%" ASDM
 SG_ DET_EXISTENCE_PROB_129 : 91|6@0+ (1.588,0) [0|100] "%" ASDM
 SG_ DET_OUTSIDE_SECTOR_129 : 101|1@0+ (1,0) [0|1] "" ASDM
 SG_ DET_HVC_FLAG_129 : 87|1@0+ (1,0) [0|1] "" ASDM
 SG_ DET_CONFD_AZIMUTH_129 : 97|2@0+ (1,0) [0|3] "" ASDM
 SG_ DET_CONFD_ELEVATION_129 : 99|2@0+ (1,0) [0|3] "" ASDM
 SG_ DET_AZIMUTH_AMB_ID_129 : 82|3@0+ (1,0) [0|7] "" ASDM
 SG_ DET_AMBG_AZIMUTH_PROB_129 : 86|4@0+ (6.67,0) [0|100] "%" ASDM
 SG_ DET_RANGE_130 : 127|15@0+ (0.015625,0) [0|500] "m" ASDM
 SG_ DET_RANGE_ERR_130 : 128|7@0+ (0.0075,0) [0|0.9525] "m" ASDM
 SG_ DET_RANGE_VELOCITY_130 : 137|15@0+ (0.0078125,-128) [-128|127.9921875] "m/s" ASDM
 SG_ DET_RANGE_VELOCITY_ERR_130 : 154|8@0+ (0.003,0) [0|0.765] "m/s" ASDM
 SG_ DET_AZIMUTH_130 : 180|13@0+ (0.0004,-1.5708) [-1.5708|1.5708] "rad" ASDM
 SG_ DET_AZIMUTH_ERR_130 : 198|7@0+ (0.00087267,0) [0|0.11082909] "rad" ASDM
 SG_ DET_ELEVATION_130 : 162|8@0+ (0.00275,-0.34925) [-0.34925|0.34925] "rad" ASDM
 SG_ DET_ELEVATION_ERR_130 : 170|6@0+ (0.00174533,0) [0|0.10995579] "rad" ASDM
 SG_ DET_RCS_130 : 239|8@0+ (0.5,-64) [-64|63.5] "dBsm" ASDM
 SG_ DET_VALID_FLAG_130 : 220|1@0+ (1,0) [0|1] "" ASDM
 SG_ DET_BI_STATIC_FLAG_130 : 486|1@0+ (1,0) [0|1] "" ASDM
 SG_ DET_SUPER_RES_TARGET_130 : 199|1@0+ (1,0) [0|1] "" ASDM
 SG_ DET_SNR_130 : 231|8@0+ (0.35156,0) [0|89.6478] "dB" ASDM
 SG_ DET_POINT_TARGET_PROB_130 : 215|4@0+ (6.67,0) [0|100] "%" ASDM
 SG_ DET_EXISTENCE_PROB_130 : 211|6@0+ (1.588,0) [0|100] "%" ASDM
 SG_ DET_OUTSIDE_SECTOR_130 : 221|1@0+ (1,0) [0|1] "" ASDM
 SG_ DET_HVC_FLAG_130 : 207|1@0+ (1,0) [0|1] "" ASDM
 SG_ DET_CONFD_AZIMUTH_130 : 217|2@0+ (1,0) [0|3] "" ASDM
 SG_ DET_CONFD_ELEVATION_130 : 219|2@0+ (1,0) [0|3] "" ASDM
 SG_ DET_AZIMUTH_AMB_ID_130 : 202|3@0+ (1,0) [0|7] "" ASDM
 SG_ DET_AMBG_AZIMUTH_PROB_130 : 206|4@0+ (6.67,0) [0|100] "%" ASDM
 SG_ DET_RANGE_131 : 247|15@0+ (0.015625,0) [0|500] "m" ASDM
 SG_ DET_RANGE_ERR_131 : 248|7@0+ (0.0075,0) [0|0.9525] "m" ASDM
 SG_ DET_RANGE_VELOCITY_131 : 257|15@0+ (0.0078125,-128) [-128|127.9921875] "m/s" ASDM
 SG_ DET_RANGE_VELOCITY_ERR_131 : 274|8@0+ (0.003,0) [0|0.765] "m/s" ASDM
 SG_ DET_AZIMUTH_131 : 300|13@0+ (0.0004,-1.5708) [-1.5708|1.5708] "rad" ASDM
 SG_ DET_AZIMUTH_ERR_131 : 318|7@0+ (0.00087267,0) [0|0.11082909] "rad" ASDM
 SG_ DET_ELEVATION_131 : 282|8@0+ (0.00275,-0.34925) [-0.34925|0.34925] "rad" ASDM
 SG_ DET_ELEVATION_ERR_131 : 290|6@0+ (0.00174533,0) [0|0.10995579] "rad" ASDM
 SG_ DET_RCS_131 : 359|8@0+ (0.5,-64) [-64|63.5] "dBsm" ASDM
 SG_ DET_VALID_FLAG_131 : 340|1@0+ (1,0) [0|1] "" ASDM
 SG_ DET_BI_STATIC_FLAG_131 : 485|1@0+ (1,0) [0|1] "" ASDM
 SG_ DET_SUPER_RES_TARGET_131 : 319|1@0+ (1,0) [0|1] "" ASDM
 SG_ DET_SNR_131 : 351|8@0+ (0.35156,0) [0|89.6478] "dB" ASDM
 SG_ DET_POINT_TARGET_PROB_131 : 335|4@0+ (6.67,0) [0|100] "%" ASDM
 SG_ DET_EXISTENCE_PROB_131 : 331|6@0+ (1.588,0) [0|100] "%" ASDM
 SG_ DET_OUTSIDE_SECTOR_131 : 341|1@0+ (1,0) [0|1] "" ASDM
 SG_ DET_HVC_FLAG_131 : 327|1@0+ (1,0) [0|1] "" ASDM
 SG_ DET_CONFD_AZIMUTH_131 : 337|2@0+ (1,0) [0|3] "" ASDM
 SG_ DET_CONFD_ELEVATION_131 : 339|2@0+ (1,0) [0|3] "" ASDM
 SG_ DET_AZIMUTH_AMB_ID_131 : 322|3@0+ (1,0) [0|7] "" ASDM
 SG_ DET_AMBG_AZIMUTH_PROB_131 : 326|4@0+ (6.67,0) [0|100] "%" ASDM
 SG_ DET_RANGE_132 : 367|15@0+ (0.015625,0) [0|500] "m" ASDM
 SG_ DET_RANGE_ERR_132 : 368|7@0+ (0.0075,0) [0|0.9525] "m" ASDM
 SG_ DET_RANGE_VELOCITY_132 : 377|15@0+ (0.0078125,-128) [-128|127.9921875] "m/s" ASDM
 SG_ DET_RANGE_VELOCITY_ERR_132 : 394|8@0+ (0.003,0) [0|0.765] "m/s" ASDM
 SG_ DET_AZIMUTH_132 : 420|13@0+ (0.0004,-1.5708) [-1.5708|1.5708] "rad" ASDM
 SG_ DET_AZIMUTH_ERR_132 : 438|7@0+ (0.00087267,0) [0|0.11082909] "rad" ASDM
 SG_ DET_ELEVATION_132 : 402|8@0+ (0.00275,-0.34925) [-0.34925|0.34925] "rad" ASDM
 SG_ DET_ELEVATION_ERR_132 : 410|6@0+ (0.00174533,0) [0|0.10995579] "rad" ASDM
 SG_ DET_RCS_132 : 479|8@0+ (0.5,-64) [-64|63.5] "dBsm" ASDM
 SG_ DET_VALID_FLAG_132 : 460|1@0+ (1,0) [0|1] "" ASDM
 SG_ DET_BI_STATIC_FLAG_132 : 484|1@0+ (1,0) [0|1] "" ASDM
 SG_ DET_SUPER_RES_TARGET_132 : 439|1@0+ (1,0) [0|1] "" ASDM
 SG_ DET_SNR_132 : 471|8@0+ (0.35156,0) [0|89.6478] "dB" ASDM
 SG_ DET_POINT_TARGET_PROB_132 : 455|4@0+ (6.67,0) [0|100] "%" ASDM
 SG_ DET_EXISTENCE_PROB_132 : 451|6@0+ (1.588,0) [0|100] "%" ASDM
 SG_ DET_OUTSIDE_SECTOR_132 : 461|1@0+ (1,0) [0|1] "" ASDM
 SG_ DET_HVC_FLAG_132 : 447|1@0+ (1,0) [0|1] "" ASDM
 SG_ DET_CONFD_AZIMUTH_132 : 457|2@0+ (1,0) [0|3] "" ASDM
 SG_ DET_CONFD_ELEVATION_132 : 459|2@0+ (1,0) [0|3] "" ASDM
 SG_ DET_AZIMUTH_AMB_ID_132 : 442|3@0+ (1,0) [0|7] "" ASDM
 SG_ DET_AMBG_AZIMUTH_PROB_132 : 446|4@0+ (6.67,0) [0|100] "%" ASDM
 SG_ DET_MH_SCAN_INDEX_4LSB_129_132 : 483|4@0+ (1,0) [0|15] "" ASDM
 SG_ DET_MH_CYCLE_COUNTER_129_132 : 495|8@0+ (1,0) [0|255] "" ASDM
 SG_ DET_MH_CRC16_129_132 : 503|16@0+ (1,0) [0|65535] "" ASDM

BO_ 545 RDR_DETECTION_133_136: 64 G5_RDR03
 SG_ DET_RANGE_133 : 7|15@0+ (0.015625,0) [0|500] "m" ASDM
 SG_ DET_RANGE_ERR_133 : 8|7@0+ (0.0075,0) [0|0.9525] "m" ASDM
 SG_ DET_RANGE_VELOCITY_133 : 17|15@0+ (0.0078125,-128) [-128|127.9921875] "m/s" ASDM
 SG_ DET_RANGE_VELOCITY_ERR_133 : 34|8@0+ (0.003,0) [0|0.765] "m/s" ASDM
 SG_ DET_AZIMUTH_133 : 60|13@0+ (0.0004,-1.5708) [-1.5708|1.5708] "rad" ASDM
 SG_ DET_AZIMUTH_ERR_133 : 78|7@0+ (0.00087267,0) [0|0.11082909] "rad" ASDM
 SG_ DET_ELEVATION_133 : 42|8@0+ (0.00275,-0.34925) [-0.34925|0.34925] "rad" ASDM
 SG_ DET_ELEVATION_ERR_133 : 50|6@0+ (0.00174533,0) [0|0.10995579] "rad" ASDM
 SG_ DET_RCS_133 : 119|8@0+ (0.5,-64) [-64|63.5] "dBsm" ASDM
 SG_ DET_VALID_FLAG_133 : 100|1@0+ (1,0) [0|1] "" ASDM
 SG_ DET_BI_STATIC_FLAG_133 : 487|1@0+ (1,0) [0|1] "" ASDM
 SG_ DET_SUPER_RES_TARGET_133 : 79|1@0+ (1,0) [0|1] "" ASDM
 SG_ DET_SNR_133 : 111|8@0+ (0.35156,0) [0|89.6478] "dB" ASDM
 SG_ DET_POINT_TARGET_PROB_133 : 95|4@0+ (6.67,0) [0|100] "%" ASDM
 SG_ DET_EXISTENCE_PROB_133 : 91|6@0+ (1.588,0) [0|100] "%" ASDM
 SG_ DET_OUTSIDE_SECTOR_133 : 101|1@0+ (1,0) [0|1] "" ASDM
 SG_ DET_HVC_FLAG_133 : 87|1@0+ (1,0) [0|1] "" ASDM
 SG_ DET_CONFD_AZIMUTH_133 : 97|2@0+ (1,0) [0|3] "" ASDM
 SG_ DET_CONFD_ELEVATION_133 : 99|2@0+ (1,0) [0|3] "" ASDM
 SG_ DET_AZIMUTH_AMB_ID_133 : 82|3@0+ (1,0) [0|7] "" ASDM
 SG_ DET_AMBG_AZIMUTH_PROB_133 : 86|4@0+ (6.67,0) [0|100] "%" ASDM
 SG_ DET_RANGE_134 : 127|15@0+ (0.015625,0) [0|500] "m" ASDM
 SG_ DET_RANGE_ERR_134 : 128|7@0+ (0.0075,0) [0|0.9525] "m" ASDM
 SG_ DET_RANGE_VELOCITY_134 : 137|15@0+ (0.0078125,-128) [-128|127.9921875] "m/s" ASDM
 SG_ DET_RANGE_VELOCITY_ERR_134 : 154|8@0+ (0.003,0) [0|0.765] "m/s" ASDM
 SG_ DET_AZIMUTH_134 : 180|13@0+ (0.0004,-1.5708) [-1.5708|1.5708] "rad" ASDM
 SG_ DET_AZIMUTH_ERR_134 : 198|7@0+ (0.00087267,0) [0|0.11082909] "rad" ASDM
 SG_ DET_ELEVATION_134 : 162|8@0+ (0.00275,-0.34925) [-0.34925|0.34925] "rad" ASDM
 SG_ DET_ELEVATION_ERR_134 : 170|6@0+ (0.00174533,0) [0|0.10995579] "rad" ASDM
 SG_ DET_RCS_134 : 239|8@0+ (0.5,-64) [-64|63.5] "dBsm" ASDM
 SG_ DET_VALID_FLAG_134 : 220|1@0+ (1,0) [0|1] "" ASDM
 SG_ DET_BI_STATIC_FLAG_134 : 486|1@0+ (1,0) [0|1] "" ASDM
 SG_ DET_SUPER_RES_TARGET_134 : 199|1@0+ (1,0) [0|1] "" ASDM
 SG_ DET_SNR_134 : 231|8@0+ (0.35156,0) [0|89.6478] "dB" ASDM
 SG_ DET_POINT_TARGET_PROB_134 : 215|4@0+ (6.67,0) [0|100] "%" ASDM
 SG_ DET_EXISTENCE_PROB_134 : 211|6@0+ (1.588,0) [0|100] "%" ASDM
 SG_ DET_OUTSIDE_SECTOR_134 : 221|1@0+ (1,0) [0|1] "" ASDM
 SG_ DET_HVC_FLAG_134 : 207|1@0+ (1,0) [0|1] "" ASDM
 SG_ DET_CONFD_AZIMUTH_134 : 217|2@0+ (1,0) [0|3] "" ASDM
 SG_ DET_CONFD_ELEVATION_134 : 219|2@0+ (1,0) [0|3] "" ASDM
 SG_ DET_AZIMUTH_AMB_ID_134 : 202|3@0+ (1,0) [0|7] "" ASDM
 SG_ DET_AMBG_AZIMUTH_PROB_134 : 206|4@0+ (6.67,0) [0|100] "%" ASDM
 SG_ DET_RANGE_135 : 247|15@0+ (0.015625,0) [0|500] "m" ASDM
 SG_ DET_RANGE_ERR_135 : 248|7@0+ (0.0075,0) [0|0.9525] "m" ASDM
 SG_ DET_RANGE_VELOCITY_135 : 257|15@0+ (0.0078125,-128) [-128|127.9921875] "m/s" ASDM
 SG_ DET_RANGE_VELOCITY_ERR_135 : 274|8@0+ (0.003,0) [0|0.765] "m/s" ASDM
 SG_ DET_AZIMUTH_135 : 300|13@0+ (0.0004,-1.5708) [-1.5708|1.5708] "rad" ASDM
 SG_ DET_AZIMUTH_ERR_135 : 318|7@0+ (0.00087267,0) [0|0.11082909] "rad" ASDM
 SG_ DET_ELEVATION_135 : 282|8@0+ (0.00275,-0.34925) [-0.34925|0.34925] "rad" ASDM
 SG_ DET_ELEVATION_ERR_135 : 290|6@0+ (0.00174533,0) [0|0.10995579] "rad" ASDM
 SG_ DET_RCS_135 : 359|8@0+ (0.5,-64) [-64|63.5] "dBsm" ASDM
 SG_ DET_VALID_FLAG_135 : 340|1@0+ (1,0) [0|1] "" ASDM
 SG_ DET_BI_STATIC_FLAG_135 : 485|1@0+ (1,0) [0|1] "" ASDM
 SG_ DET_SUPER_RES_TARGET_135 : 319|1@0+ (1,0) [0|1] "" ASDM
 SG_ DET_SNR_135 : 351|8@0+ (0.35156,0) [0|89.6478] "dB" ASDM
 SG_ DET_POINT_TARGET_PROB_135 : 335|4@0+ (6.67,0) [0|100] "%" ASDM
 SG_ DET_EXISTENCE_PROB_135 : 331|6@0+ (1.588,0) [0|100] "%" ASDM
 SG_ DET_OUTSIDE_SECTOR_135 : 341|1@0+ (1,0) [0|1] "" ASDM
 SG_ DET_HVC_FLAG_135 : 327|1@0+ (1,0) [0|1] "" ASDM
 SG_ DET_CONFD_AZIMUTH_135 : 337|2@0+ (1,0) [0|3] "" ASDM
 SG_ DET_CONFD_ELEVATION_135 : 339|2@0+ (1,0) [0|3] "" ASDM
 SG_ DET_AZIMUTH_AMB_ID_135 : 322|3@0+ (1,0) [0|7] "" ASDM
 SG_ DET_AMBG_AZIMUTH_PROB_135 : 326|4@0+ (6.67,0) [0|100] "%" ASDM
 SG_ DET_RANGE_136 : 367|15@0+ (0.015625,0) [0|500] "m" ASDM
 SG_ DET_RANGE_ERR_136 : 368|7@0+ (0.0075,0) [0|0.9525] "m" ASDM
 SG_ DET_RANGE_VELOCITY_136 : 377|15@0+ (0.0078125,-128) [-128|127.9921875] "m/s" ASDM
 SG_ DET_RANGE_VELOCITY_ERR_136 : 394|8@0+ (0.003,0) [0|0.765] "m/s" ASDM
 SG_ DET_AZIMUTH_136 : 420|13@0+ (0.0004,-1.5708) [-1.5708|1.5708] "rad" ASDM
 SG_ DET_AZIMUTH_ERR_136 : 438|7@0+ (0.00087267,0) [0|0.11082909] "rad" ASDM
 SG_ DET_ELEVATION_136 : 402|8@0+ (0.00275,-0.34925) [-0.34925|0.34925] "rad" ASDM
 SG_ DET_ELEVATION_ERR_136 : 410|6@0+ (0.00174533,0) [0|0.10995579] "rad" ASDM
 SG_ DET_RCS_136 : 479|8@0+ (0.5,-64) [-64|63.5] "dBsm" ASDM
 SG_ DET_VALID_FLAG_136 : 460|1@0+ (1,0) [0|1] "" ASDM
 SG_ DET_BI_STATIC_FLAG_136 : 484|1@0+ (1,0) [0|1] "" ASDM
 SG_ DET_SUPER_RES_TARGET_136 : 439|1@0+ (1,0) [0|1] "" ASDM
 SG_ DET_SNR_136 : 471|8@0+ (0.35156,0) [0|89.6478] "dB" ASDM
 SG_ DET_POINT_TARGET_PROB_136 : 455|4@0+ (6.67,0) [0|100] "%" ASDM
 SG_ DET_EXISTENCE_PROB_136 : 451|6@0+ (1.588,0) [0|100] "%" ASDM
 SG_ DET_OUTSIDE_SECTOR_136 : 461|1@0+ (1,0) [0|1] "" ASDM
 SG_ DET_HVC_FLAG_136 : 447|1@0+ (1,0) [0|1] "" ASDM
 SG_ DET_CONFD_AZIMUTH_136 : 457|2@0+ (1,0) [0|3] "" ASDM
 SG_ DET_CONFD_ELEVATION_136 : 459|2@0+ (1,0) [0|3] "" ASDM
 SG_ DET_AZIMUTH_AMB_ID_136 : 442|3@0+ (1,0) [0|7] "" ASDM
 SG_ DET_AMBG_AZIMUTH_PROB_136 : 446|4@0+ (6.67,0) [0|100] "%" ASDM
 SG_ DET_MH_SCAN_INDEX_4LSB_133_136 : 483|4@0+ (1,0) [0|15] "" ASDM
 SG_ DET_MH_CYCLE_COUNTER_133_136 : 495|8@0+ (1,0) [0|255] "" ASDM
 SG_ DET_MH_CRC16_133_136 : 503|16@0+ (1,0) [0|65535] "" ASDM

BO_ 546 RDR_DETECTION_137_140: 64 G5_RDR03
 SG_ DET_RANGE_137 : 7|15@0+ (0.015625,0) [0|500] "m" ASDM
 SG_ DET_RANGE_ERR_137 : 8|7@0+ (0.0075,0) [0|0.9525] "m" ASDM
 SG_ DET_RANGE_VELOCITY_137 : 17|15@0+ (0.0078125,-128) [-128|127.9921875] "m/s" ASDM
 SG_ DET_RANGE_VELOCITY_ERR_137 : 34|8@0+ (0.003,0) [0|0.765] "m/s" ASDM
 SG_ DET_AZIMUTH_137 : 60|13@0+ (0.0004,-1.5708) [-1.5708|1.5708] "rad" ASDM
 SG_ DET_AZIMUTH_ERR_137 : 78|7@0+ (0.00087267,0) [0|0.11082909] "rad" ASDM
 SG_ DET_ELEVATION_137 : 42|8@0+ (0.00275,-0.34925) [-0.34925|0.34925] "rad" ASDM
 SG_ DET_ELEVATION_ERR_137 : 50|6@0+ (0.00174533,0) [0|0.10995579] "rad" ASDM
 SG_ DET_RCS_137 : 119|8@0+ (0.5,-64) [-64|63.5] "dBsm" ASDM
 SG_ DET_VALID_FLAG_137 : 100|1@0+ (1,0) [0|1] "" ASDM
 SG_ DET_BI_STATIC_FLAG_137 : 487|1@0+ (1,0) [0|1] "" ASDM
 SG_ DET_SUPER_RES_TARGET_137 : 79|1@0+ (1,0) [0|1] "" ASDM
 SG_ DET_SNR_137 : 111|8@0+ (0.35156,0) [0|89.6478] "dB" ASDM
 SG_ DET_POINT_TARGET_PROB_137 : 95|4@0+ (6.67,0) [0|100] "%" ASDM
 SG_ DET_EXISTENCE_PROB_137 : 91|6@0+ (1.588,0) [0|100] "%" ASDM
 SG_ DET_OUTSIDE_SECTOR_137 : 101|1@0+ (1,0) [0|1] "" ASDM
 SG_ DET_HVC_FLAG_137 : 87|1@0+ (1,0) [0|1] "" ASDM
 SG_ DET_CONFD_AZIMUTH_137 : 97|2@0+ (1,0) [0|3] "" ASDM
 SG_ DET_CONFD_ELEVATION_137 : 99|2@0+ (1,0) [0|3] "" ASDM
 SG_ DET_AZIMUTH_AMB_ID_137 : 82|3@0+ (1,0) [0|7] "" ASDM
 SG_ DET_AMBG_AZIMUTH_PROB_137 : 86|4@0+ (6.67,0) [0|100] "%" ASDM
 SG_ DET_RANGE_138 : 127|15@0+ (0.015625,0) [0|500] "m" ASDM
 SG_ DET_RANGE_ERR_138 : 128|7@0+ (0.0075,0) [0|0.9525] "m" ASDM
 SG_ DET_RANGE_VELOCITY_138 : 137|15@0+ (0.0078125,-128) [-128|127.9921875] "m/s" ASDM
 SG_ DET_RANGE_VELOCITY_ERR_138 : 154|8@0+ (0.003,0) [0|0.765] "m/s" ASDM
 SG_ DET_AZIMUTH_138 : 180|13@0+ (0.0004,-1.5708) [-1.5708|1.5708] "rad" ASDM
 SG_ DET_AZIMUTH_ERR_138 : 198|7@0+ (0.00087267,0) [0|0.11082909] "rad" ASDM
 SG_ DET_ELEVATION_138 : 162|8@0+ (0.00275,-0.34925) [-0.34925|0.34925] "rad" ASDM
 SG_ DET_ELEVATION_ERR_138 : 170|6@0+ (0.00174533,0) [0|0.10995579] "rad" ASDM
 SG_ DET_RCS_138 : 239|8@0+ (0.5,-64) [-64|63.5] "dBsm" ASDM
 SG_ DET_VALID_FLAG_138 : 220|1@0+ (1,0) [0|1] "" ASDM
 SG_ DET_BI_STATIC_FLAG_138 : 486|1@0+ (1,0) [0|1] "" ASDM
 SG_ DET_SUPER_RES_TARGET_138 : 199|1@0+ (1,0) [0|1] "" ASDM
 SG_ DET_SNR_138 : 231|8@0+ (0.35156,0) [0|89.6478] "dB" ASDM
 SG_ DET_POINT_TARGET_PROB_138 : 215|4@0+ (6.67,0) [0|100] "%" ASDM
 SG_ DET_EXISTENCE_PROB_138 : 211|6@0+ (1.588,0) [0|100] "%" ASDM
 SG_ DET_OUTSIDE_SECTOR_138 : 221|1@0+ (1,0) [0|1] "" ASDM
 SG_ DET_HVC_FLAG_138 : 207|1@0+ (1,0) [0|1] "" ASDM
 SG_ DET_CONFD_AZIMUTH_138 : 217|2@0+ (1,0) [0|3] "" ASDM
 SG_ DET_CONFD_ELEVATION_138 : 219|2@0+ (1,0) [0|3] "" ASDM
 SG_ DET_AZIMUTH_AMB_ID_138 : 202|3@0+ (1,0) [0|7] "" ASDM
 SG_ DET_AMBG_AZIMUTH_PROB_138 : 206|4@0+ (6.67,0) [0|100] "%" ASDM
 SG_ DET_RANGE_139 : 247|15@0+ (0.015625,0) [0|500] "m" ASDM
 SG_ DET_RANGE_ERR_139 : 248|7@0+ (0.0075,0) [0|0.9525] "m" ASDM
 SG_ DET_RANGE_VELOCITY_139 : 257|15@0+ (0.0078125,-128) [-128|127.9921875] "m/s" ASDM
 SG_ DET_RANGE_VELOCITY_ERR_139 : 274|8@0+ (0.003,0) [0|0.765] "m/s" ASDM
 SG_ DET_AZIMUTH_139 : 300|13@0+ (0.0004,-1.5708) [-1.5708|1.5708] "rad" ASDM
 SG_ DET_AZIMUTH_ERR_139 : 318|7@0+ (0.00087267,0) [0|0.11082909] "rad" ASDM
 SG_ DET_ELEVATION_139 : 282|8@0+ (0.00275,-0.34925) [-0.34925|0.34925] "rad" ASDM
 SG_ DET_ELEVATION_ERR_139 : 290|6@0+ (0.00174533,0) [0|0.10995579] "rad" ASDM
 SG_ DET_RCS_139 : 359|8@0+ (0.5,-64) [-64|63.5] "dBsm" ASDM
 SG_ DET_VALID_FLAG_139 : 340|1@0+ (1,0) [0|1] "" ASDM
 SG_ DET_BI_STATIC_FLAG_139 : 485|1@0+ (1,0) [0|1] "" ASDM
 SG_ DET_SUPER_RES_TARGET_139 : 319|1@0+ (1,0) [0|1] "" ASDM
 SG_ DET_SNR_139 : 351|8@0+ (0.35156,0) [0|89.6478] "dB" ASDM
 SG_ DET_POINT_TARGET_PROB_139 : 335|4@0+ (6.67,0) [0|100] "%" ASDM
 SG_ DET_EXISTENCE_PROB_139 : 331|6@0+ (1.588,0) [0|100] "%" ASDM
 SG_ DET_OUTSIDE_SECTOR_139 : 341|1@0+ (1,0) [0|1] "" ASDM
 SG_ DET_HVC_FLAG_139 : 327|1@0+ (1,0) [0|1] "" ASDM
 SG_ DET_CONFD_AZIMUTH_139 : 337|2@0+ (1,0) [0|3] "" ASDM
 SG_ DET_CONFD_ELEVATION_139 : 339|2@0+ (1,0) [0|3] "" ASDM
 SG_ DET_AZIMUTH_AMB_ID_139 : 322|3@0+ (1,0) [0|7] "" ASDM
 SG_ DET_AMBG_AZIMUTH_PROB_139 : 326|4@0+ (6.67,0) [0|100] "%" ASDM
 SG_ DET_RANGE_140 : 367|15@0+ (0.015625,0) [0|500] "m" ASDM
 SG_ DET_RANGE_ERR_140 : 368|7@0+ (0.0075,0) [0|0.9525] "m" ASDM
 SG_ DET_RANGE_VELOCITY_140 : 377|15@0+ (0.0078125,-128) [-128|127.9921875] "m/s" ASDM
 SG_ DET_RANGE_VELOCITY_ERR_140 : 394|8@0+ (0.003,0) [0|0.765] "m/s" ASDM
 SG_ DET_AZIMUTH_140 : 420|13@0+ (0.0004,-1.5708) [-1.5708|1.5708] "rad" ASDM
 SG_ DET_AZIMUTH_ERR_140 : 438|7@0+ (0.00087267,0) [0|0.11082909] "rad" ASDM
 SG_ DET_ELEVATION_140 : 402|8@0+ (0.00275,-0.34925) [-0.34925|0.34925] "rad" ASDM
 SG_ DET_ELEVATION_ERR_140 : 410|6@0+ (0.00174533,0) [0|0.10995579] "rad" ASDM
 SG_ DET_RCS_140 : 479|8@0+ (0.5,-64) [-64|63.5] "dBsm" ASDM
 SG_ DET_VALID_FLAG_140 : 460|1@0+ (1,0) [0|1] "" ASDM
 SG_ DET_BI_STATIC_FLAG_140 : 484|1@0+ (1,0) [0|1] "" ASDM
 SG_ DET_SUPER_RES_TARGET_140 : 439|1@0+ (1,0) [0|1] "" ASDM
 SG_ DET_SNR_140 : 471|8@0+ (0.35156,0) [0|89.6478] "dB" ASDM
 SG_ DET_POINT_TARGET_PROB_140 : 455|4@0+ (6.67,0) [0|100] "%" ASDM
 SG_ DET_EXISTENCE_PROB_140 : 451|6@0+ (1.588,0) [0|100] "%" ASDM
 SG_ DET_OUTSIDE_SECTOR_140 : 461|1@0+ (1,0) [0|1] "" ASDM
 SG_ DET_HVC_FLAG_140 : 447|1@0+ (1,0) [0|1] "" ASDM
 SG_ DET_CONFD_AZIMUTH_140 : 457|2@0+ (1,0) [0|3] "" ASDM
 SG_ DET_CONFD_ELEVATION_140 : 459|2@0+ (1,0) [0|3] "" ASDM
 SG_ DET_AZIMUTH_AMB_ID_140 : 442|3@0+ (1,0) [0|7] "" ASDM
 SG_ DET_AMBG_AZIMUTH_PROB_140 : 446|4@0+ (6.67,0) [0|100] "%" ASDM
 SG_ DET_MH_SCAN_INDEX_4LSB_137_140 : 483|4@0+ (1,0) [0|15] "" ASDM
 SG_ DET_MH_CYCLE_COUNTER_137_140 : 495|8@0+ (1,0) [0|255] "" ASDM
 SG_ DET_MH_CRC16_137_140 : 503|16@0+ (1,0) [0|65535] "" ASDM

BO_ 547 RDR_DETECTION_141_144: 64 G5_RDR03
 SG_ DET_RANGE_141 : 7|15@0+ (0.015625,0) [0|500] "m" ASDM
 SG_ DET_RANGE_ERR_141 : 8|7@0+ (0.0075,0) [0|0.9525] "m" ASDM
 SG_ DET_RANGE_VELOCITY_141 : 17|15@0+ (0.0078125,-128) [-128|127.9921875] "m/s" ASDM
 SG_ DET_RANGE_VELOCITY_ERR_141 : 34|8@0+ (0.003,0) [0|0.765] "m/s" ASDM
 SG_ DET_AZIMUTH_141 : 60|13@0+ (0.0004,-1.5708) [-1.5708|1.5708] "rad" ASDM
 SG_ DET_AZIMUTH_ERR_141 : 78|7@0+ (0.00087267,0) [0|0.11082909] "rad" ASDM
 SG_ DET_ELEVATION_141 : 42|8@0+ (0.00275,-0.34925) [-0.34925|0.34925] "rad" ASDM
 SG_ DET_ELEVATION_ERR_141 : 50|6@0+ (0.00174533,0) [0|0.10995579] "rad" ASDM
 SG_ DET_RCS_141 : 119|8@0+ (0.5,-64) [-64|63.5] "dBsm" ASDM
 SG_ DET_VALID_FLAG_141 : 100|1@0+ (1,0) [0|1] "" ASDM
 SG_ DET_BI_STATIC_FLAG_141 : 487|1@0+ (1,0) [0|1] "" ASDM
 SG_ DET_SUPER_RES_TARGET_141 : 79|1@0+ (1,0) [0|1] "" ASDM
 SG_ DET_SNR_141 : 111|8@0+ (0.35156,0) [0|89.6478] "dB" ASDM
 SG_ DET_POINT_TARGET_PROB_141 : 95|4@0+ (6.67,0) [0|100] "%" ASDM
 SG_ DET_EXISTENCE_PROB_141 : 91|6@0+ (1.588,0) [0|100] "%" ASDM
 SG_ DET_OUTSIDE_SECTOR_141 : 101|1@0+ (1,0) [0|1] "" ASDM
 SG_ DET_HVC_FLAG_141 : 87|1@0+ (1,0) [0|1] "" ASDM
 SG_ DET_CONFD_AZIMUTH_141 : 97|2@0+ (1,0) [0|3] "" ASDM
 SG_ DET_CONFD_ELEVATION_141 : 99|2@0+ (1,0) [0|3] "" ASDM
 SG_ DET_AZIMUTH_AMB_ID_141 : 82|3@0+ (1,0) [0|7] "" ASDM
 SG_ DET_AMBG_AZIMUTH_PROB_141 : 86|4@0+ (6.67,0) [0|100] "%" ASDM
 SG_ DET_RANGE_142 : 127|15@0+ (0.015625,0) [0|500] "m" ASDM
 SG_ DET_RANGE_ERR_142 : 128|7@0+ (0.0075,0) [0|0.9525] "m" ASDM
 SG_ DET_RANGE_VELOCITY_142 : 137|15@0+ (0.0078125,-128) [-128|127.9921875] "m/s" ASDM
 SG_ DET_RANGE_VELOCITY_ERR_142 : 154|8@0+ (0.003,0) [0|0.765] "m/s" ASDM
 SG_ DET_AZIMUTH_142 : 180|13@0+ (0.0004,-1.5708) [-1.5708|1.5708] "rad" ASDM
 SG_ DET_AZIMUTH_ERR_142 : 198|7@0+ (0.00087267,0) [0|0.11082909] "rad" ASDM
 SG_ DET_ELEVATION_142 : 162|8@0+ (0.00275,-0.34925) [-0.34925|0.34925] "rad" ASDM
 SG_ DET_ELEVATION_ERR_142 : 170|6@0+ (0.00174533,0) [0|0.10995579] "rad" ASDM
 SG_ DET_RCS_142 : 239|8@0+ (0.5,-64) [-64|63.5] "dBsm" ASDM
 SG_ DET_VALID_FLAG_142 : 220|1@0+ (1,0) [0|1] "" ASDM
 SG_ DET_BI_STATIC_FLAG_142 : 486|1@0+ (1,0) [0|1] "" ASDM
 SG_ DET_SUPER_RES_TARGET_142 : 199|1@0+ (1,0) [0|1] "" ASDM
 SG_ DET_SNR_142 : 231|8@0+ (0.35156,0) [0|89.6478] "dB" ASDM
 SG_ DET_POINT_TARGET_PROB_142 : 215|4@0+ (6.67,0) [0|100] "%" ASDM
 SG_ DET_EXISTENCE_PROB_142 : 211|6@0+ (1.588,0) [0|100] "%" ASDM
 SG_ DET_OUTSIDE_SECTOR_142 : 221|1@0+ (1,0) [0|1] "" ASDM
 SG_ DET_HVC_FLAG_142 : 207|1@0+ (1,0) [0|1] "" ASDM
 SG_ DET_CONFD_AZIMUTH_142 : 217|2@0+ (1,0) [0|3] "" ASDM
 SG_ DET_CONFD_ELEVATION_142 : 219|2@0+ (1,0) [0|3] "" ASDM
 SG_ DET_AZIMUTH_AMB_ID_142 : 202|3@0+ (1,0) [0|7] "" ASDM
 SG_ DET_AMBG_AZIMUTH_PROB_142 : 206|4@0+ (6.67,0) [0|100] "%" ASDM
 SG_ DET_RANGE_143 : 247|15@0+ (0.015625,0) [0|500] "m" ASDM
 SG_ DET_RANGE_ERR_143 : 248|7@0+ (0.0075,0) [0|0.9525] "m" ASDM
 SG_ DET_RANGE_VELOCITY_143 : 257|15@0+ (0.0078125,-128) [-128|127.9921875] "m/s" ASDM
 SG_ DET_RANGE_VELOCITY_ERR_143 : 274|8@0+ (0.003,0) [0|0.765] "m/s" ASDM
 SG_ DET_AZIMUTH_143 : 300|13@0+ (0.0004,-1.5708) [-1.5708|1.5708] "rad" ASDM
 SG_ DET_AZIMUTH_ERR_143 : 318|7@0+ (0.00087267,0) [0|0.11082909] "rad" ASDM
 SG_ DET_ELEVATION_143 : 282|8@0+ (0.00275,-0.34925) [-0.34925|0.34925] "rad" ASDM
 SG_ DET_ELEVATION_ERR_143 : 290|6@0+ (0.00174533,0) [0|0.10995579] "rad" ASDM
 SG_ DET_RCS_143 : 359|8@0+ (0.5,-64) [-64|63.5] "dBsm" ASDM
 SG_ DET_VALID_FLAG_143 : 340|1@0+ (1,0) [0|1] "" ASDM
 SG_ DET_BI_STATIC_FLAG_143 : 485|1@0+ (1,0) [0|1] "" ASDM
 SG_ DET_SUPER_RES_TARGET_143 : 319|1@0+ (1,0) [0|1] "" ASDM
 SG_ DET_SNR_143 : 351|8@0+ (0.35156,0) [0|89.6478] "dB" ASDM
 SG_ DET_POINT_TARGET_PROB_143 : 335|4@0+ (6.67,0) [0|100] "%" ASDM
 SG_ DET_EXISTENCE_PROB_143 : 331|6@0+ (1.588,0) [0|100] "%" ASDM
 SG_ DET_OUTSIDE_SECTOR_143 : 341|1@0+ (1,0) [0|1] "" ASDM
 SG_ DET_HVC_FLAG_143 : 327|1@0+ (1,0) [0|1] "" ASDM
 SG_ DET_CONFD_AZIMUTH_143 : 337|2@0+ (1,0) [0|3] "" ASDM
 SG_ DET_CONFD_ELEVATION_143 : 339|2@0+ (1,0) [0|3] "" ASDM
 SG_ DET_AZIMUTH_AMB_ID_143 : 322|3@0+ (1,0) [0|7] "" ASDM
 SG_ DET_AMBG_AZIMUTH_PROB_143 : 326|4@0+ (6.67,0) [0|100] "%" ASDM
 SG_ DET_RANGE_144 : 367|15@0+ (0.015625,0) [0|500] "m" ASDM
 SG_ DET_RANGE_ERR_144 : 368|7@0+ (0.0075,0) [0|0.9525] "m" ASDM
 SG_ DET_RANGE_VELOCITY_144 : 377|15@0+ (0.0078125,-128) [-128|127.9921875] "m/s" ASDM
 SG_ DET_RANGE_VELOCITY_ERR_144 : 394|8@0+ (0.003,0) [0|0.765] "m/s" ASDM
 SG_ DET_AZIMUTH_144 : 420|13@0+ (0.0004,-1.5708) [-1.5708|1.5708] "rad" ASDM
 SG_ DET_AZIMUTH_ERR_144 : 438|7@0+ (0.00087267,0) [0|0.11082909] "rad" ASDM
 SG_ DET_ELEVATION_144 : 402|8@0+ (0.00275,-0.34925) [-0.34925|0.34925] "rad" ASDM
 SG_ DET_ELEVATION_ERR_144 : 410|6@0+ (0.00174533,0) [0|0.10995579] "rad" ASDM
 SG_ DET_RCS_144 : 479|8@0+ (0.5,-64) [-64|63.5] "dBsm" ASDM
 SG_ DET_VALID_FLAG_144 : 460|1@0+ (1,0) [0|1] "" ASDM
 SG_ DET_BI_STATIC_FLAG_144 : 484|1@0+ (1,0) [0|1] "" ASDM
 SG_ DET_SUPER_RES_TARGET_144 : 439|1@0+ (1,0) [0|1] "" ASDM
 SG_ DET_SNR_144 : 471|8@0+ (0.35156,0) [0|89.6478] "dB" ASDM
 SG_ DET_POINT_TARGET_PROB_144 : 455|4@0+ (6.67,0) [0|100] "%" ASDM
 SG_ DET_EXISTENCE_PROB_144 : 451|6@0+ (1.588,0) [0|100] "%" ASDM
 SG_ DET_OUTSIDE_SECTOR_144 : 461|1@0+ (1,0) [0|1] "" ASDM
 SG_ DET_HVC_FLAG_144 : 447|1@0+ (1,0) [0|1] "" ASDM
 SG_ DET_CONFD_AZIMUTH_144 : 457|2@0+ (1,0) [0|3] "" ASDM
 SG_ DET_CONFD_ELEVATION_144 : 459|2@0+ (1,0) [0|3] "" ASDM
 SG_ DET_AZIMUTH_AMB_ID_144 : 442|3@0+ (1,0) [0|7] "" ASDM
 SG_ DET_AMBG_AZIMUTH_PROB_144 : 446|4@0+ (6.67,0) [0|100] "%" ASDM
 SG_ DET_MH_SCAN_INDEX_4LSB_141_144 : 483|4@0+ (1,0) [0|15] "" ASDM
 SG_ DET_MH_CYCLE_COUNTER_141_144 : 495|8@0+ (1,0) [0|255] "" ASDM
 SG_ DET_MH_CRC16_141_144 : 503|16@0+ (1,0) [0|65535] "" ASDM

BO_ 548 RDR_DETECTION_145_148: 64 G5_RDR03
 SG_ DET_RANGE_145 : 7|15@0+ (0.015625,0) [0|500] "m" ASDM
 SG_ DET_RANGE_ERR_145 : 8|7@0+ (0.0075,0) [0|0.9525] "m" ASDM
 SG_ DET_RANGE_VELOCITY_145 : 17|15@0+ (0.0078125,-128) [-128|127.9921875] "m/s" ASDM
 SG_ DET_RANGE_VELOCITY_ERR_145 : 34|8@0+ (0.003,0) [0|0.765] "m/s" ASDM
 SG_ DET_AZIMUTH_145 : 60|13@0+ (0.0004,-1.5708) [-1.5708|1.5708] "rad" ASDM
 SG_ DET_AZIMUTH_ERR_145 : 78|7@0+ (0.00087267,0) [0|0.11082909] "rad" ASDM
 SG_ DET_ELEVATION_145 : 42|8@0+ (0.00275,-0.34925) [-0.34925|0.34925] "rad" ASDM
 SG_ DET_ELEVATION_ERR_145 : 50|6@0+ (0.00174533,0) [0|0.10995579] "rad" ASDM
 SG_ DET_RCS_145 : 119|8@0+ (0.5,-64) [-64|63.5] "dBsm" ASDM
 SG_ DET_VALID_FLAG_145 : 100|1@0+ (1,0) [0|1] "" ASDM
 SG_ DET_BI_STATIC_FLAG_145 : 487|1@0+ (1,0) [0|1] "" ASDM
 SG_ DET_SUPER_RES_TARGET_145 : 79|1@0+ (1,0) [0|1] "" ASDM
 SG_ DET_SNR_145 : 111|8@0+ (0.35156,0) [0|89.6478] "dB" ASDM
 SG_ DET_POINT_TARGET_PROB_145 : 95|4@0+ (6.67,0) [0|100] "%" ASDM
 SG_ DET_EXISTENCE_PROB_145 : 91|6@0+ (1.588,0) [0|100] "%" ASDM
 SG_ DET_OUTSIDE_SECTOR_145 : 101|1@0+ (1,0) [0|1] "" ASDM
 SG_ DET_HVC_FLAG_145 : 87|1@0+ (1,0) [0|1] "" ASDM
 SG_ DET_CONFD_AZIMUTH_145 : 97|2@0+ (1,0) [0|3] "" ASDM
 SG_ DET_CONFD_ELEVATION_145 : 99|2@0+ (1,0) [0|3] "" ASDM
 SG_ DET_AZIMUTH_AMB_ID_145 : 82|3@0+ (1,0) [0|7] "" ASDM
 SG_ DET_AMBG_AZIMUTH_PROB_145 : 86|4@0+ (6.67,0) [0|100] "%" ASDM
 SG_ DET_RANGE_146 : 127|15@0+ (0.015625,0) [0|500] "m" ASDM
 SG_ DET_RANGE_ERR_146 : 128|7@0+ (0.0075,0) [0|0.9525] "m" ASDM
 SG_ DET_RANGE_VELOCITY_146 : 137|15@0+ (0.0078125,-128) [-128|127.9921875] "m/s" ASDM
 SG_ DET_RANGE_VELOCITY_ERR_146 : 154|8@0+ (0.003,0) [0|0.765] "m/s" ASDM
 SG_ DET_AZIMUTH_146 : 180|13@0+ (0.0004,-1.5708) [-1.5708|1.5708] "rad" ASDM
 SG_ DET_AZIMUTH_ERR_146 : 198|7@0+ (0.00087267,0) [0|0.11082909] "rad" ASDM
 SG_ DET_ELEVATION_146 : 162|8@0+ (0.00275,-0.34925) [-0.34925|0.34925] "rad" ASDM
 SG_ DET_ELEVATION_ERR_146 : 170|6@0+ (0.00174533,0) [0|0.10995579] "rad" ASDM
 SG_ DET_RCS_146 : 239|8@0+ (0.5,-64) [-64|63.5] "dBsm" ASDM
 SG_ DET_VALID_FLAG_146 : 220|1@0+ (1,0) [0|1] "" ASDM
 SG_ DET_BI_STATIC_FLAG_146 : 486|1@0+ (1,0) [0|1] "" ASDM
 SG_ DET_SUPER_RES_TARGET_146 : 199|1@0+ (1,0) [0|1] "" ASDM
 SG_ DET_SNR_146 : 231|8@0+ (0.35156,0) [0|89.6478] "dB" ASDM
 SG_ DET_POINT_TARGET_PROB_146 : 215|4@0+ (6.67,0) [0|100] "%" ASDM
 SG_ DET_EXISTENCE_PROB_146 : 211|6@0+ (1.588,0) [0|100] "%" ASDM
 SG_ DET_OUTSIDE_SECTOR_146 : 221|1@0+ (1,0) [0|1] "" ASDM
 SG_ DET_HVC_FLAG_146 : 207|1@0+ (1,0) [0|1] "" ASDM
 SG_ DET_CONFD_AZIMUTH_146 : 217|2@0+ (1,0) [0|3] "" ASDM
 SG_ DET_CONFD_ELEVATION_146 : 219|2@0+ (1,0) [0|3] "" ASDM
 SG_ DET_AZIMUTH_AMB_ID_146 : 202|3@0+ (1,0) [0|7] "" ASDM
 SG_ DET_AMBG_AZIMUTH_PROB_146 : 206|4@0+ (6.67,0) [0|100] "%" ASDM
 SG_ DET_RANGE_147 : 247|15@0+ (0.015625,0) [0|500] "m" ASDM
 SG_ DET_RANGE_ERR_147 : 248|7@0+ (0.0075,0) [0|0.9525] "m" ASDM
 SG_ DET_RANGE_VELOCITY_147 : 257|15@0+ (0.0078125,-128) [-128|127.9921875] "m/s" ASDM
 SG_ DET_RANGE_VELOCITY_ERR_147 : 274|8@0+ (0.003,0) [0|0.765] "m/s" ASDM
 SG_ DET_AZIMUTH_147 : 300|13@0+ (0.0004,-1.5708) [-1.5708|1.5708] "rad" ASDM
 SG_ DET_AZIMUTH_ERR_147 : 318|7@0+ (0.00087267,0) [0|0.11082909] "rad" ASDM
 SG_ DET_ELEVATION_147 : 282|8@0+ (0.00275,-0.34925) [-0.34925|0.34925] "rad" ASDM
 SG_ DET_ELEVATION_ERR_147 : 290|6@0+ (0.00174533,0) [0|0.10995579] "rad" ASDM
 SG_ DET_RCS_147 : 359|8@0+ (0.5,-64) [-64|63.5] "dBsm" ASDM
 SG_ DET_VALID_FLAG_147 : 340|1@0+ (1,0) [0|1] "" ASDM
 SG_ DET_BI_STATIC_FLAG_147 : 485|1@0+ (1,0) [0|1] "" ASDM
 SG_ DET_SUPER_RES_TARGET_147 : 319|1@0+ (1,0) [0|1] "" ASDM
 SG_ DET_SNR_147 : 351|8@0+ (0.35156,0) [0|89.6478] "dB" ASDM
 SG_ DET_POINT_TARGET_PROB_147 : 335|4@0+ (6.67,0) [0|100] "%" ASDM
 SG_ DET_EXISTENCE_PROB_147 : 331|6@0+ (1.588,0) [0|100] "%" ASDM
 SG_ DET_OUTSIDE_SECTOR_147 : 341|1@0+ (1,0) [0|1] "" ASDM
 SG_ DET_HVC_FLAG_147 : 327|1@0+ (1,0) [0|1] "" ASDM
 SG_ DET_CONFD_AZIMUTH_147 : 337|2@0+ (1,0) [0|3] "" ASDM
 SG_ DET_CONFD_ELEVATION_147 : 339|2@0+ (1,0) [0|3] "" ASDM
 SG_ DET_AZIMUTH_AMB_ID_147 : 322|3@0+ (1,0) [0|7] "" ASDM
 SG_ DET_AMBG_AZIMUTH_PROB_147 : 326|4@0+ (6.67,0) [0|100] "%" ASDM
 SG_ DET_RANGE_148 : 367|15@0+ (0.015625,0) [0|500] "m" ASDM
 SG_ DET_RANGE_ERR_148 : 368|7@0+ (0.0075,0) [0|0.9525] "m" ASDM
 SG_ DET_RANGE_VELOCITY_148 : 377|15@0+ (0.0078125,-128) [-128|127.9921875] "m/s" ASDM
 SG_ DET_RANGE_VELOCITY_ERR_148 : 394|8@0+ (0.003,0) [0|0.765] "m/s" ASDM
 SG_ DET_AZIMUTH_148 : 420|13@0+ (0.0004,-1.5708) [-1.5708|1.5708] "rad" ASDM
 SG_ DET_AZIMUTH_ERR_148 : 438|7@0+ (0.00087267,0) [0|0.11082909] "rad" ASDM
 SG_ DET_ELEVATION_148 : 402|8@0+ (0.00275,-0.34925) [-0.34925|0.34925] "rad" ASDM
 SG_ DET_ELEVATION_ERR_148 : 410|6@0+ (0.00174533,0) [0|0.10995579] "rad" ASDM
 SG_ DET_RCS_148 : 479|8@0+ (0.5,-64) [-64|63.5] "dBsm" ASDM
 SG_ DET_VALID_FLAG_148 : 460|1@0+ (1,0) [0|1] "" ASDM
 SG_ DET_BI_STATIC_FLAG_148 : 484|1@0+ (1,0) [0|1] "" ASDM
 SG_ DET_SUPER_RES_TARGET_148 : 439|1@0+ (1,0) [0|1] "" ASDM
 SG_ DET_SNR_148 : 471|8@0+ (0.35156,0) [0|89.6478] "dB" ASDM
 SG_ DET_POINT_TARGET_PROB_148 : 455|4@0+ (6.67,0) [0|100] "%" ASDM
 SG_ DET_EXISTENCE_PROB_148 : 451|6@0+ (1.588,0) [0|100] "%" ASDM
 SG_ DET_OUTSIDE_SECTOR_148 : 461|1@0+ (1,0) [0|1] "" ASDM
 SG_ DET_HVC_FLAG_148 : 447|1@0+ (1,0) [0|1] "" ASDM
 SG_ DET_CONFD_AZIMUTH_148 : 457|2@0+ (1,0) [0|3] "" ASDM
 SG_ DET_CONFD_ELEVATION_148 : 459|2@0+ (1,0) [0|3] "" ASDM
 SG_ DET_AZIMUTH_AMB_ID_148 : 442|3@0+ (1,0) [0|7] "" ASDM
 SG_ DET_AMBG_AZIMUTH_PROB_148 : 446|4@0+ (6.67,0) [0|100] "%" ASDM
 SG_ DET_MH_SCAN_INDEX_4LSB_145_148 : 483|4@0+ (1,0) [0|15] "" ASDM
 SG_ DET_MH_CYCLE_COUNTER_145_148 : 495|8@0+ (1,0) [0|255] "" ASDM
 SG_ DET_MH_CRC16_145_148 : 503|16@0+ (1,0) [0|65535] "" ASDM

BO_ 549 RDR_DETECTION_149_152: 64 G5_RDR03
 SG_ DET_RANGE_149 : 7|15@0+ (0.015625,0) [0|500] "m" ASDM
 SG_ DET_RANGE_ERR_149 : 8|7@0+ (0.0075,0) [0|0.9525] "m" ASDM
 SG_ DET_RANGE_VELOCITY_149 : 17|15@0+ (0.0078125,-128) [-128|127.9921875] "m/s" ASDM
 SG_ DET_RANGE_VELOCITY_ERR_149 : 34|8@0+ (0.003,0) [0|0.765] "m/s" ASDM
 SG_ DET_AZIMUTH_149 : 60|13@0+ (0.0004,-1.5708) [-1.5708|1.5708] "rad" ASDM
 SG_ DET_AZIMUTH_ERR_149 : 78|7@0+ (0.00087267,0) [0|0.11082909] "rad" ASDM
 SG_ DET_ELEVATION_149 : 42|8@0+ (0.00275,-0.34925) [-0.34925|0.34925] "rad" ASDM
 SG_ DET_ELEVATION_ERR_149 : 50|6@0+ (0.00174533,0) [0|0.10995579] "rad" ASDM
 SG_ DET_RCS_149 : 119|8@0+ (0.5,-64) [-64|63.5] "dBsm" ASDM
 SG_ DET_VALID_FLAG_149 : 100|1@0+ (1,0) [0|1] "" ASDM
 SG_ DET_BI_STATIC_FLAG_149 : 487|1@0+ (1,0) [0|1] "" ASDM
 SG_ DET_SUPER_RES_TARGET_149 : 79|1@0+ (1,0) [0|1] "" ASDM
 SG_ DET_SNR_149 : 111|8@0+ (0.35156,0) [0|89.6478] "dB" ASDM
 SG_ DET_POINT_TARGET_PROB_149 : 95|4@0+ (6.67,0) [0|100] "%" ASDM
 SG_ DET_EXISTENCE_PROB_149 : 91|6@0+ (1.588,0) [0|100] "%" ASDM
 SG_ DET_OUTSIDE_SECTOR_149 : 101|1@0+ (1,0) [0|1] "" ASDM
 SG_ DET_HVC_FLAG_149 : 87|1@0+ (1,0) [0|1] "" ASDM
 SG_ DET_CONFD_AZIMUTH_149 : 97|2@0+ (1,0) [0|3] "" ASDM
 SG_ DET_CONFD_ELEVATION_149 : 99|2@0+ (1,0) [0|3] "" ASDM
 SG_ DET_AZIMUTH_AMB_ID_149 : 82|3@0+ (1,0) [0|7] "" ASDM
 SG_ DET_AMBG_AZIMUTH_PROB_149 : 86|4@0+ (6.67,0) [0|100] "%" ASDM
 SG_ DET_RANGE_150 : 127|15@0+ (0.015625,0) [0|500] "m" ASDM
 SG_ DET_RANGE_ERR_150 : 128|7@0+ (0.0075,0) [0|0.9525] "m" ASDM
 SG_ DET_RANGE_VELOCITY_150 : 137|15@0+ (0.0078125,-128) [-128|127.9921875] "m/s" ASDM
 SG_ DET_RANGE_VELOCITY_ERR_150 : 154|8@0+ (0.003,0) [0|0.765] "m/s" ASDM
 SG_ DET_AZIMUTH_150 : 180|13@0+ (0.0004,-1.5708) [-1.5708|1.5708] "rad" ASDM
 SG_ DET_AZIMUTH_ERR_150 : 198|7@0+ (0.00087267,0) [0|0.11082909] "rad" ASDM
 SG_ DET_ELEVATION_150 : 162|8@0+ (0.00275,-0.34925) [-0.34925|0.34925] "rad" ASDM
 SG_ DET_ELEVATION_ERR_150 : 170|6@0+ (0.00174533,0) [0|0.10995579] "rad" ASDM
 SG_ DET_RCS_150 : 239|8@0+ (0.5,-64) [-64|63.5] "dBsm" ASDM
 SG_ DET_VALID_FLAG_150 : 220|1@0+ (1,0) [0|1] "" ASDM
 SG_ DET_BI_STATIC_FLAG_150 : 486|1@0+ (1,0) [0|1] "" ASDM
 SG_ DET_SUPER_RES_TARGET_150 : 199|1@0+ (1,0) [0|1] "" ASDM
 SG_ DET_SNR_150 : 231|8@0+ (0.35156,0) [0|89.6478] "dB" ASDM
 SG_ DET_POINT_TARGET_PROB_150 : 215|4@0+ (6.67,0) [0|100] "%" ASDM
 SG_ DET_EXISTENCE_PROB_150 : 211|6@0+ (1.588,0) [0|100] "%" ASDM
 SG_ DET_OUTSIDE_SECTOR_150 : 221|1@0+ (1,0) [0|1] "" ASDM
 SG_ DET_HVC_FLAG_150 : 207|1@0+ (1,0) [0|1] "" ASDM
 SG_ DET_CONFD_AZIMUTH_150 : 217|2@0+ (1,0) [0|3] "" ASDM
 SG_ DET_CONFD_ELEVATION_150 : 219|2@0+ (1,0) [0|3] "" ASDM
 SG_ DET_AZIMUTH_AMB_ID_150 : 202|3@0+ (1,0) [0|7] "" ASDM
 SG_ DET_AMBG_AZIMUTH_PROB_150 : 206|4@0+ (6.67,0) [0|100] "%" ASDM
 SG_ DET_RANGE_151 : 247|15@0+ (0.015625,0) [0|500] "m" ASDM
 SG_ DET_RANGE_ERR_151 : 248|7@0+ (0.0075,0) [0|0.9525] "m" ASDM
 SG_ DET_RANGE_VELOCITY_151 : 257|15@0+ (0.0078125,-128) [-128|127.9921875] "m/s" ASDM
 SG_ DET_RANGE_VELOCITY_ERR_151 : 274|8@0+ (0.003,0) [0|0.765] "m/s" ASDM
 SG_ DET_AZIMUTH_151 : 300|13@0+ (0.0004,-1.5708) [-1.5708|1.5708] "rad" ASDM
 SG_ DET_AZIMUTH_ERR_151 : 318|7@0+ (0.00087267,0) [0|0.11082909] "rad" ASDM
 SG_ DET_ELEVATION_151 : 282|8@0+ (0.00275,-0.34925) [-0.34925|0.34925] "rad" ASDM
 SG_ DET_ELEVATION_ERR_151 : 290|6@0+ (0.00174533,0) [0|0.10995579] "rad" ASDM
 SG_ DET_RCS_151 : 359|8@0+ (0.5,-64) [-64|63.5] "dBsm" ASDM
 SG_ DET_VALID_FLAG_151 : 340|1@0+ (1,0) [0|1] "" ASDM
 SG_ DET_BI_STATIC_FLAG_151 : 485|1@0+ (1,0) [0|1] "" ASDM
 SG_ DET_SUPER_RES_TARGET_151 : 319|1@0+ (1,0) [0|1] "" ASDM
 SG_ DET_SNR_151 : 351|8@0+ (0.35156,0) [0|89.6478] "dB" ASDM
 SG_ DET_POINT_TARGET_PROB_151 : 335|4@0+ (6.67,0) [0|100] "%" ASDM
 SG_ DET_EXISTENCE_PROB_151 : 331|6@0+ (1.588,0) [0|100] "%" ASDM
 SG_ DET_OUTSIDE_SECTOR_151 : 341|1@0+ (1,0) [0|1] "" ASDM
 SG_ DET_HVC_FLAG_151 : 327|1@0+ (1,0) [0|1] "" ASDM
 SG_ DET_CONFD_AZIMUTH_151 : 337|2@0+ (1,0) [0|3] "" ASDM
 SG_ DET_CONFD_ELEVATION_151 : 339|2@0+ (1,0) [0|3] "" ASDM
 SG_ DET_AZIMUTH_AMB_ID_151 : 322|3@0+ (1,0) [0|7] "" ASDM
 SG_ DET_AMBG_AZIMUTH_PROB_151 : 326|4@0+ (6.67,0) [0|100] "%" ASDM
 SG_ DET_RANGE_152 : 367|15@0+ (0.015625,0) [0|500] "m" ASDM
 SG_ DET_RANGE_ERR_152 : 368|7@0+ (0.0075,0) [0|0.9525] "m" ASDM
 SG_ DET_RANGE_VELOCITY_152 : 377|15@0+ (0.0078125,-128) [-128|127.9921875] "m/s" ASDM
 SG_ DET_RANGE_VELOCITY_ERR_152 : 394|8@0+ (0.003,0) [0|0.765] "m/s" ASDM
 SG_ DET_AZIMUTH_152 : 420|13@0+ (0.0004,-1.5708) [-1.5708|1.5708] "rad" ASDM
 SG_ DET_AZIMUTH_ERR_152 : 438|7@0+ (0.00087267,0) [0|0.11082909] "rad" ASDM
 SG_ DET_ELEVATION_152 : 402|8@0+ (0.00275,-0.34925) [-0.34925|0.34925] "rad" ASDM
 SG_ DET_ELEVATION_ERR_152 : 410|6@0+ (0.00174533,0) [0|0.10995579] "rad" ASDM
 SG_ DET_RCS_152 : 479|8@0+ (0.5,-64) [-64|63.5] "dBsm" ASDM
 SG_ DET_VALID_FLAG_152 : 460|1@0+ (1,0) [0|1] "" ASDM
 SG_ DET_BI_STATIC_FLAG_152 : 484|1@0+ (1,0) [0|1] "" ASDM
 SG_ DET_SUPER_RES_TARGET_152 : 439|1@0+ (1,0) [0|1] "" ASDM
 SG_ DET_SNR_152 : 471|8@0+ (0.35156,0) [0|89.6478] "dB" ASDM
 SG_ DET_POINT_TARGET_PROB_152 : 455|4@0+ (6.67,0) [0|100] "%" ASDM
 SG_ DET_EXISTENCE_PROB_152 : 451|6@0+ (1.588,0) [0|100] "%" ASDM
 SG_ DET_OUTSIDE_SECTOR_152 : 461|1@0+ (1,0) [0|1] "" ASDM
 SG_ DET_HVC_FLAG_152 : 447|1@0+ (1,0) [0|1] "" ASDM
 SG_ DET_CONFD_AZIMUTH_152 : 457|2@0+ (1,0) [0|3] "" ASDM
 SG_ DET_CONFD_ELEVATION_152 : 459|2@0+ (1,0) [0|3] "" ASDM
 SG_ DET_AZIMUTH_AMB_ID_152 : 442|3@0+ (1,0) [0|7] "" ASDM
 SG_ DET_AMBG_AZIMUTH_PROB_152 : 446|4@0+ (6.67,0) [0|100] "%" ASDM
 SG_ DET_MH_SCAN_INDEX_4LSB_149_152 : 483|4@0+ (1,0) [0|15] "" ASDM
 SG_ DET_MH_CYCLE_COUNTER_149_152 : 495|8@0+ (1,0) [0|255] "" ASDM
 SG_ DET_MH_CRC16_149_152 : 503|16@0+ (1,0) [0|65535] "" ASDM

BO_ 550 RDR_DETECTION_153_156: 64 G5_RDR03
 SG_ DET_RANGE_153 : 7|15@0+ (0.015625,0) [0|500] "m" ASDM
 SG_ DET_RANGE_ERR_153 : 8|7@0+ (0.0075,0) [0|0.9525] "m" ASDM
 SG_ DET_RANGE_VELOCITY_153 : 17|15@0+ (0.0078125,-128) [-128|127.9921875] "m/s" ASDM
 SG_ DET_RANGE_VELOCITY_ERR_153 : 34|8@0+ (0.003,0) [0|0.765] "m/s" ASDM
 SG_ DET_AZIMUTH_153 : 60|13@0+ (0.0004,-1.5708) [-1.5708|1.5708] "rad" ASDM
 SG_ DET_AZIMUTH_ERR_153 : 78|7@0+ (0.00087267,0) [0|0.11082909] "rad" ASDM
 SG_ DET_ELEVATION_153 : 42|8@0+ (0.00275,-0.34925) [-0.34925|0.34925] "rad" ASDM
 SG_ DET_ELEVATION_ERR_153 : 50|6@0+ (0.00174533,0) [0|0.10995579] "rad" ASDM
 SG_ DET_RCS_153 : 119|8@0+ (0.5,-64) [-64|63.5] "dBsm" ASDM
 SG_ DET_VALID_FLAG_153 : 100|1@0+ (1,0) [0|1] "" ASDM
 SG_ DET_BI_STATIC_FLAG_153 : 487|1@0+ (1,0) [0|1] "" ASDM
 SG_ DET_SUPER_RES_TARGET_153 : 79|1@0+ (1,0) [0|1] "" ASDM
 SG_ DET_SNR_153 : 111|8@0+ (0.35156,0) [0|89.6478] "dB" ASDM
 SG_ DET_POINT_TARGET_PROB_153 : 95|4@0+ (6.67,0) [0|100] "%" ASDM
 SG_ DET_EXISTENCE_PROB_153 : 91|6@0+ (1.588,0) [0|100] "%" ASDM
 SG_ DET_OUTSIDE_SECTOR_153 : 101|1@0+ (1,0) [0|1] "" ASDM
 SG_ DET_HVC_FLAG_153 : 87|1@0+ (1,0) [0|1] "" ASDM
 SG_ DET_CONFD_AZIMUTH_153 : 97|2@0+ (1,0) [0|3] "" ASDM
 SG_ DET_CONFD_ELEVATION_153 : 99|2@0+ (1,0) [0|3] "" ASDM
 SG_ DET_AZIMUTH_AMB_ID_153 : 82|3@0+ (1,0) [0|7] "" ASDM
 SG_ DET_AMBG_AZIMUTH_PROB_153 : 86|4@0+ (6.67,0) [0|100] "%" ASDM
 SG_ DET_RANGE_154 : 127|15@0+ (0.015625,0) [0|500] "m" ASDM
 SG_ DET_RANGE_ERR_154 : 128|7@0+ (0.0075,0) [0|0.9525] "m" ASDM
 SG_ DET_RANGE_VELOCITY_154 : 137|15@0+ (0.0078125,-128) [-128|127.9921875] "m/s" ASDM
 SG_ DET_RANGE_VELOCITY_ERR_154 : 154|8@0+ (0.003,0) [0|0.765] "m/s" ASDM
 SG_ DET_AZIMUTH_154 : 180|13@0+ (0.0004,-1.5708) [-1.5708|1.5708] "rad" ASDM
 SG_ DET_AZIMUTH_ERR_154 : 198|7@0+ (0.00087267,0) [0|0.11082909] "rad" ASDM
 SG_ DET_ELEVATION_154 : 162|8@0+ (0.00275,-0.34925) [-0.34925|0.34925] "rad" ASDM
 SG_ DET_ELEVATION_ERR_154 : 170|6@0+ (0.00174533,0) [0|0.10995579] "rad" ASDM
 SG_ DET_RCS_154 : 239|8@0+ (0.5,-64) [-64|63.5] "dBsm" ASDM
 SG_ DET_VALID_FLAG_154 : 220|1@0+ (1,0) [0|1] "" ASDM
 SG_ DET_BI_STATIC_FLAG_154 : 486|1@0+ (1,0) [0|1] "" ASDM
 SG_ DET_SUPER_RES_TARGET_154 : 199|1@0+ (1,0) [0|1] "" ASDM
 SG_ DET_SNR_154 : 231|8@0+ (0.35156,0) [0|89.6478] "dB" ASDM
 SG_ DET_POINT_TARGET_PROB_154 : 215|4@0+ (6.67,0) [0|100] "%" ASDM
 SG_ DET_EXISTENCE_PROB_154 : 211|6@0+ (1.588,0) [0|100] "%" ASDM
 SG_ DET_OUTSIDE_SECTOR_154 : 221|1@0+ (1,0) [0|1] "" ASDM
 SG_ DET_HVC_FLAG_154 : 207|1@0+ (1,0) [0|1] "" ASDM
 SG_ DET_CONFD_AZIMUTH_154 : 217|2@0+ (1,0) [0|3] "" ASDM
 SG_ DET_CONFD_ELEVATION_154 : 219|2@0+ (1,0) [0|3] "" ASDM
 SG_ DET_AZIMUTH_AMB_ID_154 : 202|3@0+ (1,0) [0|7] "" ASDM
 SG_ DET_AMBG_AZIMUTH_PROB_154 : 206|4@0+ (6.67,0) [0|100] "%" ASDM
 SG_ DET_RANGE_155 : 247|15@0+ (0.015625,0) [0|500] "m" ASDM
 SG_ DET_RANGE_ERR_155 : 248|7@0+ (0.0075,0) [0|0.9525] "m" ASDM
 SG_ DET_RANGE_VELOCITY_155 : 257|15@0+ (0.0078125,-128) [-128|127.9921875] "m/s" ASDM
 SG_ DET_RANGE_VELOCITY_ERR_155 : 274|8@0+ (0.003,0) [0|0.765] "m/s" ASDM
 SG_ DET_AZIMUTH_155 : 300|13@0+ (0.0004,-1.5708) [-1.5708|1.5708] "rad" ASDM
 SG_ DET_AZIMUTH_ERR_155 : 318|7@0+ (0.00087267,0) [0|0.11082909] "rad" ASDM
 SG_ DET_ELEVATION_155 : 282|8@0+ (0.00275,-0.34925) [-0.34925|0.34925] "rad" ASDM
 SG_ DET_ELEVATION_ERR_155 : 290|6@0+ (0.00174533,0) [0|0.10995579] "rad" ASDM
 SG_ DET_RCS_155 : 359|8@0+ (0.5,-64) [-64|63.5] "dBsm" ASDM
 SG_ DET_VALID_FLAG_155 : 340|1@0+ (1,0) [0|1] "" ASDM
 SG_ DET_BI_STATIC_FLAG_155 : 485|1@0+ (1,0) [0|1] "" ASDM
 SG_ DET_SUPER_RES_TARGET_155 : 319|1@0+ (1,0) [0|1] "" ASDM
 SG_ DET_SNR_155 : 351|8@0+ (0.35156,0) [0|89.6478] "dB" ASDM
 SG_ DET_POINT_TARGET_PROB_155 : 335|4@0+ (6.67,0) [0|100] "%" ASDM
 SG_ DET_EXISTENCE_PROB_155 : 331|6@0+ (1.588,0) [0|100] "%" ASDM
 SG_ DET_OUTSIDE_SECTOR_155 : 341|1@0+ (1,0) [0|1] "" ASDM
 SG_ DET_HVC_FLAG_155 : 327|1@0+ (1,0) [0|1] "" ASDM
 SG_ DET_CONFD_AZIMUTH_155 : 337|2@0+ (1,0) [0|3] "" ASDM
 SG_ DET_CONFD_ELEVATION_155 : 339|2@0+ (1,0) [0|3] "" ASDM
 SG_ DET_AZIMUTH_AMB_ID_155 : 322|3@0+ (1,0) [0|7] "" ASDM
 SG_ DET_AMBG_AZIMUTH_PROB_155 : 326|4@0+ (6.67,0) [0|100] "%" ASDM
 SG_ DET_RANGE_156 : 367|15@0+ (0.015625,0) [0|500] "m" ASDM
 SG_ DET_RANGE_ERR_156 : 368|7@0+ (0.0075,0) [0|0.9525] "m" ASDM
 SG_ DET_RANGE_VELOCITY_156 : 377|15@0+ (0.0078125,-128) [-128|127.9921875] "m/s" ASDM
 SG_ DET_RANGE_VELOCITY_ERR_156 : 394|8@0+ (0.003,0) [0|0.765] "m/s" ASDM
 SG_ DET_AZIMUTH_156 : 420|13@0+ (0.0004,-1.5708) [-1.5708|1.5708] "rad" ASDM
 SG_ DET_AZIMUTH_ERR_156 : 438|7@0+ (0.00087267,0) [0|0.11082909] "rad" ASDM
 SG_ DET_ELEVATION_156 : 402|8@0+ (0.00275,-0.34925) [-0.34925|0.34925] "rad" ASDM
 SG_ DET_ELEVATION_ERR_156 : 410|6@0+ (0.00174533,0) [0|0.10995579] "rad" ASDM
 SG_ DET_RCS_156 : 479|8@0+ (0.5,-64) [-64|63.5] "dBsm" ASDM
 SG_ DET_VALID_FLAG_156 : 460|1@0+ (1,0) [0|1] "" ASDM
 SG_ DET_BI_STATIC_FLAG_156 : 484|1@0+ (1,0) [0|1] "" ASDM
 SG_ DET_SUPER_RES_TARGET_156 : 439|1@0+ (1,0) [0|1] "" ASDM
 SG_ DET_SNR_156 : 471|8@0+ (0.35156,0) [0|89.6478] "dB" ASDM
 SG_ DET_POINT_TARGET_PROB_156 : 455|4@0+ (6.67,0) [0|100] "%" ASDM
 SG_ DET_EXISTENCE_PROB_156 : 451|6@0+ (1.588,0) [0|100] "%" ASDM
 SG_ DET_OUTSIDE_SECTOR_156 : 461|1@0+ (1,0) [0|1] "" ASDM
 SG_ DET_HVC_FLAG_156 : 447|1@0+ (1,0) [0|1] "" ASDM
 SG_ DET_CONFD_AZIMUTH_156 : 457|2@0+ (1,0) [0|3] "" ASDM
 SG_ DET_CONFD_ELEVATION_156 : 459|2@0+ (1,0) [0|3] "" ASDM
 SG_ DET_AZIMUTH_AMB_ID_156 : 442|3@0+ (1,0) [0|7] "" ASDM
 SG_ DET_AMBG_AZIMUTH_PROB_156 : 446|4@0+ (6.67,0) [0|100] "%" ASDM
 SG_ DET_MH_SCAN_INDEX_4LSB_153_156 : 483|4@0+ (1,0) [0|15] "" ASDM
 SG_ DET_MH_CYCLE_COUNTER_153_156 : 495|8@0+ (1,0) [0|255] "" ASDM
 SG_ DET_MH_CRC16_153_156 : 503|16@0+ (1,0) [0|65535] "" ASDM

BO_ 551 RDR_DETECTION_157_160: 64 G5_RDR03
 SG_ DET_RANGE_157 : 7|15@0+ (0.015625,0) [0|500] "m" ASDM
 SG_ DET_RANGE_ERR_157 : 8|7@0+ (0.0075,0) [0|0.9525] "m" ASDM
 SG_ DET_RANGE_VELOCITY_157 : 17|15@0+ (0.0078125,-128) [-128|127.9921875] "m/s" ASDM
 SG_ DET_RANGE_VELOCITY_ERR_157 : 34|8@0+ (0.003,0) [0|0.765] "m/s" ASDM
 SG_ DET_AZIMUTH_157 : 60|13@0+ (0.0004,-1.5708) [-1.5708|1.5708] "rad" ASDM
 SG_ DET_AZIMUTH_ERR_157 : 78|7@0+ (0.00087267,0) [0|0.11082909] "rad" ASDM
 SG_ DET_ELEVATION_157 : 42|8@0+ (0.00275,-0.34925) [-0.34925|0.34925] "rad" ASDM
 SG_ DET_ELEVATION_ERR_157 : 50|6@0+ (0.00174533,0) [0|0.10995579] "rad" ASDM
 SG_ DET_RCS_157 : 119|8@0+ (0.5,-64) [-64|63.5] "dBsm" ASDM
 SG_ DET_VALID_FLAG_157 : 100|1@0+ (1,0) [0|1] "" ASDM
 SG_ DET_BI_STATIC_FLAG_157 : 487|1@0+ (1,0) [0|1] "" ASDM
 SG_ DET_SUPER_RES_TARGET_157 : 79|1@0+ (1,0) [0|1] "" ASDM
 SG_ DET_SNR_157 : 111|8@0+ (0.35156,0) [0|89.6478] "dB" ASDM
 SG_ DET_POINT_TARGET_PROB_157 : 95|4@0+ (6.67,0) [0|100] "%" ASDM
 SG_ DET_EXISTENCE_PROB_157 : 91|6@0+ (1.588,0) [0|100] "%" ASDM
 SG_ DET_OUTSIDE_SECTOR_157 : 101|1@0+ (1,0) [0|1] "" ASDM
 SG_ DET_HVC_FLAG_157 : 87|1@0+ (1,0) [0|1] "" ASDM
 SG_ DET_CONFD_AZIMUTH_157 : 97|2@0+ (1,0) [0|3] "" ASDM
 SG_ DET_CONFD_ELEVATION_157 : 99|2@0+ (1,0) [0|3] "" ASDM
 SG_ DET_AZIMUTH_AMB_ID_157 : 82|3@0+ (1,0) [0|7] "" ASDM
 SG_ DET_AMBG_AZIMUTH_PROB_157 : 86|4@0+ (6.67,0) [0|100] "%" ASDM
 SG_ DET_RANGE_158 : 127|15@0+ (0.015625,0) [0|500] "m" ASDM
 SG_ DET_RANGE_ERR_158 : 128|7@0+ (0.0075,0) [0|0.9525] "m" ASDM
 SG_ DET_RANGE_VELOCITY_158 : 137|15@0+ (0.0078125,-128) [-128|127.9921875] "m/s" ASDM
 SG_ DET_RANGE_VELOCITY_ERR_158 : 154|8@0+ (0.003,0) [0|0.765] "m/s" ASDM
 SG_ DET_AZIMUTH_158 : 180|13@0+ (0.0004,-1.5708) [-1.5708|1.5708] "rad" ASDM
 SG_ DET_AZIMUTH_ERR_158 : 198|7@0+ (0.00087267,0) [0|0.11082909] "rad" ASDM
 SG_ DET_ELEVATION_158 : 162|8@0+ (0.00275,-0.34925) [-0.34925|0.34925] "rad" ASDM
 SG_ DET_ELEVATION_ERR_158 : 170|6@0+ (0.00174533,0) [0|0.10995579] "rad" ASDM
 SG_ DET_RCS_158 : 239|8@0+ (0.5,-64) [-64|63.5] "dBsm" ASDM
 SG_ DET_VALID_FLAG_158 : 220|1@0+ (1,0) [0|1] "" ASDM
 SG_ DET_BI_STATIC_FLAG_158 : 486|1@0+ (1,0) [0|1] "" ASDM
 SG_ DET_SUPER_RES_TARGET_158 : 199|1@0+ (1,0) [0|1] "" ASDM
 SG_ DET_SNR_158 : 231|8@0+ (0.35156,0) [0|89.6478] "dB" ASDM
 SG_ DET_POINT_TARGET_PROB_158 : 215|4@0+ (6.67,0) [0|100] "%" ASDM
 SG_ DET_EXISTENCE_PROB_158 : 211|6@0+ (1.588,0) [0|100] "%" ASDM
 SG_ DET_OUTSIDE_SECTOR_158 : 221|1@0+ (1,0) [0|1] "" ASDM
 SG_ DET_HVC_FLAG_158 : 207|1@0+ (1,0) [0|1] "" ASDM
 SG_ DET_CONFD_AZIMUTH_158 : 217|2@0+ (1,0) [0|3] "" ASDM
 SG_ DET_CONFD_ELEVATION_158 : 219|2@0+ (1,0) [0|3] "" ASDM
 SG_ DET_AZIMUTH_AMB_ID_158 : 202|3@0+ (1,0) [0|7] "" ASDM
 SG_ DET_AMBG_AZIMUTH_PROB_158 : 206|4@0+ (6.67,0) [0|100] "%" ASDM
 SG_ DET_RANGE_159 : 247|15@0+ (0.015625,0) [0|500] "m" ASDM
 SG_ DET_RANGE_ERR_159 : 248|7@0+ (0.0075,0) [0|0.9525] "m" ASDM
 SG_ DET_RANGE_VELOCITY_159 : 257|15@0+ (0.0078125,-128) [-128|127.9921875] "m/s" ASDM
 SG_ DET_RANGE_VELOCITY_ERR_159 : 274|8@0+ (0.003,0) [0|0.765] "m/s" ASDM
 SG_ DET_AZIMUTH_159 : 300|13@0+ (0.0004,-1.5708) [-1.5708|1.5708] "rad" ASDM
 SG_ DET_AZIMUTH_ERR_159 : 318|7@0+ (0.00087267,0) [0|0.11082909] "rad" ASDM
 SG_ DET_ELEVATION_159 : 282|8@0+ (0.00275,-0.34925) [-0.34925|0.34925] "rad" ASDM
 SG_ DET_ELEVATION_ERR_159 : 290|6@0+ (0.00174533,0) [0|0.10995579] "rad" ASDM
 SG_ DET_RCS_159 : 359|8@0+ (0.5,-64) [-64|63.5] "dBsm" ASDM
 SG_ DET_VALID_FLAG_159 : 340|1@0+ (1,0) [0|1] "" ASDM
 SG_ DET_BI_STATIC_FLAG_159 : 485|1@0+ (1,0) [0|1] "" ASDM
 SG_ DET_SUPER_RES_TARGET_159 : 319|1@0+ (1,0) [0|1] "" ASDM
 SG_ DET_SNR_159 : 351|8@0+ (0.35156,0) [0|89.6478] "dB" ASDM
 SG_ DET_POINT_TARGET_PROB_159 : 335|4@0+ (6.67,0) [0|100] "%" ASDM
 SG_ DET_EXISTENCE_PROB_159 : 331|6@0+ (1.588,0) [0|100] "%" ASDM
 SG_ DET_OUTSIDE_SECTOR_159 : 341|1@0+ (1,0) [0|1] "" ASDM
 SG_ DET_HVC_FLAG_159 : 327|1@0+ (1,0) [0|1] "" ASDM
 SG_ DET_CONFD_AZIMUTH_159 : 337|2@0+ (1,0) [0|3] "" ASDM
 SG_ DET_CONFD_ELEVATION_159 : 339|2@0+ (1,0) [0|3] "" ASDM
 SG_ DET_AZIMUTH_AMB_ID_159 : 322|3@0+ (1,0) [0|7] "" ASDM
 SG_ DET_AMBG_AZIMUTH_PROB_159 : 326|4@0+ (6.67,0) [0|100] "%" ASDM
 SG_ DET_RANGE_160 : 367|15@0+ (0.015625,0) [0|500] "m" ASDM
 SG_ DET_RANGE_ERR_160 : 368|7@0+ (0.0075,0) [0|0.9525] "m" ASDM
 SG_ DET_RANGE_VELOCITY_160 : 377|15@0+ (0.0078125,-128) [-128|127.9921875] "m/s" ASDM
 SG_ DET_RANGE_VELOCITY_ERR_160 : 394|8@0+ (0.003,0) [0|0.765] "m/s" ASDM
 SG_ DET_AZIMUTH_160 : 420|13@0+ (0.0004,-1.5708) [-1.5708|1.5708] "rad" ASDM
 SG_ DET_AZIMUTH_ERR_160 : 438|7@0+ (0.00087267,0) [0|0.11082909] "rad" ASDM
 SG_ DET_ELEVATION_160 : 402|8@0+ (0.00275,-0.34925) [-0.34925|0.34925] "rad" ASDM
 SG_ DET_ELEVATION_ERR_160 : 410|6@0+ (0.00174533,0) [0|0.10995579] "rad" ASDM
 SG_ DET_RCS_160 : 479|8@0+ (0.5,-64) [-64|63.5] "dBsm" ASDM
 SG_ DET_VALID_FLAG_160 : 460|1@0+ (1,0) [0|1] "" ASDM
 SG_ DET_BI_STATIC_FLAG_160 : 484|1@0+ (1,0) [0|1] "" ASDM
 SG_ DET_SUPER_RES_TARGET_160 : 439|1@0+ (1,0) [0|1] "" ASDM
 SG_ DET_SNR_160 : 471|8@0+ (0.35156,0) [0|89.6478] "dB" ASDM
 SG_ DET_POINT_TARGET_PROB_160 : 455|4@0+ (6.67,0) [0|100] "%" ASDM
 SG_ DET_EXISTENCE_PROB_160 : 451|6@0+ (1.588,0) [0|100] "%" ASDM
 SG_ DET_OUTSIDE_SECTOR_160 : 461|1@0+ (1,0) [0|1] "" ASDM
 SG_ DET_HVC_FLAG_160 : 447|1@0+ (1,0) [0|1] "" ASDM
 SG_ DET_CONFD_AZIMUTH_160 : 457|2@0+ (1,0) [0|3] "" ASDM
 SG_ DET_CONFD_ELEVATION_160 : 459|2@0+ (1,0) [0|3] "" ASDM
 SG_ DET_AZIMUTH_AMB_ID_160 : 442|3@0+ (1,0) [0|7] "" ASDM
 SG_ DET_AMBG_AZIMUTH_PROB_160 : 446|4@0+ (6.67,0) [0|100] "%" ASDM
 SG_ DET_MH_SCAN_INDEX_4LSB_157_160 : 483|4@0+ (1,0) [0|15] "" ASDM
 SG_ DET_MH_CYCLE_COUNTER_157_160 : 495|8@0+ (1,0) [0|255] "" ASDM
 SG_ DET_MH_CRC16_157_160 : 503|16@0+ (1,0) [0|65535] "" ASDM

BO_ 552 RDR_DETECTION_161_164: 64 G5_RDR03
 SG_ DET_RANGE_161 : 7|15@0+ (0.015625,0) [0|500] "m" ASDM
 SG_ DET_RANGE_ERR_161 : 8|7@0+ (0.0075,0) [0|0.9525] "m" ASDM
 SG_ DET_RANGE_VELOCITY_161 : 17|15@0+ (0.0078125,-128) [-128|127.9921875] "m/s" ASDM
 SG_ DET_RANGE_VELOCITY_ERR_161 : 34|8@0+ (0.003,0) [0|0.765] "m/s" ASDM
 SG_ DET_AZIMUTH_161 : 60|13@0+ (0.0004,-1.5708) [-1.5708|1.5708] "rad" ASDM
 SG_ DET_AZIMUTH_ERR_161 : 78|7@0+ (0.00087267,0) [0|0.11082909] "rad" ASDM
 SG_ DET_ELEVATION_161 : 42|8@0+ (0.00275,-0.34925) [-0.34925|0.34925] "rad" ASDM
 SG_ DET_ELEVATION_ERR_161 : 50|6@0+ (0.00174533,0) [0|0.10995579] "rad" ASDM
 SG_ DET_RCS_161 : 119|8@0+ (0.5,-64) [-64|63.5] "dBsm" ASDM
 SG_ DET_VALID_FLAG_161 : 100|1@0+ (1,0) [0|1] "" ASDM
 SG_ DET_BI_STATIC_FLAG_161 : 487|1@0+ (1,0) [0|1] "" ASDM
 SG_ DET_SUPER_RES_TARGET_161 : 79|1@0+ (1,0) [0|1] "" ASDM
 SG_ DET_SNR_161 : 111|8@0+ (0.35156,0) [0|89.6478] "dB" ASDM
 SG_ DET_POINT_TARGET_PROB_161 : 95|4@0+ (6.67,0) [0|100] "%" ASDM
 SG_ DET_EXISTENCE_PROB_161 : 91|6@0+ (1.588,0) [0|100] "%" ASDM
 SG_ DET_OUTSIDE_SECTOR_161 : 101|1@0+ (1,0) [0|1] "" ASDM
 SG_ DET_HVC_FLAG_161 : 87|1@0+ (1,0) [0|1] "" ASDM
 SG_ DET_CONFD_AZIMUTH_161 : 97|2@0+ (1,0) [0|3] "" ASDM
 SG_ DET_CONFD_ELEVATION_161 : 99|2@0+ (1,0) [0|3] "" ASDM
 SG_ DET_AZIMUTH_AMB_ID_161 : 82|3@0+ (1,0) [0|7] "" ASDM
 SG_ DET_AMBG_AZIMUTH_PROB_161 : 86|4@0+ (6.67,0) [0|100] "%" ASDM
 SG_ DET_RANGE_162 : 127|15@0+ (0.015625,0) [0|500] "m" ASDM
 SG_ DET_RANGE_ERR_162 : 128|7@0+ (0.0075,0) [0|0.9525] "m" ASDM
 SG_ DET_RANGE_VELOCITY_162 : 137|15@0+ (0.0078125,-128) [-128|127.9921875] "m/s" ASDM
 SG_ DET_RANGE_VELOCITY_ERR_162 : 154|8@0+ (0.003,0) [0|0.765] "m/s" ASDM
 SG_ DET_AZIMUTH_162 : 180|13@0+ (0.0004,-1.5708) [-1.5708|1.5708] "rad" ASDM
 SG_ DET_AZIMUTH_ERR_162 : 198|7@0+ (0.00087267,0) [0|0.11082909] "rad" ASDM
 SG_ DET_ELEVATION_162 : 162|8@0+ (0.00275,-0.34925) [-0.34925|0.34925] "rad" ASDM
 SG_ DET_ELEVATION_ERR_162 : 170|6@0+ (0.00174533,0) [0|0.10995579] "rad" ASDM
 SG_ DET_RCS_162 : 239|8@0+ (0.5,-64) [-64|63.5] "dBsm" ASDM
 SG_ DET_VALID_FLAG_162 : 220|1@0+ (1,0) [0|1] "" ASDM
 SG_ DET_BI_STATIC_FLAG_162 : 486|1@0+ (1,0) [0|1] "" ASDM
 SG_ DET_SUPER_RES_TARGET_162 : 199|1@0+ (1,0) [0|1] "" ASDM
 SG_ DET_SNR_162 : 231|8@0+ (0.35156,0) [0|89.6478] "dB" ASDM
 SG_ DET_POINT_TARGET_PROB_162 : 215|4@0+ (6.67,0) [0|100] "%" ASDM
 SG_ DET_EXISTENCE_PROB_162 : 211|6@0+ (1.588,0) [0|100] "%" ASDM
 SG_ DET_OUTSIDE_SECTOR_162 : 221|1@0+ (1,0) [0|1] "" ASDM
 SG_ DET_HVC_FLAG_162 : 207|1@0+ (1,0) [0|1] "" ASDM
 SG_ DET_CONFD_AZIMUTH_162 : 217|2@0+ (1,0) [0|3] "" ASDM
 SG_ DET_CONFD_ELEVATION_162 : 219|2@0+ (1,0) [0|3] "" ASDM
 SG_ DET_AZIMUTH_AMB_ID_162 : 202|3@0+ (1,0) [0|7] "" ASDM
 SG_ DET_AMBG_AZIMUTH_PROB_162 : 206|4@0+ (6.67,0) [0|100] "%" ASDM
 SG_ DET_RANGE_163 : 247|15@0+ (0.015625,0) [0|500] "m" ASDM
 SG_ DET_RANGE_ERR_163 : 248|7@0+ (0.0075,0) [0|0.9525] "m" ASDM
 SG_ DET_RANGE_VELOCITY_163 : 257|15@0+ (0.0078125,-128) [-128|127.9921875] "m/s" ASDM
 SG_ DET_RANGE_VELOCITY_ERR_163 : 274|8@0+ (0.003,0) [0|0.765] "m/s" ASDM
 SG_ DET_AZIMUTH_163 : 300|13@0+ (0.0004,-1.5708) [-1.5708|1.5708] "rad" ASDM
 SG_ DET_AZIMUTH_ERR_163 : 318|7@0+ (0.00087267,0) [0|0.11082909] "rad" ASDM
 SG_ DET_ELEVATION_163 : 282|8@0+ (0.00275,-0.34925) [-0.34925|0.34925] "rad" ASDM
 SG_ DET_ELEVATION_ERR_163 : 290|6@0+ (0.00174533,0) [0|0.10995579] "rad" ASDM
 SG_ DET_RCS_163 : 359|8@0+ (0.5,-64) [-64|63.5] "dBsm" ASDM
 SG_ DET_VALID_FLAG_163 : 340|1@0+ (1,0) [0|1] "" ASDM
 SG_ DET_BI_STATIC_FLAG_163 : 485|1@0+ (1,0) [0|1] "" ASDM
 SG_ DET_SUPER_RES_TARGET_163 : 319|1@0+ (1,0) [0|1] "" ASDM
 SG_ DET_SNR_163 : 351|8@0+ (0.35156,0) [0|89.6478] "dB" ASDM
 SG_ DET_POINT_TARGET_PROB_163 : 335|4@0+ (6.67,0) [0|100] "%" ASDM
 SG_ DET_EXISTENCE_PROB_163 : 331|6@0+ (1.588,0) [0|100] "%" ASDM
 SG_ DET_OUTSIDE_SECTOR_163 : 341|1@0+ (1,0) [0|1] "" ASDM
 SG_ DET_HVC_FLAG_163 : 327|1@0+ (1,0) [0|1] "" ASDM
 SG_ DET_CONFD_AZIMUTH_163 : 337|2@0+ (1,0) [0|3] "" ASDM
 SG_ DET_CONFD_ELEVATION_163 : 339|2@0+ (1,0) [0|3] "" ASDM
 SG_ DET_AZIMUTH_AMB_ID_163 : 322|3@0+ (1,0) [0|7] "" ASDM
 SG_ DET_AMBG_AZIMUTH_PROB_163 : 326|4@0+ (6.67,0) [0|100] "%" ASDM
 SG_ DET_RANGE_164 : 367|15@0+ (0.015625,0) [0|500] "m" ASDM
 SG_ DET_RANGE_ERR_164 : 368|7@0+ (0.0075,0) [0|0.9525] "m" ASDM
 SG_ DET_RANGE_VELOCITY_164 : 377|15@0+ (0.0078125,-128) [-128|127.9921875] "m/s" ASDM
 SG_ DET_RANGE_VELOCITY_ERR_164 : 394|8@0+ (0.003,0) [0|0.765] "m/s" ASDM
 SG_ DET_AZIMUTH_164 : 420|13@0+ (0.0004,-1.5708) [-1.5708|1.5708] "rad" ASDM
 SG_ DET_AZIMUTH_ERR_164 : 438|7@0+ (0.00087267,0) [0|0.11082909] "rad" ASDM
 SG_ DET_ELEVATION_164 : 402|8@0+ (0.00275,-0.34925) [-0.34925|0.34925] "rad" ASDM
 SG_ DET_ELEVATION_ERR_164 : 410|6@0+ (0.00174533,0) [0|0.10995579] "rad" ASDM
 SG_ DET_RCS_164 : 479|8@0+ (0.5,-64) [-64|63.5] "dBsm" ASDM
 SG_ DET_VALID_FLAG_164 : 460|1@0+ (1,0) [0|1] "" ASDM
 SG_ DET_BI_STATIC_FLAG_164 : 484|1@0+ (1,0) [0|1] "" ASDM
 SG_ DET_SUPER_RES_TARGET_164 : 439|1@0+ (1,0) [0|1] "" ASDM
 SG_ DET_SNR_164 : 471|8@0+ (0.35156,0) [0|89.6478] "dB" ASDM
 SG_ DET_POINT_TARGET_PROB_164 : 455|4@0+ (6.67,0) [0|100] "%" ASDM
 SG_ DET_EXISTENCE_PROB_164 : 451|6@0+ (1.588,0) [0|100] "%" ASDM
 SG_ DET_OUTSIDE_SECTOR_164 : 461|1@0+ (1,0) [0|1] "" ASDM
 SG_ DET_HVC_FLAG_164 : 447|1@0+ (1,0) [0|1] "" ASDM
 SG_ DET_CONFD_AZIMUTH_164 : 457|2@0+ (1,0) [0|3] "" ASDM
 SG_ DET_CONFD_ELEVATION_164 : 459|2@0+ (1,0) [0|3] "" ASDM
 SG_ DET_AZIMUTH_AMB_ID_164 : 442|3@0+ (1,0) [0|7] "" ASDM
 SG_ DET_AMBG_AZIMUTH_PROB_164 : 446|4@0+ (6.67,0) [0|100] "%" ASDM
 SG_ DET_MH_SCAN_INDEX_4LSB_161_164 : 483|4@0+ (1,0) [0|15] "" ASDM
 SG_ DET_MH_CYCLE_COUNTER_161_164 : 495|8@0+ (1,0) [0|255] "" ASDM
 SG_ DET_MH_CRC16_161_164 : 503|16@0+ (1,0) [0|65535] "" ASDM

BO_ 553 RDR_DETECTION_165_168: 64 G5_RDR03
 SG_ DET_RANGE_165 : 7|15@0+ (0.015625,0) [0|500] "m" ASDM
 SG_ DET_RANGE_ERR_165 : 8|7@0+ (0.0075,0) [0|0.9525] "m" ASDM
 SG_ DET_RANGE_VELOCITY_165 : 17|15@0+ (0.0078125,-128) [-128|127.9921875] "m/s" ASDM
 SG_ DET_RANGE_VELOCITY_ERR_165 : 34|8@0+ (0.003,0) [0|0.765] "m/s" ASDM
 SG_ DET_AZIMUTH_165 : 60|13@0+ (0.0004,-1.5708) [-1.5708|1.5708] "rad" ASDM
 SG_ DET_AZIMUTH_ERR_165 : 78|7@0+ (0.00087267,0) [0|0.11082909] "rad" ASDM
 SG_ DET_ELEVATION_165 : 42|8@0+ (0.00275,-0.34925) [-0.34925|0.34925] "rad" ASDM
 SG_ DET_ELEVATION_ERR_165 : 50|6@0+ (0.00174533,0) [0|0.10995579] "rad" ASDM
 SG_ DET_RCS_165 : 119|8@0+ (0.5,-64) [-64|63.5] "dBsm" ASDM
 SG_ DET_VALID_FLAG_165 : 100|1@0+ (1,0) [0|1] "" ASDM
 SG_ DET_BI_STATIC_FLAG_165 : 487|1@0+ (1,0) [0|1] "" ASDM
 SG_ DET_SUPER_RES_TARGET_165 : 79|1@0+ (1,0) [0|1] "" ASDM
 SG_ DET_SNR_165 : 111|8@0+ (0.35156,0) [0|89.6478] "dB" ASDM
 SG_ DET_POINT_TARGET_PROB_165 : 95|4@0+ (6.67,0) [0|100] "%" ASDM
 SG_ DET_EXISTENCE_PROB_165 : 91|6@0+ (1.588,0) [0|100] "%" ASDM
 SG_ DET_OUTSIDE_SECTOR_165 : 101|1@0+ (1,0) [0|1] "" ASDM
 SG_ DET_HVC_FLAG_165 : 87|1@0+ (1,0) [0|1] "" ASDM
 SG_ DET_CONFD_AZIMUTH_165 : 97|2@0+ (1,0) [0|3] "" ASDM
 SG_ DET_CONFD_ELEVATION_165 : 99|2@0+ (1,0) [0|3] "" ASDM
 SG_ DET_AZIMUTH_AMB_ID_165 : 82|3@0+ (1,0) [0|7] "" ASDM
 SG_ DET_AMBG_AZIMUTH_PROB_165 : 86|4@0+ (6.67,0) [0|100] "%" ASDM
 SG_ DET_RANGE_166 : 127|15@0+ (0.015625,0) [0|500] "m" ASDM
 SG_ DET_RANGE_ERR_166 : 128|7@0+ (0.0075,0) [0|0.9525] "m" ASDM
 SG_ DET_RANGE_VELOCITY_166 : 137|15@0+ (0.0078125,-128) [-128|127.9921875] "m/s" ASDM
 SG_ DET_RANGE_VELOCITY_ERR_166 : 154|8@0+ (0.003,0) [0|0.765] "m/s" ASDM
 SG_ DET_AZIMUTH_166 : 180|13@0+ (0.0004,-1.5708) [-1.5708|1.5708] "rad" ASDM
 SG_ DET_AZIMUTH_ERR_166 : 198|7@0+ (0.00087267,0) [0|0.11082909] "rad" ASDM
 SG_ DET_ELEVATION_166 : 162|8@0+ (0.00275,-0.34925) [-0.34925|0.34925] "rad" ASDM
 SG_ DET_ELEVATION_ERR_166 : 170|6@0+ (0.00174533,0) [0|0.10995579] "rad" ASDM
 SG_ DET_RCS_166 : 239|8@0+ (0.5,-64) [-64|63.5] "dBsm" ASDM
 SG_ DET_VALID_FLAG_166 : 220|1@0+ (1,0) [0|1] "" ASDM
 SG_ DET_BI_STATIC_FLAG_166 : 486|1@0+ (1,0) [0|1] "" ASDM
 SG_ DET_SUPER_RES_TARGET_166 : 199|1@0+ (1,0) [0|1] "" ASDM
 SG_ DET_SNR_166 : 231|8@0+ (0.35156,0) [0|89.6478] "dB" ASDM
 SG_ DET_POINT_TARGET_PROB_166 : 215|4@0+ (6.67,0) [0|100] "%" ASDM
 SG_ DET_EXISTENCE_PROB_166 : 211|6@0+ (1.588,0) [0|100] "%" ASDM
 SG_ DET_OUTSIDE_SECTOR_166 : 221|1@0+ (1,0) [0|1] "" ASDM
 SG_ DET_HVC_FLAG_166 : 207|1@0+ (1,0) [0|1] "" ASDM
 SG_ DET_CONFD_AZIMUTH_166 : 217|2@0+ (1,0) [0|3] "" ASDM
 SG_ DET_CONFD_ELEVATION_166 : 219|2@0+ (1,0) [0|3] "" ASDM
 SG_ DET_AZIMUTH_AMB_ID_166 : 202|3@0+ (1,0) [0|7] "" ASDM
 SG_ DET_AMBG_AZIMUTH_PROB_166 : 206|4@0+ (6.67,0) [0|100] "%" ASDM
 SG_ DET_RANGE_167 : 247|15@0+ (0.015625,0) [0|500] "m" ASDM
 SG_ DET_RANGE_ERR_167 : 248|7@0+ (0.0075,0) [0|0.9525] "m" ASDM
 SG_ DET_RANGE_VELOCITY_167 : 257|15@0+ (0.0078125,-128) [-128|127.9921875] "m/s" ASDM
 SG_ DET_RANGE_VELOCITY_ERR_167 : 274|8@0+ (0.003,0) [0|0.765] "m/s" ASDM
 SG_ DET_AZIMUTH_167 : 300|13@0+ (0.0004,-1.5708) [-1.5708|1.5708] "rad" ASDM
 SG_ DET_AZIMUTH_ERR_167 : 318|7@0+ (0.00087267,0) [0|0.11082909] "rad" ASDM
 SG_ DET_ELEVATION_167 : 282|8@0+ (0.00275,-0.34925) [-0.34925|0.34925] "rad" ASDM
 SG_ DET_ELEVATION_ERR_167 : 290|6@0+ (0.00174533,0) [0|0.10995579] "rad" ASDM
 SG_ DET_RCS_167 : 359|8@0+ (0.5,-64) [-64|63.5] "dBsm" ASDM
 SG_ DET_VALID_FLAG_167 : 340|1@0+ (1,0) [0|1] "" ASDM
 SG_ DET_BI_STATIC_FLAG_167 : 485|1@0+ (1,0) [0|1] "" ASDM
 SG_ DET_SUPER_RES_TARGET_167 : 319|1@0+ (1,0) [0|1] "" ASDM
 SG_ DET_SNR_167 : 351|8@0+ (0.35156,0) [0|89.6478] "dB" ASDM
 SG_ DET_POINT_TARGET_PROB_167 : 335|4@0+ (6.67,0) [0|100] "%" ASDM
 SG_ DET_EXISTENCE_PROB_167 : 331|6@0+ (1.588,0) [0|100] "%" ASDM
 SG_ DET_OUTSIDE_SECTOR_167 : 341|1@0+ (1,0) [0|1] "" ASDM
 SG_ DET_HVC_FLAG_167 : 327|1@0+ (1,0) [0|1] "" ASDM
 SG_ DET_CONFD_AZIMUTH_167 : 337|2@0+ (1,0) [0|3] "" ASDM
 SG_ DET_CONFD_ELEVATION_167 : 339|2@0+ (1,0) [0|3] "" ASDM
 SG_ DET_AZIMUTH_AMB_ID_167 : 322|3@0+ (1,0) [0|7] "" ASDM
 SG_ DET_AMBG_AZIMUTH_PROB_167 : 326|4@0+ (6.67,0) [0|100] "%" ASDM
 SG_ DET_RANGE_168 : 367|15@0+ (0.015625,0) [0|500] "m" ASDM
 SG_ DET_RANGE_ERR_168 : 368|7@0+ (0.0075,0) [0|0.9525] "m" ASDM
 SG_ DET_RANGE_VELOCITY_168 : 377|15@0+ (0.0078125,-128) [-128|127.9921875] "m/s" ASDM
 SG_ DET_RANGE_VELOCITY_ERR_168 : 394|8@0+ (0.003,0) [0|0.765] "m/s" ASDM
 SG_ DET_AZIMUTH_168 : 420|13@0+ (0.0004,-1.5708) [-1.5708|1.5708] "rad" ASDM
 SG_ DET_AZIMUTH_ERR_168 : 438|7@0+ (0.00087267,0) [0|0.11082909] "rad" ASDM
 SG_ DET_ELEVATION_168 : 402|8@0+ (0.00275,-0.34925) [-0.34925|0.34925] "rad" ASDM
 SG_ DET_ELEVATION_ERR_168 : 410|6@0+ (0.00174533,0) [0|0.10995579] "rad" ASDM
 SG_ DET_RCS_168 : 479|8@0+ (0.5,-64) [-64|63.5] "dBsm" ASDM
 SG_ DET_VALID_FLAG_168 : 460|1@0+ (1,0) [0|1] "" ASDM
 SG_ DET_BI_STATIC_FLAG_168 : 484|1@0+ (1,0) [0|1] "" ASDM
 SG_ DET_SUPER_RES_TARGET_168 : 439|1@0+ (1,0) [0|1] "" ASDM
 SG_ DET_SNR_168 : 471|8@0+ (0.35156,0) [0|89.6478] "dB" ASDM
 SG_ DET_POINT_TARGET_PROB_168 : 455|4@0+ (6.67,0) [0|100] "%" ASDM
 SG_ DET_EXISTENCE_PROB_168 : 451|6@0+ (1.588,0) [0|100] "%" ASDM
 SG_ DET_OUTSIDE_SECTOR_168 : 461|1@0+ (1,0) [0|1] "" ASDM
 SG_ DET_HVC_FLAG_168 : 447|1@0+ (1,0) [0|1] "" ASDM
 SG_ DET_CONFD_AZIMUTH_168 : 457|2@0+ (1,0) [0|3] "" ASDM
 SG_ DET_CONFD_ELEVATION_168 : 459|2@0+ (1,0) [0|3] "" ASDM
 SG_ DET_AZIMUTH_AMB_ID_168 : 442|3@0+ (1,0) [0|7] "" ASDM
 SG_ DET_AMBG_AZIMUTH_PROB_168 : 446|4@0+ (6.67,0) [0|100] "%" ASDM
 SG_ DET_MH_SCAN_INDEX_4LSB_165_168 : 483|4@0+ (1,0) [0|15] "" ASDM
 SG_ DET_MH_CYCLE_COUNTER_165_168 : 495|8@0+ (1,0) [0|255] "" ASDM
 SG_ DET_MH_CRC16_165_168 : 503|16@0+ (1,0) [0|65535] "" ASDM

BO_ 554 RDR_DETECTION_169_172: 64 G5_RDR03
 SG_ DET_RANGE_169 : 7|15@0+ (0.015625,0) [0|500] "m" ASDM
 SG_ DET_RANGE_ERR_169 : 8|7@0+ (0.0075,0) [0|0.9525] "m" ASDM
 SG_ DET_RANGE_VELOCITY_169 : 17|15@0+ (0.0078125,-128) [-128|127.9921875] "m/s" ASDM
 SG_ DET_RANGE_VELOCITY_ERR_169 : 34|8@0+ (0.003,0) [0|0.765] "m/s" ASDM
 SG_ DET_AZIMUTH_169 : 60|13@0+ (0.0004,-1.5708) [-1.5708|1.5708] "rad" ASDM
 SG_ DET_AZIMUTH_ERR_169 : 78|7@0+ (0.00087267,0) [0|0.11082909] "rad" ASDM
 SG_ DET_ELEVATION_169 : 42|8@0+ (0.00275,-0.34925) [-0.34925|0.34925] "rad" ASDM
 SG_ DET_ELEVATION_ERR_169 : 50|6@0+ (0.00174533,0) [0|0.10995579] "rad" ASDM
 SG_ DET_RCS_169 : 119|8@0+ (0.5,-64) [-64|63.5] "dBsm" ASDM
 SG_ DET_VALID_FLAG_169 : 100|1@0+ (1,0) [0|1] "" ASDM
 SG_ DET_BI_STATIC_FLAG_169 : 487|1@0+ (1,0) [0|1] "" ASDM
 SG_ DET_SUPER_RES_TARGET_169 : 79|1@0+ (1,0) [0|1] "" ASDM
 SG_ DET_SNR_169 : 111|8@0+ (0.35156,0) [0|89.6478] "dB" ASDM
 SG_ DET_POINT_TARGET_PROB_169 : 95|4@0+ (6.67,0) [0|100] "%" ASDM
 SG_ DET_EXISTENCE_PROB_169 : 91|6@0+ (1.588,0) [0|100] "%" ASDM
 SG_ DET_OUTSIDE_SECTOR_169 : 101|1@0+ (1,0) [0|1] "" ASDM
 SG_ DET_HVC_FLAG_169 : 87|1@0+ (1,0) [0|1] "" ASDM
 SG_ DET_CONFD_AZIMUTH_169 : 97|2@0+ (1,0) [0|3] "" ASDM
 SG_ DET_CONFD_ELEVATION_169 : 99|2@0+ (1,0) [0|3] "" ASDM
 SG_ DET_AZIMUTH_AMB_ID_169 : 82|3@0+ (1,0) [0|7] "" ASDM
 SG_ DET_AMBG_AZIMUTH_PROB_169 : 86|4@0+ (6.67,0) [0|100] "%" ASDM
 SG_ DET_RANGE_170 : 127|15@0+ (0.015625,0) [0|500] "m" ASDM
 SG_ DET_RANGE_ERR_170 : 128|7@0+ (0.0075,0) [0|0.9525] "m" ASDM
 SG_ DET_RANGE_VELOCITY_170 : 137|15@0+ (0.0078125,-128) [-128|127.9921875] "m/s" ASDM
 SG_ DET_RANGE_VELOCITY_ERR_170 : 154|8@0+ (0.003,0) [0|0.765] "m/s" ASDM
 SG_ DET_AZIMUTH_170 : 180|13@0+ (0.0004,-1.5708) [-1.5708|1.5708] "rad" ASDM
 SG_ DET_AZIMUTH_ERR_170 : 198|7@0+ (0.00087267,0) [0|0.11082909] "rad" ASDM
 SG_ DET_ELEVATION_170 : 162|8@0+ (0.00275,-0.34925) [-0.34925|0.34925] "rad" ASDM
 SG_ DET_ELEVATION_ERR_170 : 170|6@0+ (0.00174533,0) [0|0.10995579] "rad" ASDM
 SG_ DET_RCS_170 : 239|8@0+ (0.5,-64) [-64|63.5] "dBsm" ASDM
 SG_ DET_VALID_FLAG_170 : 220|1@0+ (1,0) [0|1] "" ASDM
 SG_ DET_BI_STATIC_FLAG_170 : 486|1@0+ (1,0) [0|1] "" ASDM
 SG_ DET_SUPER_RES_TARGET_170 : 199|1@0+ (1,0) [0|1] "" ASDM
 SG_ DET_SNR_170 : 231|8@0+ (0.35156,0) [0|89.6478] "dB" ASDM
 SG_ DET_POINT_TARGET_PROB_170 : 215|4@0+ (6.67,0) [0|100] "%" ASDM
 SG_ DET_EXISTENCE_PROB_170 : 211|6@0+ (1.588,0) [0|100] "%" ASDM
 SG_ DET_OUTSIDE_SECTOR_170 : 221|1@0+ (1,0) [0|1] "" ASDM
 SG_ DET_HVC_FLAG_170 : 207|1@0+ (1,0) [0|1] "" ASDM
 SG_ DET_CONFD_AZIMUTH_170 : 217|2@0+ (1,0) [0|3] "" ASDM
 SG_ DET_CONFD_ELEVATION_170 : 219|2@0+ (1,0) [0|3] "" ASDM
 SG_ DET_AZIMUTH_AMB_ID_170 : 202|3@0+ (1,0) [0|7] "" ASDM
 SG_ DET_AMBG_AZIMUTH_PROB_170 : 206|4@0+ (6.67,0) [0|100] "%" ASDM
 SG_ DET_RANGE_171 : 247|15@0+ (0.015625,0) [0|500] "m" ASDM
 SG_ DET_RANGE_ERR_171 : 248|7@0+ (0.0075,0) [0|0.9525] "m" ASDM
 SG_ DET_RANGE_VELOCITY_171 : 257|15@0+ (0.0078125,-128) [-128|127.9921875] "m/s" ASDM
 SG_ DET_RANGE_VELOCITY_ERR_171 : 274|8@0+ (0.003,0) [0|0.765] "m/s" ASDM
 SG_ DET_AZIMUTH_171 : 300|13@0+ (0.0004,-1.5708) [-1.5708|1.5708] "rad" ASDM
 SG_ DET_AZIMUTH_ERR_171 : 318|7@0+ (0.00087267,0) [0|0.11082909] "rad" ASDM
 SG_ DET_ELEVATION_171 : 282|8@0+ (0.00275,-0.34925) [-0.34925|0.34925] "rad" ASDM
 SG_ DET_ELEVATION_ERR_171 : 290|6@0+ (0.00174533,0) [0|0.10995579] "rad" ASDM
 SG_ DET_RCS_171 : 359|8@0+ (0.5,-64) [-64|63.5] "dBsm" ASDM
 SG_ DET_VALID_FLAG_171 : 340|1@0+ (1,0) [0|1] "" ASDM
 SG_ DET_BI_STATIC_FLAG_171 : 485|1@0+ (1,0) [0|1] "" ASDM
 SG_ DET_SUPER_RES_TARGET_171 : 319|1@0+ (1,0) [0|1] "" ASDM
 SG_ DET_SNR_171 : 351|8@0+ (0.35156,0) [0|89.6478] "dB" ASDM
 SG_ DET_POINT_TARGET_PROB_171 : 335|4@0+ (6.67,0) [0|100] "%" ASDM
 SG_ DET_EXISTENCE_PROB_171 : 331|6@0+ (1.588,0) [0|100] "%" ASDM
 SG_ DET_OUTSIDE_SECTOR_171 : 341|1@0+ (1,0) [0|1] "" ASDM
 SG_ DET_HVC_FLAG_171 : 327|1@0+ (1,0) [0|1] "" ASDM
 SG_ DET_CONFD_AZIMUTH_171 : 337|2@0+ (1,0) [0|3] "" ASDM
 SG_ DET_CONFD_ELEVATION_171 : 339|2@0+ (1,0) [0|3] "" ASDM
 SG_ DET_AZIMUTH_AMB_ID_171 : 322|3@0+ (1,0) [0|7] "" ASDM
 SG_ DET_AMBG_AZIMUTH_PROB_171 : 326|4@0+ (6.67,0) [0|100] "%" ASDM
 SG_ DET_RANGE_172 : 367|15@0+ (0.015625,0) [0|500] "m" ASDM
 SG_ DET_RANGE_ERR_172 : 368|7@0+ (0.0075,0) [0|0.9525] "m" ASDM
 SG_ DET_RANGE_VELOCITY_172 : 377|15@0+ (0.0078125,-128) [-128|127.9921875] "m/s" ASDM
 SG_ DET_RANGE_VELOCITY_ERR_172 : 394|8@0+ (0.003,0) [0|0.765] "m/s" ASDM
 SG_ DET_AZIMUTH_172 : 420|13@0+ (0.0004,-1.5708) [-1.5708|1.5708] "rad" ASDM
 SG_ DET_AZIMUTH_ERR_172 : 438|7@0+ (0.00087267,0) [0|0.11082909] "rad" ASDM
 SG_ DET_ELEVATION_172 : 402|8@0+ (0.00275,-0.34925) [-0.34925|0.34925] "rad" ASDM
 SG_ DET_ELEVATION_ERR_172 : 410|6@0+ (0.00174533,0) [0|0.10995579] "rad" ASDM
 SG_ DET_RCS_172 : 479|8@0+ (0.5,-64) [-64|63.5] "dBsm" ASDM
 SG_ DET_VALID_FLAG_172 : 460|1@0+ (1,0) [0|1] "" ASDM
 SG_ DET_BI_STATIC_FLAG_172 : 484|1@0+ (1,0) [0|1] "" ASDM
 SG_ DET_SUPER_RES_TARGET_172 : 439|1@0+ (1,0) [0|1] "" ASDM
 SG_ DET_SNR_172 : 471|8@0+ (0.35156,0) [0|89.6478] "dB" ASDM
 SG_ DET_POINT_TARGET_PROB_172 : 455|4@0+ (6.67,0) [0|100] "%" ASDM
 SG_ DET_EXISTENCE_PROB_172 : 451|6@0+ (1.588,0) [0|100] "%" ASDM
 SG_ DET_OUTSIDE_SECTOR_172 : 461|1@0+ (1,0) [0|1] "" ASDM
 SG_ DET_HVC_FLAG_172 : 447|1@0+ (1,0) [0|1] "" ASDM
 SG_ DET_CONFD_AZIMUTH_172 : 457|2@0+ (1,0) [0|3] "" ASDM
 SG_ DET_CONFD_ELEVATION_172 : 459|2@0+ (1,0) [0|3] "" ASDM
 SG_ DET_AZIMUTH_AMB_ID_172 : 442|3@0+ (1,0) [0|7] "" ASDM
 SG_ DET_AMBG_AZIMUTH_PROB_172 : 446|4@0+ (6.67,0) [0|100] "%" ASDM
 SG_ DET_MH_SCAN_INDEX_4LSB_169_172 : 483|4@0+ (1,0) [0|15] "" ASDM
 SG_ DET_MH_CYCLE_COUNTER_169_172 : 495|8@0+ (1,0) [0|255] "" ASDM
 SG_ DET_MH_CRC16_169_172 : 503|16@0+ (1,0) [0|65535] "" ASDM

CM_ SG_ 538 DET_RANGE_105 " measured position  of the detection";
CM_ SG_ 538 DET_RANGE_ERR_105 "RMSE or standard deviation of the measured angle  of the detection";
CM_ SG_ 538 DET_RANGE_VELOCITY_105 "Radial velocity of the detection positive in direction to the sensor";
CM_ SG_ 538 DET_RANGE_VELOCITY_ERR_105 "RMSE or standard deviation of the measure radial velocity of the detection";
CM_ SG_ 538 DET_AZIMUTH_105 "Measured angle  of the detection";
CM_ SG_ 538 DET_AZIMUTH_ERR_105 "RMSE or standard deviation of the measured angle  of the detection";
CM_ SG_ 538 DET_ELEVATION_105 "measured elevation of the detection";
CM_ SG_ 538 DET_ELEVATION_ERR_105 "RMSE or standard deviation of the measured elevation  of the detection";
CM_ SG_ 538 DET_RCS_105 "Radar Cross Section or Amplitude, is a measure of how detectable an object is by radar. A larger RCS indicates that an object is more easily detected.";
CM_ SG_ 538 DET_VALID_FLAG_105 "is set if the measured detection is valid";
CM_ SG_ 538 DET_BI_STATIC_FLAG_105 "1 if detection is bi-static 0 otherwise";
CM_ SG_ 538 DET_SUPER_RES_TARGET_105 "flasg is set if the detection is super resolution target";
CM_ SG_ 538 DET_SNR_105 "The signal to noise ratio (SNR) of the radar detection";
CM_ SG_ 538 DET_POINT_TARGET_PROB_105 "Describes the possibility if more than one real-world object has led to this detection. 0[%] := 100[%] Multi target probability";
CM_ SG_ 538 DET_EXISTENCE_PROB_105 "Existence probability of the detection not based on history. Value does  not depend on any past experience with similar detections.
\note Use as confidence measure where a low value means less confidence
and a high value indicates strong confidence.";
CM_ SG_ 538 DET_OUTSIDE_SECTOR_105 "Flag to indicate detections outside the sector, set if the wrong sector calibration matrix was used";
CM_ SG_ 538 DET_HVC_FLAG_105 "Core2 Vehicle clutter flag";
CM_ SG_ 538 DET_CONFD_AZIMUTH_105 "Define the Confidence of Azimuth for Detection ";
CM_ SG_ 538 DET_CONFD_ELEVATION_105 "Define the Confidence of Elevation for the Detection ";
CM_ SG_ 538 DET_AZIMUTH_AMB_ID_105 "Each ambiguous measurement generates one Ambiguity ID. Ambiguity is indicated by an identical ambiguity ID.
note Unambiguous measurements have the ambiguity ID 0.";
CM_ SG_ 538 DET_AMBG_AZIMUTH_PROB_105 "Probability for different hypothesis, sum is 100 [%] for all detections with the same Ambiguity ID. 0 means no Ambiguity";
CM_ SG_ 538 DET_BI_STATIC_FLAG_106 "1 if detection is bi-static 0 otherwise";
CM_ SG_ 538 DET_BI_STATIC_FLAG_107 "1 if detection is bi-static 0 otherwise";
CM_ SG_ 538 DET_BI_STATIC_FLAG_108 "1 if detection is bi-static 0 otherwise";
CM_ SG_ 538 DET_MH_SCAN_INDEX_4LSB_105_108 "Scan index of the measured detection";
CM_ SG_ 538 DET_MH_CYCLE_COUNTER_105_108 "Detection Alive Counter";
CM_ SG_ 539 DET_RANGE_109 " measured position  of the detection";
CM_ SG_ 539 DET_RANGE_ERR_109 "RMSE or standard deviation of the measured angle  of the detection";
CM_ SG_ 539 DET_RANGE_VELOCITY_109 "Radial velocity of the detection positive in direction to the sensor";
CM_ SG_ 539 DET_RANGE_VELOCITY_ERR_109 "RMSE or standard deviation of the measure radial velocity of the detection";
CM_ SG_ 539 DET_AZIMUTH_109 "Measured angle  of the detection";
CM_ SG_ 539 DET_AZIMUTH_ERR_109 "RMSE or standard deviation of the measured angle  of the detection";
CM_ SG_ 539 DET_ELEVATION_109 "measured elevation of the detection";
CM_ SG_ 539 DET_ELEVATION_ERR_109 "RMSE or standard deviation of the measured elevation  of the detection";
CM_ SG_ 539 DET_RCS_109 "Radar Cross Section or Amplitude, is a measure of how detectable an object is by radar. A larger RCS indicates that an object is more easily detected.";
CM_ SG_ 539 DET_VALID_FLAG_109 "is set if the measured detection is valid";
CM_ SG_ 539 DET_BI_STATIC_FLAG_109 "1 if detection is bi-static 0 otherwise";
CM_ SG_ 539 DET_SUPER_RES_TARGET_109 "flasg is set if the detection is super resolution target";
CM_ SG_ 539 DET_SNR_109 "The signal to noise ratio (SNR) of the radar detection";
CM_ SG_ 539 DET_POINT_TARGET_PROB_109 "Describes the possibility if more than one real-world object has led to this detection. 0[%] := 100[%] Multi target probability";
CM_ SG_ 539 DET_EXISTENCE_PROB_109 "Existence probability of the detection not based on history. Value does  not depend on any past experience with similar detections.
\note Use as confidence measure where a low value means less confidence
and a high value indicates strong confidence.";
CM_ SG_ 539 DET_OUTSIDE_SECTOR_109 "Flag to indicate detections outside the sector, set if the wrong sector calibration matrix was used";
CM_ SG_ 539 DET_HVC_FLAG_109 "Core2 Vehicle clutter flag";
CM_ SG_ 539 DET_CONFD_AZIMUTH_109 "Define the Confidence of Azimuth for Detection ";
CM_ SG_ 539 DET_CONFD_ELEVATION_109 "Define the Confidence of Elevation for the Detection ";
CM_ SG_ 539 DET_AZIMUTH_AMB_ID_109 "Each ambiguous measurement generates one Ambiguity ID. Ambiguity is indicated by an identical ambiguity ID.
note Unambiguous measurements have the ambiguity ID 0.";
CM_ SG_ 539 DET_AMBG_AZIMUTH_PROB_109 "Probability for different hypothesis, sum is 100 [%] for all detections with the same Ambiguity ID. 0 means no Ambiguity";
CM_ SG_ 539 DET_BI_STATIC_FLAG_110 "1 if detection is bi-static 0 otherwise";
CM_ SG_ 539 DET_BI_STATIC_FLAG_111 "1 if detection is bi-static 0 otherwise";
CM_ SG_ 539 DET_BI_STATIC_FLAG_112 "1 if detection is bi-static 0 otherwise";
CM_ SG_ 539 DET_MH_SCAN_INDEX_4LSB_109_112 "Scan index of the measured detection";
CM_ SG_ 539 DET_MH_CYCLE_COUNTER_109_112 "Detection Alive Counter";
CM_ SG_ 540 DET_RANGE_113 " measured position  of the detection";
CM_ SG_ 540 DET_RANGE_ERR_113 "RMSE or standard deviation of the measured angle  of the detection";
CM_ SG_ 540 DET_RANGE_VELOCITY_113 "Radial velocity of the detection positive in direction to the sensor";
CM_ SG_ 540 DET_RANGE_VELOCITY_ERR_113 "RMSE or standard deviation of the measure radial velocity of the detection";
CM_ SG_ 540 DET_AZIMUTH_113 "Measured angle  of the detection";
CM_ SG_ 540 DET_AZIMUTH_ERR_113 "RMSE or standard deviation of the measured angle  of the detection";
CM_ SG_ 540 DET_ELEVATION_113 "measured elevation of the detection";
CM_ SG_ 540 DET_ELEVATION_ERR_113 "RMSE or standard deviation of the measured elevation  of the detection";
CM_ SG_ 540 DET_RCS_113 "Radar Cross Section or Amplitude, is a measure of how detectable an object is by radar. A larger RCS indicates that an object is more easily detected.";
CM_ SG_ 540 DET_VALID_FLAG_113 "is set if the measured detection is valid";
CM_ SG_ 540 DET_BI_STATIC_FLAG_113 "1 if detection is bi-static 0 otherwise";
CM_ SG_ 540 DET_SUPER_RES_TARGET_113 "flasg is set if the detection is super resolution target";
CM_ SG_ 540 DET_SNR_113 "The signal to noise ratio (SNR) of the radar detection";
CM_ SG_ 540 DET_POINT_TARGET_PROB_113 "Describes the possibility if more than one real-world object has led to this detection. 0[%] := 100[%] Multi target probability";
CM_ SG_ 540 DET_EXISTENCE_PROB_113 "Existence probability of the detection not based on history. Value does  not depend on any past experience with similar detections.
\note Use as confidence measure where a low value means less confidence
and a high value indicates strong confidence.";
CM_ SG_ 540 DET_OUTSIDE_SECTOR_113 "Flag to indicate detections outside the sector, set if the wrong sector calibration matrix was used";
CM_ SG_ 540 DET_HVC_FLAG_113 "Core2 Vehicle clutter flag";
CM_ SG_ 540 DET_CONFD_AZIMUTH_113 "Define the Confidence of Azimuth for Detection ";
CM_ SG_ 540 DET_CONFD_ELEVATION_113 "Define the Confidence of Elevation for the Detection ";
CM_ SG_ 540 DET_AZIMUTH_AMB_ID_113 "Each ambiguous measurement generates one Ambiguity ID. Ambiguity is indicated by an identical ambiguity ID.
note Unambiguous measurements have the ambiguity ID 0.";
CM_ SG_ 540 DET_AMBG_AZIMUTH_PROB_113 "Probability for different hypothesis, sum is 100 [%] for all detections with the same Ambiguity ID. 0 means no Ambiguity";
CM_ SG_ 540 DET_BI_STATIC_FLAG_114 "1 if detection is bi-static 0 otherwise";
CM_ SG_ 540 DET_BI_STATIC_FLAG_115 "1 if detection is bi-static 0 otherwise";
CM_ SG_ 540 DET_BI_STATIC_FLAG_116 "1 if detection is bi-static 0 otherwise";
CM_ SG_ 540 DET_MH_SCAN_INDEX_4LSB_113_116 "Scan index of the measured detection";
CM_ SG_ 540 DET_MH_CYCLE_COUNTER_113_116 "Detection Alive Counter";
CM_ SG_ 541 DET_RANGE_117 " measured position  of the detection";
CM_ SG_ 541 DET_RANGE_ERR_117 "RMSE or standard deviation of the measured angle  of the detection";
CM_ SG_ 541 DET_RANGE_VELOCITY_117 "Radial velocity of the detection positive in direction to the sensor";
CM_ SG_ 541 DET_RANGE_VELOCITY_ERR_117 "RMSE or standard deviation of the measure radial velocity of the detection";
CM_ SG_ 541 DET_AZIMUTH_117 "Measured angle  of the detection";
CM_ SG_ 541 DET_AZIMUTH_ERR_117 "RMSE or standard deviation of the measured angle  of the detection";
CM_ SG_ 541 DET_ELEVATION_117 "measured elevation of the detection";
CM_ SG_ 541 DET_ELEVATION_ERR_117 "RMSE or standard deviation of the measured elevation  of the detection";
CM_ SG_ 541 DET_RCS_117 "Radar Cross Section or Amplitude, is a measure of how detectable an object is by radar. A larger RCS indicates that an object is more easily detected.";
CM_ SG_ 541 DET_VALID_FLAG_117 "is set if the measured detection is valid";
CM_ SG_ 541 DET_BI_STATIC_FLAG_117 "1 if detection is bi-static 0 otherwise";
CM_ SG_ 541 DET_SUPER_RES_TARGET_117 "flasg is set if the detection is super resolution target";
CM_ SG_ 541 DET_SNR_117 "The signal to noise ratio (SNR) of the radar detection";
CM_ SG_ 541 DET_POINT_TARGET_PROB_117 "Describes the possibility if more than one real-world object has led to this detection. 0[%] := 100[%] Multi target probability";
CM_ SG_ 541 DET_EXISTENCE_PROB_117 "Existence probability of the detection not based on history. Value does  not depend on any past experience with similar detections.
\note Use as confidence measure where a low value means less confidence
and a high value indicates strong confidence.";
CM_ SG_ 541 DET_OUTSIDE_SECTOR_117 "Flag to indicate detections outside the sector, set if the wrong sector calibration matrix was used";
CM_ SG_ 541 DET_HVC_FLAG_117 "Core2 Vehicle clutter flag";
CM_ SG_ 541 DET_CONFD_AZIMUTH_117 "Define the Confidence of Azimuth for Detection ";
CM_ SG_ 541 DET_CONFD_ELEVATION_117 "Define the Confidence of Elevation for the Detection ";
CM_ SG_ 541 DET_AZIMUTH_AMB_ID_117 "Each ambiguous measurement generates one Ambiguity ID. Ambiguity is indicated by an identical ambiguity ID.
note Unambiguous measurements have the ambiguity ID 0.";
CM_ SG_ 541 DET_AMBG_AZIMUTH_PROB_117 "Probability for different hypothesis, sum is 100 [%] for all detections with the same Ambiguity ID. 0 means no Ambiguity";
CM_ SG_ 541 DET_BI_STATIC_FLAG_118 "1 if detection is bi-static 0 otherwise";
CM_ SG_ 541 DET_BI_STATIC_FLAG_119 "1 if detection is bi-static 0 otherwise";
CM_ SG_ 541 DET_BI_STATIC_FLAG_120 "1 if detection is bi-static 0 otherwise";
CM_ SG_ 541 DET_MH_SCAN_INDEX_4LSB_117_120 "Scan index of the measured detection";
CM_ SG_ 541 DET_MH_CYCLE_COUNTER_117_120 "Detection Alive Counter";
CM_ SG_ 542 DET_RANGE_121 " measured position  of the detection";
CM_ SG_ 542 DET_RANGE_ERR_121 "RMSE or standard deviation of the measured angle  of the detection";
CM_ SG_ 542 DET_RANGE_VELOCITY_121 "Radial velocity of the detection positive in direction to the sensor";
CM_ SG_ 542 DET_RANGE_VELOCITY_ERR_121 "RMSE or standard deviation of the measure radial velocity of the detection";
CM_ SG_ 542 DET_AZIMUTH_121 "Measured angle  of the detection";
CM_ SG_ 542 DET_AZIMUTH_ERR_121 "RMSE or standard deviation of the measured angle  of the detection";
CM_ SG_ 542 DET_ELEVATION_121 "measured elevation of the detection";
CM_ SG_ 542 DET_ELEVATION_ERR_121 "RMSE or standard deviation of the measured elevation  of the detection";
CM_ SG_ 542 DET_RCS_121 "Radar Cross Section or Amplitude, is a measure of how detectable an object is by radar. A larger RCS indicates that an object is more easily detected.";
CM_ SG_ 542 DET_VALID_FLAG_121 "is set if the measured detection is valid";
CM_ SG_ 542 DET_BI_STATIC_FLAG_121 "1 if detection is bi-static 0 otherwise";
CM_ SG_ 542 DET_SUPER_RES_TARGET_121 "flasg is set if the detection is super resolution target";
CM_ SG_ 542 DET_SNR_121 "The signal to noise ratio (SNR) of the radar detection";
CM_ SG_ 542 DET_POINT_TARGET_PROB_121 "Describes the possibility if more than one real-world object has led to this detection. 0[%] := 100[%] Multi target probability";
CM_ SG_ 542 DET_EXISTENCE_PROB_121 "Existence probability of the detection not based on history. Value does  not depend on any past experience with similar detections.
\note Use as confidence measure where a low value means less confidence
and a high value indicates strong confidence.";
CM_ SG_ 542 DET_OUTSIDE_SECTOR_121 "Flag to indicate detections outside the sector, set if the wrong sector calibration matrix was used";
CM_ SG_ 542 DET_HVC_FLAG_121 "Core2 Vehicle clutter flag";
CM_ SG_ 542 DET_CONFD_AZIMUTH_121 "Define the Confidence of Azimuth for Detection ";
CM_ SG_ 542 DET_CONFD_ELEVATION_121 "Define the Confidence of Elevation for the Detection ";
CM_ SG_ 542 DET_AZIMUTH_AMB_ID_121 "Each ambiguous measurement generates one Ambiguity ID. Ambiguity is indicated by an identical ambiguity ID.
note Unambiguous measurements have the ambiguity ID 0.";
CM_ SG_ 542 DET_AMBG_AZIMUTH_PROB_121 "Probability for different hypothesis, sum is 100 [%] for all detections with the same Ambiguity ID. 0 means no Ambiguity";
CM_ SG_ 542 DET_BI_STATIC_FLAG_122 "1 if detection is bi-static 0 otherwise";
CM_ SG_ 542 DET_BI_STATIC_FLAG_123 "1 if detection is bi-static 0 otherwise";
CM_ SG_ 542 DET_BI_STATIC_FLAG_124 "1 if detection is bi-static 0 otherwise";
CM_ SG_ 542 DET_MH_SCAN_INDEX_4LSB_121_124 "Scan index of the measured detection";
CM_ SG_ 542 DET_MH_CYCLE_COUNTER_121_124 "Detection Alive Counter";
CM_ SG_ 543 DET_RANGE_125 " measured position  of the detection";
CM_ SG_ 543 DET_RANGE_ERR_125 "RMSE or standard deviation of the measured angle  of the detection";
CM_ SG_ 543 DET_RANGE_VELOCITY_125 "Radial velocity of the detection positive in direction to the sensor";
CM_ SG_ 543 DET_RANGE_VELOCITY_ERR_125 "RMSE or standard deviation of the measure radial velocity of the detection";
CM_ SG_ 543 DET_AZIMUTH_125 "Measured angle  of the detection";
CM_ SG_ 543 DET_AZIMUTH_ERR_125 "RMSE or standard deviation of the measured angle  of the detection";
CM_ SG_ 543 DET_ELEVATION_125 "measured elevation of the detection";
CM_ SG_ 543 DET_ELEVATION_ERR_125 "RMSE or standard deviation of the measured elevation  of the detection";
CM_ SG_ 543 DET_RCS_125 "Radar Cross Section or Amplitude, is a measure of how detectable an object is by radar. A larger RCS indicates that an object is more easily detected.";
CM_ SG_ 543 DET_VALID_FLAG_125 "is set if the measured detection is valid";
CM_ SG_ 543 DET_BI_STATIC_FLAG_125 "1 if detection is bi-static 0 otherwise";
CM_ SG_ 543 DET_SUPER_RES_TARGET_125 "flasg is set if the detection is super resolution target";
CM_ SG_ 543 DET_SNR_125 "The signal to noise ratio (SNR) of the radar detection";
CM_ SG_ 543 DET_POINT_TARGET_PROB_125 "Describes the possibility if more than one real-world object has led to this detection. 0[%] := 100[%] Multi target probability";
CM_ SG_ 543 DET_EXISTENCE_PROB_125 "Existence probability of the detection not based on history. Value does  not depend on any past experience with similar detections.
\note Use as confidence measure where a low value means less confidence
and a high value indicates strong confidence.";
CM_ SG_ 543 DET_OUTSIDE_SECTOR_125 "Flag to indicate detections outside the sector, set if the wrong sector calibration matrix was used";
CM_ SG_ 543 DET_HVC_FLAG_125 "Core2 Vehicle clutter flag";
CM_ SG_ 543 DET_CONFD_AZIMUTH_125 "Define the Confidence of Azimuth for Detection ";
CM_ SG_ 543 DET_CONFD_ELEVATION_125 "Define the Confidence of Elevation for the Detection ";
CM_ SG_ 543 DET_AZIMUTH_AMB_ID_125 "Each ambiguous measurement generates one Ambiguity ID. Ambiguity is indicated by an identical ambiguity ID.
note Unambiguous measurements have the ambiguity ID 0.";
CM_ SG_ 543 DET_AMBG_AZIMUTH_PROB_125 "Probability for different hypothesis, sum is 100 [%] for all detections with the same Ambiguity ID. 0 means no Ambiguity";
CM_ SG_ 543 DET_BI_STATIC_FLAG_126 "1 if detection is bi-static 0 otherwise";
CM_ SG_ 543 DET_BI_STATIC_FLAG_127 "1 if detection is bi-static 0 otherwise";
CM_ SG_ 543 DET_BI_STATIC_FLAG_128 "1 if detection is bi-static 0 otherwise";
CM_ SG_ 543 DET_MH_SCAN_INDEX_4LSB_125_128 "Scan index of the measured detection";
CM_ SG_ 543 DET_MH_CYCLE_COUNTER_125_128 "Detection Alive Counter";
CM_ SG_ 544 DET_RANGE_129 " measured position  of the detection";
CM_ SG_ 544 DET_RANGE_ERR_129 "RMSE or standard deviation of the measured angle  of the detection";
CM_ SG_ 544 DET_RANGE_VELOCITY_129 "Radial velocity of the detection positive in direction to the sensor";
CM_ SG_ 544 DET_RANGE_VELOCITY_ERR_129 "RMSE or standard deviation of the measure radial velocity of the detection";
CM_ SG_ 544 DET_AZIMUTH_129 "Measured angle  of the detection";
CM_ SG_ 544 DET_AZIMUTH_ERR_129 "RMSE or standard deviation of the measured angle  of the detection";
CM_ SG_ 544 DET_ELEVATION_129 "measured elevation of the detection";
CM_ SG_ 544 DET_ELEVATION_ERR_129 "RMSE or standard deviation of the measured elevation  of the detection";
CM_ SG_ 544 DET_RCS_129 "Radar Cross Section or Amplitude, is a measure of how detectable an object is by radar. A larger RCS indicates that an object is more easily detected.";
CM_ SG_ 544 DET_VALID_FLAG_129 "is set if the measured detection is valid";
CM_ SG_ 544 DET_BI_STATIC_FLAG_129 "1 if detection is bi-static 0 otherwise";
CM_ SG_ 544 DET_SUPER_RES_TARGET_129 "flasg is set if the detection is super resolution target";
CM_ SG_ 544 DET_SNR_129 "The signal to noise ratio (SNR) of the radar detection";
CM_ SG_ 544 DET_POINT_TARGET_PROB_129 "Describes the possibility if more than one real-world object has led to this detection. 0[%] := 100[%] Multi target probability";
CM_ SG_ 544 DET_EXISTENCE_PROB_129 "Existence probability of the detection not based on history. Value does  not depend on any past experience with similar detections.
\note Use as confidence measure where a low value means less confidence
and a high value indicates strong confidence.";
CM_ SG_ 544 DET_OUTSIDE_SECTOR_129 "Flag to indicate detections outside the sector, set if the wrong sector calibration matrix was used";
CM_ SG_ 544 DET_HVC_FLAG_129 "Core2 Vehicle clutter flag";
CM_ SG_ 544 DET_CONFD_AZIMUTH_129 "Define the Confidence of Azimuth for Detection ";
CM_ SG_ 544 DET_CONFD_ELEVATION_129 "Define the Confidence of Elevation for the Detection ";
CM_ SG_ 544 DET_AZIMUTH_AMB_ID_129 "Each ambiguous measurement generates one Ambiguity ID. Ambiguity is indicated by an identical ambiguity ID.
note Unambiguous measurements have the ambiguity ID 0.";
CM_ SG_ 544 DET_AMBG_AZIMUTH_PROB_129 "Probability for different hypothesis, sum is 100 [%] for all detections with the same Ambiguity ID. 0 means no Ambiguity";
CM_ SG_ 544 DET_BI_STATIC_FLAG_130 "1 if detection is bi-static 0 otherwise";
CM_ SG_ 544 DET_BI_STATIC_FLAG_131 "1 if detection is bi-static 0 otherwise";
CM_ SG_ 544 DET_BI_STATIC_FLAG_132 "1 if detection is bi-static 0 otherwise";
CM_ SG_ 544 DET_MH_SCAN_INDEX_4LSB_129_132 "Scan index of the measured detection";
CM_ SG_ 544 DET_MH_CYCLE_COUNTER_129_132 "Detection Alive Counter";
CM_ SG_ 545 DET_RANGE_133 " measured position  of the detection";
CM_ SG_ 545 DET_RANGE_ERR_133 "RMSE or standard deviation of the measured angle  of the detection";
CM_ SG_ 545 DET_RANGE_VELOCITY_133 "Radial velocity of the detection positive in direction to the sensor";
CM_ SG_ 545 DET_RANGE_VELOCITY_ERR_133 "RMSE or standard deviation of the measure radial velocity of the detection";
CM_ SG_ 545 DET_AZIMUTH_133 "Measured angle  of the detection";
CM_ SG_ 545 DET_AZIMUTH_ERR_133 "RMSE or standard deviation of the measured angle  of the detection";
CM_ SG_ 545 DET_ELEVATION_133 "measured elevation of the detection";
CM_ SG_ 545 DET_ELEVATION_ERR_133 "RMSE or standard deviation of the measured elevation  of the detection";
CM_ SG_ 545 DET_RCS_133 "Radar Cross Section or Amplitude, is a measure of how detectable an object is by radar. A larger RCS indicates that an object is more easily detected.";
CM_ SG_ 545 DET_VALID_FLAG_133 "is set if the measured detection is valid";
CM_ SG_ 545 DET_BI_STATIC_FLAG_133 "1 if detection is bi-static 0 otherwise";
CM_ SG_ 545 DET_SUPER_RES_TARGET_133 "flasg is set if the detection is super resolution target";
CM_ SG_ 545 DET_SNR_133 "The signal to noise ratio (SNR) of the radar detection";
CM_ SG_ 545 DET_POINT_TARGET_PROB_133 "Describes the possibility if more than one real-world object has led to this detection. 0[%] := 100[%] Multi target probability";
CM_ SG_ 545 DET_EXISTENCE_PROB_133 "Existence probability of the detection not based on history. Value does  not depend on any past experience with similar detections.
\note Use as confidence measure where a low value means less confidence
and a high value indicates strong confidence.";
CM_ SG_ 545 DET_OUTSIDE_SECTOR_133 "Flag to indicate detections outside the sector, set if the wrong sector calibration matrix was used";
CM_ SG_ 545 DET_HVC_FLAG_133 "Core2 Vehicle clutter flag";
CM_ SG_ 545 DET_CONFD_AZIMUTH_133 "Define the Confidence of Azimuth for Detection ";
CM_ SG_ 545 DET_CONFD_ELEVATION_133 "Define the Confidence of Elevation for the Detection ";
CM_ SG_ 545 DET_AZIMUTH_AMB_ID_133 "Each ambiguous measurement generates one Ambiguity ID. Ambiguity is indicated by an identical ambiguity ID.
note Unambiguous measurements have the ambiguity ID 0.";
CM_ SG_ 545 DET_AMBG_AZIMUTH_PROB_133 "Probability for different hypothesis, sum is 100 [%] for all detections with the same Ambiguity ID. 0 means no Ambiguity";
CM_ SG_ 545 DET_BI_STATIC_FLAG_134 "1 if detection is bi-static 0 otherwise";
CM_ SG_ 545 DET_BI_STATIC_FLAG_135 "1 if detection is bi-static 0 otherwise";
CM_ SG_ 545 DET_BI_STATIC_FLAG_136 "1 if detection is bi-static 0 otherwise";
CM_ SG_ 545 DET_MH_SCAN_INDEX_4LSB_133_136 "Scan index of the measured detection";
CM_ SG_ 545 DET_MH_CYCLE_COUNTER_133_136 "Detection Alive Counter";
CM_ SG_ 546 DET_RANGE_137 " measured position  of the detection";
CM_ SG_ 546 DET_RANGE_ERR_137 "RMSE or standard deviation of the measured angle  of the detection";
CM_ SG_ 546 DET_RANGE_VELOCITY_137 "Radial velocity of the detection positive in direction to the sensor";
CM_ SG_ 546 DET_RANGE_VELOCITY_ERR_137 "RMSE or standard deviation of the measure radial velocity of the detection";
CM_ SG_ 546 DET_AZIMUTH_137 "Measured angle  of the detection";
CM_ SG_ 546 DET_AZIMUTH_ERR_137 "RMSE or standard deviation of the measured angle  of the detection";
CM_ SG_ 546 DET_ELEVATION_137 "measured elevation of the detection";
CM_ SG_ 546 DET_ELEVATION_ERR_137 "RMSE or standard deviation of the measured elevation  of the detection";
CM_ SG_ 546 DET_RCS_137 "Radar Cross Section or Amplitude, is a measure of how detectable an object is by radar. A larger RCS indicates that an object is more easily detected.";
CM_ SG_ 546 DET_VALID_FLAG_137 "is set if the measured detection is valid";
CM_ SG_ 546 DET_BI_STATIC_FLAG_137 "1 if detection is bi-static 0 otherwise";
CM_ SG_ 546 DET_SUPER_RES_TARGET_137 "flasg is set if the detection is super resolution target";
CM_ SG_ 546 DET_SNR_137 "The signal to noise ratio (SNR) of the radar detection";
CM_ SG_ 546 DET_POINT_TARGET_PROB_137 "Describes the possibility if more than one real-world object has led to this detection. 0[%] := 100[%] Multi target probability";
CM_ SG_ 546 DET_EXISTENCE_PROB_137 "Existence probability of the detection not based on history. Value does  not depend on any past experience with similar detections.
\note Use as confidence measure where a low value means less confidence
and a high value indicates strong confidence.";
CM_ SG_ 546 DET_OUTSIDE_SECTOR_137 "Flag to indicate detections outside the sector, set if the wrong sector calibration matrix was used";
CM_ SG_ 546 DET_HVC_FLAG_137 "Core2 Vehicle clutter flag";
CM_ SG_ 546 DET_CONFD_AZIMUTH_137 "Define the Confidence of Azimuth for Detection ";
CM_ SG_ 546 DET_CONFD_ELEVATION_137 "Define the Confidence of Elevation for the Detection ";
CM_ SG_ 546 DET_AZIMUTH_AMB_ID_137 "Each ambiguous measurement generates one Ambiguity ID. Ambiguity is indicated by an identical ambiguity ID.
note Unambiguous measurements have the ambiguity ID 0.";
CM_ SG_ 546 DET_AMBG_AZIMUTH_PROB_137 "Probability for different hypothesis, sum is 100 [%] for all detections with the same Ambiguity ID. 0 means no Ambiguity";
CM_ SG_ 546 DET_BI_STATIC_FLAG_138 "1 if detection is bi-static 0 otherwise";
CM_ SG_ 546 DET_BI_STATIC_FLAG_139 "1 if detection is bi-static 0 otherwise";
CM_ SG_ 546 DET_BI_STATIC_FLAG_140 "1 if detection is bi-static 0 otherwise";
CM_ SG_ 546 DET_MH_SCAN_INDEX_4LSB_137_140 "Scan index of the measured detection";
CM_ SG_ 546 DET_MH_CYCLE_COUNTER_137_140 "Detection Alive Counter";
CM_ SG_ 547 DET_RANGE_141 " measured position  of the detection";
CM_ SG_ 547 DET_RANGE_ERR_141 "RMSE or standard deviation of the measured angle  of the detection";
CM_ SG_ 547 DET_RANGE_VELOCITY_141 "Radial velocity of the detection positive in direction to the sensor";
CM_ SG_ 547 DET_RANGE_VELOCITY_ERR_141 "RMSE or standard deviation of the measure radial velocity of the detection";
CM_ SG_ 547 DET_AZIMUTH_141 "Measured angle  of the detection";
CM_ SG_ 547 DET_AZIMUTH_ERR_141 "RMSE or standard deviation of the measured angle  of the detection";
CM_ SG_ 547 DET_ELEVATION_141 "measured elevation of the detection";
CM_ SG_ 547 DET_ELEVATION_ERR_141 "RMSE or standard deviation of the measured elevation  of the detection";
CM_ SG_ 547 DET_RCS_141 "Radar Cross Section or Amplitude, is a measure of how detectable an object is by radar. A larger RCS indicates that an object is more easily detected.";
CM_ SG_ 547 DET_VALID_FLAG_141 "is set if the measured detection is valid";
CM_ SG_ 547 DET_BI_STATIC_FLAG_141 "1 if detection is bi-static 0 otherwise";
CM_ SG_ 547 DET_SUPER_RES_TARGET_141 "flasg is set if the detection is super resolution target";
CM_ SG_ 547 DET_SNR_141 "The signal to noise ratio (SNR) of the radar detection";
CM_ SG_ 547 DET_POINT_TARGET_PROB_141 "Describes the possibility if more than one real-world object has led to this detection. 0[%] := 100[%] Multi target probability";
CM_ SG_ 547 DET_EXISTENCE_PROB_141 "Existence probability of the detection not based on history. Value does  not depend on any past experience with similar detections.
\note Use as confidence measure where a low value means less confidence
and a high value indicates strong confidence.";
CM_ SG_ 547 DET_OUTSIDE_SECTOR_141 "Flag to indicate detections outside the sector, set if the wrong sector calibration matrix was used";
CM_ SG_ 547 DET_HVC_FLAG_141 "Core2 Vehicle clutter flag";
CM_ SG_ 547 DET_CONFD_AZIMUTH_141 "Define the Confidence of Azimuth for Detection ";
CM_ SG_ 547 DET_CONFD_ELEVATION_141 "Define the Confidence of Elevation for the Detection ";
CM_ SG_ 547 DET_AZIMUTH_AMB_ID_141 "Each ambiguous measurement generates one Ambiguity ID. Ambiguity is indicated by an identical ambiguity ID.
note Unambiguous measurements have the ambiguity ID 0.";
CM_ SG_ 547 DET_AMBG_AZIMUTH_PROB_141 "Probability for different hypothesis, sum is 100 [%] for all detections with the same Ambiguity ID. 0 means no Ambiguity";
CM_ SG_ 547 DET_BI_STATIC_FLAG_142 "1 if detection is bi-static 0 otherwise";
CM_ SG_ 547 DET_BI_STATIC_FLAG_143 "1 if detection is bi-static 0 otherwise";
CM_ SG_ 547 DET_BI_STATIC_FLAG_144 "1 if detection is bi-static 0 otherwise";
CM_ SG_ 547 DET_MH_SCAN_INDEX_4LSB_141_144 "Scan index of the measured detection";
CM_ SG_ 547 DET_MH_CYCLE_COUNTER_141_144 "Detection Alive Counter";
CM_ SG_ 548 DET_RANGE_145 " measured position  of the detection";
CM_ SG_ 548 DET_RANGE_ERR_145 "RMSE or standard deviation of the measured angle  of the detection";
CM_ SG_ 548 DET_RANGE_VELOCITY_145 "Radial velocity of the detection positive in direction to the sensor";
CM_ SG_ 548 DET_RANGE_VELOCITY_ERR_145 "RMSE or standard deviation of the measure radial velocity of the detection";
CM_ SG_ 548 DET_AZIMUTH_145 "Measured angle  of the detection";
CM_ SG_ 548 DET_AZIMUTH_ERR_145 "RMSE or standard deviation of the measured angle  of the detection";
CM_ SG_ 548 DET_ELEVATION_145 "measured elevation of the detection";
CM_ SG_ 548 DET_ELEVATION_ERR_145 "RMSE or standard deviation of the measured elevation  of the detection";
CM_ SG_ 548 DET_RCS_145 "Radar Cross Section or Amplitude, is a measure of how detectable an object is by radar. A larger RCS indicates that an object is more easily detected.";
CM_ SG_ 548 DET_VALID_FLAG_145 "is set if the measured detection is valid";
CM_ SG_ 548 DET_BI_STATIC_FLAG_145 "1 if detection is bi-static 0 otherwise";
CM_ SG_ 548 DET_SUPER_RES_TARGET_145 "flasg is set if the detection is super resolution target";
CM_ SG_ 548 DET_SNR_145 "The signal to noise ratio (SNR) of the radar detection";
CM_ SG_ 548 DET_POINT_TARGET_PROB_145 "Describes the possibility if more than one real-world object has led to this detection. 0[%] := 100[%] Multi target probability";
CM_ SG_ 548 DET_EXISTENCE_PROB_145 "Existence probability of the detection not based on history. Value does  not depend on any past experience with similar detections.
\note Use as confidence measure where a low value means less confidence
and a high value indicates strong confidence.";
CM_ SG_ 548 DET_OUTSIDE_SECTOR_145 "Flag to indicate detections outside the sector, set if the wrong sector calibration matrix was used";
CM_ SG_ 548 DET_HVC_FLAG_145 "Core2 Vehicle clutter flag";
CM_ SG_ 548 DET_CONFD_AZIMUTH_145 "Define the Confidence of Azimuth for Detection ";
CM_ SG_ 548 DET_CONFD_ELEVATION_145 "Define the Confidence of Elevation for the Detection ";
CM_ SG_ 548 DET_AZIMUTH_AMB_ID_145 "Each ambiguous measurement generates one Ambiguity ID. Ambiguity is indicated by an identical ambiguity ID.
note Unambiguous measurements have the ambiguity ID 0.";
CM_ SG_ 548 DET_AMBG_AZIMUTH_PROB_145 "Probability for different hypothesis, sum is 100 [%] for all detections with the same Ambiguity ID. 0 means no Ambiguity";
CM_ SG_ 548 DET_BI_STATIC_FLAG_146 "1 if detection is bi-static 0 otherwise";
CM_ SG_ 548 DET_BI_STATIC_FLAG_147 "1 if detection is bi-static 0 otherwise";
CM_ SG_ 548 DET_BI_STATIC_FLAG_148 "1 if detection is bi-static 0 otherwise";
CM_ SG_ 548 DET_MH_SCAN_INDEX_4LSB_145_148 "Scan index of the measured detection";
CM_ SG_ 548 DET_MH_CYCLE_COUNTER_145_148 "Detection Alive Counter";
CM_ SG_ 549 DET_RANGE_149 " measured position  of the detection";
CM_ SG_ 549 DET_RANGE_ERR_149 "RMSE or standard deviation of the measured angle  of the detection";
CM_ SG_ 549 DET_RANGE_VELOCITY_149 "Radial velocity of the detection positive in direction to the sensor";
CM_ SG_ 549 DET_RANGE_VELOCITY_ERR_149 "RMSE or standard deviation of the measure radial velocity of the detection";
CM_ SG_ 549 DET_AZIMUTH_149 "Measured angle  of the detection";
CM_ SG_ 549 DET_AZIMUTH_ERR_149 "RMSE or standard deviation of the measured angle  of the detection";
CM_ SG_ 549 DET_ELEVATION_149 "measured elevation of the detection";
CM_ SG_ 549 DET_ELEVATION_ERR_149 "RMSE or standard deviation of the measured elevation  of the detection";
CM_ SG_ 549 DET_RCS_149 "Radar Cross Section or Amplitude, is a measure of how detectable an object is by radar. A larger RCS indicates that an object is more easily detected.";
CM_ SG_ 549 DET_VALID_FLAG_149 "is set if the measured detection is valid";
CM_ SG_ 549 DET_BI_STATIC_FLAG_149 "1 if detection is bi-static 0 otherwise";
CM_ SG_ 549 DET_SUPER_RES_TARGET_149 "flasg is set if the detection is super resolution target";
CM_ SG_ 549 DET_SNR_149 "The signal to noise ratio (SNR) of the radar detection";
CM_ SG_ 549 DET_POINT_TARGET_PROB_149 "Describes the possibility if more than one real-world object has led to this detection. 0[%] := 100[%] Multi target probability";
CM_ SG_ 549 DET_EXISTENCE_PROB_149 "Existence probability of the detection not based on history. Value does  not depend on any past experience with similar detections.
\note Use as confidence measure where a low value means less confidence
and a high value indicates strong confidence.";
CM_ SG_ 549 DET_OUTSIDE_SECTOR_149 "Flag to indicate detections outside the sector, set if the wrong sector calibration matrix was used";
CM_ SG_ 549 DET_HVC_FLAG_149 "Core2 Vehicle clutter flag";
CM_ SG_ 549 DET_CONFD_AZIMUTH_149 "Define the Confidence of Azimuth for Detection ";
CM_ SG_ 549 DET_CONFD_ELEVATION_149 "Define the Confidence of Elevation for the Detection ";
CM_ SG_ 549 DET_AZIMUTH_AMB_ID_149 "Each ambiguous measurement generates one Ambiguity ID. Ambiguity is indicated by an identical ambiguity ID.
note Unambiguous measurements have the ambiguity ID 0.";
CM_ SG_ 549 DET_AMBG_AZIMUTH_PROB_149 "Probability for different hypothesis, sum is 100 [%] for all detections with the same Ambiguity ID. 0 means no Ambiguity";
CM_ SG_ 549 DET_BI_STATIC_FLAG_150 "1 if detection is bi-static 0 otherwise";
CM_ SG_ 549 DET_BI_STATIC_FLAG_151 "1 if detection is bi-static 0 otherwise";
CM_ SG_ 549 DET_BI_STATIC_FLAG_152 "1 if detection is bi-static 0 otherwise";
CM_ SG_ 549 DET_MH_SCAN_INDEX_4LSB_149_152 "Scan index of the measured detection";
CM_ SG_ 549 DET_MH_CYCLE_COUNTER_149_152 "Detection Alive Counter";
CM_ SG_ 550 DET_RANGE_153 " measured position  of the detection";
CM_ SG_ 550 DET_RANGE_ERR_153 "RMSE or standard deviation of the measured angle  of the detection";
CM_ SG_ 550 DET_RANGE_VELOCITY_153 "Radial velocity of the detection positive in direction to the sensor";
CM_ SG_ 550 DET_RANGE_VELOCITY_ERR_153 "RMSE or standard deviation of the measure radial velocity of the detection";
CM_ SG_ 550 DET_AZIMUTH_153 "Measured angle  of the detection";
CM_ SG_ 550 DET_AZIMUTH_ERR_153 "RMSE or standard deviation of the measured angle  of the detection";
CM_ SG_ 550 DET_ELEVATION_153 "measured elevation of the detection";
CM_ SG_ 550 DET_ELEVATION_ERR_153 "RMSE or standard deviation of the measured elevation  of the detection";
CM_ SG_ 550 DET_RCS_153 "Radar Cross Section or Amplitude, is a measure of how detectable an object is by radar. A larger RCS indicates that an object is more easily detected.";
CM_ SG_ 550 DET_VALID_FLAG_153 "is set if the measured detection is valid";
CM_ SG_ 550 DET_BI_STATIC_FLAG_153 "1 if detection is bi-static 0 otherwise";
CM_ SG_ 550 DET_SUPER_RES_TARGET_153 "flasg is set if the detection is super resolution target";
CM_ SG_ 550 DET_SNR_153 "The signal to noise ratio (SNR) of the radar detection";
CM_ SG_ 550 DET_POINT_TARGET_PROB_153 "Describes the possibility if more than one real-world object has led to this detection. 0[%] := 100[%] Multi target probability";
CM_ SG_ 550 DET_EXISTENCE_PROB_153 "Existence probability of the detection not based on history. Value does  not depend on any past experience with similar detections.
\note Use as confidence measure where a low value means less confidence
and a high value indicates strong confidence.";
CM_ SG_ 550 DET_OUTSIDE_SECTOR_153 "Flag to indicate detections outside the sector, set if the wrong sector calibration matrix was used";
CM_ SG_ 550 DET_HVC_FLAG_153 "Core2 Vehicle clutter flag";
CM_ SG_ 550 DET_CONFD_AZIMUTH_153 "Define the Confidence of Azimuth for Detection ";
CM_ SG_ 550 DET_CONFD_ELEVATION_153 "Define the Confidence of Elevation for the Detection ";
CM_ SG_ 550 DET_AZIMUTH_AMB_ID_153 "Each ambiguous measurement generates one Ambiguity ID. Ambiguity is indicated by an identical ambiguity ID.
note Unambiguous measurements have the ambiguity ID 0.";
CM_ SG_ 550 DET_AMBG_AZIMUTH_PROB_153 "Probability for different hypothesis, sum is 100 [%] for all detections with the same Ambiguity ID. 0 means no Ambiguity";
CM_ SG_ 550 DET_BI_STATIC_FLAG_154 "1 if detection is bi-static 0 otherwise";
CM_ SG_ 550 DET_BI_STATIC_FLAG_155 "1 if detection is bi-static 0 otherwise";
CM_ SG_ 550 DET_BI_STATIC_FLAG_156 "1 if detection is bi-static 0 otherwise";
CM_ SG_ 550 DET_MH_SCAN_INDEX_4LSB_153_156 "Scan index of the measured detection";
CM_ SG_ 550 DET_MH_CYCLE_COUNTER_153_156 "Detection Alive Counter";
CM_ SG_ 551 DET_RANGE_157 " measured position  of the detection";
CM_ SG_ 551 DET_RANGE_ERR_157 "RMSE or standard deviation of the measured angle  of the detection";
CM_ SG_ 551 DET_RANGE_VELOCITY_157 "Radial velocity of the detection positive in direction to the sensor";
CM_ SG_ 551 DET_RANGE_VELOCITY_ERR_157 "RMSE or standard deviation of the measure radial velocity of the detection";
CM_ SG_ 551 DET_AZIMUTH_157 "Measured angle  of the detection";
CM_ SG_ 551 DET_AZIMUTH_ERR_157 "RMSE or standard deviation of the measured angle  of the detection";
CM_ SG_ 551 DET_ELEVATION_157 "measured elevation of the detection";
CM_ SG_ 551 DET_ELEVATION_ERR_157 "RMSE or standard deviation of the measured elevation  of the detection";
CM_ SG_ 551 DET_RCS_157 "Radar Cross Section or Amplitude, is a measure of how detectable an object is by radar. A larger RCS indicates that an object is more easily detected.";
CM_ SG_ 551 DET_VALID_FLAG_157 "is set if the measured detection is valid";
CM_ SG_ 551 DET_BI_STATIC_FLAG_157 "1 if detection is bi-static 0 otherwise";
CM_ SG_ 551 DET_SUPER_RES_TARGET_157 "flasg is set if the detection is super resolution target";
CM_ SG_ 551 DET_SNR_157 "The signal to noise ratio (SNR) of the radar detection";
CM_ SG_ 551 DET_POINT_TARGET_PROB_157 "Describes the possibility if more than one real-world object has led to this detection. 0[%] := 100[%] Multi target probability";
CM_ SG_ 551 DET_EXISTENCE_PROB_157 "Existence probability of the detection not based on history. Value does  not depend on any past experience with similar detections.
\note Use as confidence measure where a low value means less confidence
and a high value indicates strong confidence.";
CM_ SG_ 551 DET_OUTSIDE_SECTOR_157 "Flag to indicate detections outside the sector, set if the wrong sector calibration matrix was used";
CM_ SG_ 551 DET_HVC_FLAG_157 "Core2 Vehicle clutter flag";
CM_ SG_ 551 DET_CONFD_AZIMUTH_157 "Define the Confidence of Azimuth for Detection ";
CM_ SG_ 551 DET_CONFD_ELEVATION_157 "Define the Confidence of Elevation for the Detection ";
CM_ SG_ 551 DET_AZIMUTH_AMB_ID_157 "Each ambiguous measurement generates one Ambiguity ID. Ambiguity is indicated by an identical ambiguity ID.
note Unambiguous measurements have the ambiguity ID 0.";
CM_ SG_ 551 DET_AMBG_AZIMUTH_PROB_157 "Probability for different hypothesis, sum is 100 [%] for all detections with the same Ambiguity ID. 0 means no Ambiguity";
CM_ SG_ 551 DET_BI_STATIC_FLAG_158 "1 if detection is bi-static 0 otherwise";
CM_ SG_ 551 DET_BI_STATIC_FLAG_159 "1 if detection is bi-static 0 otherwise";
CM_ SG_ 551 DET_BI_STATIC_FLAG_160 "1 if detection is bi-static 0 otherwise";
CM_ SG_ 551 DET_MH_SCAN_INDEX_4LSB_157_160 "Scan index of the measured detection";
CM_ SG_ 551 DET_MH_CYCLE_COUNTER_157_160 "Detection Alive Counter";
CM_ SG_ 552 DET_RANGE_161 " measured position  of the detection";
CM_ SG_ 552 DET_RANGE_ERR_161 "RMSE or standard deviation of the measured angle  of the detection";
CM_ SG_ 552 DET_RANGE_VELOCITY_161 "Radial velocity of the detection positive in direction to the sensor";
CM_ SG_ 552 DET_RANGE_VELOCITY_ERR_161 "RMSE or standard deviation of the measure radial velocity of the detection";
CM_ SG_ 552 DET_AZIMUTH_161 "Measured angle  of the detection";
CM_ SG_ 552 DET_AZIMUTH_ERR_161 "RMSE or standard deviation of the measured angle  of the detection";
CM_ SG_ 552 DET_ELEVATION_161 "measured elevation of the detection";
CM_ SG_ 552 DET_ELEVATION_ERR_161 "RMSE or standard deviation of the measured elevation  of the detection";
CM_ SG_ 552 DET_RCS_161 "Radar Cross Section or Amplitude, is a measure of how detectable an object is by radar. A larger RCS indicates that an object is more easily detected.";
CM_ SG_ 552 DET_VALID_FLAG_161 "is set if the measured detection is valid";
CM_ SG_ 552 DET_BI_STATIC_FLAG_161 "1 if detection is bi-static 0 otherwise";
CM_ SG_ 552 DET_SUPER_RES_TARGET_161 "flasg is set if the detection is super resolution target";
CM_ SG_ 552 DET_SNR_161 "The signal to noise ratio (SNR) of the radar detection";
CM_ SG_ 552 DET_POINT_TARGET_PROB_161 "Describes the possibility if more than one real-world object has led to this detection. 0[%] := 100[%] Multi target probability";
CM_ SG_ 552 DET_EXISTENCE_PROB_161 "Existence probability of the detection not based on history. Value does  not depend on any past experience with similar detections.
\note Use as confidence measure where a low value means less confidence
and a high value indicates strong confidence.";
CM_ SG_ 552 DET_OUTSIDE_SECTOR_161 "Flag to indicate detections outside the sector, set if the wrong sector calibration matrix was used";
CM_ SG_ 552 DET_HVC_FLAG_161 "Core2 Vehicle clutter flag";
CM_ SG_ 552 DET_CONFD_AZIMUTH_161 "Define the Confidence of Azimuth for Detection ";
CM_ SG_ 552 DET_CONFD_ELEVATION_161 "Define the Confidence of Elevation for the Detection ";
CM_ SG_ 552 DET_AZIMUTH_AMB_ID_161 "Each ambiguous measurement generates one Ambiguity ID. Ambiguity is indicated by an identical ambiguity ID.
note Unambiguous measurements have the ambiguity ID 0.";
CM_ SG_ 552 DET_AMBG_AZIMUTH_PROB_161 "Probability for different hypothesis, sum is 100 [%] for all detections with the same Ambiguity ID. 0 means no Ambiguity";
CM_ SG_ 552 DET_BI_STATIC_FLAG_162 "1 if detection is bi-static 0 otherwise";
CM_ SG_ 552 DET_BI_STATIC_FLAG_163 "1 if detection is bi-static 0 otherwise";
CM_ SG_ 552 DET_BI_STATIC_FLAG_164 "1 if detection is bi-static 0 otherwise";
CM_ SG_ 552 DET_MH_SCAN_INDEX_4LSB_161_164 "Scan index of the measured detection";
CM_ SG_ 552 DET_MH_CYCLE_COUNTER_161_164 "Detection Alive Counter";
CM_ SG_ 553 DET_RANGE_165 " measured position  of the detection";
CM_ SG_ 553 DET_RANGE_ERR_165 "RMSE or standard deviation of the measured angle  of the detection";
CM_ SG_ 553 DET_RANGE_VELOCITY_165 "Radial velocity of the detection positive in direction to the sensor";
CM_ SG_ 553 DET_RANGE_VELOCITY_ERR_165 "RMSE or standard deviation of the measure radial velocity of the detection";
CM_ SG_ 553 DET_AZIMUTH_165 "Measured angle  of the detection";
CM_ SG_ 553 DET_AZIMUTH_ERR_165 "RMSE or standard deviation of the measured angle  of the detection";
CM_ SG_ 553 DET_ELEVATION_165 "measured elevation of the detection";
CM_ SG_ 553 DET_ELEVATION_ERR_165 "RMSE or standard deviation of the measured elevation  of the detection";
CM_ SG_ 553 DET_RCS_165 "Radar Cross Section or Amplitude, is a measure of how detectable an object is by radar. A larger RCS indicates that an object is more easily detected.";
CM_ SG_ 553 DET_VALID_FLAG_165 "is set if the measured detection is valid";
CM_ SG_ 553 DET_BI_STATIC_FLAG_165 "1 if detection is bi-static 0 otherwise";
CM_ SG_ 553 DET_SUPER_RES_TARGET_165 "flasg is set if the detection is super resolution target";
CM_ SG_ 553 DET_SNR_165 "The signal to noise ratio (SNR) of the radar detection";
CM_ SG_ 553 DET_POINT_TARGET_PROB_165 "Describes the possibility if more than one real-world object has led to this detection. 0[%] := 100[%] Multi target probability";
CM_ SG_ 553 DET_EXISTENCE_PROB_165 "Existence probability of the detection not based on history. Value does  not depend on any past experience with similar detections.
\note Use as confidence measure where a low value means less confidence
and a high value indicates strong confidence.";
CM_ SG_ 553 DET_OUTSIDE_SECTOR_165 "Flag to indicate detections outside the sector, set if the wrong sector calibration matrix was used";
CM_ SG_ 553 DET_HVC_FLAG_165 "Core2 Vehicle clutter flag";
CM_ SG_ 553 DET_CONFD_AZIMUTH_165 "Define the Confidence of Azimuth for Detection ";
CM_ SG_ 553 DET_CONFD_ELEVATION_165 "Define the Confidence of Elevation for the Detection ";
CM_ SG_ 553 DET_AZIMUTH_AMB_ID_165 "Each ambiguous measurement generates one Ambiguity ID. Ambiguity is indicated by an identical ambiguity ID.
note Unambiguous measurements have the ambiguity ID 0.";
CM_ SG_ 553 DET_AMBG_AZIMUTH_PROB_165 "Probability for different hypothesis, sum is 100 [%] for all detections with the same Ambiguity ID. 0 means no Ambiguity";
CM_ SG_ 553 DET_BI_STATIC_FLAG_166 "1 if detection is bi-static 0 otherwise";
CM_ SG_ 553 DET_BI_STATIC_FLAG_167 "1 if detection is bi-static 0 otherwise";
CM_ SG_ 553 DET_BI_STATIC_FLAG_168 "1 if detection is bi-static 0 otherwise";
CM_ SG_ 553 DET_MH_SCAN_INDEX_4LSB_165_168 "Scan index of the measured detection";
CM_ SG_ 553 DET_MH_CYCLE_COUNTER_165_168 "Detection Alive Counter";
CM_ SG_ 554 DET_RANGE_169 " measured position  of the detection";
CM_ SG_ 554 DET_RANGE_ERR_169 "RMSE or standard deviation of the measured angle  of the detection";
CM_ SG_ 554 DET_RANGE_VELOCITY_169 "Radial velocity of the detection positive in direction to the sensor";
CM_ SG_ 554 DET_RANGE_VELOCITY_ERR_169 "RMSE or standard deviation of the measure radial velocity of the detection";
CM_ SG_ 554 DET_AZIMUTH_169 "Measured angle  of the detection";
CM_ SG_ 554 DET_AZIMUTH_ERR_169 "RMSE or standard deviation of the measured angle  of the detection";
CM_ SG_ 554 DET_ELEVATION_169 "measured elevation of the detection";
CM_ SG_ 554 DET_ELEVATION_ERR_169 "RMSE or standard deviation of the measured elevation  of the detection";
CM_ SG_ 554 DET_RCS_169 "Radar Cross Section or Amplitude, is a measure of how detectable an object is by radar. A larger RCS indicates that an object is more easily detected.";
CM_ SG_ 554 DET_VALID_FLAG_169 "is set if the measured detection is valid";
CM_ SG_ 554 DET_BI_STATIC_FLAG_169 "1 if detection is bi-static 0 otherwise";
CM_ SG_ 554 DET_SUPER_RES_TARGET_169 "flasg is set if the detection is super resolution target";
CM_ SG_ 554 DET_SNR_169 "The signal to noise ratio (SNR) of the radar detection";
CM_ SG_ 554 DET_POINT_TARGET_PROB_169 "Describes the possibility if more than one real-world object has led to this detection. 0[%] := 100[%] Multi target probability";
CM_ SG_ 554 DET_EXISTENCE_PROB_169 "Existence probability of the detection not based on history. Value does  not depend on any past experience with similar detections.
\note Use as confidence measure where a low value means less confidence
and a high value indicates strong confidence.";
CM_ SG_ 554 DET_OUTSIDE_SECTOR_169 "Flag to indicate detections outside the sector, set if the wrong sector calibration matrix was used";
CM_ SG_ 554 DET_HVC_FLAG_169 "Core2 Vehicle clutter flag";
CM_ SG_ 554 DET_CONFD_AZIMUTH_169 "Define the Confidence of Azimuth for Detection ";
CM_ SG_ 554 DET_CONFD_ELEVATION_169 "Define the Confidence of Elevation for the Detection ";
CM_ SG_ 554 DET_AZIMUTH_AMB_ID_169 "Each ambiguous measurement generates one Ambiguity ID. Ambiguity is indicated by an identical ambiguity ID.
note Unambiguous measurements have the ambiguity ID 0.";
CM_ SG_ 554 DET_AMBG_AZIMUTH_PROB_169 "Probability for different hypothesis, sum is 100 [%] for all detections with the same Ambiguity ID. 0 means no Ambiguity";
CM_ SG_ 554 DET_BI_STATIC_FLAG_170 "1 if detection is bi-static 0 otherwise";
CM_ SG_ 554 DET_BI_STATIC_FLAG_171 "1 if detection is bi-static 0 otherwise";
CM_ SG_ 554 DET_BI_STATIC_FLAG_172 "1 if detection is bi-static 0 otherwise";
CM_ SG_ 554 DET_MH_SCAN_INDEX_4LSB_169_172 "Scan index of the measured detection";
CM_ SG_ 554 DET_MH_CYCLE_COUNTER_169_172 "Detection Alive Counter";

BA_DEF_ BO_ "CanTpBs" INT 0 255;
BA_DEF_ BO_ "EventRateOfChange" INT 10 10000;
BA_DEF_ BO_ "GenMsgCycleTime" INT 0 100000;
BA_DEF_ BO_ "GenMsgILSupport" ENUM  "No","Yes";
BA_DEF_ BO_ "GenMsgNrOfRepetition" INT 0 100;
BA_DEF_ BO_ "GenMsgSendType" ENUM  "FixedPeriodic","Event","EnabledPeriodic","NotUsed","NotUsed","EventPeriodic","NotUsed","NotUsed","NoMsgSendType";
BA_DEF_ BO_ "NetworkInitialization" ENUM  "No","Yes";
BA_DEF_ BO_ "VFrameFormat" ENUM  "StandardCAN","ExtendedCAN","reserved","reserved","reserved","reserved","reserved","reserved","reserved","reserved","reserved","reserved","reserved","reserved","StandardCAN_FD","ExtendedCAN_FD";
BA_DEF_ SG_ "GenSigCmt" STRING;
BA_DEF_ SG_ "GenSigCycleTime" INT 0 0;
BA_DEF_ SG_ "GenSigSendType" ENUM  "Cyclic","OnWrite","vector_leerstring","OnChange","vector_leerstring","IfActive","vector_leerstring","NoSigSendType";
BA_DEF_ SG_ "GenSigStartValue" INT 0 1000000000;
BA_DEF_ SG_ "GenSigTimeoutTime" INT 0 0;
BA_DEF_ SG_ "GenSigVtEn" STRING;
BA_DEF_ SG_ "GenSigVtName" STRING;
BA_DEF_DEF_ "CanTpBs" 255;
BA_DEF_DEF_ "EventRateOfChange" 10000;
BA_DEF_DEF_ "GenMsgCycleTime" 0;
BA_DEF_DEF_ "GenMsgILSupport" "Yes";
BA_DEF_DEF_ "GenMsgNrOfRepetition" 0;
BA_DEF_DEF_ "GenMsgSendType" "NoMsgSendType";
BA_DEF_DEF_ "GenSigCmt" "";
BA_DEF_DEF_ "GenSigCycleTime" 0;
BA_DEF_DEF_ "GenSigSendType" "NoSigSendType";
BA_DEF_DEF_ "GenSigStartValue" 0;
BA_DEF_DEF_ "GenSigTimeoutTime" 0;
BA_DEF_DEF_ "GenSigVtEn" "";
BA_DEF_DEF_ "GenSigVtName" "";
BA_DEF_DEF_ "NetworkInitialization" "Yes";
BA_DEF_DEF_ "VFrameFormat" "StandardCAN_FD";
BA_ "GenMsgSendType" BO_ 538 1;
BA_ "GenMsgSendType" BO_ 539 1;
BA_ "GenMsgSendType" BO_ 540 1;
BA_ "GenMsgSendType" BO_ 541 1;
BA_ "GenMsgSendType" BO_ 542 1;
BA_ "GenMsgSendType" BO_ 543 1;
BA_ "GenMsgSendType" BO_ 544 1;
BA_ "GenMsgSendType" BO_ 545 1;
BA_ "GenMsgSendType" BO_ 546 1;
BA_ "GenMsgSendType" BO_ 547 1;
BA_ "GenMsgSendType" BO_ 548 1;
BA_ "GenMsgSendType" BO_ 549 1;
BA_ "GenMsgSendType" BO_ 550 1;
BA_ "GenMsgSendType" BO_ 551 1;
BA_ "GenMsgSendType" BO_ 552 1;
BA_ "GenMsgSendType" BO_ 553 1;
BA_ "GenMsgSendType" BO_ 554 1;
BA_ "GenSigStartValue" SG_ 538 DET_RANGE_VELOCITY_105 16384;
BA_ "GenSigStartValue" SG_ 538 DET_RCS_105 128;
BA_ "GenSigStartValue" SG_ 538 DET_RANGE_VELOCITY_106 16384;
BA_ "GenSigStartValue" SG_ 538 DET_RCS_106 128;
BA_ "GenSigStartValue" SG_ 538 DET_RANGE_VELOCITY_107 16384;
BA_ "GenSigStartValue" SG_ 538 DET_RCS_107 128;
BA_ "GenSigStartValue" SG_ 538 DET_RANGE_VELOCITY_108 16384;
BA_ "GenSigStartValue" SG_ 538 DET_RCS_108 128;
BA_ "GenSigStartValue" SG_ 539 DET_RANGE_VELOCITY_109 16384;
BA_ "GenSigStartValue" SG_ 539 DET_RCS_109 128;
BA_ "GenSigStartValue" SG_ 539 DET_RANGE_VELOCITY_110 16384;
BA_ "GenSigStartValue" SG_ 539 DET_RCS_110 128;
BA_ "GenSigStartValue" SG_ 539 DET_RANGE_VELOCITY_111 16384;
BA_ "GenSigStartValue" SG_ 539 DET_RCS_111 128;
BA_ "GenSigStartValue" SG_ 539 DET_RANGE_VELOCITY_112 16384;
BA_ "GenSigStartValue" SG_ 539 DET_RCS_112 128;
BA_ "GenSigStartValue" SG_ 540 DET_RANGE_VELOCITY_113 16384;
BA_ "GenSigStartValue" SG_ 540 DET_RCS_113 128;
BA_ "GenSigStartValue" SG_ 540 DET_RANGE_VELOCITY_114 16384;
BA_ "GenSigStartValue" SG_ 540 DET_RCS_114 128;
BA_ "GenSigStartValue" SG_ 540 DET_RANGE_VELOCITY_115 16384;
BA_ "GenSigStartValue" SG_ 540 DET_RCS_115 128;
BA_ "GenSigStartValue" SG_ 540 DET_RANGE_VELOCITY_116 16384;
BA_ "GenSigStartValue" SG_ 540 DET_RCS_116 128;
BA_ "GenSigStartValue" SG_ 541 DET_RANGE_VELOCITY_117 16384;
BA_ "GenSigStartValue" SG_ 541 DET_RCS_117 128;
BA_ "GenSigStartValue" SG_ 541 DET_RANGE_VELOCITY_118 16384;
BA_ "GenSigStartValue" SG_ 541 DET_RCS_118 128;
BA_ "GenSigStartValue" SG_ 541 DET_RANGE_VELOCITY_119 16384;
BA_ "GenSigStartValue" SG_ 541 DET_RCS_119 128;
BA_ "GenSigStartValue" SG_ 541 DET_RANGE_VELOCITY_120 16384;
BA_ "GenSigStartValue" SG_ 541 DET_RCS_120 128;
BA_ "GenSigStartValue" SG_ 542 DET_RANGE_VELOCITY_121 16384;
BA_ "GenSigStartValue" SG_ 542 DET_RCS_121 128;
BA_ "GenSigStartValue" SG_ 542 DET_RANGE_VELOCITY_122 16384;
BA_ "GenSigStartValue" SG_ 542 DET_RCS_122 128;
BA_ "GenSigStartValue" SG_ 542 DET_RANGE_VELOCITY_123 16384;
BA_ "GenSigStartValue" SG_ 542 DET_RCS_123 128;
BA_ "GenSigStartValue" SG_ 542 DET_RANGE_VELOCITY_124 16384;
BA_ "GenSigStartValue" SG_ 542 DET_RCS_124 128;
BA_ "GenSigStartValue" SG_ 543 DET_RANGE_VELOCITY_125 16384;
BA_ "GenSigStartValue" SG_ 543 DET_RCS_125 128;
BA_ "GenSigStartValue" SG_ 543 DET_RANGE_VELOCITY_126 16384;
BA_ "GenSigStartValue" SG_ 543 DET_RCS_126 128;
BA_ "GenSigStartValue" SG_ 543 DET_RANGE_VELOCITY_127 16384;
BA_ "GenSigStartValue" SG_ 543 DET_RCS_127 128;
BA_ "GenSigStartValue" SG_ 543 DET_RANGE_VELOCITY_128 16384;
BA_ "GenSigStartValue" SG_ 543 DET_RCS_128 128;
BA_ "GenSigStartValue" SG_ 544 DET_RANGE_VELOCITY_129 16384;
BA_ "GenSigStartValue" SG_ 544 DET_RCS_129 128;
BA_ "GenSigStartValue" SG_ 544 DET_RANGE_VELOCITY_130 16384;
BA_ "GenSigStartValue" SG_ 544 DET_RCS_130 128;
BA_ "GenSigStartValue" SG_ 544 DET_RANGE_VELOCITY_131 16384;
BA_ "GenSigStartValue" SG_ 544 DET_RCS_131 128;
BA_ "GenSigStartValue" SG_ 544 DET_RANGE_VELOCITY_132 16384;
BA_ "GenSigStartValue" SG_ 544 DET_RCS_132 128;
BA_ "GenSigStartValue" SG_ 545 DET_RANGE_VELOCITY_133 16384;
BA_ "GenSigStartValue" SG_ 545 DET_RCS_133 128;
BA_ "GenSigStartValue" SG_ 545 DET_RANGE_VELOCITY_134 16384;
BA_ "GenSigStartValue" SG_ 545 DET_RCS_134 128;
BA_ "GenSigStartValue" SG_ 545 DET_RANGE_VELOCITY_135 16384;
BA_ "GenSigStartValue" SG_ 545 DET_RCS_135 128;
BA_ "GenSigStartValue" SG_ 545 DET_RANGE_VELOCITY_136 16384;
BA_ "GenSigStartValue" SG_ 545 DET_RCS_136 128;
BA_ "GenSigStartValue" SG_ 546 DET_RANGE_VELOCITY_137 16384;
BA_ "GenSigStartValue" SG_ 546 DET_RCS_137 128;
BA_ "GenSigStartValue" SG_ 546 DET_RANGE_VELOCITY_138 16384;
BA_ "GenSigStartValue" SG_ 546 DET_RCS_138 128;
BA_ "GenSigStartValue" SG_ 546 DET_RANGE_VELOCITY_139 16384;
BA_ "GenSigStartValue" SG_ 546 DET_RCS_139 128;
BA_ "GenSigStartValue" SG_ 546 DET_RANGE_VELOCITY_140 16384;
BA_ "GenSigStartValue" SG_ 546 DET_RCS_140 128;
BA_ "GenSigStartValue" SG_ 547 DET_RANGE_VELOCITY_141 16384;
BA_ "GenSigStartValue" SG_ 547 DET_RCS_141 128;
BA_ "GenSigStartValue" SG_ 547 DET_RANGE_VELOCITY_142 16384;
BA_ "GenSigStartValue" SG_ 547 DET_RCS_142 128;
BA_ "GenSigStartValue" SG_ 547 DET_RANGE_VELOCITY_143 16384;
BA_ "GenSigStartValue" SG_ 547 DET_RCS_143 128;
BA_ "GenSigStartValue" SG_ 547 DET_RANGE_VELOCITY_144 16384;
BA_ "GenSigStartValue" SG_ 547 DET_RCS_144 128;
BA_ "GenSigStartValue" SG_ 548 DET_RANGE_VELOCITY_145 16384;
BA_ "GenSigStartValue" SG_ 548 DET_RCS_145 128;
BA_ "GenSigStartValue" SG_ 548 DET_RANGE_VELOCITY_146 16384;
BA_ "GenSigStartValue" SG_ 548 DET_RCS_146 128;
BA_ "GenSigStartValue" SG_ 548 DET_RANGE_VELOCITY_147 16384;
BA_ "GenSigStartValue" SG_ 548 DET_RCS_147 128;
BA_ "GenSigStartValue" SG_ 548 DET_RANGE_VELOCITY_148 16384;
BA_ "GenSigStartValue" SG_ 548 DET_RCS_148 128;
BA_ "GenSigStartValue" SG_ 549 DET_RANGE_VELOCITY_149 16384;
BA_ "GenSigStartValue" SG_ 549 DET_RCS_149 128;
BA_ "GenSigStartValue" SG_ 549 DET_RANGE_VELOCITY_150 16384;
BA_ "GenSigStartValue" SG_ 549 DET_RCS_150 128;
BA_ "GenSigStartValue" SG_ 549 DET_RANGE_VELOCITY_151 16384;
BA_ "GenSigStartValue" SG_ 549 DET_RCS_151 128;
BA_ "GenSigStartValue" SG_ 549 DET_RANGE_VELOCITY_152 16384;
BA_ "GenSigStartValue" SG_ 549 DET_RCS_152 128;
BA_ "GenSigStartValue" SG_ 550 DET_RANGE_VELOCITY_153 16384;
BA_ "GenSigStartValue" SG_ 550 DET_RCS_153 128;
BA_ "GenSigStartValue" SG_ 550 DET_RANGE_VELOCITY_154 16384;
BA_ "GenSigStartValue" SG_ 550 DET_RCS_154 128;
BA_ "GenSigStartValue" SG_ 550 DET_RANGE_VELOCITY_155 16384;
BA_ "GenSigStartValue" SG_ 550 DET_RCS_155 128;
BA_ "GenSigStartValue" SG_ 550 DET_RANGE_VELOCITY_156 16384;
BA_ "GenSigStartValue" SG_ 550 DET_RCS_156 128;
BA_ "GenSigStartValue" SG_ 551 DET_RANGE_VELOCITY_157 16384;
BA_ "GenSigStartValue" SG_ 551 DET_RCS_157 128;
BA_ "GenSigStartValue" SG_ 551 DET_RANGE_VELOCITY_158 16384;
BA_ "GenSigStartValue" SG_ 551 DET_RCS_158 128;
BA_ "GenSigStartValue" SG_ 551 DET_RANGE_VELOCITY_159 16384;
BA_ "GenSigStartValue" SG_ 551 DET_RCS_159 128;
BA_ "GenSigStartValue" SG_ 551 DET_RANGE_VELOCITY_160 16384;
BA_ "GenSigStartValue" SG_ 551 DET_RCS_160 128;
BA_ "GenSigStartValue" SG_ 552 DET_RANGE_VELOCITY_161 16384;
BA_ "GenSigStartValue" SG_ 552 DET_RCS_161 128;
BA_ "GenSigStartValue" SG_ 552 DET_RANGE_VELOCITY_162 16384;
BA_ "GenSigStartValue" SG_ 552 DET_RCS_162 128;
BA_ "GenSigStartValue" SG_ 552 DET_RANGE_VELOCITY_163 16384;
BA_ "GenSigStartValue" SG_ 552 DET_RCS_163 128;
BA_ "GenSigStartValue" SG_ 552 DET_RANGE_VELOCITY_164 16384;
BA_ "GenSigStartValue" SG_ 552 DET_RCS_164 128;
BA_ "GenSigStartValue" SG_ 553 DET_RANGE_VELOCITY_165 16384;
BA_ "GenSigStartValue" SG_ 553 DET_RCS_165 128;
BA_ "GenSigStartValue" SG_ 553 DET_RANGE_VELOCITY_166 16384;
BA_ "GenSigStartValue" SG_ 553 DET_RCS_166 128;
BA_ "GenSigStartValue" SG_ 553 DET_RANGE_VELOCITY_167 16384;
BA_ "GenSigStartValue" SG_ 553 DET_RCS_167 128;
BA_ "GenSigStartValue" SG_ 553 DET_RANGE_VELOCITY_168 16384;
BA_ "GenSigStartValue" SG_ 553 DET_RCS_168 128;
BA_ "GenSigStartValue" SG_ 554 DET_RANGE_VELOCITY_169 16384;
BA_ "GenSigStartValue" SG_ 554 DET_RCS_169 128;
BA_ "GenSigStartValue" SG_ 554 DET_RANGE_VELOCITY_170 16384;
BA_ "GenSigStartValue" SG_ 554 DET_RCS_170 128;
BA_ "GenSigStartValue" SG_ 554 DET_RANGE_VELOCITY_171 16384;
BA_ "GenSigStartValue" SG_ 554 DET_RCS_171 128;
BA_ "GenSigStartValue" SG_ 554 DET_RANGE_VELOCITY_172 16384;
BA_ "GenSigStartValue" SG_ 554 DET_RCS_172 128;
VAL_ 538 DET_CONFD_AZIMUTH_105 0 "High" 1 "MidHigh" 2 "MidLow" 3 "Low";
VAL_ 538 DET_CONFD_ELEVATION_105 0 "High" 1 "MidHigh" 2 "MidLow" 3 "Low";
VAL_ 538 DET_CONFD_AZIMUTH_106 0 "High" 1 "MidHigh" 2 "MidLow" 3 "Low";
VAL_ 538 DET_CONFD_ELEVATION_106 0 "High" 1 "MidHigh" 2 "MidLow" 3 "Low";
VAL_ 538 DET_CONFD_AZIMUTH_107 0 "High" 1 "MidHigh" 2 "MidLow" 3 "Low";
VAL_ 538 DET_CONFD_ELEVATION_107 0 "High" 1 "MidHigh" 2 "MidLow" 3 "Low";
VAL_ 539 DET_CONFD_AZIMUTH_109 0 "High" 1 "MidHigh" 2 "MidLow" 3 "Low";
VAL_ 539 DET_CONFD_ELEVATION_109 0 "High" 1 "MidHigh" 2 "MidLow" 3 "Low";
VAL_ 539 DET_CONFD_AZIMUTH_110 0 "High" 1 "MidHigh" 2 "MidLow" 3 "Low";
VAL_ 539 DET_CONFD_ELEVATION_110 0 "High" 1 "MidHigh" 2 "MidLow" 3 "Low";
VAL_ 539 DET_CONFD_AZIMUTH_111 0 "High" 1 "MidHigh" 2 "MidLow" 3 "Low";
VAL_ 539 DET_CONFD_ELEVATION_111 0 "High" 1 "MidHigh" 2 "MidLow" 3 "Low";
VAL_ 540 DET_CONFD_AZIMUTH_113 0 "High" 1 "MidHigh" 2 "MidLow" 3 "Low";
VAL_ 540 DET_CONFD_ELEVATION_113 0 "High" 1 "MidHigh" 2 "MidLow" 3 "Low";
VAL_ 540 DET_CONFD_AZIMUTH_114 0 "High" 1 "MidHigh" 2 "MidLow" 3 "Low";
VAL_ 540 DET_CONFD_ELEVATION_114 0 "High" 1 "MidHigh" 2 "MidLow" 3 "Low";
VAL_ 540 DET_CONFD_AZIMUTH_115 0 "High" 1 "MidHigh" 2 "MidLow" 3 "Low";
VAL_ 540 DET_CONFD_ELEVATION_115 0 "High" 1 "MidHigh" 2 "MidLow" 3 "Low";
VAL_ 541 DET_CONFD_AZIMUTH_117 0 "High" 1 "MidHigh" 2 "MidLow" 3 "Low";
VAL_ 541 DET_CONFD_ELEVATION_117 0 "High" 1 "MidHigh" 2 "MidLow" 3 "Low";
VAL_ 541 DET_CONFD_AZIMUTH_118 0 "High" 1 "MidHigh" 2 "MidLow" 3 "Low";
VAL_ 541 DET_CONFD_ELEVATION_118 0 "High" 1 "MidHigh" 2 "MidLow" 3 "Low";
VAL_ 541 DET_CONFD_AZIMUTH_119 0 "High" 1 "MidHigh" 2 "MidLow" 3 "Low";
VAL_ 541 DET_CONFD_ELEVATION_119 0 "High" 1 "MidHigh" 2 "MidLow" 3 "Low";
VAL_ 542 DET_CONFD_AZIMUTH_121 0 "High" 1 "MidHigh" 2 "MidLow" 3 "Low";
VAL_ 542 DET_CONFD_ELEVATION_121 0 "High" 1 "MidHigh" 2 "MidLow" 3 "Low";
VAL_ 542 DET_CONFD_AZIMUTH_122 0 "High" 1 "MidHigh" 2 "MidLow" 3 "Low";
VAL_ 542 DET_CONFD_ELEVATION_122 0 "High" 1 "MidHigh" 2 "MidLow" 3 "Low";
VAL_ 542 DET_CONFD_AZIMUTH_123 0 "High" 1 "MidHigh" 2 "MidLow" 3 "Low";
VAL_ 542 DET_CONFD_ELEVATION_123 0 "High" 1 "MidHigh" 2 "MidLow" 3 "Low";
VAL_ 543 DET_CONFD_AZIMUTH_125 0 "High" 1 "MidHigh" 2 "MidLow" 3 "Low";
VAL_ 543 DET_CONFD_ELEVATION_125 0 "High" 1 "MidHigh" 2 "MidLow" 3 "Low";
VAL_ 543 DET_CONFD_AZIMUTH_126 0 "High" 1 "MidHigh" 2 "MidLow" 3 "Low";
VAL_ 543 DET_CONFD_ELEVATION_126 0 "High" 1 "MidHigh" 2 "MidLow" 3 "Low";
VAL_ 543 DET_CONFD_AZIMUTH_127 0 "High" 1 "MidHigh" 2 "MidLow" 3 "Low";
VAL_ 543 DET_CONFD_ELEVATION_127 0 "High" 1 "MidHigh" 2 "MidLow" 3 "Low";
VAL_ 544 DET_CONFD_AZIMUTH_129 0 "High" 1 "MidHigh" 2 "MidLow" 3 "Low";
VAL_ 544 DET_CONFD_ELEVATION_129 0 "High" 1 "MidHigh" 2 "MidLow" 3 "Low";
VAL_ 544 DET_CONFD_AZIMUTH_130 0 "High" 1 "MidHigh" 2 "MidLow" 3 "Low";
VAL_ 544 DET_CONFD_ELEVATION_130 0 "High" 1 "MidHigh" 2 "MidLow" 3 "Low";
VAL_ 544 DET_CONFD_AZIMUTH_131 0 "High" 1 "MidHigh" 2 "MidLow" 3 "Low";
VAL_ 544 DET_CONFD_ELEVATION_131 0 "High" 1 "MidHigh" 2 "MidLow" 3 "Low";
VAL_ 545 DET_CONFD_AZIMUTH_133 0 "High" 1 "MidHigh" 2 "MidLow" 3 "Low";
VAL_ 545 DET_CONFD_ELEVATION_133 0 "High" 1 "MidHigh" 2 "MidLow" 3 "Low";
VAL_ 545 DET_CONFD_AZIMUTH_134 0 "High" 1 "MidHigh" 2 "MidLow" 3 "Low";
VAL_ 545 DET_CONFD_ELEVATION_134 0 "High" 1 "MidHigh" 2 "MidLow" 3 "Low";
VAL_ 545 DET_CONFD_AZIMUTH_135 0 "High" 1 "MidHigh" 2 "MidLow" 3 "Low";
VAL_ 545 DET_CONFD_ELEVATION_135 0 "High" 1 "MidHigh" 2 "MidLow" 3 "Low";
VAL_ 546 DET_CONFD_AZIMUTH_137 0 "High" 1 "MidHigh" 2 "MidLow" 3 "Low";
VAL_ 546 DET_CONFD_ELEVATION_137 0 "High" 1 "MidHigh" 2 "MidLow" 3 "Low";
VAL_ 546 DET_CONFD_AZIMUTH_138 0 "High" 1 "MidHigh" 2 "MidLow" 3 "Low";
VAL_ 546 DET_CONFD_ELEVATION_138 0 "High" 1 "MidHigh" 2 "MidLow" 3 "Low";
VAL_ 546 DET_CONFD_AZIMUTH_139 0 "High" 1 "MidHigh" 2 "MidLow" 3 "Low";
VAL_ 546 DET_CONFD_ELEVATION_139 0 "High" 1 "MidHigh" 2 "MidLow" 3 "Low";
VAL_ 547 DET_CONFD_AZIMUTH_141 0 "High" 1 "MidHigh" 2 "MidLow" 3 "Low";
VAL_ 547 DET_CONFD_ELEVATION_141 0 "High" 1 "MidHigh" 2 "MidLow" 3 "Low";
VAL_ 547 DET_CONFD_AZIMUTH_142 0 "High" 1 "MidHigh" 2 "MidLow" 3 "Low";
VAL_ 547 DET_CONFD_ELEVATION_142 0 "High" 1 "MidHigh" 2 "MidLow" 3 "Low";
VAL_ 547 DET_CONFD_AZIMUTH_143 0 "High" 1 "MidHigh" 2 "MidLow" 3 "Low";
VAL_ 547 DET_CONFD_ELEVATION_143 0 "High" 1 "MidHigh" 2 "MidLow" 3 "Low";
VAL_ 548 DET_CONFD_AZIMUTH_145 0 "High" 1 "MidHigh" 2 "MidLow" 3 "Low";
VAL_ 548 DET_CONFD_ELEVATION_145 0 "High" 1 "MidHigh" 2 "MidLow" 3 "Low";
VAL_ 548 DET_CONFD_AZIMUTH_146 0 "High" 1 "MidHigh" 2 "MidLow" 3 "Low";
VAL_ 548 DET_CONFD_ELEVATION_146 0 "High" 1 "MidHigh" 2 "MidLow" 3 "Low";
VAL_ 548 DET_CONFD_AZIMUTH_147 0 "High" 1 "MidHigh" 2 "MidLow" 3 "Low";
VAL_ 548 DET_CONFD_ELEVATION_147 0 "High" 1 "MidHigh" 2 "MidLow" 3 "Low";
VAL_ 549 DET_CONFD_AZIMUTH_149 0 "High" 1 "MidHigh" 2 "MidLow" 3 "Low";
VAL_ 549 DET_CONFD_ELEVATION_149 0 "High" 1 "MidHigh" 2 "MidLow" 3 "Low";
VAL_ 549 DET_CONFD_AZIMUTH_150 0 "High" 1 "MidHigh" 2 "MidLow" 3 "Low";
VAL_ 549 DET_CONFD_ELEVATION_150 0 "High" 1 "MidHigh" 2 "MidLow" 3 "Low";
VAL_ 549 DET_CONFD_AZIMUTH_151 0 "High" 1 "MidHigh" 2 "MidLow" 3 "Low";
VAL_ 549 DET_CONFD_ELEVATION_151 0 "High" 1 "MidHigh" 2 "MidLow" 3 "Low";
VAL_ 550 DET_CONFD_AZIMUTH_153 0 "High" 1 "MidHigh" 2 "MidLow" 3 "Low";
VAL_ 550 DET_CONFD_ELEVATION_153 0 "High" 1 "MidHigh" 2 "MidLow" 3 "Low";
VAL_ 550 DET_CONFD_AZIMUTH_154 0 "High" 1 "MidHigh" 2 "MidLow" 3 "Low";
VAL_ 550 DET_CONFD_ELEVATION_154 0 "High" 1 "MidHigh" 2 "MidLow" 3 "Low";
VAL_ 550 DET_CONFD_AZIMUTH_155 0 "High" 1 "MidHigh" 2 "MidLow" 3 "Low";
VAL_ 550 DET_CONFD_ELEVATION_155 0 "High" 1 "MidHigh" 2 "MidLow" 3 "Low";
VAL_ 551 DET_CONFD_AZIMUTH_157 0 "High" 1 "MidHigh" 2 "MidLow" 3 "Low";
VAL_ 551 DET_CONFD_ELEVATION_157 0 "High" 1 "MidHigh" 2 "MidLow" 3 "Low";
VAL_ 551 DET_CONFD_AZIMUTH_158 0 "High" 1 "MidHigh" 2 "MidLow" 3 "Low";
VAL_ 551 DET_CONFD_ELEVATION_158 0 "High" 1 "MidHigh" 2 "MidLow" 3 "Low";
VAL_ 551 DET_CONFD_AZIMUTH_159 0 "High" 1 "MidHigh" 2 "MidLow" 3 "Low";
VAL_ 551 DET_CONFD_ELEVATION_159 0 "High" 1 "MidHigh" 2 "MidLow" 3 "Low";
VAL_ 552 DET_CONFD_AZIMUTH_161 0 "High" 1 "MidHigh" 2 "MidLow" 3 "Low";
VAL_ 552 DET_CONFD_ELEVATION_161 0 "High" 1 "MidHigh" 2 "MidLow" 3 "Low";
VAL_ 552 DET_CONFD_AZIMUTH_162 0 "High" 1 "MidHigh" 2 "MidLow" 3 "Low";
VAL_ 552 DET_CONFD_ELEVATION_162 0 "High" 1 "MidHigh" 2 "MidLow" 3 "Low";
VAL_ 552 DET_CONFD_AZIMUTH_163 0 "High" 1 "MidHigh" 2 "MidLow" 3 "Low";
VAL_ 552 DET_CONFD_ELEVATION_163 0 "High" 1 "MidHigh" 2 "MidLow" 3 "Low";
VAL_ 553 DET_CONFD_AZIMUTH_165 0 "High" 1 "MidHigh" 2 "MidLow" 3 "Low";
VAL_ 553 DET_CONFD_ELEVATION_165 0 "High" 1 "MidHigh" 2 "MidLow" 3 "Low";
VAL_ 553 DET_CONFD_AZIMUTH_166 0 "High" 1 "MidHigh" 2 "MidLow" 3 "Low";
VAL_ 553 DET_CONFD_ELEVATION_166 0 "High" 1 "MidHigh" 2 "MidLow" 3 "Low";
VAL_ 553 DET_CONFD_AZIMUTH_167 0 "High" 1 "MidHigh" 2 "MidLow" 3 "Low";
VAL_ 553 DET_CONFD_ELEVATION_167 0 "High" 1 "MidHigh" 2 "MidLow" 3 "Low";
VAL_ 554 DET_CONFD_AZIMUTH_169 0 "High" 1 "MidHigh" 2 "MidLow" 3 "Low";
VAL_ 554 DET_CONFD_ELEVATION_169 0 "High" 1 "MidHigh" 2 "MidLow" 3 "Low";
VAL_ 554 DET_CONFD_AZIMUTH_170 0 "High" 1 "MidHigh" 2 "MidLow" 3 "Low";
VAL_ 554 DET_CONFD_ELEVATION_170 0 "High" 1 "MidHigh" 2 "MidLow" 3 "Low";
VAL_ 554 DET_CONFD_AZIMUTH_171 0 "High" 1 "MidHigh" 2 "MidLow" 3 "Low";
VAL_ 554 DET_CONFD_ELEVATION_171 0 "High" 1 "MidHigh" 2 "MidLow" 3 "Low";
SIG_GROUP_ 538 Detection105 1 : DET_BI_STATIC_FLAG_105 DET_AMBG_AZIMUTH_PROB_105 DET_AZIMUTH_AMB_ID_105 DET_CONFD_ELEVATION_105 DET_CONFD_AZIMUTH_105 DET_HVC_FLAG_105 DET_OUTSIDE_SECTOR_105 DET_AZIMUTH_ERR_105 DET_ELEVATION_ERR_105 DET_RANGE_ERR_105 DET_RANGE_VELOCITY_ERR_105 DET_EXISTENCE_PROB_105 DET_POINT_TARGET_PROB_105 DET_SNR_105 DET_SUPER_RES_TARGET_105 DET_VALID_FLAG_105 DET_RCS_105 DET_ELEVATION_105 DET_AZIMUTH_105 DET_RANGE_VELOCITY_105 DET_RANGE_105;
SIG_GROUP_ 538 Detection106 1 : DET_BI_STATIC_FLAG_106 DET_AMBG_AZIMUTH_PROB_106 DET_AZIMUTH_AMB_ID_106 DET_CONFD_ELEVATION_106 DET_CONFD_AZIMUTH_106 DET_HVC_FLAG_106 DET_OUTSIDE_SECTOR_106 DET_AZIMUTH_ERR_106 DET_ELEVATION_ERR_106 DET_RANGE_ERR_106 DET_RANGE_VELOCITY_ERR_106 DET_EXISTENCE_PROB_106 DET_POINT_TARGET_PROB_106 DET_SNR_106 DET_SUPER_RES_TARGET_106 DET_VALID_FLAG_106 DET_RCS_106 DET_ELEVATION_106 DET_AZIMUTH_106 DET_RANGE_VELOCITY_106 DET_RANGE_106;
SIG_GROUP_ 538 Detection107 1 : DET_BI_STATIC_FLAG_107 DET_AMBG_AZIMUTH_PROB_107 DET_AZIMUTH_AMB_ID_107 DET_CONFD_ELEVATION_107 DET_CONFD_AZIMUTH_107 DET_HVC_FLAG_107 DET_OUTSIDE_SECTOR_107 DET_AZIMUTH_ERR_107 DET_ELEVATION_ERR_107 DET_RANGE_ERR_107 DET_RANGE_VELOCITY_ERR_107 DET_EXISTENCE_PROB_107 DET_POINT_TARGET_PROB_107 DET_SNR_107 DET_SUPER_RES_TARGET_107 DET_VALID_FLAG_107 DET_RCS_107 DET_ELEVATION_107 DET_AZIMUTH_107 DET_RANGE_VELOCITY_107 DET_RANGE_107;
SIG_GROUP_ 538 Detection108 1 : DET_BI_STATIC_FLAG_108 DET_AMBG_AZIMUTH_PROB_108 DET_AZIMUTH_AMB_ID_108 DET_CONFD_ELEVATION_108 DET_CONFD_AZIMUTH_108 DET_HVC_FLAG_108 DET_OUTSIDE_SECTOR_108 DET_EXISTENCE_PROB_108 DET_POINT_TARGET_PROB_108 DET_SNR_108 DET_SUPER_RES_TARGET_108 DET_VALID_FLAG_108 DET_RCS_108 DET_ELEVATION_ERR_108 DET_ELEVATION_108 DET_AZIMUTH_ERR_108 DET_AZIMUTH_108 DET_RANGE_VELOCITY_ERR_108 DET_RANGE_VELOCITY_108 DET_RANGE_ERR_108 DET_RANGE_108;
SIG_GROUP_ 539 Detection109 1 : DET_BI_STATIC_FLAG_109 DET_AMBG_AZIMUTH_PROB_109 DET_AZIMUTH_AMB_ID_109 DET_CONFD_ELEVATION_109 DET_CONFD_AZIMUTH_109 DET_HVC_FLAG_109 DET_OUTSIDE_SECTOR_109 DET_AZIMUTH_ERR_109 DET_ELEVATION_ERR_109 DET_RANGE_ERR_109 DET_RANGE_VELOCITY_ERR_109 DET_EXISTENCE_PROB_109 DET_POINT_TARGET_PROB_109 DET_SNR_109 DET_SUPER_RES_TARGET_109 DET_VALID_FLAG_109 DET_RCS_109 DET_ELEVATION_109 DET_AZIMUTH_109 DET_RANGE_VELOCITY_109 DET_RANGE_109;
SIG_GROUP_ 539 Detection110 1 : DET_BI_STATIC_FLAG_110 DET_AMBG_AZIMUTH_PROB_110 DET_AZIMUTH_AMB_ID_110 DET_CONFD_ELEVATION_110 DET_CONFD_AZIMUTH_110 DET_HVC_FLAG_110 DET_OUTSIDE_SECTOR_110 DET_AZIMUTH_ERR_110 DET_ELEVATION_ERR_110 DET_RANGE_ERR_110 DET_RANGE_VELOCITY_ERR_110 DET_EXISTENCE_PROB_110 DET_POINT_TARGET_PROB_110 DET_SNR_110 DET_SUPER_RES_TARGET_110 DET_VALID_FLAG_110 DET_RCS_110 DET_ELEVATION_110 DET_AZIMUTH_110 DET_RANGE_VELOCITY_110 DET_RANGE_110;
SIG_GROUP_ 539 Detection111 1 : DET_BI_STATIC_FLAG_111 DET_AMBG_AZIMUTH_PROB_111 DET_AZIMUTH_AMB_ID_111 DET_CONFD_ELEVATION_111 DET_CONFD_AZIMUTH_111 DET_HVC_FLAG_111 DET_OUTSIDE_SECTOR_111 DET_AZIMUTH_ERR_111 DET_ELEVATION_ERR_111 DET_RANGE_ERR_111 DET_RANGE_VELOCITY_ERR_111 DET_EXISTENCE_PROB_111 DET_POINT_TARGET_PROB_111 DET_SNR_111 DET_SUPER_RES_TARGET_111 DET_VALID_FLAG_111 DET_RCS_111 DET_ELEVATION_111 DET_AZIMUTH_111 DET_RANGE_VELOCITY_111 DET_RANGE_111;
SIG_GROUP_ 539 Detection112 1 : DET_BI_STATIC_FLAG_112 DET_AMBG_AZIMUTH_PROB_112 DET_AZIMUTH_AMB_ID_112 DET_CONFD_ELEVATION_112 DET_CONFD_AZIMUTH_112 DET_HVC_FLAG_112 DET_OUTSIDE_SECTOR_112 DET_EXISTENCE_PROB_112 DET_POINT_TARGET_PROB_112 DET_SNR_112 DET_SUPER_RES_TARGET_112 DET_VALID_FLAG_112 DET_RCS_112 DET_ELEVATION_ERR_112 DET_ELEVATION_112 DET_AZIMUTH_ERR_112 DET_AZIMUTH_112 DET_RANGE_VELOCITY_ERR_112 DET_RANGE_VELOCITY_112 DET_RANGE_ERR_112 DET_RANGE_112;
SIG_GROUP_ 540 Detection113 1 : DET_BI_STATIC_FLAG_113 DET_AMBG_AZIMUTH_PROB_113 DET_AZIMUTH_AMB_ID_113 DET_CONFD_ELEVATION_113 DET_CONFD_AZIMUTH_113 DET_HVC_FLAG_113 DET_OUTSIDE_SECTOR_113 DET_AZIMUTH_ERR_113 DET_ELEVATION_ERR_113 DET_RANGE_ERR_113 DET_RANGE_VELOCITY_ERR_113 DET_EXISTENCE_PROB_113 DET_POINT_TARGET_PROB_113 DET_SNR_113 DET_SUPER_RES_TARGET_113 DET_VALID_FLAG_113 DET_RCS_113 DET_ELEVATION_113 DET_AZIMUTH_113 DET_RANGE_VELOCITY_113 DET_RANGE_113;
SIG_GROUP_ 540 Detection114 1 : DET_BI_STATIC_FLAG_114 DET_AMBG_AZIMUTH_PROB_114 DET_AZIMUTH_AMB_ID_114 DET_CONFD_ELEVATION_114 DET_CONFD_AZIMUTH_114 DET_HVC_FLAG_114 DET_OUTSIDE_SECTOR_114 DET_AZIMUTH_ERR_114 DET_ELEVATION_ERR_114 DET_RANGE_ERR_114 DET_RANGE_VELOCITY_ERR_114 DET_EXISTENCE_PROB_114 DET_POINT_TARGET_PROB_114 DET_SNR_114 DET_SUPER_RES_TARGET_114 DET_VALID_FLAG_114 DET_RCS_114 DET_ELEVATION_114 DET_AZIMUTH_114 DET_RANGE_VELOCITY_114 DET_RANGE_114;
SIG_GROUP_ 540 Detection115 1 : DET_BI_STATIC_FLAG_115 DET_AMBG_AZIMUTH_PROB_115 DET_AZIMUTH_AMB_ID_115 DET_CONFD_ELEVATION_115 DET_CONFD_AZIMUTH_115 DET_HVC_FLAG_115 DET_OUTSIDE_SECTOR_115 DET_AZIMUTH_ERR_115 DET_ELEVATION_ERR_115 DET_RANGE_ERR_115 DET_RANGE_VELOCITY_ERR_115 DET_EXISTENCE_PROB_115 DET_POINT_TARGET_PROB_115 DET_SNR_115 DET_SUPER_RES_TARGET_115 DET_VALID_FLAG_115 DET_RCS_115 DET_ELEVATION_115 DET_AZIMUTH_115 DET_RANGE_VELOCITY_115 DET_RANGE_115;
SIG_GROUP_ 540 Detection116 1 : DET_BI_STATIC_FLAG_116 DET_AMBG_AZIMUTH_PROB_116 DET_AZIMUTH_AMB_ID_116 DET_CONFD_ELEVATION_116 DET_CONFD_AZIMUTH_116 DET_HVC_FLAG_116 DET_OUTSIDE_SECTOR_116 DET_EXISTENCE_PROB_116 DET_POINT_TARGET_PROB_116 DET_SNR_116 DET_SUPER_RES_TARGET_116 DET_VALID_FLAG_116 DET_RCS_116 DET_ELEVATION_ERR_116 DET_ELEVATION_116 DET_AZIMUTH_ERR_116 DET_AZIMUTH_116 DET_RANGE_VELOCITY_ERR_116 DET_RANGE_VELOCITY_116 DET_RANGE_ERR_116 DET_RANGE_116;
SIG_GROUP_ 541 Detection117 1 : DET_BI_STATIC_FLAG_117 DET_AMBG_AZIMUTH_PROB_117 DET_AZIMUTH_AMB_ID_117 DET_CONFD_ELEVATION_117 DET_CONFD_AZIMUTH_117 DET_HVC_FLAG_117 DET_OUTSIDE_SECTOR_117 DET_AZIMUTH_ERR_117 DET_ELEVATION_ERR_117 DET_RANGE_ERR_117 DET_RANGE_VELOCITY_ERR_117 DET_EXISTENCE_PROB_117 DET_POINT_TARGET_PROB_117 DET_SNR_117 DET_SUPER_RES_TARGET_117 DET_VALID_FLAG_117 DET_RCS_117 DET_ELEVATION_117 DET_AZIMUTH_117 DET_RANGE_VELOCITY_117 DET_RANGE_117;
SIG_GROUP_ 541 Detection118 1 : DET_BI_STATIC_FLAG_118 DET_AMBG_AZIMUTH_PROB_118 DET_AZIMUTH_AMB_ID_118 DET_CONFD_ELEVATION_118 DET_CONFD_AZIMUTH_118 DET_HVC_FLAG_118 DET_OUTSIDE_SECTOR_118 DET_AZIMUTH_ERR_118 DET_ELEVATION_ERR_118 DET_RANGE_ERR_118 DET_RANGE_VELOCITY_ERR_118 DET_EXISTENCE_PROB_118 DET_POINT_TARGET_PROB_118 DET_SNR_118 DET_SUPER_RES_TARGET_118 DET_VALID_FLAG_118 DET_RCS_118 DET_ELEVATION_118 DET_AZIMUTH_118 DET_RANGE_VELOCITY_118 DET_RANGE_118;
SIG_GROUP_ 541 Detection119 1 : DET_BI_STATIC_FLAG_119 DET_AMBG_AZIMUTH_PROB_119 DET_AZIMUTH_AMB_ID_119 DET_CONFD_ELEVATION_119 DET_CONFD_AZIMUTH_119 DET_HVC_FLAG_119 DET_OUTSIDE_SECTOR_119 DET_AZIMUTH_ERR_119 DET_ELEVATION_ERR_119 DET_RANGE_ERR_119 DET_RANGE_VELOCITY_ERR_119 DET_EXISTENCE_PROB_119 DET_POINT_TARGET_PROB_119 DET_SNR_119 DET_SUPER_RES_TARGET_119 DET_VALID_FLAG_119 DET_RCS_119 DET_ELEVATION_119 DET_AZIMUTH_119 DET_RANGE_VELOCITY_119 DET_RANGE_119;
SIG_GROUP_ 541 Detection120 1 : DET_BI_STATIC_FLAG_120 DET_AMBG_AZIMUTH_PROB_120 DET_AZIMUTH_AMB_ID_120 DET_CONFD_ELEVATION_120 DET_CONFD_AZIMUTH_120 DET_HVC_FLAG_120 DET_OUTSIDE_SECTOR_120 DET_EXISTENCE_PROB_120 DET_POINT_TARGET_PROB_120 DET_SNR_120 DET_SUPER_RES_TARGET_120 DET_VALID_FLAG_120 DET_RCS_120 DET_ELEVATION_ERR_120 DET_ELEVATION_120 DET_AZIMUTH_ERR_120 DET_AZIMUTH_120 DET_RANGE_VELOCITY_ERR_120 DET_RANGE_VELOCITY_120 DET_RANGE_ERR_120 DET_RANGE_120;
SIG_GROUP_ 542 Detection121 1 : DET_BI_STATIC_FLAG_121 DET_AMBG_AZIMUTH_PROB_121 DET_AZIMUTH_AMB_ID_121 DET_CONFD_ELEVATION_121 DET_CONFD_AZIMUTH_121 DET_HVC_FLAG_121 DET_OUTSIDE_SECTOR_121 DET_AZIMUTH_ERR_121 DET_ELEVATION_ERR_121 DET_RANGE_ERR_121 DET_RANGE_VELOCITY_ERR_121 DET_EXISTENCE_PROB_121 DET_POINT_TARGET_PROB_121 DET_SNR_121 DET_SUPER_RES_TARGET_121 DET_VALID_FLAG_121 DET_RCS_121 DET_ELEVATION_121 DET_AZIMUTH_121 DET_RANGE_VELOCITY_121 DET_RANGE_121;
SIG_GROUP_ 542 Detection122 1 : DET_BI_STATIC_FLAG_122 DET_AMBG_AZIMUTH_PROB_122 DET_AZIMUTH_AMB_ID_122 DET_CONFD_ELEVATION_122 DET_CONFD_AZIMUTH_122 DET_HVC_FLAG_122 DET_OUTSIDE_SECTOR_122 DET_AZIMUTH_ERR_122 DET_ELEVATION_ERR_122 DET_RANGE_ERR_122 DET_RANGE_VELOCITY_ERR_122 DET_EXISTENCE_PROB_122 DET_POINT_TARGET_PROB_122 DET_SNR_122 DET_SUPER_RES_TARGET_122 DET_VALID_FLAG_122 DET_RCS_122 DET_ELEVATION_122 DET_AZIMUTH_122 DET_RANGE_VELOCITY_122 DET_RANGE_122;
SIG_GROUP_ 542 Detection123 1 : DET_BI_STATIC_FLAG_123 DET_AMBG_AZIMUTH_PROB_123 DET_AZIMUTH_AMB_ID_123 DET_CONFD_ELEVATION_123 DET_CONFD_AZIMUTH_123 DET_HVC_FLAG_123 DET_OUTSIDE_SECTOR_123 DET_AZIMUTH_ERR_123 DET_ELEVATION_ERR_123 DET_RANGE_ERR_123 DET_RANGE_VELOCITY_ERR_123 DET_EXISTENCE_PROB_123 DET_POINT_TARGET_PROB_123 DET_SNR_123 DET_SUPER_RES_TARGET_123 DET_VALID_FLAG_123 DET_RCS_123 DET_ELEVATION_123 DET_AZIMUTH_123 DET_RANGE_VELOCITY_123 DET_RANGE_123;
SIG_GROUP_ 542 Detection124 1 : DET_BI_STATIC_FLAG_124 DET_AMBG_AZIMUTH_PROB_124 DET_AZIMUTH_AMB_ID_124 DET_CONFD_ELEVATION_124 DET_CONFD_AZIMUTH_124 DET_HVC_FLAG_124 DET_OUTSIDE_SECTOR_124 DET_EXISTENCE_PROB_124 DET_POINT_TARGET_PROB_124 DET_SNR_124 DET_SUPER_RES_TARGET_124 DET_VALID_FLAG_124 DET_RCS_124 DET_ELEVATION_ERR_124 DET_ELEVATION_124 DET_AZIMUTH_ERR_124 DET_AZIMUTH_124 DET_RANGE_VELOCITY_ERR_124 DET_RANGE_VELOCITY_124 DET_RANGE_ERR_124 DET_RANGE_124;
SIG_GROUP_ 543 Detection125 1 : DET_BI_STATIC_FLAG_125 DET_AMBG_AZIMUTH_PROB_125 DET_AZIMUTH_AMB_ID_125 DET_CONFD_ELEVATION_125 DET_CONFD_AZIMUTH_125 DET_HVC_FLAG_125 DET_OUTSIDE_SECTOR_125 DET_AZIMUTH_ERR_125 DET_ELEVATION_ERR_125 DET_RANGE_ERR_125 DET_RANGE_VELOCITY_ERR_125 DET_EXISTENCE_PROB_125 DET_POINT_TARGET_PROB_125 DET_SNR_125 DET_SUPER_RES_TARGET_125 DET_VALID_FLAG_125 DET_RCS_125 DET_ELEVATION_125 DET_AZIMUTH_125 DET_RANGE_VELOCITY_125 DET_RANGE_125;
SIG_GROUP_ 543 Detection126 1 : DET_BI_STATIC_FLAG_126 DET_AMBG_AZIMUTH_PROB_126 DET_AZIMUTH_AMB_ID_126 DET_CONFD_ELEVATION_126 DET_CONFD_AZIMUTH_126 DET_HVC_FLAG_126 DET_OUTSIDE_SECTOR_126 DET_AZIMUTH_ERR_126 DET_ELEVATION_ERR_126 DET_RANGE_ERR_126 DET_RANGE_VELOCITY_ERR_126 DET_EXISTENCE_PROB_126 DET_POINT_TARGET_PROB_126 DET_SNR_126 DET_SUPER_RES_TARGET_126 DET_VALID_FLAG_126 DET_RCS_126 DET_ELEVATION_126 DET_AZIMUTH_126 DET_RANGE_VELOCITY_126 DET_RANGE_126;
SIG_GROUP_ 543 Detection127 1 : DET_BI_STATIC_FLAG_127 DET_AMBG_AZIMUTH_PROB_127 DET_AZIMUTH_AMB_ID_127 DET_CONFD_ELEVATION_127 DET_CONFD_AZIMUTH_127 DET_HVC_FLAG_127 DET_OUTSIDE_SECTOR_127 DET_AZIMUTH_ERR_127 DET_ELEVATION_ERR_127 DET_RANGE_ERR_127 DET_RANGE_VELOCITY_ERR_127 DET_EXISTENCE_PROB_127 DET_POINT_TARGET_PROB_127 DET_SNR_127 DET_SUPER_RES_TARGET_127 DET_VALID_FLAG_127 DET_RCS_127 DET_ELEVATION_127 DET_AZIMUTH_127 DET_RANGE_VELOCITY_127 DET_RANGE_127;
SIG_GROUP_ 543 Detection128 1 : DET_BI_STATIC_FLAG_128 DET_AMBG_AZIMUTH_PROB_128 DET_AZIMUTH_AMB_ID_128 DET_CONFD_ELEVATION_128 DET_CONFD_AZIMUTH_128 DET_HVC_FLAG_128 DET_OUTSIDE_SECTOR_128 DET_EXISTENCE_PROB_128 DET_POINT_TARGET_PROB_128 DET_SNR_128 DET_SUPER_RES_TARGET_128 DET_VALID_FLAG_128 DET_RCS_128 DET_ELEVATION_ERR_128 DET_ELEVATION_128 DET_AZIMUTH_ERR_128 DET_AZIMUTH_128 DET_RANGE_VELOCITY_ERR_128 DET_RANGE_VELOCITY_128 DET_RANGE_ERR_128 DET_RANGE_128;
SIG_GROUP_ 544 Detection129 1 : DET_BI_STATIC_FLAG_129 DET_AMBG_AZIMUTH_PROB_129 DET_AZIMUTH_AMB_ID_129 DET_CONFD_ELEVATION_129 DET_CONFD_AZIMUTH_129 DET_HVC_FLAG_129 DET_OUTSIDE_SECTOR_129 DET_AZIMUTH_ERR_129 DET_ELEVATION_ERR_129 DET_RANGE_ERR_129 DET_RANGE_VELOCITY_ERR_129 DET_EXISTENCE_PROB_129 DET_POINT_TARGET_PROB_129 DET_SNR_129 DET_SUPER_RES_TARGET_129 DET_VALID_FLAG_129 DET_RCS_129 DET_ELEVATION_129 DET_AZIMUTH_129 DET_RANGE_VELOCITY_129 DET_RANGE_129;
SIG_GROUP_ 544 Detection130 1 : DET_BI_STATIC_FLAG_130 DET_AMBG_AZIMUTH_PROB_130 DET_AZIMUTH_AMB_ID_130 DET_CONFD_ELEVATION_130 DET_CONFD_AZIMUTH_130 DET_HVC_FLAG_130 DET_OUTSIDE_SECTOR_130 DET_AZIMUTH_ERR_130 DET_ELEVATION_ERR_130 DET_RANGE_ERR_130 DET_RANGE_VELOCITY_ERR_130 DET_EXISTENCE_PROB_130 DET_POINT_TARGET_PROB_130 DET_SNR_130 DET_SUPER_RES_TARGET_130 DET_VALID_FLAG_130 DET_RCS_130 DET_ELEVATION_130 DET_AZIMUTH_130 DET_RANGE_VELOCITY_130 DET_RANGE_130;
SIG_GROUP_ 544 Detection131 1 : DET_BI_STATIC_FLAG_131 DET_AMBG_AZIMUTH_PROB_131 DET_AZIMUTH_AMB_ID_131 DET_CONFD_ELEVATION_131 DET_CONFD_AZIMUTH_131 DET_HVC_FLAG_131 DET_OUTSIDE_SECTOR_131 DET_AZIMUTH_ERR_131 DET_ELEVATION_ERR_131 DET_RANGE_ERR_131 DET_RANGE_VELOCITY_ERR_131 DET_EXISTENCE_PROB_131 DET_POINT_TARGET_PROB_131 DET_SNR_131 DET_SUPER_RES_TARGET_131 DET_VALID_FLAG_131 DET_RCS_131 DET_ELEVATION_131 DET_AZIMUTH_131 DET_RANGE_VELOCITY_131 DET_RANGE_131;
SIG_GROUP_ 544 Detection132 1 : DET_BI_STATIC_FLAG_132 DET_AMBG_AZIMUTH_PROB_132 DET_AZIMUTH_AMB_ID_132 DET_CONFD_ELEVATION_132 DET_CONFD_AZIMUTH_132 DET_HVC_FLAG_132 DET_OUTSIDE_SECTOR_132 DET_EXISTENCE_PROB_132 DET_POINT_TARGET_PROB_132 DET_SNR_132 DET_SUPER_RES_TARGET_132 DET_VALID_FLAG_132 DET_RCS_132 DET_ELEVATION_ERR_132 DET_ELEVATION_132 DET_AZIMUTH_ERR_132 DET_AZIMUTH_132 DET_RANGE_VELOCITY_ERR_132 DET_RANGE_VELOCITY_132 DET_RANGE_ERR_132 DET_RANGE_132;
SIG_GROUP_ 545 Detection133 1 : DET_BI_STATIC_FLAG_133 DET_AMBG_AZIMUTH_PROB_133 DET_AZIMUTH_AMB_ID_133 DET_CONFD_ELEVATION_133 DET_CONFD_AZIMUTH_133 DET_HVC_FLAG_133 DET_OUTSIDE_SECTOR_133 DET_AZIMUTH_ERR_133 DET_ELEVATION_ERR_133 DET_RANGE_ERR_133 DET_RANGE_VELOCITY_ERR_133 DET_EXISTENCE_PROB_133 DET_POINT_TARGET_PROB_133 DET_SNR_133 DET_SUPER_RES_TARGET_133 DET_VALID_FLAG_133 DET_RCS_133 DET_ELEVATION_133 DET_AZIMUTH_133 DET_RANGE_VELOCITY_133 DET_RANGE_133;
SIG_GROUP_ 545 Detection134 1 : DET_BI_STATIC_FLAG_134 DET_AMBG_AZIMUTH_PROB_134 DET_AZIMUTH_AMB_ID_134 DET_CONFD_ELEVATION_134 DET_CONFD_AZIMUTH_134 DET_HVC_FLAG_134 DET_OUTSIDE_SECTOR_134 DET_AZIMUTH_ERR_134 DET_ELEVATION_ERR_134 DET_RANGE_ERR_134 DET_RANGE_VELOCITY_ERR_134 DET_EXISTENCE_PROB_134 DET_POINT_TARGET_PROB_134 DET_SNR_134 DET_SUPER_RES_TARGET_134 DET_VALID_FLAG_134 DET_RCS_134 DET_ELEVATION_134 DET_AZIMUTH_134 DET_RANGE_VELOCITY_134 DET_RANGE_134;
SIG_GROUP_ 545 Detection135 1 : DET_BI_STATIC_FLAG_135 DET_AMBG_AZIMUTH_PROB_135 DET_AZIMUTH_AMB_ID_135 DET_CONFD_ELEVATION_135 DET_CONFD_AZIMUTH_135 DET_HVC_FLAG_135 DET_OUTSIDE_SECTOR_135 DET_AZIMUTH_ERR_135 DET_ELEVATION_ERR_135 DET_RANGE_ERR_135 DET_RANGE_VELOCITY_ERR_135 DET_EXISTENCE_PROB_135 DET_POINT_TARGET_PROB_135 DET_SNR_135 DET_SUPER_RES_TARGET_135 DET_VALID_FLAG_135 DET_RCS_135 DET_ELEVATION_135 DET_AZIMUTH_135 DET_RANGE_VELOCITY_135 DET_RANGE_135;
SIG_GROUP_ 545 Detection136 1 : DET_BI_STATIC_FLAG_136 DET_AMBG_AZIMUTH_PROB_136 DET_AZIMUTH_AMB_ID_136 DET_CONFD_ELEVATION_136 DET_CONFD_AZIMUTH_136 DET_HVC_FLAG_136 DET_OUTSIDE_SECTOR_136 DET_EXISTENCE_PROB_136 DET_POINT_TARGET_PROB_136 DET_SNR_136 DET_SUPER_RES_TARGET_136 DET_VALID_FLAG_136 DET_RCS_136 DET_ELEVATION_ERR_136 DET_ELEVATION_136 DET_AZIMUTH_ERR_136 DET_AZIMUTH_136 DET_RANGE_VELOCITY_ERR_136 DET_RANGE_VELOCITY_136 DET_RANGE_ERR_136 DET_RANGE_136;
SIG_GROUP_ 546 Detection137 1 : DET_BI_STATIC_FLAG_137 DET_AMBG_AZIMUTH_PROB_137 DET_AZIMUTH_AMB_ID_137 DET_CONFD_ELEVATION_137 DET_CONFD_AZIMUTH_137 DET_HVC_FLAG_137 DET_OUTSIDE_SECTOR_137 DET_AZIMUTH_ERR_137 DET_ELEVATION_ERR_137 DET_RANGE_ERR_137 DET_RANGE_VELOCITY_ERR_137 DET_EXISTENCE_PROB_137 DET_POINT_TARGET_PROB_137 DET_SNR_137 DET_SUPER_RES_TARGET_137 DET_VALID_FLAG_137 DET_RCS_137 DET_ELEVATION_137 DET_AZIMUTH_137 DET_RANGE_VELOCITY_137 DET_RANGE_137;
SIG_GROUP_ 546 Detection138 1 : DET_BI_STATIC_FLAG_138 DET_AMBG_AZIMUTH_PROB_138 DET_AZIMUTH_AMB_ID_138 DET_CONFD_ELEVATION_138 DET_CONFD_AZIMUTH_138 DET_HVC_FLAG_138 DET_OUTSIDE_SECTOR_138 DET_AZIMUTH_ERR_138 DET_ELEVATION_ERR_138 DET_RANGE_ERR_138 DET_RANGE_VELOCITY_ERR_138 DET_EXISTENCE_PROB_138 DET_POINT_TARGET_PROB_138 DET_SNR_138 DET_SUPER_RES_TARGET_138 DET_VALID_FLAG_138 DET_RCS_138 DET_ELEVATION_138 DET_AZIMUTH_138 DET_RANGE_VELOCITY_138 DET_RANGE_138;
SIG_GROUP_ 546 Detection139 1 : DET_BI_STATIC_FLAG_139 DET_AMBG_AZIMUTH_PROB_139 DET_AZIMUTH_AMB_ID_139 DET_CONFD_ELEVATION_139 DET_CONFD_AZIMUTH_139 DET_HVC_FLAG_139 DET_OUTSIDE_SECTOR_139 DET_AZIMUTH_ERR_139 DET_ELEVATION_ERR_139 DET_RANGE_ERR_139 DET_RANGE_VELOCITY_ERR_139 DET_EXISTENCE_PROB_139 DET_POINT_TARGET_PROB_139 DET_SNR_139 DET_SUPER_RES_TARGET_139 DET_VALID_FLAG_139 DET_RCS_139 DET_ELEVATION_139 DET_AZIMUTH_139 DET_RANGE_VELOCITY_139 DET_RANGE_139;
SIG_GROUP_ 546 Detection140 1 : DET_BI_STATIC_FLAG_140 DET_AMBG_AZIMUTH_PROB_140 DET_AZIMUTH_AMB_ID_140 DET_CONFD_ELEVATION_140 DET_CONFD_AZIMUTH_140 DET_HVC_FLAG_140 DET_OUTSIDE_SECTOR_140 DET_EXISTENCE_PROB_140 DET_POINT_TARGET_PROB_140 DET_SNR_140 DET_SUPER_RES_TARGET_140 DET_VALID_FLAG_140 DET_RCS_140 DET_ELEVATION_ERR_140 DET_ELEVATION_140 DET_AZIMUTH_ERR_140 DET_AZIMUTH_140 DET_RANGE_VELOCITY_ERR_140 DET_RANGE_VELOCITY_140 DET_RANGE_ERR_140 DET_RANGE_140;
SIG_GROUP_ 547 Detection141 1 : DET_BI_STATIC_FLAG_141 DET_AMBG_AZIMUTH_PROB_141 DET_AZIMUTH_AMB_ID_141 DET_CONFD_ELEVATION_141 DET_CONFD_AZIMUTH_141 DET_HVC_FLAG_141 DET_OUTSIDE_SECTOR_141 DET_AZIMUTH_ERR_141 DET_ELEVATION_ERR_141 DET_RANGE_ERR_141 DET_RANGE_VELOCITY_ERR_141 DET_EXISTENCE_PROB_141 DET_POINT_TARGET_PROB_141 DET_SNR_141 DET_SUPER_RES_TARGET_141 DET_VALID_FLAG_141 DET_RCS_141 DET_ELEVATION_141 DET_AZIMUTH_141 DET_RANGE_VELOCITY_141 DET_RANGE_141;
SIG_GROUP_ 547 Detection142 1 : DET_BI_STATIC_FLAG_142 DET_AMBG_AZIMUTH_PROB_142 DET_AZIMUTH_AMB_ID_142 DET_CONFD_ELEVATION_142 DET_CONFD_AZIMUTH_142 DET_HVC_FLAG_142 DET_OUTSIDE_SECTOR_142 DET_AZIMUTH_ERR_142 DET_ELEVATION_ERR_142 DET_RANGE_ERR_142 DET_RANGE_VELOCITY_ERR_142 DET_EXISTENCE_PROB_142 DET_POINT_TARGET_PROB_142 DET_SNR_142 DET_SUPER_RES_TARGET_142 DET_VALID_FLAG_142 DET_RCS_142 DET_ELEVATION_142 DET_AZIMUTH_142 DET_RANGE_VELOCITY_142 DET_RANGE_142;
SIG_GROUP_ 547 Detection143 1 : DET_BI_STATIC_FLAG_143 DET_AMBG_AZIMUTH_PROB_143 DET_AZIMUTH_AMB_ID_143 DET_CONFD_ELEVATION_143 DET_CONFD_AZIMUTH_143 DET_HVC_FLAG_143 DET_OUTSIDE_SECTOR_143 DET_AZIMUTH_ERR_143 DET_ELEVATION_ERR_143 DET_RANGE_ERR_143 DET_RANGE_VELOCITY_ERR_143 DET_EXISTENCE_PROB_143 DET_POINT_TARGET_PROB_143 DET_SNR_143 DET_SUPER_RES_TARGET_143 DET_VALID_FLAG_143 DET_RCS_143 DET_ELEVATION_143 DET_AZIMUTH_143 DET_RANGE_VELOCITY_143 DET_RANGE_143;
SIG_GROUP_ 547 Detection144 1 : DET_BI_STATIC_FLAG_144 DET_AMBG_AZIMUTH_PROB_144 DET_AZIMUTH_AMB_ID_144 DET_CONFD_ELEVATION_144 DET_CONFD_AZIMUTH_144 DET_HVC_FLAG_144 DET_OUTSIDE_SECTOR_144 DET_EXISTENCE_PROB_144 DET_POINT_TARGET_PROB_144 DET_SNR_144 DET_SUPER_RES_TARGET_144 DET_VALID_FLAG_144 DET_RCS_144 DET_ELEVATION_ERR_144 DET_ELEVATION_144 DET_AZIMUTH_ERR_144 DET_AZIMUTH_144 DET_RANGE_VELOCITY_ERR_144 DET_RANGE_VELOCITY_144 DET_RANGE_ERR_144 DET_RANGE_144;
SIG_GROUP_ 548 Detection145 1 : DET_BI_STATIC_FLAG_145 DET_AMBG_AZIMUTH_PROB_145 DET_AZIMUTH_AMB_ID_145 DET_CONFD_ELEVATION_145 DET_CONFD_AZIMUTH_145 DET_HVC_FLAG_145 DET_OUTSIDE_SECTOR_145 DET_AZIMUTH_ERR_145 DET_ELEVATION_ERR_145 DET_RANGE_ERR_145 DET_RANGE_VELOCITY_ERR_145 DET_EXISTENCE_PROB_145 DET_POINT_TARGET_PROB_145 DET_SNR_145 DET_SUPER_RES_TARGET_145 DET_VALID_FLAG_145 DET_RCS_145 DET_ELEVATION_145 DET_AZIMUTH_145 DET_RANGE_VELOCITY_145 DET_RANGE_145;
SIG_GROUP_ 548 Detection146 1 : DET_BI_STATIC_FLAG_146 DET_AMBG_AZIMUTH_PROB_146 DET_AZIMUTH_AMB_ID_146 DET_CONFD_ELEVATION_146 DET_CONFD_AZIMUTH_146 DET_HVC_FLAG_146 DET_OUTSIDE_SECTOR_146 DET_AZIMUTH_ERR_146 DET_ELEVATION_ERR_146 DET_RANGE_ERR_146 DET_RANGE_VELOCITY_ERR_146 DET_EXISTENCE_PROB_146 DET_POINT_TARGET_PROB_146 DET_SNR_146 DET_SUPER_RES_TARGET_146 DET_VALID_FLAG_146 DET_RCS_146 DET_ELEVATION_146 DET_AZIMUTH_146 DET_RANGE_VELOCITY_146 DET_RANGE_146;
SIG_GROUP_ 548 Detection147 1 : DET_BI_STATIC_FLAG_147 DET_AMBG_AZIMUTH_PROB_147 DET_AZIMUTH_AMB_ID_147 DET_CONFD_ELEVATION_147 DET_CONFD_AZIMUTH_147 DET_HVC_FLAG_147 DET_OUTSIDE_SECTOR_147 DET_AZIMUTH_ERR_147 DET_ELEVATION_ERR_147 DET_RANGE_ERR_147 DET_RANGE_VELOCITY_ERR_147 DET_EXISTENCE_PROB_147 DET_POINT_TARGET_PROB_147 DET_SNR_147 DET_SUPER_RES_TARGET_147 DET_VALID_FLAG_147 DET_RCS_147 DET_ELEVATION_147 DET_AZIMUTH_147 DET_RANGE_VELOCITY_147 DET_RANGE_147;
SIG_GROUP_ 548 Detection148 1 : DET_BI_STATIC_FLAG_148 DET_AMBG_AZIMUTH_PROB_148 DET_AZIMUTH_AMB_ID_148 DET_CONFD_ELEVATION_148 DET_CONFD_AZIMUTH_148 DET_HVC_FLAG_148 DET_OUTSIDE_SECTOR_148 DET_EXISTENCE_PROB_148 DET_POINT_TARGET_PROB_148 DET_SNR_148 DET_SUPER_RES_TARGET_148 DET_VALID_FLAG_148 DET_RCS_148 DET_ELEVATION_ERR_148 DET_ELEVATION_148 DET_AZIMUTH_ERR_148 DET_AZIMUTH_148 DET_RANGE_VELOCITY_ERR_148 DET_RANGE_VELOCITY_148 DET_RANGE_ERR_148 DET_RANGE_148;
SIG_GROUP_ 549 Detection149 1 : DET_BI_STATIC_FLAG_149 DET_AMBG_AZIMUTH_PROB_149 DET_AZIMUTH_AMB_ID_149 DET_CONFD_ELEVATION_149 DET_CONFD_AZIMUTH_149 DET_HVC_FLAG_149 DET_OUTSIDE_SECTOR_149 DET_AZIMUTH_ERR_149 DET_ELEVATION_ERR_149 DET_RANGE_ERR_149 DET_RANGE_VELOCITY_ERR_149 DET_EXISTENCE_PROB_149 DET_POINT_TARGET_PROB_149 DET_SNR_149 DET_SUPER_RES_TARGET_149 DET_VALID_FLAG_149 DET_RCS_149 DET_ELEVATION_149 DET_AZIMUTH_149 DET_RANGE_VELOCITY_149 DET_RANGE_149;
SIG_GROUP_ 549 Detection150 1 : DET_BI_STATIC_FLAG_150 DET_AMBG_AZIMUTH_PROB_150 DET_AZIMUTH_AMB_ID_150 DET_CONFD_ELEVATION_150 DET_CONFD_AZIMUTH_150 DET_HVC_FLAG_150 DET_OUTSIDE_SECTOR_150 DET_AZIMUTH_ERR_150 DET_ELEVATION_ERR_150 DET_RANGE_ERR_150 DET_RANGE_VELOCITY_ERR_150 DET_EXISTENCE_PROB_150 DET_POINT_TARGET_PROB_150 DET_SNR_150 DET_SUPER_RES_TARGET_150 DET_VALID_FLAG_150 DET_RCS_150 DET_ELEVATION_150 DET_AZIMUTH_150 DET_RANGE_VELOCITY_150 DET_RANGE_150;
SIG_GROUP_ 549 Detection151 1 : DET_BI_STATIC_FLAG_151 DET_AMBG_AZIMUTH_PROB_151 DET_AZIMUTH_AMB_ID_151 DET_CONFD_ELEVATION_151 DET_CONFD_AZIMUTH_151 DET_HVC_FLAG_151 DET_OUTSIDE_SECTOR_151 DET_AZIMUTH_ERR_151 DET_ELEVATION_ERR_151 DET_RANGE_ERR_151 DET_RANGE_VELOCITY_ERR_151 DET_EXISTENCE_PROB_151 DET_POINT_TARGET_PROB_151 DET_SNR_151 DET_SUPER_RES_TARGET_151 DET_VALID_FLAG_151 DET_RCS_151 DET_ELEVATION_151 DET_AZIMUTH_151 DET_RANGE_VELOCITY_151 DET_RANGE_151;
SIG_GROUP_ 549 Detection152 1 : DET_BI_STATIC_FLAG_152 DET_AMBG_AZIMUTH_PROB_152 DET_AZIMUTH_AMB_ID_152 DET_CONFD_ELEVATION_152 DET_CONFD_AZIMUTH_152 DET_HVC_FLAG_152 DET_OUTSIDE_SECTOR_152 DET_EXISTENCE_PROB_152 DET_POINT_TARGET_PROB_152 DET_SNR_152 DET_SUPER_RES_TARGET_152 DET_VALID_FLAG_152 DET_RCS_152 DET_ELEVATION_ERR_152 DET_ELEVATION_152 DET_AZIMUTH_ERR_152 DET_AZIMUTH_152 DET_RANGE_VELOCITY_ERR_152 DET_RANGE_VELOCITY_152 DET_RANGE_ERR_152 DET_RANGE_152;
SIG_GROUP_ 550 Detection153 1 : DET_BI_STATIC_FLAG_153 DET_AMBG_AZIMUTH_PROB_153 DET_AZIMUTH_AMB_ID_153 DET_CONFD_ELEVATION_153 DET_CONFD_AZIMUTH_153 DET_HVC_FLAG_153 DET_OUTSIDE_SECTOR_153 DET_AZIMUTH_ERR_153 DET_ELEVATION_ERR_153 DET_RANGE_ERR_153 DET_RANGE_VELOCITY_ERR_153 DET_EXISTENCE_PROB_153 DET_POINT_TARGET_PROB_153 DET_SNR_153 DET_SUPER_RES_TARGET_153 DET_VALID_FLAG_153 DET_RCS_153 DET_ELEVATION_153 DET_AZIMUTH_153 DET_RANGE_VELOCITY_153 DET_RANGE_153;
SIG_GROUP_ 550 Detection154 1 : DET_BI_STATIC_FLAG_154 DET_AMBG_AZIMUTH_PROB_154 DET_AZIMUTH_AMB_ID_154 DET_CONFD_ELEVATION_154 DET_CONFD_AZIMUTH_154 DET_HVC_FLAG_154 DET_OUTSIDE_SECTOR_154 DET_AZIMUTH_ERR_154 DET_ELEVATION_ERR_154 DET_RANGE_ERR_154 DET_RANGE_VELOCITY_ERR_154 DET_EXISTENCE_PROB_154 DET_POINT_TARGET_PROB_154 DET_SNR_154 DET_SUPER_RES_TARGET_154 DET_VALID_FLAG_154 DET_RCS_154 DET_ELEVATION_154 DET_AZIMUTH_154 DET_RANGE_VELOCITY_154 DET_RANGE_154;
SIG_GROUP_ 550 Detection155 1 : DET_BI_STATIC_FLAG_155 DET_AMBG_AZIMUTH_PROB_155 DET_AZIMUTH_AMB_ID_155 DET_CONFD_ELEVATION_155 DET_CONFD_AZIMUTH_155 DET_HVC_FLAG_155 DET_OUTSIDE_SECTOR_155 DET_AZIMUTH_ERR_155 DET_ELEVATION_ERR_155 DET_RANGE_ERR_155 DET_RANGE_VELOCITY_ERR_155 DET_EXISTENCE_PROB_155 DET_POINT_TARGET_PROB_155 DET_SNR_155 DET_SUPER_RES_TARGET_155 DET_VALID_FLAG_155 DET_RCS_155 DET_ELEVATION_155 DET_AZIMUTH_155 DET_RANGE_VELOCITY_155 DET_RANGE_155;
SIG_GROUP_ 550 Detection156 1 : DET_BI_STATIC_FLAG_156 DET_AMBG_AZIMUTH_PROB_156 DET_AZIMUTH_AMB_ID_156 DET_CONFD_ELEVATION_156 DET_CONFD_AZIMUTH_156 DET_HVC_FLAG_156 DET_OUTSIDE_SECTOR_156 DET_EXISTENCE_PROB_156 DET_POINT_TARGET_PROB_156 DET_SNR_156 DET_SUPER_RES_TARGET_156 DET_VALID_FLAG_156 DET_RCS_156 DET_ELEVATION_ERR_156 DET_ELEVATION_156 DET_AZIMUTH_ERR_156 DET_AZIMUTH_156 DET_RANGE_VELOCITY_ERR_156 DET_RANGE_VELOCITY_156 DET_RANGE_ERR_156 DET_RANGE_156;
SIG_GROUP_ 551 Detection157 1 : DET_BI_STATIC_FLAG_157 DET_AMBG_AZIMUTH_PROB_157 DET_AZIMUTH_AMB_ID_157 DET_CONFD_ELEVATION_157 DET_CONFD_AZIMUTH_157 DET_HVC_FLAG_157 DET_OUTSIDE_SECTOR_157 DET_AZIMUTH_ERR_157 DET_ELEVATION_ERR_157 DET_RANGE_ERR_157 DET_RANGE_VELOCITY_ERR_157 DET_EXISTENCE_PROB_157 DET_POINT_TARGET_PROB_157 DET_SNR_157 DET_SUPER_RES_TARGET_157 DET_VALID_FLAG_157 DET_RCS_157 DET_ELEVATION_157 DET_AZIMUTH_157 DET_RANGE_VELOCITY_157 DET_RANGE_157;
SIG_GROUP_ 551 Detection158 1 : DET_BI_STATIC_FLAG_158 DET_AMBG_AZIMUTH_PROB_158 DET_AZIMUTH_AMB_ID_158 DET_CONFD_ELEVATION_158 DET_CONFD_AZIMUTH_158 DET_HVC_FLAG_158 DET_OUTSIDE_SECTOR_158 DET_AZIMUTH_ERR_158 DET_ELEVATION_ERR_158 DET_RANGE_ERR_158 DET_RANGE_VELOCITY_ERR_158 DET_EXISTENCE_PROB_158 DET_POINT_TARGET_PROB_158 DET_SNR_158 DET_SUPER_RES_TARGET_158 DET_VALID_FLAG_158 DET_RCS_158 DET_ELEVATION_158 DET_AZIMUTH_158 DET_RANGE_VELOCITY_158 DET_RANGE_158;
SIG_GROUP_ 551 Detection159 1 : DET_BI_STATIC_FLAG_159 DET_AMBG_AZIMUTH_PROB_159 DET_AZIMUTH_AMB_ID_159 DET_CONFD_ELEVATION_159 DET_CONFD_AZIMUTH_159 DET_HVC_FLAG_159 DET_OUTSIDE_SECTOR_159 DET_AZIMUTH_ERR_159 DET_ELEVATION_ERR_159 DET_RANGE_ERR_159 DET_RANGE_VELOCITY_ERR_159 DET_EXISTENCE_PROB_159 DET_POINT_TARGET_PROB_159 DET_SNR_159 DET_SUPER_RES_TARGET_159 DET_VALID_FLAG_159 DET_RCS_159 DET_ELEVATION_159 DET_AZIMUTH_159 DET_RANGE_VELOCITY_159 DET_RANGE_159;
SIG_GROUP_ 551 Detection160 1 : DET_BI_STATIC_FLAG_160 DET_AMBG_AZIMUTH_PROB_160 DET_AZIMUTH_AMB_ID_160 DET_CONFD_ELEVATION_160 DET_CONFD_AZIMUTH_160 DET_HVC_FLAG_160 DET_OUTSIDE_SECTOR_160 DET_EXISTENCE_PROB_160 DET_POINT_TARGET_PROB_160 DET_SNR_160 DET_SUPER_RES_TARGET_160 DET_VALID_FLAG_160 DET_RCS_160 DET_ELEVATION_ERR_160 DET_ELEVATION_160 DET_AZIMUTH_ERR_160 DET_AZIMUTH_160 DET_RANGE_VELOCITY_ERR_160 DET_RANGE_VELOCITY_160 DET_RANGE_ERR_160 DET_RANGE_160;
SIG_GROUP_ 552 Detection161 1 : DET_BI_STATIC_FLAG_161 DET_AMBG_AZIMUTH_PROB_161 DET_AZIMUTH_AMB_ID_161 DET_CONFD_ELEVATION_161 DET_CONFD_AZIMUTH_161 DET_HVC_FLAG_161 DET_OUTSIDE_SECTOR_161 DET_AZIMUTH_ERR_161 DET_ELEVATION_ERR_161 DET_RANGE_ERR_161 DET_RANGE_VELOCITY_ERR_161 DET_EXISTENCE_PROB_161 DET_POINT_TARGET_PROB_161 DET_SNR_161 DET_SUPER_RES_TARGET_161 DET_VALID_FLAG_161 DET_RCS_161 DET_ELEVATION_161 DET_AZIMUTH_161 DET_RANGE_VELOCITY_161 DET_RANGE_161;
SIG_GROUP_ 552 Detection162 1 : DET_BI_STATIC_FLAG_162 DET_AMBG_AZIMUTH_PROB_162 DET_AZIMUTH_AMB_ID_162 DET_CONFD_ELEVATION_162 DET_CONFD_AZIMUTH_162 DET_HVC_FLAG_162 DET_OUTSIDE_SECTOR_162 DET_AZIMUTH_ERR_162 DET_ELEVATION_ERR_162 DET_RANGE_ERR_162 DET_RANGE_VELOCITY_ERR_162 DET_EXISTENCE_PROB_162 DET_POINT_TARGET_PROB_162 DET_SNR_162 DET_SUPER_RES_TARGET_162 DET_VALID_FLAG_162 DET_RCS_162 DET_ELEVATION_162 DET_AZIMUTH_162 DET_RANGE_VELOCITY_162 DET_RANGE_162;
SIG_GROUP_ 552 Detection163 1 : DET_BI_STATIC_FLAG_163 DET_AMBG_AZIMUTH_PROB_163 DET_AZIMUTH_AMB_ID_163 DET_CONFD_ELEVATION_163 DET_CONFD_AZIMUTH_163 DET_HVC_FLAG_163 DET_OUTSIDE_SECTOR_163 DET_AZIMUTH_ERR_163 DET_ELEVATION_ERR_163 DET_RANGE_ERR_163 DET_RANGE_VELOCITY_ERR_163 DET_EXISTENCE_PROB_163 DET_POINT_TARGET_PROB_163 DET_SNR_163 DET_SUPER_RES_TARGET_163 DET_VALID_FLAG_163 DET_RCS_163 DET_ELEVATION_163 DET_AZIMUTH_163 DET_RANGE_VELOCITY_163 DET_RANGE_163;
SIG_GROUP_ 552 Detection164 1 : DET_BI_STATIC_FLAG_164 DET_AMBG_AZIMUTH_PROB_164 DET_AZIMUTH_AMB_ID_164 DET_CONFD_ELEVATION_164 DET_CONFD_AZIMUTH_164 DET_HVC_FLAG_164 DET_OUTSIDE_SECTOR_164 DET_EXISTENCE_PROB_164 DET_POINT_TARGET_PROB_164 DET_SNR_164 DET_SUPER_RES_TARGET_164 DET_VALID_FLAG_164 DET_RCS_164 DET_ELEVATION_ERR_164 DET_ELEVATION_164 DET_AZIMUTH_ERR_164 DET_AZIMUTH_164 DET_RANGE_VELOCITY_ERR_164 DET_RANGE_VELOCITY_164 DET_RANGE_ERR_164 DET_RANGE_164;
SIG_GROUP_ 553 Detection165 1 : DET_BI_STATIC_FLAG_165 DET_AMBG_AZIMUTH_PROB_165 DET_AZIMUTH_AMB_ID_165 DET_CONFD_ELEVATION_165 DET_CONFD_AZIMUTH_165 DET_HVC_FLAG_165 DET_OUTSIDE_SECTOR_165 DET_AZIMUTH_ERR_165 DET_ELEVATION_ERR_165 DET_RANGE_ERR_165 DET_RANGE_VELOCITY_ERR_165 DET_EXISTENCE_PROB_165 DET_POINT_TARGET_PROB_165 DET_SNR_165 DET_SUPER_RES_TARGET_165 DET_VALID_FLAG_165 DET_RCS_165 DET_ELEVATION_165 DET_AZIMUTH_165 DET_RANGE_VELOCITY_165 DET_RANGE_165;
SIG_GROUP_ 553 Detection166 1 : DET_BI_STATIC_FLAG_166 DET_AMBG_AZIMUTH_PROB_166 DET_AZIMUTH_AMB_ID_166 DET_CONFD_ELEVATION_166 DET_CONFD_AZIMUTH_166 DET_HVC_FLAG_166 DET_OUTSIDE_SECTOR_166 DET_AZIMUTH_ERR_166 DET_ELEVATION_ERR_166 DET_RANGE_ERR_166 DET_RANGE_VELOCITY_ERR_166 DET_EXISTENCE_PROB_166 DET_POINT_TARGET_PROB_166 DET_SNR_166 DET_SUPER_RES_TARGET_166 DET_VALID_FLAG_166 DET_RCS_166 DET_ELEVATION_166 DET_AZIMUTH_166 DET_RANGE_VELOCITY_166 DET_RANGE_166;
SIG_GROUP_ 553 Detection167 1 : DET_BI_STATIC_FLAG_167 DET_AMBG_AZIMUTH_PROB_167 DET_AZIMUTH_AMB_ID_167 DET_CONFD_ELEVATION_167 DET_CONFD_AZIMUTH_167 DET_HVC_FLAG_167 DET_OUTSIDE_SECTOR_167 DET_AZIMUTH_ERR_167 DET_ELEVATION_ERR_167 DET_RANGE_ERR_167 DET_RANGE_VELOCITY_ERR_167 DET_EXISTENCE_PROB_167 DET_POINT_TARGET_PROB_167 DET_SNR_167 DET_SUPER_RES_TARGET_167 DET_VALID_FLAG_167 DET_RCS_167 DET_ELEVATION_167 DET_AZIMUTH_167 DET_RANGE_VELOCITY_167 DET_RANGE_167;
SIG_GROUP_ 553 Detection168 1 : DET_BI_STATIC_FLAG_168 DET_AMBG_AZIMUTH_PROB_168 DET_AZIMUTH_AMB_ID_168 DET_CONFD_ELEVATION_168 DET_CONFD_AZIMUTH_168 DET_HVC_FLAG_168 DET_OUTSIDE_SECTOR_168 DET_EXISTENCE_PROB_168 DET_POINT_TARGET_PROB_168 DET_SNR_168 DET_SUPER_RES_TARGET_168 DET_VALID_FLAG_168 DET_RCS_168 DET_ELEVATION_ERR_168 DET_ELEVATION_168 DET_AZIMUTH_ERR_168 DET_AZIMUTH_168 DET_RANGE_VELOCITY_ERR_168 DET_RANGE_VELOCITY_168 DET_RANGE_ERR_168 DET_RANGE_168;
SIG_GROUP_ 554 Detection169 1 : DET_BI_STATIC_FLAG_169 DET_AMBG_AZIMUTH_PROB_169 DET_AZIMUTH_AMB_ID_169 DET_CONFD_ELEVATION_169 DET_CONFD_AZIMUTH_169 DET_HVC_FLAG_169 DET_OUTSIDE_SECTOR_169 DET_AZIMUTH_ERR_169 DET_ELEVATION_ERR_169 DET_RANGE_ERR_169 DET_RANGE_VELOCITY_ERR_169 DET_EXISTENCE_PROB_169 DET_POINT_TARGET_PROB_169 DET_SNR_169 DET_SUPER_RES_TARGET_169 DET_VALID_FLAG_169 DET_RCS_169 DET_ELEVATION_169 DET_AZIMUTH_169 DET_RANGE_VELOCITY_169 DET_RANGE_169;
SIG_GROUP_ 554 Detection170 1 : DET_BI_STATIC_FLAG_170 DET_AMBG_AZIMUTH_PROB_170 DET_AZIMUTH_AMB_ID_170 DET_CONFD_ELEVATION_170 DET_CONFD_AZIMUTH_170 DET_HVC_FLAG_170 DET_OUTSIDE_SECTOR_170 DET_AZIMUTH_ERR_170 DET_ELEVATION_ERR_170 DET_RANGE_ERR_170 DET_RANGE_VELOCITY_ERR_170 DET_EXISTENCE_PROB_170 DET_POINT_TARGET_PROB_170 DET_SNR_170 DET_SUPER_RES_TARGET_170 DET_VALID_FLAG_170 DET_RCS_170 DET_ELEVATION_170 DET_AZIMUTH_170 DET_RANGE_VELOCITY_170 DET_RANGE_170;
SIG_GROUP_ 554 Detection171 1 : DET_BI_STATIC_FLAG_171 DET_AMBG_AZIMUTH_PROB_171 DET_AZIMUTH_AMB_ID_171 DET_CONFD_ELEVATION_171 DET_CONFD_AZIMUTH_171 DET_HVC_FLAG_171 DET_OUTSIDE_SECTOR_171 DET_AZIMUTH_ERR_171 DET_ELEVATION_ERR_171 DET_RANGE_ERR_171 DET_RANGE_VELOCITY_ERR_171 DET_EXISTENCE_PROB_171 DET_POINT_TARGET_PROB_171 DET_SNR_171 DET_SUPER_RES_TARGET_171 DET_VALID_FLAG_171 DET_RCS_171 DET_ELEVATION_171 DET_AZIMUTH_171 DET_RANGE_VELOCITY_171 DET_RANGE_171;
SIG_GROUP_ 554 Detection172 1 : DET_BI_STATIC_FLAG_172 DET_AMBG_AZIMUTH_PROB_172 DET_AZIMUTH_AMB_ID_172 DET_CONFD_ELEVATION_172 DET_CONFD_AZIMUTH_172 DET_HVC_FLAG_172 DET_OUTSIDE_SECTOR_172 DET_EXISTENCE_PROB_172 DET_POINT_TARGET_PROB_172 DET_SNR_172 DET_SUPER_RES_TARGET_172 DET_VALID_FLAG_172 DET_RCS_172 DET_ELEVATION_ERR_172 DET_ELEVATION_172 DET_AZIMUTH_ERR_172 DET_AZIMUTH_172 DET_RANGE_VELOCITY_ERR_172 DET_RANGE_VELOCITY_172 DET_RANGE_ERR_172 DET_RANGE_172;

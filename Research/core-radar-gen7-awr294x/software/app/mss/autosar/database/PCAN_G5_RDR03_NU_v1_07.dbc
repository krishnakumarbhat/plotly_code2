VERSION "created by canmatrix"

NS_ :

BS_:

BU_: External_Tool ASDM G5_RDR03

BO_ 607 RDR_TRACKER_OBJ_032: 64 G5_RDR03
 SG_ OBJ_ALIVE_TIME_032 : 255|16@0+ (1,0) [0|65535] "ms" ASDM
 SG_ OBJ_ACCELERATION_LONG_ERR_032 : 215|8@0+ (0.025,0) [0|6.375] "m/s^2" ASDM
 SG_ OBJ_ACCELERATION_LAT_ERR_032 : 223|8@0+ (0.025,0) [0|6.375] "m/s^2" ASDM
 SG_ OBJ_VELOCITY_LONG_ERR_032 : 143|8@0+ (0.05,0) [0|12.75] "m/s" ASDM
 SG_ OBJ_VELOCITY_LAT_ERR_032 : 151|8@0+ (0.05,0) [0|12.75] "m/s" ASDM
 SG_ OBJ_POS_LONG_ERR_032 : 95|8@0+ (0.025,0) [0|6.375] "m" ASDM
 SG_ OBJ_POS_LAT_ERR_032 : 103|8@0+ (0.025,0) [0|6.375] "m" ASDM
 SG_ OBJ_TRACK_MOTION_MODEL_032 : 9|2@0+ (1,0) [1|3] "NA" ASDM
 SG_ OBJ_DIMENSION_WIDTH_032 : 17|10@0+ (0.01,0) [0|10.23] "m" ASDM
 SG_ OBJ_DIMENSION_LENGTH_032 : 37|12@0+ (0.01,0) [0|40.95] "m" ASDM
 SG_ OBJ_EXISTENCE_PROB_032 : 229|14@0+ (0.0001,0) [0|1] "NA" ASDM
 SG_ OBJ_YAW_ANGLE_032 : 155|12@0+ (0.005,-10) [-10|10.475] "rad" ASDM
 SG_ OBJ_YAW_ANGLE_ERR_032 : 175|7@0+ (0.01,0) [0|1.27] "rad" ASDM
 SG_ OBJ_ID_032 : 7|8@0+ (1,0) [0|255] "NA" ASDM
 SG_ OBJ_MOVEMENT_STATUS_032 : 196|3@0+ (1,0) [0|3] "NA" ASDM
 SG_ OBJ_MEASUREMENT_STATUS_032 : 14|3@0+ (1,0) [0|7] "NA" ASDM
 SG_ OBJ_POS_LONG_032 : 63|16@0+ (0.01,-327) [-327|327] "m" ASDM
 SG_ OBJ_POS_LAT_032 : 79|16@0+ (0.01,-327) [-327|327] "m" ASDM
 SG_ OBJ_VELOCITY_LONG_032 : 110|15@0+ (0.01,-163) [-163|163] "m/s" ASDM
 SG_ OBJ_VELOCITY_LAT_032 : 126|15@0+ (0.01,-163) [-163|163] "m/s" ASDM
 SG_ OBJ_ACCELERATION_LONG_032 : 193|10@0+ (0.05,-20) [-20|20] "m/s^2" ASDM
 SG_ OBJ_ACCELERATION_LAT_032 : 177|10@0+ (0.05,-20) [-20|20] "m/s^2" ASDM
 SG_ OBJ_VEH_TRACK_FLAG_032 : 10|1@0+ (1,0) [0|1] "NA" ASDM
 SG_ OBJ_MH_CYCLE_COUNTER_032 : 487|8@0+ (1,0) [0|255] "NA" ASDM
 SG_ OBJ_MH_CRC16_032 : 495|16@0+ (1,0) [0|65535] "NA" ASDM
 SG_ OBJ_TIMESTAMP_OFFSET_032 : 247|8@0+ (1,-127) [-127|128] "ms" ASDM
 SG_ OBJ_DIMENSION_WIDTH_ERR_032 : 23|6@0+ (0.01,0) [0|0.63] "m" ASDM
 SG_ OBJ_DIMENSION_LENGTH_ERR_032 : 41|10@0+ (0.01,0) [0|10.23] "m" ASDM
 SG_ OBJ_CLS_TYPE1_032 : 271|4@0+ (1,0) [0|15] "NA" ASDM
 SG_ OBJ_CLS_TYPE1_PROB_032 : 303|8@0+ (0.004,0) [0|1] "NA" ASDM
 SG_ OBJ_CLS_TYPE2_032 : 267|4@0+ (1,0) [0|15] "NA" ASDM
 SG_ OBJ_CLS_TYPE2_PROB_032 : 311|8@0+ (0.004,0) [0|1] "NA" ASDM
 SG_ OBJ_CLS_TYPE3_032 : 279|4@0+ (1,0) [0|15] "NA" ASDM
 SG_ OBJ_CLS_TYPE3_PROB_032 : 319|8@0+ (0.004,0) [0|1] "NA" ASDM
 SG_ OBJ_CLS_TYPE4_032 : 275|4@0+ (1,0) [0|15] "NA" ASDM
 SG_ OBJ_CLS_TYPE4_PROB_032 : 327|8@0+ (0.004,0) [0|1] "NA" ASDM
 SG_ OBJ_CLS_TYPE5_032 : 287|4@0+ (1,0) [0|15] "NA" ASDM
 SG_ OBJ_CLS_TYPE5_PROB_032 : 335|8@0+ (0.004,0) [0|1] "NA" ASDM
 SG_ OBJ_CLS_TYPE6_032 : 282|4@0+ (1,0) [0|15] "NA" ASDM
 SG_ OBJ_CLS_TYPE6_PROB_032 : 343|8@0+ (0.004,0) [0|1] "NA" ASDM
 SG_ OBJ_RCS_032 : 351|7@0+ (1,-64) [-64|63] "dBsm" ASDM
 SG_ OBJ_REF_PT_LONG_OFFSET_032 : 357|14@0+ (0.0001,0) [0|1] "NA" ASDM
 SG_ OBJ_REF_PT_LAT_OFFSET_032 : 370|14@0+ (0.0001,0) [0|1] "NA" ASDM
 SG_ OBJ_YAW_RATE_032 : 399|10@0+ (0.005,-2.24) [-2.24|2.24] "rad/s" ASDM
 SG_ OBJ_YAW_RATE_ERR_032 : 388|5@0+ (0.025,0) [0|0.775] "rad/s" ASDM
 SG_ OBJ_GROUP_ID_032 : 405|6@0+ (1,0) [0|63] "NA" ASDM
 SG_ OBJ_POS_ERR_CRR_COEF_032 : 415|8@0+ (0.01,-1.2) [-1.2|1] "NA" ASDM
 SG_ OBJ_VELOCITY_ERR_CRR_COEF_032 : 423|8@0+ (0.01,-1.2) [-1.2|1] "NA" ASDM
 SG_ OBJ_ACCEL_ERR_CRR_COEF_032 : 431|8@0+ (0.01,-1.2) [-1.2|1] "NA" ASDM

BO_ 608 RDR_TRACKER_OBJ_033: 64 G5_RDR03
 SG_ OBJ_ALIVE_TIME_033 : 255|16@0+ (1,0) [0|65535] "ms" ASDM
 SG_ OBJ_ACCELERATION_LONG_ERR_033 : 215|8@0+ (0.025,0) [0|6.375] "m/s^2" ASDM
 SG_ OBJ_ACCELERATION_LAT_ERR_033 : 223|8@0+ (0.025,0) [0|6.375] "m/s^2" ASDM
 SG_ OBJ_VELOCITY_LONG_ERR_033 : 143|8@0+ (0.05,0) [0|12.75] "m/s" ASDM
 SG_ OBJ_VELOCITY_LAT_ERR_033 : 151|8@0+ (0.05,0) [0|12.75] "m/s" ASDM
 SG_ OBJ_POS_LONG_ERR_033 : 95|8@0+ (0.025,0) [0|6.375] "m" ASDM
 SG_ OBJ_POS_LAT_ERR_033 : 103|8@0+ (0.025,0) [0|6.375] "m" ASDM
 SG_ OBJ_TRACK_MOTION_MODEL_033 : 9|2@0+ (1,0) [1|3] "NA" ASDM
 SG_ OBJ_DIMENSION_WIDTH_033 : 17|10@0+ (0.01,0) [0|10.23] "m" ASDM
 SG_ OBJ_DIMENSION_LENGTH_033 : 37|12@0+ (0.01,0) [0|40.95] "m" ASDM
 SG_ OBJ_EXISTENCE_PROB_033 : 229|14@0+ (0.0001,0) [0|1] "NA" ASDM
 SG_ OBJ_YAW_ANGLE_033 : 155|12@0+ (0.005,-10) [-10|10.475] "rad" ASDM
 SG_ OBJ_YAW_ANGLE_ERR_033 : 175|7@0+ (0.01,0) [0|1.27] "rad" ASDM
 SG_ OBJ_ID_033 : 7|8@0+ (1,0) [0|255] "NA" ASDM
 SG_ OBJ_MOVEMENT_STATUS_033 : 196|3@0+ (1,0) [0|3] "NA" ASDM
 SG_ OBJ_MEASUREMENT_STATUS_033 : 14|3@0+ (1,0) [0|7] "NA" ASDM
 SG_ OBJ_POS_LONG_033 : 63|16@0+ (0.01,-327) [-327|327] "m" ASDM
 SG_ OBJ_POS_LAT_033 : 79|16@0+ (0.01,-327) [-327|327] "m" ASDM
 SG_ OBJ_VELOCITY_LONG_033 : 110|15@0+ (0.01,-163) [-163|163] "m/s" ASDM
 SG_ OBJ_VELOCITY_LAT_033 : 126|15@0+ (0.01,-163) [-163|163] "m/s" ASDM
 SG_ OBJ_ACCELERATION_LONG_033 : 193|10@0+ (0.05,-20) [-20|20] "m/s^2" ASDM
 SG_ OBJ_ACCELERATION_LAT_033 : 177|10@0+ (0.05,-20) [-20|20] "m/s^2" ASDM
 SG_ OBJ_VEH_TRACK_FLAG_033 : 10|1@0+ (1,0) [0|1] "NA" ASDM
 SG_ OBJ_MH_CYCLE_COUNTER_033 : 487|8@0+ (1,0) [0|255] "NA" ASDM
 SG_ OBJ_MH_CRC16_033 : 495|16@0+ (1,0) [0|65535] "NA" ASDM
 SG_ OBJ_TIMESTAMP_OFFSET_033 : 247|8@0+ (1,-127) [-127|128] "ms" ASDM
 SG_ OBJ_DIMENSION_WIDTH_ERR_033 : 23|6@0+ (0.01,0) [0|0.63] "m" ASDM
 SG_ OBJ_DIMENSION_LENGTH_ERR_033 : 41|10@0+ (0.01,0) [0|10.23] "m" ASDM
 SG_ OBJ_CLS_TYPE1_033 : 271|4@0+ (1,0) [0|15] "NA" ASDM
 SG_ OBJ_CLS_TYPE1_PROB_033 : 303|8@0+ (0.004,0) [0|1] "NA" ASDM
 SG_ OBJ_CLS_TYPE2_033 : 267|4@0+ (1,0) [0|15] "NA" ASDM
 SG_ OBJ_CLS_TYPE2_PROB_033 : 311|8@0+ (0.004,0) [0|1] "NA" ASDM
 SG_ OBJ_CLS_TYPE3_033 : 279|4@0+ (1,0) [0|15] "NA" ASDM
 SG_ OBJ_CLS_TYPE3_PROB_033 : 319|8@0+ (0.004,0) [0|1] "NA" ASDM
 SG_ OBJ_CLS_TYPE4_033 : 275|4@0+ (1,0) [0|15] "NA" ASDM
 SG_ OBJ_CLS_TYPE4_PROB_033 : 327|8@0+ (0.004,0) [0|1] "NA" ASDM
 SG_ OBJ_CLS_TYPE5_033 : 287|4@0+ (1,0) [0|15] "NA" ASDM
 SG_ OBJ_CLS_TYPE5_PROB_033 : 335|8@0+ (0.004,0) [0|1] "NA" ASDM
 SG_ OBJ_CLS_TYPE6_033 : 282|4@0+ (1,0) [0|15] "NA" ASDM
 SG_ OBJ_CLS_TYPE6_PROB_033 : 343|8@0+ (0.004,0) [0|1] "NA" ASDM
 SG_ OBJ_RCS_033 : 351|7@0+ (1,-64) [-64|63] "dBsm" ASDM
 SG_ OBJ_REF_PT_LONG_OFFSET_033 : 357|14@0+ (0.0001,0) [0|1] "NA" ASDM
 SG_ OBJ_REF_PT_LAT_OFFSET_033 : 370|14@0+ (0.0001,0) [0|1] "NA" ASDM
 SG_ OBJ_YAW_RATE_033 : 399|10@0+ (0.005,-2.24) [-2.24|2.24] "rad/s" ASDM
 SG_ OBJ_YAW_RATE_ERR_033 : 388|5@0+ (0.025,0) [0|0.775] "rad/s" ASDM
 SG_ OBJ_GROUP_ID_033 : 405|6@0+ (1,0) [0|63] "NA" ASDM
 SG_ OBJ_POS_ERR_CRR_COEF_033 : 415|8@0+ (0.01,-1.2) [-1.2|1] "NA" ASDM
 SG_ OBJ_VELOCITY_ERR_CRR_COEF_033 : 423|8@0+ (0.01,-1.2) [-1.2|1] "NA" ASDM
 SG_ OBJ_ACCEL_ERR_CRR_COEF_033 : 431|8@0+ (0.01,-1.2) [-1.2|1] "NA" ASDM

BO_ 609 RDR_TRACKER_OBJ_034: 64 G5_RDR03
 SG_ OBJ_ALIVE_TIME_034 : 255|16@0+ (1,0) [0|65535] "ms" ASDM
 SG_ OBJ_ACCELERATION_LONG_ERR_034 : 215|8@0+ (0.025,0) [0|6.375] "m/s^2" ASDM
 SG_ OBJ_ACCELERATION_LAT_ERR_034 : 223|8@0+ (0.025,0) [0|6.375] "m/s^2" ASDM
 SG_ OBJ_VELOCITY_LONG_ERR_034 : 143|8@0+ (0.05,0) [0|12.75] "m/s" ASDM
 SG_ OBJ_VELOCITY_LAT_ERR_034 : 151|8@0+ (0.05,0) [0|12.75] "m/s" ASDM
 SG_ OBJ_POS_LONG_ERR_034 : 95|8@0+ (0.025,0) [0|6.375] "m" ASDM
 SG_ OBJ_POS_LAT_ERR_034 : 103|8@0+ (0.025,0) [0|6.375] "m" ASDM
 SG_ OBJ_TRACK_MOTION_MODEL_034 : 9|2@0+ (1,0) [1|3] "NA" ASDM
 SG_ OBJ_DIMENSION_WIDTH_034 : 17|10@0+ (0.01,0) [0|10.23] "m" ASDM
 SG_ OBJ_DIMENSION_LENGTH_034 : 37|12@0+ (0.01,0) [0|40.95] "m" ASDM
 SG_ OBJ_EXISTENCE_PROB_034 : 229|14@0+ (0.0001,0) [0|1] "NA" ASDM
 SG_ OBJ_YAW_ANGLE_034 : 155|12@0+ (0.005,-10) [-10|10.475] "rad" ASDM
 SG_ OBJ_YAW_ANGLE_ERR_034 : 175|7@0+ (0.01,0) [0|1.27] "rad" ASDM
 SG_ OBJ_ID_034 : 7|8@0+ (1,0) [0|255] "NA" ASDM
 SG_ OBJ_MOVEMENT_STATUS_034 : 196|3@0+ (1,0) [0|3] "NA" ASDM
 SG_ OBJ_MEASUREMENT_STATUS_034 : 14|3@0+ (1,0) [0|7] "NA" ASDM
 SG_ OBJ_POS_LONG_034 : 63|16@0+ (0.01,-327) [-327|327] "m" ASDM
 SG_ OBJ_POS_LAT_034 : 79|16@0+ (0.01,-327) [-327|327] "m" ASDM
 SG_ OBJ_VELOCITY_LONG_034 : 110|15@0+ (0.01,-163) [-163|163] "m/s" ASDM
 SG_ OBJ_VELOCITY_LAT_034 : 126|15@0+ (0.01,-163) [-163|163] "m/s" ASDM
 SG_ OBJ_ACCELERATION_LONG_034 : 193|10@0+ (0.05,-20) [-20|20] "m/s^2" ASDM
 SG_ OBJ_ACCELERATION_LAT_034 : 177|10@0+ (0.05,-20) [-20|20] "m/s^2" ASDM
 SG_ OBJ_VEH_TRACK_FLAG_034 : 10|1@0+ (1,0) [0|1] "NA" ASDM
 SG_ OBJ_MH_CYCLE_COUNTER_034 : 487|8@0+ (1,0) [0|255] "NA" ASDM
 SG_ OBJ_MH_CRC16_034 : 495|16@0+ (1,0) [0|65535] "NA" ASDM
 SG_ OBJ_TIMESTAMP_OFFSET_034 : 247|8@0+ (1,-127) [-127|128] "ms" ASDM
 SG_ OBJ_DIMENSION_WIDTH_ERR_034 : 23|6@0+ (0.01,0) [0|0.63] "m" ASDM
 SG_ OBJ_DIMENSION_LENGTH_ERR_034 : 41|10@0+ (0.01,0) [0|10.23] "m" ASDM
 SG_ OBJ_CLS_TYPE1_034 : 271|4@0+ (1,0) [0|15] "NA" ASDM
 SG_ OBJ_CLS_TYPE1_PROB_034 : 303|8@0+ (0.004,0) [0|1] "NA" ASDM
 SG_ OBJ_CLS_TYPE2_034 : 267|4@0+ (1,0) [0|15] "NA" ASDM
 SG_ OBJ_CLS_TYPE2_PROB_034 : 311|8@0+ (0.004,0) [0|1] "NA" ASDM
 SG_ OBJ_CLS_TYPE3_034 : 279|4@0+ (1,0) [0|15] "NA" ASDM
 SG_ OBJ_CLS_TYPE3_PROB_034 : 319|8@0+ (0.004,0) [0|1] "NA" ASDM
 SG_ OBJ_CLS_TYPE4_034 : 275|4@0+ (1,0) [0|15] "NA" ASDM
 SG_ OBJ_CLS_TYPE4_PROB_034 : 327|8@0+ (0.004,0) [0|1] "NA" ASDM
 SG_ OBJ_CLS_TYPE5_034 : 287|4@0+ (1,0) [0|15] "NA" ASDM
 SG_ OBJ_CLS_TYPE5_PROB_034 : 335|8@0+ (0.004,0) [0|1] "NA" ASDM
 SG_ OBJ_CLS_TYPE6_034 : 282|4@0+ (1,0) [0|15] "NA" ASDM
 SG_ OBJ_CLS_TYPE6_PROB_034 : 343|8@0+ (0.004,0) [0|1] "NA" ASDM
 SG_ OBJ_RCS_034 : 351|7@0+ (1,-64) [-64|63] "dBsm" ASDM
 SG_ OBJ_REF_PT_LONG_OFFSET_034 : 357|14@0+ (0.0001,0) [0|1] "NA" ASDM
 SG_ OBJ_REF_PT_LAT_OFFSET_034 : 370|14@0+ (0.0001,0) [0|1] "NA" ASDM
 SG_ OBJ_YAW_RATE_034 : 399|10@0+ (0.005,-2.24) [-2.24|2.24] "rad/s" ASDM
 SG_ OBJ_YAW_RATE_ERR_034 : 388|5@0+ (0.025,0) [0|0.775] "rad/s" ASDM
 SG_ OBJ_GROUP_ID_034 : 405|6@0+ (1,0) [0|63] "NA" ASDM
 SG_ OBJ_POS_ERR_CRR_COEF_034 : 415|8@0+ (0.01,-1.2) [-1.2|1] "NA" ASDM
 SG_ OBJ_VELOCITY_ERR_CRR_COEF_034 : 423|8@0+ (0.01,-1.2) [-1.2|1] "NA" ASDM
 SG_ OBJ_ACCEL_ERR_CRR_COEF_034 : 431|8@0+ (0.01,-1.2) [-1.2|1] "NA" ASDM

BO_ 610 RDR_TRACKER_OBJ_035: 64 G5_RDR03
 SG_ OBJ_ALIVE_TIME_035 : 255|16@0+ (1,0) [0|65535] "ms" ASDM
 SG_ OBJ_ACCELERATION_LONG_ERR_035 : 215|8@0+ (0.025,0) [0|6.375] "m/s^2" ASDM
 SG_ OBJ_ACCELERATION_LAT_ERR_035 : 223|8@0+ (0.025,0) [0|6.375] "m/s^2" ASDM
 SG_ OBJ_VELOCITY_LONG_ERR_035 : 143|8@0+ (0.05,0) [0|12.75] "m/s" ASDM
 SG_ OBJ_VELOCITY_LAT_ERR_035 : 151|8@0+ (0.05,0) [0|12.75] "m/s" ASDM
 SG_ OBJ_POS_LONG_ERR_035 : 95|8@0+ (0.025,0) [0|6.375] "m" ASDM
 SG_ OBJ_POS_LAT_ERR_035 : 103|8@0+ (0.025,0) [0|6.375] "m" ASDM
 SG_ OBJ_TRACK_MOTION_MODEL_035 : 9|2@0+ (1,0) [1|3] "NA" ASDM
 SG_ OBJ_DIMENSION_WIDTH_035 : 17|10@0+ (0.01,0) [0|10.23] "m" ASDM
 SG_ OBJ_DIMENSION_LENGTH_035 : 37|12@0+ (0.01,0) [0|40.95] "m" ASDM
 SG_ OBJ_EXISTENCE_PROB_035 : 229|14@0+ (0.0001,0) [0|1] "NA" ASDM
 SG_ OBJ_YAW_ANGLE_035 : 155|12@0+ (0.005,-10) [-10|10.475] "rad" ASDM
 SG_ OBJ_YAW_ANGLE_ERR_035 : 175|7@0+ (0.01,0) [0|1.27] "rad" ASDM
 SG_ OBJ_ID_035 : 7|8@0+ (1,0) [0|255] "NA" ASDM
 SG_ OBJ_MOVEMENT_STATUS_035 : 196|3@0+ (1,0) [0|3] "NA" ASDM
 SG_ OBJ_MEASUREMENT_STATUS_035 : 14|3@0+ (1,0) [0|7] "NA" ASDM
 SG_ OBJ_POS_LONG_035 : 63|16@0+ (0.01,-327) [-327|327] "m" ASDM
 SG_ OBJ_POS_LAT_035 : 79|16@0+ (0.01,-327) [-327|327] "m" ASDM
 SG_ OBJ_VELOCITY_LONG_035 : 110|15@0+ (0.01,-163) [-163|163] "m/s" ASDM
 SG_ OBJ_VELOCITY_LAT_035 : 126|15@0+ (0.01,-163) [-163|163] "m/s" ASDM
 SG_ OBJ_ACCELERATION_LONG_035 : 193|10@0+ (0.05,-20) [-20|20] "m/s^2" ASDM
 SG_ OBJ_ACCELERATION_LAT_035 : 177|10@0+ (0.05,-20) [-20|20] "m/s^2" ASDM
 SG_ OBJ_VEH_TRACK_FLAG_035 : 10|1@0+ (1,0) [0|1] "NA" ASDM
 SG_ OBJ_MH_CYCLE_COUNTER_035 : 487|8@0+ (1,0) [0|255] "NA" ASDM
 SG_ OBJ_MH_CRC16_035 : 495|16@0+ (1,0) [0|65535] "NA" ASDM
 SG_ OBJ_TIMESTAMP_OFFSET_035 : 247|8@0+ (1,-127) [-127|128] "ms" ASDM
 SG_ OBJ_DIMENSION_WIDTH_ERR_035 : 23|6@0+ (0.01,0) [0|0.63] "m" ASDM
 SG_ OBJ_DIMENSION_LENGTH_ERR_035 : 41|10@0+ (0.01,0) [0|10.23] "m" ASDM
 SG_ OBJ_CLS_TYPE1_035 : 271|4@0+ (1,0) [0|15] "NA" ASDM
 SG_ OBJ_CLS_TYPE1_PROB_035 : 303|8@0+ (0.004,0) [0|1] "NA" ASDM
 SG_ OBJ_CLS_TYPE2_035 : 267|4@0+ (1,0) [0|15] "NA" ASDM
 SG_ OBJ_CLS_TYPE2_PROB_035 : 311|8@0+ (0.004,0) [0|1] "NA" ASDM
 SG_ OBJ_CLS_TYPE3_035 : 279|4@0+ (1,0) [0|15] "NA" ASDM
 SG_ OBJ_CLS_TYPE3_PROB_035 : 319|8@0+ (0.004,0) [0|1] "NA" ASDM
 SG_ OBJ_CLS_TYPE4_035 : 275|4@0+ (1,0) [0|15] "NA" ASDM
 SG_ OBJ_CLS_TYPE4_PROB_035 : 327|8@0+ (0.004,0) [0|1] "NA" ASDM
 SG_ OBJ_CLS_TYPE5_035 : 287|4@0+ (1,0) [0|15] "NA" ASDM
 SG_ OBJ_CLS_TYPE5_PROB_035 : 335|8@0+ (0.004,0) [0|1] "NA" ASDM
 SG_ OBJ_CLS_TYPE6_035 : 282|4@0+ (1,0) [0|15] "NA" ASDM
 SG_ OBJ_CLS_TYPE6_PROB_035 : 343|8@0+ (0.004,0) [0|1] "NA" ASDM
 SG_ OBJ_RCS_035 : 351|7@0+ (1,-64) [-64|63] "dBsm" ASDM
 SG_ OBJ_REF_PT_LONG_OFFSET_035 : 357|14@0+ (0.0001,0) [0|1] "NA" ASDM
 SG_ OBJ_REF_PT_LAT_OFFSET_035 : 370|14@0+ (0.0001,0) [0|1] "NA" ASDM
 SG_ OBJ_YAW_RATE_035 : 399|10@0+ (0.005,-2.24) [-2.24|2.24] "rad/s" ASDM
 SG_ OBJ_YAW_RATE_ERR_035 : 388|5@0+ (0.025,0) [0|0.775] "rad/s" ASDM
 SG_ OBJ_GROUP_ID_035 : 405|6@0+ (1,0) [0|63] "NA" ASDM
 SG_ OBJ_POS_ERR_CRR_COEF_035 : 415|8@0+ (0.01,-1.2) [-1.2|1] "NA" ASDM
 SG_ OBJ_VELOCITY_ERR_CRR_COEF_035 : 423|8@0+ (0.01,-1.2) [-1.2|1] "NA" ASDM
 SG_ OBJ_ACCEL_ERR_CRR_COEF_035 : 431|8@0+ (0.01,-1.2) [-1.2|1] "NA" ASDM

BO_ 611 RDR_TRACKER_OBJ_036: 64 G5_RDR03
 SG_ OBJ_ALIVE_TIME_036 : 255|16@0+ (1,0) [0|65535] "ms" ASDM
 SG_ OBJ_ACCELERATION_LONG_ERR_036 : 215|8@0+ (0.025,0) [0|6.375] "m/s^2" ASDM
 SG_ OBJ_ACCELERATION_LAT_ERR_036 : 223|8@0+ (0.025,0) [0|6.375] "m/s^2" ASDM
 SG_ OBJ_VELOCITY_LONG_ERR_036 : 143|8@0+ (0.05,0) [0|12.75] "m/s" ASDM
 SG_ OBJ_VELOCITY_LAT_ERR_036 : 151|8@0+ (0.05,0) [0|12.75] "m/s" ASDM
 SG_ OBJ_POS_LONG_ERR_036 : 95|8@0+ (0.025,0) [0|6.375] "m" ASDM
 SG_ OBJ_POS_LAT_ERR_036 : 103|8@0+ (0.025,0) [0|6.375] "m" ASDM
 SG_ OBJ_TRACK_MOTION_MODEL_036 : 9|2@0+ (1,0) [1|3] "NA" ASDM
 SG_ OBJ_DIMENSION_WIDTH_036 : 17|10@0+ (0.01,0) [0|10.23] "m" ASDM
 SG_ OBJ_DIMENSION_LENGTH_036 : 37|12@0+ (0.01,0) [0|40.95] "m" ASDM
 SG_ OBJ_EXISTENCE_PROB_036 : 229|14@0+ (0.0001,0) [0|1] "NA" ASDM
 SG_ OBJ_YAW_ANGLE_036 : 155|12@0+ (0.005,-10) [-10|10.475] "rad" ASDM
 SG_ OBJ_YAW_ANGLE_ERR_036 : 175|7@0+ (0.01,0) [0|1.27] "rad" ASDM
 SG_ OBJ_ID_036 : 7|8@0+ (1,0) [0|255] "NA" ASDM
 SG_ OBJ_MOVEMENT_STATUS_036 : 196|3@0+ (1,0) [0|3] "NA" ASDM
 SG_ OBJ_MEASUREMENT_STATUS_036 : 14|3@0+ (1,0) [0|7] "NA" ASDM
 SG_ OBJ_POS_LONG_036 : 63|16@0+ (0.01,-327) [-327|327] "m" ASDM
 SG_ OBJ_POS_LAT_036 : 79|16@0+ (0.01,-327) [-327|327] "m" ASDM
 SG_ OBJ_VELOCITY_LONG_036 : 110|15@0+ (0.01,-163) [-163|163] "m/s" ASDM
 SG_ OBJ_VELOCITY_LAT_036 : 126|15@0+ (0.01,-163) [-163|163] "m/s" ASDM
 SG_ OBJ_ACCELERATION_LONG_036 : 193|10@0+ (0.05,-20) [-20|20] "m/s^2" ASDM
 SG_ OBJ_ACCELERATION_LAT_036 : 177|10@0+ (0.05,-20) [-20|20] "m/s^2" ASDM
 SG_ OBJ_VEH_TRACK_FLAG_036 : 10|1@0+ (1,0) [0|1] "NA" ASDM
 SG_ OBJ_MH_CYCLE_COUNTER_036 : 487|8@0+ (1,0) [0|255] "NA" ASDM
 SG_ OBJ_MH_CRC16_036 : 495|16@0+ (1,0) [0|65535] "NA" ASDM
 SG_ OBJ_TIMESTAMP_OFFSET_036 : 247|8@0+ (1,-127) [-127|128] "ms" ASDM
 SG_ OBJ_DIMENSION_WIDTH_ERR_036 : 23|6@0+ (0.01,0) [0|0.63] "m" ASDM
 SG_ OBJ_DIMENSION_LENGTH_ERR_036 : 41|10@0+ (0.01,0) [0|10.23] "m" ASDM
 SG_ OBJ_CLS_TYPE1_036 : 271|4@0+ (1,0) [0|15] "NA" ASDM
 SG_ OBJ_CLS_TYPE1_PROB_036 : 303|8@0+ (0.004,0) [0|1] "NA" ASDM
 SG_ OBJ_CLS_TYPE2_036 : 267|4@0+ (1,0) [0|15] "NA" ASDM
 SG_ OBJ_CLS_TYPE2_PROB_036 : 311|8@0+ (0.004,0) [0|1] "NA" ASDM
 SG_ OBJ_CLS_TYPE3_036 : 279|4@0+ (1,0) [0|15] "NA" ASDM
 SG_ OBJ_CLS_TYPE3_PROB_036 : 319|8@0+ (0.004,0) [0|1] "NA" ASDM
 SG_ OBJ_CLS_TYPE4_036 : 275|4@0+ (1,0) [0|15] "NA" ASDM
 SG_ OBJ_CLS_TYPE4_PROB_036 : 327|8@0+ (0.004,0) [0|1] "NA" ASDM
 SG_ OBJ_CLS_TYPE5_036 : 287|4@0+ (1,0) [0|15] "NA" ASDM
 SG_ OBJ_CLS_TYPE5_PROB_036 : 335|8@0+ (0.004,0) [0|1] "NA" ASDM
 SG_ OBJ_CLS_TYPE6_036 : 282|4@0+ (1,0) [0|15] "NA" ASDM
 SG_ OBJ_CLS_TYPE6_PROB_036 : 343|8@0+ (0.004,0) [0|1] "NA" ASDM
 SG_ OBJ_RCS_036 : 351|7@0+ (1,-64) [-64|63] "dBsm" ASDM
 SG_ OBJ_REF_PT_LONG_OFFSET_036 : 357|14@0+ (0.0001,0) [0|1] "NA" ASDM
 SG_ OBJ_REF_PT_LAT_OFFSET_036 : 370|14@0+ (0.0001,0) [0|1] "NA" ASDM
 SG_ OBJ_YAW_RATE_036 : 399|10@0+ (0.005,-2.24) [-2.24|2.24] "rad/s" ASDM
 SG_ OBJ_YAW_RATE_ERR_036 : 388|5@0+ (0.025,0) [0|0.775] "rad/s" ASDM
 SG_ OBJ_GROUP_ID_036 : 405|6@0+ (1,0) [0|63] "NA" ASDM
 SG_ OBJ_POS_ERR_CRR_COEF_036 : 415|8@0+ (0.01,-1.2) [-1.2|1] "NA" ASDM
 SG_ OBJ_VELOCITY_ERR_CRR_COEF_036 : 423|8@0+ (0.01,-1.2) [-1.2|1] "NA" ASDM
 SG_ OBJ_ACCEL_ERR_CRR_COEF_036 : 431|8@0+ (0.01,-1.2) [-1.2|1] "NA" ASDM

BO_ 612 RDR_TRACKER_OBJ_037: 64 G5_RDR03
 SG_ OBJ_ALIVE_TIME_037 : 255|16@0+ (1,0) [0|65535] "ms" ASDM
 SG_ OBJ_ACCELERATION_LONG_ERR_037 : 215|8@0+ (0.025,0) [0|6.375] "m/s^2" ASDM
 SG_ OBJ_ACCELERATION_LAT_ERR_037 : 223|8@0+ (0.025,0) [0|6.375] "m/s^2" ASDM
 SG_ OBJ_VELOCITY_LONG_ERR_037 : 143|8@0+ (0.05,0) [0|12.75] "m/s" ASDM
 SG_ OBJ_VELOCITY_LAT_ERR_037 : 151|8@0+ (0.05,0) [0|12.75] "m/s" ASDM
 SG_ OBJ_POS_LONG_ERR_037 : 95|8@0+ (0.025,0) [0|6.375] "m" ASDM
 SG_ OBJ_POS_LAT_ERR_037 : 103|8@0+ (0.025,0) [0|6.375] "m" ASDM
 SG_ OBJ_TRACK_MOTION_MODEL_037 : 9|2@0+ (1,0) [1|3] "NA" ASDM
 SG_ OBJ_DIMENSION_WIDTH_037 : 17|10@0+ (0.01,0) [0|10.23] "m" ASDM
 SG_ OBJ_DIMENSION_LENGTH_037 : 37|12@0+ (0.01,0) [0|40.95] "m" ASDM
 SG_ OBJ_EXISTENCE_PROB_037 : 229|14@0+ (0.0001,0) [0|1] "NA" ASDM
 SG_ OBJ_YAW_ANGLE_037 : 155|12@0+ (0.005,-10) [-10|10.475] "rad" ASDM
 SG_ OBJ_YAW_ANGLE_ERR_037 : 175|7@0+ (0.01,0) [0|1.27] "rad" ASDM
 SG_ OBJ_ID_037 : 7|8@0+ (1,0) [0|255] "NA" ASDM
 SG_ OBJ_MOVEMENT_STATUS_037 : 196|3@0+ (1,0) [0|3] "NA" ASDM
 SG_ OBJ_MEASUREMENT_STATUS_037 : 14|3@0+ (1,0) [0|7] "NA" ASDM
 SG_ OBJ_POS_LONG_037 : 63|16@0+ (0.01,-327) [-327|327] "m" ASDM
 SG_ OBJ_POS_LAT_037 : 79|16@0+ (0.01,-327) [-327|327] "m" ASDM
 SG_ OBJ_VELOCITY_LONG_037 : 110|15@0+ (0.01,-163) [-163|163] "m/s" ASDM
 SG_ OBJ_VELOCITY_LAT_037 : 126|15@0+ (0.01,-163) [-163|163] "m/s" ASDM
 SG_ OBJ_ACCELERATION_LONG_037 : 193|10@0+ (0.05,-20) [-20|20] "m/s^2" ASDM
 SG_ OBJ_ACCELERATION_LAT_037 : 177|10@0+ (0.05,-20) [-20|20] "m/s^2" ASDM
 SG_ OBJ_VEH_TRACK_FLAG_037 : 10|1@0+ (1,0) [0|1] "NA" ASDM
 SG_ OBJ_MH_CYCLE_COUNTER_037 : 487|8@0+ (1,0) [0|255] "NA" ASDM
 SG_ OBJ_MH_CRC16_037 : 495|16@0+ (1,0) [0|65535] "NA" ASDM
 SG_ OBJ_TIMESTAMP_OFFSET_037 : 247|8@0+ (1,-127) [-127|128] "ms" ASDM
 SG_ OBJ_DIMENSION_WIDTH_ERR_037 : 23|6@0+ (0.01,0) [0|0.63] "m" ASDM
 SG_ OBJ_DIMENSION_LENGTH_ERR_037 : 41|10@0+ (0.01,0) [0|10.23] "m" ASDM
 SG_ OBJ_CLS_TYPE1_037 : 271|4@0+ (1,0) [0|15] "NA" ASDM
 SG_ OBJ_CLS_TYPE1_PROB_037 : 303|8@0+ (0.004,0) [0|1] "NA" ASDM
 SG_ OBJ_CLS_TYPE2_037 : 267|4@0+ (1,0) [0|15] "NA" ASDM
 SG_ OBJ_CLS_TYPE2_PROB_037 : 311|8@0+ (0.004,0) [0|1] "NA" ASDM
 SG_ OBJ_CLS_TYPE3_037 : 279|4@0+ (1,0) [0|15] "NA" ASDM
 SG_ OBJ_CLS_TYPE3_PROB_037 : 319|8@0+ (0.004,0) [0|1] "NA" ASDM
 SG_ OBJ_CLS_TYPE4_037 : 275|4@0+ (1,0) [0|15] "NA" ASDM
 SG_ OBJ_CLS_TYPE4_PROB_037 : 327|8@0+ (0.004,0) [0|1] "NA" ASDM
 SG_ OBJ_CLS_TYPE5_037 : 287|4@0+ (1,0) [0|15] "NA" ASDM
 SG_ OBJ_CLS_TYPE5_PROB_037 : 335|8@0+ (0.004,0) [0|1] "NA" ASDM
 SG_ OBJ_CLS_TYPE6_037 : 282|4@0+ (1,0) [0|15] "NA" ASDM
 SG_ OBJ_CLS_TYPE6_PROB_037 : 343|8@0+ (0.004,0) [0|1] "NA" ASDM
 SG_ OBJ_RCS_037 : 351|7@0+ (1,-64) [-64|63] "dBsm" ASDM
 SG_ OBJ_REF_PT_LONG_OFFSET_037 : 357|14@0+ (0.0001,0) [0|1] "NA" ASDM
 SG_ OBJ_REF_PT_LAT_OFFSET_037 : 370|14@0+ (0.0001,0) [0|1] "NA" ASDM
 SG_ OBJ_YAW_RATE_037 : 399|10@0+ (0.005,-2.24) [-2.24|2.24] "rad/s" ASDM
 SG_ OBJ_YAW_RATE_ERR_037 : 388|5@0+ (0.025,0) [0|0.775] "rad/s" ASDM
 SG_ OBJ_GROUP_ID_037 : 405|6@0+ (1,0) [0|63] "NA" ASDM
 SG_ OBJ_POS_ERR_CRR_COEF_037 : 415|8@0+ (0.01,-1.2) [-1.2|1] "NA" ASDM
 SG_ OBJ_VELOCITY_ERR_CRR_COEF_037 : 423|8@0+ (0.01,-1.2) [-1.2|1] "NA" ASDM
 SG_ OBJ_ACCEL_ERR_CRR_COEF_037 : 431|8@0+ (0.01,-1.2) [-1.2|1] "NA" ASDM

BO_ 613 RDR_TRACKER_OBJ_038: 64 G5_RDR03
 SG_ OBJ_ALIVE_TIME_038 : 255|16@0+ (1,0) [0|65535] "ms" ASDM
 SG_ OBJ_ACCELERATION_LONG_ERR_038 : 215|8@0+ (0.025,0) [0|6.375] "m/s^2" ASDM
 SG_ OBJ_ACCELERATION_LAT_ERR_038 : 223|8@0+ (0.025,0) [0|6.375] "m/s^2" ASDM
 SG_ OBJ_VELOCITY_LONG_ERR_038 : 143|8@0+ (0.05,0) [0|12.75] "m/s" ASDM
 SG_ OBJ_VELOCITY_LAT_ERR_038 : 151|8@0+ (0.05,0) [0|12.75] "m/s" ASDM
 SG_ OBJ_POS_LONG_ERR_038 : 95|8@0+ (0.025,0) [0|6.375] "m" ASDM
 SG_ OBJ_POS_LAT_ERR_038 : 103|8@0+ (0.025,0) [0|6.375] "m" ASDM
 SG_ OBJ_TRACK_MOTION_MODEL_038 : 9|2@0+ (1,0) [1|3] "NA" ASDM
 SG_ OBJ_DIMENSION_WIDTH_038 : 17|10@0+ (0.01,0) [0|10.23] "m" ASDM
 SG_ OBJ_DIMENSION_LENGTH_038 : 37|12@0+ (0.01,0) [0|40.95] "m" ASDM
 SG_ OBJ_EXISTENCE_PROB_038 : 229|14@0+ (0.0001,0) [0|1] "NA" ASDM
 SG_ OBJ_YAW_ANGLE_038 : 155|12@0+ (0.005,-10) [-10|10.475] "rad" ASDM
 SG_ OBJ_YAW_ANGLE_ERR_038 : 175|7@0+ (0.01,0) [0|1.27] "rad" ASDM
 SG_ OBJ_ID_038 : 7|8@0+ (1,0) [0|255] "NA" ASDM
 SG_ OBJ_MOVEMENT_STATUS_038 : 196|3@0+ (1,0) [0|3] "NA" ASDM
 SG_ OBJ_MEASUREMENT_STATUS_038 : 14|3@0+ (1,0) [0|7] "NA" ASDM
 SG_ OBJ_POS_LONG_038 : 63|16@0+ (0.01,-327) [-327|327] "m" ASDM
 SG_ OBJ_POS_LAT_038 : 79|16@0+ (0.01,-327) [-327|327] "m" ASDM
 SG_ OBJ_VELOCITY_LONG_038 : 110|15@0+ (0.01,-163) [-163|163] "m/s" ASDM
 SG_ OBJ_VELOCITY_LAT_038 : 126|15@0+ (0.01,-163) [-163|163] "m/s" ASDM
 SG_ OBJ_ACCELERATION_LONG_038 : 193|10@0+ (0.05,-20) [-20|20] "m/s^2" ASDM
 SG_ OBJ_ACCELERATION_LAT_038 : 177|10@0+ (0.05,-20) [-20|20] "m/s^2" ASDM
 SG_ OBJ_VEH_TRACK_FLAG_038 : 10|1@0+ (1,0) [0|1] "NA" ASDM
 SG_ OBJ_MH_CYCLE_COUNTER_038 : 487|8@0+ (1,0) [0|255] "NA" ASDM
 SG_ OBJ_MH_CRC16_038 : 495|16@0+ (1,0) [0|65535] "NA" ASDM
 SG_ OBJ_TIMESTAMP_OFFSET_038 : 247|8@0+ (1,-127) [-127|128] "ms" ASDM
 SG_ OBJ_DIMENSION_WIDTH_ERR_038 : 23|6@0+ (0.01,0) [0|0.63] "m" ASDM
 SG_ OBJ_DIMENSION_LENGTH_ERR_038 : 41|10@0+ (0.01,0) [0|10.23] "m" ASDM
 SG_ OBJ_CLS_TYPE1_038 : 271|4@0+ (1,0) [0|15] "NA" ASDM
 SG_ OBJ_CLS_TYPE1_PROB_038 : 303|8@0+ (0.004,0) [0|1] "NA" ASDM
 SG_ OBJ_CLS_TYPE2_038 : 267|4@0+ (1,0) [0|15] "NA" ASDM
 SG_ OBJ_CLS_TYPE2_PROB_038 : 311|8@0+ (0.004,0) [0|1] "NA" ASDM
 SG_ OBJ_CLS_TYPE3_038 : 279|4@0+ (1,0) [0|15] "NA" ASDM
 SG_ OBJ_CLS_TYPE3_PROB_038 : 319|8@0+ (0.004,0) [0|1] "NA" ASDM
 SG_ OBJ_CLS_TYPE4_038 : 275|4@0+ (1,0) [0|15] "NA" ASDM
 SG_ OBJ_CLS_TYPE4_PROB_038 : 327|8@0+ (0.004,0) [0|1] "NA" ASDM
 SG_ OBJ_CLS_TYPE5_038 : 287|4@0+ (1,0) [0|15] "NA" ASDM
 SG_ OBJ_CLS_TYPE5_PROB_038 : 335|8@0+ (0.004,0) [0|1] "NA" ASDM
 SG_ OBJ_CLS_TYPE6_038 : 282|4@0+ (1,0) [0|15] "NA" ASDM
 SG_ OBJ_CLS_TYPE6_PROB_038 : 343|8@0+ (0.004,0) [0|1] "NA" ASDM
 SG_ OBJ_RCS_038 : 351|7@0+ (1,-64) [-64|63] "dBsm" ASDM
 SG_ OBJ_REF_PT_LONG_OFFSET_038 : 357|14@0+ (0.0001,0) [0|1] "NA" ASDM
 SG_ OBJ_REF_PT_LAT_OFFSET_038 : 370|14@0+ (0.0001,0) [0|1] "NA" ASDM
 SG_ OBJ_YAW_RATE_038 : 399|10@0+ (0.005,-2.24) [-2.24|2.24] "rad/s" ASDM
 SG_ OBJ_YAW_RATE_ERR_038 : 388|5@0+ (0.025,0) [0|0.775] "rad/s" ASDM
 SG_ OBJ_GROUP_ID_038 : 405|6@0+ (1,0) [0|63] "NA" ASDM
 SG_ OBJ_POS_ERR_CRR_COEF_038 : 415|8@0+ (0.01,-1.2) [-1.2|1] "NA" ASDM
 SG_ OBJ_VELOCITY_ERR_CRR_COEF_038 : 423|8@0+ (0.01,-1.2) [-1.2|1] "NA" ASDM
 SG_ OBJ_ACCEL_ERR_CRR_COEF_038 : 431|8@0+ (0.01,-1.2) [-1.2|1] "NA" ASDM

BO_ 614 RDR_TRACKER_OBJ_039: 64 G5_RDR03
 SG_ OBJ_ALIVE_TIME_039 : 255|16@0+ (1,0) [0|65535] "ms" ASDM
 SG_ OBJ_ACCELERATION_LONG_ERR_039 : 215|8@0+ (0.025,0) [0|6.375] "m/s^2" ASDM
 SG_ OBJ_ACCELERATION_LAT_ERR_039 : 223|8@0+ (0.025,0) [0|6.375] "m/s^2" ASDM
 SG_ OBJ_VELOCITY_LONG_ERR_039 : 143|8@0+ (0.05,0) [0|12.75] "m/s" ASDM
 SG_ OBJ_VELOCITY_LAT_ERR_039 : 151|8@0+ (0.05,0) [0|12.75] "m/s" ASDM
 SG_ OBJ_POS_LONG_ERR_039 : 95|8@0+ (0.025,0) [0|6.375] "m" ASDM
 SG_ OBJ_POS_LAT_ERR_039 : 103|8@0+ (0.025,0) [0|6.375] "m" ASDM
 SG_ OBJ_TRACK_MOTION_MODEL_039 : 9|2@0+ (1,0) [1|3] "NA" ASDM
 SG_ OBJ_DIMENSION_WIDTH_039 : 17|10@0+ (0.01,0) [0|10.23] "m" ASDM
 SG_ OBJ_DIMENSION_LENGTH_039 : 37|12@0+ (0.01,0) [0|40.95] "m" ASDM
 SG_ OBJ_EXISTENCE_PROB_039 : 229|14@0+ (0.0001,0) [0|1] "NA" ASDM
 SG_ OBJ_YAW_ANGLE_039 : 155|12@0+ (0.005,-10) [-10|10.475] "rad" ASDM
 SG_ OBJ_YAW_ANGLE_ERR_039 : 175|7@0+ (0.01,0) [0|1.27] "rad" ASDM
 SG_ OBJ_ID_039 : 7|8@0+ (1,0) [0|255] "NA" ASDM
 SG_ OBJ_MOVEMENT_STATUS_039 : 196|3@0+ (1,0) [0|3] "NA" ASDM
 SG_ OBJ_MEASUREMENT_STATUS_039 : 14|3@0+ (1,0) [0|7] "NA" ASDM
 SG_ OBJ_POS_LONG_039 : 63|16@0+ (0.01,-327) [-327|327] "m" ASDM
 SG_ OBJ_POS_LAT_039 : 79|16@0+ (0.01,-327) [-327|327] "m" ASDM
 SG_ OBJ_VELOCITY_LONG_039 : 110|15@0+ (0.01,-163) [-163|163] "m/s" ASDM
 SG_ OBJ_VELOCITY_LAT_039 : 126|15@0+ (0.01,-163) [-163|163] "m/s" ASDM
 SG_ OBJ_ACCELERATION_LONG_039 : 193|10@0+ (0.05,-20) [-20|20] "m/s^2" ASDM
 SG_ OBJ_ACCELERATION_LAT_039 : 177|10@0+ (0.05,-20) [-20|20] "m/s^2" ASDM
 SG_ OBJ_VEH_TRACK_FLAG_039 : 10|1@0+ (1,0) [0|1] "NA" ASDM
 SG_ OBJ_MH_CYCLE_COUNTER_039 : 487|8@0+ (1,0) [0|255] "NA" ASDM
 SG_ OBJ_MH_CRC16_039 : 495|16@0+ (1,0) [0|65535] "NA" ASDM
 SG_ OBJ_TIMESTAMP_OFFSET_039 : 247|8@0+ (1,-127) [-127|128] "ms" ASDM
 SG_ OBJ_DIMENSION_WIDTH_ERR_039 : 23|6@0+ (0.01,0) [0|0.63] "m" ASDM
 SG_ OBJ_DIMENSION_LENGTH_ERR_039 : 41|10@0+ (0.01,0) [0|10.23] "m" ASDM
 SG_ OBJ_CLS_TYPE1_039 : 271|4@0+ (1,0) [0|15] "NA" ASDM
 SG_ OBJ_CLS_TYPE1_PROB_039 : 303|8@0+ (0.004,0) [0|1] "NA" ASDM
 SG_ OBJ_CLS_TYPE2_039 : 267|4@0+ (1,0) [0|15] "NA" ASDM
 SG_ OBJ_CLS_TYPE2_PROB_039 : 311|8@0+ (0.004,0) [0|1] "NA" ASDM
 SG_ OBJ_CLS_TYPE3_039 : 279|4@0+ (1,0) [0|15] "NA" ASDM
 SG_ OBJ_CLS_TYPE3_PROB_039 : 319|8@0+ (0.004,0) [0|1] "NA" ASDM
 SG_ OBJ_CLS_TYPE4_039 : 275|4@0+ (1,0) [0|15] "NA" ASDM
 SG_ OBJ_CLS_TYPE4_PROB_039 : 327|8@0+ (0.004,0) [0|1] "NA" ASDM
 SG_ OBJ_CLS_TYPE5_039 : 287|4@0+ (1,0) [0|15] "NA" ASDM
 SG_ OBJ_CLS_TYPE5_PROB_039 : 335|8@0+ (0.004,0) [0|1] "NA" ASDM
 SG_ OBJ_CLS_TYPE6_039 : 282|4@0+ (1,0) [0|15] "NA" ASDM
 SG_ OBJ_CLS_TYPE6_PROB_039 : 343|8@0+ (0.004,0) [0|1] "NA" ASDM
 SG_ OBJ_RCS_039 : 351|7@0+ (1,-64) [-64|63] "dBsm" ASDM
 SG_ OBJ_REF_PT_LONG_OFFSET_039 : 357|14@0+ (0.0001,0) [0|1] "NA" ASDM
 SG_ OBJ_REF_PT_LAT_OFFSET_039 : 370|14@0+ (0.0001,0) [0|1] "NA" ASDM
 SG_ OBJ_YAW_RATE_039 : 399|10@0+ (0.005,-2.24) [-2.24|2.24] "rad/s" ASDM
 SG_ OBJ_YAW_RATE_ERR_039 : 388|5@0+ (0.025,0) [0|0.775] "rad/s" ASDM
 SG_ OBJ_GROUP_ID_039 : 405|6@0+ (1,0) [0|63] "NA" ASDM
 SG_ OBJ_POS_ERR_CRR_COEF_039 : 415|8@0+ (0.01,-1.2) [-1.2|1] "NA" ASDM
 SG_ OBJ_VELOCITY_ERR_CRR_COEF_039 : 423|8@0+ (0.01,-1.2) [-1.2|1] "NA" ASDM
 SG_ OBJ_ACCEL_ERR_CRR_COEF_039 : 431|8@0+ (0.01,-1.2) [-1.2|1] "NA" ASDM

BO_ 615 RDR_TRACKER_OBJ_040: 64 G5_RDR03
 SG_ OBJ_ALIVE_TIME_040 : 255|16@0+ (1,0) [0|65535] "ms" ASDM
 SG_ OBJ_ACCELERATION_LONG_ERR_040 : 215|8@0+ (0.025,0) [0|6.375] "m/s^2" ASDM
 SG_ OBJ_ACCELERATION_LAT_ERR_040 : 223|8@0+ (0.025,0) [0|6.375] "m/s^2" ASDM
 SG_ OBJ_VELOCITY_LONG_ERR_040 : 143|8@0+ (0.05,0) [0|12.75] "m/s" ASDM
 SG_ OBJ_VELOCITY_LAT_ERR_040 : 151|8@0+ (0.05,0) [0|12.75] "m/s" ASDM
 SG_ OBJ_POS_LONG_ERR_040 : 95|8@0+ (0.025,0) [0|6.375] "m" ASDM
 SG_ OBJ_POS_LAT_ERR_040 : 103|8@0+ (0.025,0) [0|6.375] "m" ASDM
 SG_ OBJ_TRACK_MOTION_MODEL_040 : 9|2@0+ (1,0) [1|3] "NA" ASDM
 SG_ OBJ_DIMENSION_WIDTH_040 : 17|10@0+ (0.01,0) [0|10.23] "m" ASDM
 SG_ OBJ_DIMENSION_LENGTH_040 : 37|12@0+ (0.01,0) [0|40.95] "m" ASDM
 SG_ OBJ_EXISTENCE_PROB_040 : 229|14@0+ (0.0001,0) [0|1] "NA" ASDM
 SG_ OBJ_YAW_ANGLE_040 : 155|12@0+ (0.005,-10) [-10|10.475] "rad" ASDM
 SG_ OBJ_YAW_ANGLE_ERR_040 : 175|7@0+ (0.01,0) [0|1.27] "rad" ASDM
 SG_ OBJ_ID_040 : 7|8@0+ (1,0) [0|255] "NA" ASDM
 SG_ OBJ_MOVEMENT_STATUS_040 : 196|3@0+ (1,0) [0|3] "NA" ASDM
 SG_ OBJ_MEASUREMENT_STATUS_040 : 14|3@0+ (1,0) [0|7] "NA" ASDM
 SG_ OBJ_POS_LONG_040 : 63|16@0+ (0.01,-327) [-327|327] "m" ASDM
 SG_ OBJ_POS_LAT_040 : 79|16@0+ (0.01,-327) [-327|327] "m" ASDM
 SG_ OBJ_VELOCITY_LONG_040 : 110|15@0+ (0.01,-163) [-163|163] "m/s" ASDM
 SG_ OBJ_VELOCITY_LAT_040 : 126|15@0+ (0.01,-163) [-163|163] "m/s" ASDM
 SG_ OBJ_ACCELERATION_LONG_040 : 193|10@0+ (0.05,-20) [-20|20] "m/s^2" ASDM
 SG_ OBJ_ACCELERATION_LAT_040 : 177|10@0+ (0.05,-20) [-20|20] "m/s^2" ASDM
 SG_ OBJ_VEH_TRACK_FLAG_040 : 10|1@0+ (1,0) [0|1] "NA" ASDM
 SG_ OBJ_MH_CYCLE_COUNTER_040 : 487|8@0+ (1,0) [0|255] "NA" ASDM
 SG_ OBJ_MH_CRC16_040 : 495|16@0+ (1,0) [0|65535] "NA" ASDM
 SG_ OBJ_TIMESTAMP_OFFSET_040 : 247|8@0+ (1,-127) [-127|128] "ms" ASDM
 SG_ OBJ_DIMENSION_WIDTH_ERR_040 : 23|6@0+ (0.01,0) [0|0.63] "m" ASDM
 SG_ OBJ_DIMENSION_LENGTH_ERR_040 : 41|10@0+ (0.01,0) [0|10.23] "m" ASDM
 SG_ OBJ_CLS_TYPE1_040 : 271|4@0+ (1,0) [0|15] "NA" ASDM
 SG_ OBJ_CLS_TYPE1_PROB_040 : 303|8@0+ (0.004,0) [0|1] "NA" ASDM
 SG_ OBJ_CLS_TYPE2_040 : 267|4@0+ (1,0) [0|15] "NA" ASDM
 SG_ OBJ_CLS_TYPE2_PROB_040 : 311|8@0+ (0.004,0) [0|1] "NA" ASDM
 SG_ OBJ_CLS_TYPE3_040 : 279|4@0+ (1,0) [0|15] "NA" ASDM
 SG_ OBJ_CLS_TYPE3_PROB_040 : 319|8@0+ (0.004,0) [0|1] "NA" ASDM
 SG_ OBJ_CLS_TYPE4_040 : 275|4@0+ (1,0) [0|15] "NA" ASDM
 SG_ OBJ_CLS_TYPE4_PROB_040 : 327|8@0+ (0.004,0) [0|1] "NA" ASDM
 SG_ OBJ_CLS_TYPE5_040 : 287|4@0+ (1,0) [0|15] "NA" ASDM
 SG_ OBJ_CLS_TYPE5_PROB_040 : 335|8@0+ (0.004,0) [0|1] "NA" ASDM
 SG_ OBJ_CLS_TYPE6_040 : 282|4@0+ (1,0) [0|15] "NA" ASDM
 SG_ OBJ_CLS_TYPE6_PROB_040 : 343|8@0+ (0.004,0) [0|1] "NA" ASDM
 SG_ OBJ_RCS_040 : 351|7@0+ (1,-64) [-64|63] "dBsm" ASDM
 SG_ OBJ_REF_PT_LONG_OFFSET_040 : 357|14@0+ (0.0001,0) [0|1] "NA" ASDM
 SG_ OBJ_REF_PT_LAT_OFFSET_040 : 370|14@0+ (0.0001,0) [0|1] "NA" ASDM
 SG_ OBJ_YAW_RATE_040 : 399|10@0+ (0.005,-2.24) [-2.24|2.24] "rad/s" ASDM
 SG_ OBJ_YAW_RATE_ERR_040 : 388|5@0+ (0.025,0) [0|0.775] "rad/s" ASDM
 SG_ OBJ_GROUP_ID_040 : 405|6@0+ (1,0) [0|63] "NA" ASDM
 SG_ OBJ_POS_ERR_CRR_COEF_040 : 415|8@0+ (0.01,-1.2) [-1.2|1] "NA" ASDM
 SG_ OBJ_VELOCITY_ERR_CRR_COEF_040 : 423|8@0+ (0.01,-1.2) [-1.2|1] "NA" ASDM
 SG_ OBJ_ACCEL_ERR_CRR_COEF_040 : 431|8@0+ (0.01,-1.2) [-1.2|1] "NA" ASDM

BO_ 616 RDR_TRACKER_OBJ_041: 64 G5_RDR03
 SG_ OBJ_ALIVE_TIME_041 : 255|16@0+ (1,0) [0|65535] "ms" ASDM
 SG_ OBJ_ACCELERATION_LONG_ERR_041 : 215|8@0+ (0.025,0) [0|6.375] "m/s^2" ASDM
 SG_ OBJ_ACCELERATION_LAT_ERR_041 : 223|8@0+ (0.025,0) [0|6.375] "m/s^2" ASDM
 SG_ OBJ_VELOCITY_LONG_ERR_041 : 143|8@0+ (0.05,0) [0|12.75] "m/s" ASDM
 SG_ OBJ_VELOCITY_LAT_ERR_041 : 151|8@0+ (0.05,0) [0|12.75] "m/s" ASDM
 SG_ OBJ_POS_LONG_ERR_041 : 95|8@0+ (0.025,0) [0|6.375] "m" ASDM
 SG_ OBJ_POS_LAT_ERR_041 : 103|8@0+ (0.025,0) [0|6.375] "m" ASDM
 SG_ OBJ_TRACK_MOTION_MODEL_041 : 9|2@0+ (1,0) [1|3] "NA" ASDM
 SG_ OBJ_DIMENSION_WIDTH_041 : 17|10@0+ (0.01,0) [0|10.23] "m" ASDM
 SG_ OBJ_DIMENSION_LENGTH_041 : 37|12@0+ (0.01,0) [0|40.95] "m" ASDM
 SG_ OBJ_EXISTENCE_PROB_041 : 229|14@0+ (0.0001,0) [0|1] "NA" ASDM
 SG_ OBJ_YAW_ANGLE_041 : 155|12@0+ (0.005,-10) [-10|10.475] "rad" ASDM
 SG_ OBJ_YAW_ANGLE_ERR_041 : 175|7@0+ (0.01,0) [0|1.27] "rad" ASDM
 SG_ OBJ_ID_041 : 7|8@0+ (1,0) [0|255] "NA" ASDM
 SG_ OBJ_MOVEMENT_STATUS_041 : 196|3@0+ (1,0) [0|3] "NA" ASDM
 SG_ OBJ_MEASUREMENT_STATUS_041 : 14|3@0+ (1,0) [0|7] "NA" ASDM
 SG_ OBJ_POS_LONG_041 : 63|16@0+ (0.01,-327) [-327|327] "m" ASDM
 SG_ OBJ_POS_LAT_041 : 79|16@0+ (0.01,-327) [-327|327] "m" ASDM
 SG_ OBJ_VELOCITY_LONG_041 : 110|15@0+ (0.01,-163) [-163|163] "m/s" ASDM
 SG_ OBJ_VELOCITY_LAT_041 : 126|15@0+ (0.01,-163) [-163|163] "m/s" ASDM
 SG_ OBJ_ACCELERATION_LONG_041 : 193|10@0+ (0.05,-20) [-20|20] "m/s^2" ASDM
 SG_ OBJ_ACCELERATION_LAT_041 : 177|10@0+ (0.05,-20) [-20|20] "m/s^2" ASDM
 SG_ OBJ_VEH_TRACK_FLAG_041 : 10|1@0+ (1,0) [0|1] "NA" ASDM
 SG_ OBJ_MH_CYCLE_COUNTER_041 : 487|8@0+ (1,0) [0|255] "NA" ASDM
 SG_ OBJ_MH_CRC16_041 : 495|16@0+ (1,0) [0|65535] "NA" ASDM
 SG_ OBJ_TIMESTAMP_OFFSET_041 : 247|8@0+ (1,-127) [-127|128] "ms" ASDM
 SG_ OBJ_DIMENSION_WIDTH_ERR_041 : 23|6@0+ (0.01,0) [0|0.63] "m" ASDM
 SG_ OBJ_DIMENSION_LENGTH_ERR_041 : 41|10@0+ (0.01,0) [0|10.23] "m" ASDM
 SG_ OBJ_CLS_TYPE1_041 : 271|4@0+ (1,0) [0|15] "NA" ASDM
 SG_ OBJ_CLS_TYPE1_PROB_041 : 303|8@0+ (0.004,0) [0|1] "NA" ASDM
 SG_ OBJ_CLS_TYPE2_041 : 267|4@0+ (1,0) [0|15] "NA" ASDM
 SG_ OBJ_CLS_TYPE2_PROB_041 : 311|8@0+ (0.004,0) [0|1] "NA" ASDM
 SG_ OBJ_CLS_TYPE3_041 : 279|4@0+ (1,0) [0|15] "NA" ASDM
 SG_ OBJ_CLS_TYPE3_PROB_041 : 319|8@0+ (0.004,0) [0|1] "NA" ASDM
 SG_ OBJ_CLS_TYPE4_041 : 275|4@0+ (1,0) [0|15] "NA" ASDM
 SG_ OBJ_CLS_TYPE4_PROB_041 : 327|8@0+ (0.004,0) [0|1] "NA" ASDM
 SG_ OBJ_CLS_TYPE5_041 : 287|4@0+ (1,0) [0|15] "NA" ASDM
 SG_ OBJ_CLS_TYPE5_PROB_041 : 335|8@0+ (0.004,0) [0|1] "NA" ASDM
 SG_ OBJ_CLS_TYPE6_041 : 282|4@0+ (1,0) [0|15] "NA" ASDM
 SG_ OBJ_CLS_TYPE6_PROB_041 : 343|8@0+ (0.004,0) [0|1] "NA" ASDM
 SG_ OBJ_RCS_041 : 351|7@0+ (1,-64) [-64|63] "dBsm" ASDM
 SG_ OBJ_REF_PT_LONG_OFFSET_041 : 357|14@0+ (0.0001,0) [0|1] "NA" ASDM
 SG_ OBJ_REF_PT_LAT_OFFSET_041 : 370|14@0+ (0.0001,0) [0|1] "NA" ASDM
 SG_ OBJ_YAW_RATE_041 : 399|10@0+ (0.005,-2.24) [-2.24|2.24] "rad/s" ASDM
 SG_ OBJ_YAW_RATE_ERR_041 : 388|5@0+ (0.025,0) [0|0.775] "rad/s" ASDM
 SG_ OBJ_GROUP_ID_041 : 405|6@0+ (1,0) [0|63] "NA" ASDM
 SG_ OBJ_POS_ERR_CRR_COEF_041 : 415|8@0+ (0.01,-1.2) [-1.2|1] "NA" ASDM
 SG_ OBJ_VELOCITY_ERR_CRR_COEF_041 : 423|8@0+ (0.01,-1.2) [-1.2|1] "NA" ASDM
 SG_ OBJ_ACCEL_ERR_CRR_COEF_041 : 431|8@0+ (0.01,-1.2) [-1.2|1] "NA" ASDM

BO_ 617 RDR_TRACKER_OBJ_042: 64 G5_RDR03
 SG_ OBJ_ALIVE_TIME_042 : 255|16@0+ (1,0) [0|65535] "ms" ASDM
 SG_ OBJ_ACCELERATION_LONG_ERR_042 : 215|8@0+ (0.025,0) [0|6.375] "m/s^2" ASDM
 SG_ OBJ_ACCELERATION_LAT_ERR_042 : 223|8@0+ (0.025,0) [0|6.375] "m/s^2" ASDM
 SG_ OBJ_VELOCITY_LONG_ERR_042 : 143|8@0+ (0.05,0) [0|12.75] "m/s" ASDM
 SG_ OBJ_VELOCITY_LAT_ERR_042 : 151|8@0+ (0.05,0) [0|12.75] "m/s" ASDM
 SG_ OBJ_POS_LONG_ERR_042 : 95|8@0+ (0.025,0) [0|6.375] "m" ASDM
 SG_ OBJ_POS_LAT_ERR_042 : 103|8@0+ (0.025,0) [0|6.375] "m" ASDM
 SG_ OBJ_TRACK_MOTION_MODEL_042 : 9|2@0+ (1,0) [1|3] "NA" ASDM
 SG_ OBJ_DIMENSION_WIDTH_042 : 17|10@0+ (0.01,0) [0|10.23] "m" ASDM
 SG_ OBJ_DIMENSION_LENGTH_042 : 37|12@0+ (0.01,0) [0|40.95] "m" ASDM
 SG_ OBJ_EXISTENCE_PROB_042 : 229|14@0+ (0.0001,0) [0|1] "NA" ASDM
 SG_ OBJ_YAW_ANGLE_042 : 155|12@0+ (0.005,-10) [-10|10.475] "rad" ASDM
 SG_ OBJ_YAW_ANGLE_ERR_042 : 175|7@0+ (0.01,0) [0|1.27] "rad" ASDM
 SG_ OBJ_ID_042 : 7|8@0+ (1,0) [0|255] "NA" ASDM
 SG_ OBJ_MOVEMENT_STATUS_042 : 196|3@0+ (1,0) [0|3] "NA" ASDM
 SG_ OBJ_MEASUREMENT_STATUS_042 : 14|3@0+ (1,0) [0|7] "NA" ASDM
 SG_ OBJ_POS_LONG_042 : 63|16@0+ (0.01,-327) [-327|327] "m" ASDM
 SG_ OBJ_POS_LAT_042 : 79|16@0+ (0.01,-327) [-327|327] "m" ASDM
 SG_ OBJ_VELOCITY_LONG_042 : 110|15@0+ (0.01,-163) [-163|163] "m/s" ASDM
 SG_ OBJ_VELOCITY_LAT_042 : 126|15@0+ (0.01,-163) [-163|163] "m/s" ASDM
 SG_ OBJ_ACCELERATION_LONG_042 : 193|10@0+ (0.05,-20) [-20|20] "m/s^2" ASDM
 SG_ OBJ_ACCELERATION_LAT_042 : 177|10@0+ (0.05,-20) [-20|20] "m/s^2" ASDM
 SG_ OBJ_VEH_TRACK_FLAG_042 : 10|1@0+ (1,0) [0|1] "NA" ASDM
 SG_ OBJ_MH_CYCLE_COUNTER_042 : 487|8@0+ (1,0) [0|255] "NA" ASDM
 SG_ OBJ_MH_CRC16_042 : 495|16@0+ (1,0) [0|65535] "NA" ASDM
 SG_ OBJ_TIMESTAMP_OFFSET_042 : 247|8@0+ (1,-127) [-127|128] "ms" ASDM
 SG_ OBJ_DIMENSION_WIDTH_ERR_042 : 23|6@0+ (0.01,0) [0|0.63] "m" ASDM
 SG_ OBJ_DIMENSION_LENGTH_ERR_042 : 41|10@0+ (0.01,0) [0|10.23] "m" ASDM
 SG_ OBJ_CLS_TYPE1_042 : 271|4@0+ (1,0) [0|15] "NA" ASDM
 SG_ OBJ_CLS_TYPE1_PROB_042 : 303|8@0+ (0.004,0) [0|1] "NA" ASDM
 SG_ OBJ_CLS_TYPE2_042 : 267|4@0+ (1,0) [0|15] "NA" ASDM
 SG_ OBJ_CLS_TYPE2_PROB_042 : 311|8@0+ (0.004,0) [0|1] "NA" ASDM
 SG_ OBJ_CLS_TYPE3_042 : 279|4@0+ (1,0) [0|15] "NA" ASDM
 SG_ OBJ_CLS_TYPE3_PROB_042 : 319|8@0+ (0.004,0) [0|1] "NA" ASDM
 SG_ OBJ_CLS_TYPE4_042 : 275|4@0+ (1,0) [0|15] "NA" ASDM
 SG_ OBJ_CLS_TYPE4_PROB_042 : 327|8@0+ (0.004,0) [0|1] "NA" ASDM
 SG_ OBJ_CLS_TYPE5_042 : 287|4@0+ (1,0) [0|15] "NA" ASDM
 SG_ OBJ_CLS_TYPE5_PROB_042 : 335|8@0+ (0.004,0) [0|1] "NA" ASDM
 SG_ OBJ_CLS_TYPE6_042 : 282|4@0+ (1,0) [0|15] "NA" ASDM
 SG_ OBJ_CLS_TYPE6_PROB_042 : 343|8@0+ (0.004,0) [0|1] "NA" ASDM
 SG_ OBJ_RCS_042 : 351|7@0+ (1,-64) [-64|63] "dBsm" ASDM
 SG_ OBJ_REF_PT_LONG_OFFSET_042 : 357|14@0+ (0.0001,0) [0|1] "NA" ASDM
 SG_ OBJ_REF_PT_LAT_OFFSET_042 : 370|14@0+ (0.0001,0) [0|1] "NA" ASDM
 SG_ OBJ_YAW_RATE_042 : 399|10@0+ (0.005,-2.24) [-2.24|2.24] "rad/s" ASDM
 SG_ OBJ_YAW_RATE_ERR_042 : 388|5@0+ (0.025,0) [0|0.775] "rad/s" ASDM
 SG_ OBJ_GROUP_ID_042 : 405|6@0+ (1,0) [0|63] "NA" ASDM
 SG_ OBJ_POS_ERR_CRR_COEF_042 : 415|8@0+ (0.01,-1.2) [-1.2|1] "NA" ASDM
 SG_ OBJ_VELOCITY_ERR_CRR_COEF_042 : 423|8@0+ (0.01,-1.2) [-1.2|1] "NA" ASDM
 SG_ OBJ_ACCEL_ERR_CRR_COEF_042 : 431|8@0+ (0.01,-1.2) [-1.2|1] "NA" ASDM

BO_ 618 RDR_TRACKER_OBJ_043: 64 G5_RDR03
 SG_ OBJ_ALIVE_TIME_043 : 255|16@0+ (1,0) [0|65535] "ms" ASDM
 SG_ OBJ_ACCELERATION_LONG_ERR_043 : 215|8@0+ (0.025,0) [0|6.375] "m/s^2" ASDM
 SG_ OBJ_ACCELERATION_LAT_ERR_043 : 223|8@0+ (0.025,0) [0|6.375] "m/s^2" ASDM
 SG_ OBJ_VELOCITY_LONG_ERR_043 : 143|8@0+ (0.05,0) [0|12.75] "m/s" ASDM
 SG_ OBJ_VELOCITY_LAT_ERR_043 : 151|8@0+ (0.05,0) [0|12.75] "m/s" ASDM
 SG_ OBJ_POS_LONG_ERR_043 : 95|8@0+ (0.025,0) [0|6.375] "m" ASDM
 SG_ OBJ_POS_LAT_ERR_043 : 103|8@0+ (0.025,0) [0|6.375] "m" ASDM
 SG_ OBJ_TRACK_MOTION_MODEL_043 : 9|2@0+ (1,0) [1|3] "NA" ASDM
 SG_ OBJ_DIMENSION_WIDTH_043 : 17|10@0+ (0.01,0) [0|10.23] "m" ASDM
 SG_ OBJ_DIMENSION_LENGTH_043 : 37|12@0+ (0.01,0) [0|40.95] "m" ASDM
 SG_ OBJ_EXISTENCE_PROB_043 : 229|14@0+ (0.0001,0) [0|1] "NA" ASDM
 SG_ OBJ_YAW_ANGLE_043 : 155|12@0+ (0.005,-10) [-10|10.475] "rad" ASDM
 SG_ OBJ_YAW_ANGLE_ERR_043 : 175|7@0+ (0.01,0) [0|1.27] "rad" ASDM
 SG_ OBJ_ID_043 : 7|8@0+ (1,0) [0|255] "NA" ASDM
 SG_ OBJ_MOVEMENT_STATUS_043 : 196|3@0+ (1,0) [0|3] "NA" ASDM
 SG_ OBJ_MEASUREMENT_STATUS_043 : 14|3@0+ (1,0) [0|7] "NA" ASDM
 SG_ OBJ_POS_LONG_043 : 63|16@0+ (0.01,-327) [-327|327] "m" ASDM
 SG_ OBJ_POS_LAT_043 : 79|16@0+ (0.01,-327) [-327|327] "m" ASDM
 SG_ OBJ_VELOCITY_LONG_043 : 110|15@0+ (0.01,-163) [-163|163] "m/s" ASDM
 SG_ OBJ_VELOCITY_LAT_043 : 126|15@0+ (0.01,-163) [-163|163] "m/s" ASDM
 SG_ OBJ_ACCELERATION_LONG_043 : 193|10@0+ (0.05,-20) [-20|20] "m/s^2" ASDM
 SG_ OBJ_ACCELERATION_LAT_043 : 177|10@0+ (0.05,-20) [-20|20] "m/s^2" ASDM
 SG_ OBJ_VEH_TRACK_FLAG_043 : 10|1@0+ (1,0) [0|1] "NA" ASDM
 SG_ OBJ_MH_CYCLE_COUNTER_043 : 487|8@0+ (1,0) [0|255] "NA" ASDM
 SG_ OBJ_MH_CRC16_043 : 495|16@0+ (1,0) [0|65535] "NA" ASDM
 SG_ OBJ_TIMESTAMP_OFFSET_043 : 247|8@0+ (1,-127) [-127|128] "ms" ASDM
 SG_ OBJ_DIMENSION_WIDTH_ERR_043 : 23|6@0+ (0.01,0) [0|0.63] "m" ASDM
 SG_ OBJ_DIMENSION_LENGTH_ERR_043 : 41|10@0+ (0.01,0) [0|10.23] "m" ASDM
 SG_ OBJ_CLS_TYPE1_043 : 271|4@0+ (1,0) [0|15] "NA" ASDM
 SG_ OBJ_CLS_TYPE1_PROB_043 : 303|8@0+ (0.004,0) [0|1] "NA" ASDM
 SG_ OBJ_CLS_TYPE2_043 : 267|4@0+ (1,0) [0|15] "NA" ASDM
 SG_ OBJ_CLS_TYPE2_PROB_043 : 311|8@0+ (0.004,0) [0|1] "NA" ASDM
 SG_ OBJ_CLS_TYPE3_043 : 279|4@0+ (1,0) [0|15] "NA" ASDM
 SG_ OBJ_CLS_TYPE3_PROB_043 : 319|8@0+ (0.004,0) [0|1] "NA" ASDM
 SG_ OBJ_CLS_TYPE4_043 : 275|4@0+ (1,0) [0|15] "NA" ASDM
 SG_ OBJ_CLS_TYPE4_PROB_043 : 327|8@0+ (0.004,0) [0|1] "NA" ASDM
 SG_ OBJ_CLS_TYPE5_043 : 287|4@0+ (1,0) [0|15] "NA" ASDM
 SG_ OBJ_CLS_TYPE5_PROB_043 : 335|8@0+ (0.004,0) [0|1] "NA" ASDM
 SG_ OBJ_CLS_TYPE6_043 : 282|4@0+ (1,0) [0|15] "NA" ASDM
 SG_ OBJ_CLS_TYPE6_PROB_043 : 343|8@0+ (0.004,0) [0|1] "NA" ASDM
 SG_ OBJ_RCS_043 : 351|7@0+ (1,-64) [-64|63] "dBsm" ASDM
 SG_ OBJ_REF_PT_LONG_OFFSET_043 : 357|14@0+ (0.0001,0) [0|1] "NA" ASDM
 SG_ OBJ_REF_PT_LAT_OFFSET_043 : 370|14@0+ (0.0001,0) [0|1] "NA" ASDM
 SG_ OBJ_YAW_RATE_043 : 399|10@0+ (0.005,-2.24) [-2.24|2.24] "rad/s" ASDM
 SG_ OBJ_YAW_RATE_ERR_043 : 388|5@0+ (0.025,0) [0|0.775] "rad/s" ASDM
 SG_ OBJ_GROUP_ID_043 : 405|6@0+ (1,0) [0|63] "NA" ASDM
 SG_ OBJ_POS_ERR_CRR_COEF_043 : 415|8@0+ (0.01,-1.2) [-1.2|1] "NA" ASDM
 SG_ OBJ_VELOCITY_ERR_CRR_COEF_043 : 423|8@0+ (0.01,-1.2) [-1.2|1] "NA" ASDM
 SG_ OBJ_ACCEL_ERR_CRR_COEF_043 : 431|8@0+ (0.01,-1.2) [-1.2|1] "NA" ASDM

BO_ 619 RDR_TRACKER_OBJ_044: 64 G5_RDR03
 SG_ OBJ_ALIVE_TIME_044 : 255|16@0+ (1,0) [0|65535] "ms" ASDM
 SG_ OBJ_ACCELERATION_LONG_ERR_044 : 215|8@0+ (0.025,0) [0|6.375] "m/s^2" ASDM
 SG_ OBJ_ACCELERATION_LAT_ERR_044 : 223|8@0+ (0.025,0) [0|6.375] "m/s^2" ASDM
 SG_ OBJ_VELOCITY_LONG_ERR_044 : 143|8@0+ (0.05,0) [0|12.75] "m/s" ASDM
 SG_ OBJ_VELOCITY_LAT_ERR_044 : 151|8@0+ (0.05,0) [0|12.75] "m/s" ASDM
 SG_ OBJ_POS_LONG_ERR_044 : 95|8@0+ (0.025,0) [0|6.375] "m" ASDM
 SG_ OBJ_POS_LAT_ERR_044 : 103|8@0+ (0.025,0) [0|6.375] "m" ASDM
 SG_ OBJ_TRACK_MOTION_MODEL_044 : 9|2@0+ (1,0) [1|3] "NA" ASDM
 SG_ OBJ_DIMENSION_WIDTH_044 : 17|10@0+ (0.01,0) [0|10.23] "m" ASDM
 SG_ OBJ_DIMENSION_LENGTH_044 : 37|12@0+ (0.01,0) [0|40.95] "m" ASDM
 SG_ OBJ_EXISTENCE_PROB_044 : 229|14@0+ (0.0001,0) [0|1] "NA" ASDM
 SG_ OBJ_YAW_ANGLE_044 : 155|12@0+ (0.005,-10) [-10|10.475] "rad" ASDM
 SG_ OBJ_YAW_ANGLE_ERR_044 : 175|7@0+ (0.01,0) [0|1.27] "rad" ASDM
 SG_ OBJ_ID_044 : 7|8@0+ (1,0) [0|255] "NA" ASDM
 SG_ OBJ_MOVEMENT_STATUS_044 : 196|3@0+ (1,0) [0|3] "NA" ASDM
 SG_ OBJ_MEASUREMENT_STATUS_044 : 14|3@0+ (1,0) [0|7] "NA" ASDM
 SG_ OBJ_POS_LONG_044 : 63|16@0+ (0.01,-327) [-327|327] "m" ASDM
 SG_ OBJ_POS_LAT_044 : 79|16@0+ (0.01,-327) [-327|327] "m" ASDM
 SG_ OBJ_VELOCITY_LONG_044 : 110|15@0+ (0.01,-163) [-163|163] "m/s" ASDM
 SG_ OBJ_VELOCITY_LAT_044 : 126|15@0+ (0.01,-163) [-163|163] "m/s" ASDM
 SG_ OBJ_ACCELERATION_LONG_044 : 193|10@0+ (0.05,-20) [-20|20] "m/s^2" ASDM
 SG_ OBJ_ACCELERATION_LAT_044 : 177|10@0+ (0.05,-20) [-20|20] "m/s^2" ASDM
 SG_ OBJ_VEH_TRACK_FLAG_044 : 10|1@0+ (1,0) [0|1] "NA" ASDM
 SG_ OBJ_MH_CYCLE_COUNTER_044 : 487|8@0+ (1,0) [0|255] "NA" ASDM
 SG_ OBJ_MH_CRC16_044 : 495|16@0+ (1,0) [0|65535] "NA" ASDM
 SG_ OBJ_TIMESTAMP_OFFSET_044 : 247|8@0+ (1,-127) [-127|128] "ms" ASDM
 SG_ OBJ_DIMENSION_WIDTH_ERR_044 : 23|6@0+ (0.01,0) [0|0.63] "m" ASDM
 SG_ OBJ_DIMENSION_LENGTH_ERR_044 : 41|10@0+ (0.01,0) [0|10.23] "m" ASDM
 SG_ OBJ_CLS_TYPE1_044 : 271|4@0+ (1,0) [0|15] "NA" ASDM
 SG_ OBJ_CLS_TYPE1_PROB_044 : 303|8@0+ (0.004,0) [0|1] "NA" ASDM
 SG_ OBJ_CLS_TYPE2_044 : 267|4@0+ (1,0) [0|15] "NA" ASDM
 SG_ OBJ_CLS_TYPE2_PROB_044 : 311|8@0+ (0.004,0) [0|1] "NA" ASDM
 SG_ OBJ_CLS_TYPE3_044 : 279|4@0+ (1,0) [0|15] "NA" ASDM
 SG_ OBJ_CLS_TYPE3_PROB_044 : 319|8@0+ (0.004,0) [0|1] "NA" ASDM
 SG_ OBJ_CLS_TYPE4_044 : 275|4@0+ (1,0) [0|15] "NA" ASDM
 SG_ OBJ_CLS_TYPE4_PROB_044 : 327|8@0+ (0.004,0) [0|1] "NA" ASDM
 SG_ OBJ_CLS_TYPE5_044 : 287|4@0+ (1,0) [0|15] "NA" ASDM
 SG_ OBJ_CLS_TYPE5_PROB_044 : 335|8@0+ (0.004,0) [0|1] "NA" ASDM
 SG_ OBJ_CLS_TYPE6_044 : 282|4@0+ (1,0) [0|15] "NA" ASDM
 SG_ OBJ_CLS_TYPE6_PROB_044 : 343|8@0+ (0.004,0) [0|1] "NA" ASDM
 SG_ OBJ_RCS_044 : 351|7@0+ (1,-64) [-64|63] "dBsm" ASDM
 SG_ OBJ_REF_PT_LONG_OFFSET_044 : 357|14@0+ (0.0001,0) [0|1] "NA" ASDM
 SG_ OBJ_REF_PT_LAT_OFFSET_044 : 370|14@0+ (0.0001,0) [0|1] "NA" ASDM
 SG_ OBJ_YAW_RATE_044 : 399|10@0+ (0.005,-2.24) [-2.24|2.24] "rad/s" ASDM
 SG_ OBJ_YAW_RATE_ERR_044 : 388|5@0+ (0.025,0) [0|0.775] "rad/s" ASDM
 SG_ OBJ_GROUP_ID_044 : 405|6@0+ (1,0) [0|63] "NA" ASDM
 SG_ OBJ_POS_ERR_CRR_COEF_044 : 415|8@0+ (0.01,-1.2) [-1.2|1] "NA" ASDM
 SG_ OBJ_VELOCITY_ERR_CRR_COEF_044 : 423|8@0+ (0.01,-1.2) [-1.2|1] "NA" ASDM
 SG_ OBJ_ACCEL_ERR_CRR_COEF_044 : 431|8@0+ (0.01,-1.2) [-1.2|1] "NA" ASDM

BO_ 620 RDR_TRACKER_OBJ_045: 64 G5_RDR03
 SG_ OBJ_ALIVE_TIME_045 : 255|16@0+ (1,0) [0|65535] "ms" ASDM
 SG_ OBJ_ACCELERATION_LONG_ERR_045 : 215|8@0+ (0.025,0) [0|6.375] "m/s^2" ASDM
 SG_ OBJ_ACCELERATION_LAT_ERR_045 : 223|8@0+ (0.025,0) [0|6.375] "m/s^2" ASDM
 SG_ OBJ_VELOCITY_LONG_ERR_045 : 143|8@0+ (0.05,0) [0|12.75] "m/s" ASDM
 SG_ OBJ_VELOCITY_LAT_ERR_045 : 151|8@0+ (0.05,0) [0|12.75] "m/s" ASDM
 SG_ OBJ_POS_LONG_ERR_045 : 95|8@0+ (0.025,0) [0|6.375] "m" ASDM
 SG_ OBJ_POS_LAT_ERR_045 : 103|8@0+ (0.025,0) [0|6.375] "m" ASDM
 SG_ OBJ_TRACK_MOTION_MODEL_045 : 9|2@0+ (1,0) [1|3] "NA" ASDM
 SG_ OBJ_DIMENSION_WIDTH_045 : 17|10@0+ (0.01,0) [0|10.23] "m" ASDM
 SG_ OBJ_DIMENSION_LENGTH_045 : 37|12@0+ (0.01,0) [0|40.95] "m" ASDM
 SG_ OBJ_EXISTENCE_PROB_045 : 229|14@0+ (0.0001,0) [0|1] "NA" ASDM
 SG_ OBJ_YAW_ANGLE_045 : 155|12@0+ (0.005,-10) [-10|10.475] "rad" ASDM
 SG_ OBJ_YAW_ANGLE_ERR_045 : 175|7@0+ (0.01,0) [0|1.27] "rad" ASDM
 SG_ OBJ_ID_045 : 7|8@0+ (1,0) [0|255] "NA" ASDM
 SG_ OBJ_MOVEMENT_STATUS_045 : 196|3@0+ (1,0) [0|3] "NA" ASDM
 SG_ OBJ_MEASUREMENT_STATUS_045 : 14|3@0+ (1,0) [0|7] "NA" ASDM
 SG_ OBJ_POS_LONG_045 : 63|16@0+ (0.01,-327) [-327|327] "m" ASDM
 SG_ OBJ_POS_LAT_045 : 79|16@0+ (0.01,-327) [-327|327] "m" ASDM
 SG_ OBJ_VELOCITY_LONG_045 : 110|15@0+ (0.01,-163) [-163|163] "m/s" ASDM
 SG_ OBJ_VELOCITY_LAT_045 : 126|15@0+ (0.01,-163) [-163|163] "m/s" ASDM
 SG_ OBJ_ACCELERATION_LONG_045 : 193|10@0+ (0.05,-20) [-20|20] "m/s^2" ASDM
 SG_ OBJ_ACCELERATION_LAT_045 : 177|10@0+ (0.05,-20) [-20|20] "m/s^2" ASDM
 SG_ OBJ_VEH_TRACK_FLAG_045 : 10|1@0+ (1,0) [0|1] "NA" ASDM
 SG_ OBJ_MH_CYCLE_COUNTER_045 : 487|8@0+ (1,0) [0|255] "NA" ASDM
 SG_ OBJ_MH_CRC16_045 : 495|16@0+ (1,0) [0|65535] "NA" ASDM
 SG_ OBJ_TIMESTAMP_OFFSET_045 : 247|8@0+ (1,-127) [-127|128] "ms" ASDM
 SG_ OBJ_DIMENSION_WIDTH_ERR_045 : 23|6@0+ (0.01,0) [0|0.63] "m" ASDM
 SG_ OBJ_DIMENSION_LENGTH_ERR_045 : 41|10@0+ (0.01,0) [0|10.23] "m" ASDM
 SG_ OBJ_CLS_TYPE1_045 : 271|4@0+ (1,0) [0|15] "NA" ASDM
 SG_ OBJ_CLS_TYPE1_PROB_045 : 303|8@0+ (0.004,0) [0|1] "NA" ASDM
 SG_ OBJ_CLS_TYPE2_045 : 267|4@0+ (1,0) [0|15] "NA" ASDM
 SG_ OBJ_CLS_TYPE2_PROB_045 : 311|8@0+ (0.004,0) [0|1] "NA" ASDM
 SG_ OBJ_CLS_TYPE3_045 : 279|4@0+ (1,0) [0|15] "NA" ASDM
 SG_ OBJ_CLS_TYPE3_PROB_045 : 319|8@0+ (0.004,0) [0|1] "NA" ASDM
 SG_ OBJ_CLS_TYPE4_045 : 275|4@0+ (1,0) [0|15] "NA" ASDM
 SG_ OBJ_CLS_TYPE4_PROB_045 : 327|8@0+ (0.004,0) [0|1] "NA" ASDM
 SG_ OBJ_CLS_TYPE5_045 : 287|4@0+ (1,0) [0|15] "NA" ASDM
 SG_ OBJ_CLS_TYPE5_PROB_045 : 335|8@0+ (0.004,0) [0|1] "NA" ASDM
 SG_ OBJ_CLS_TYPE6_045 : 282|4@0+ (1,0) [0|15] "NA" ASDM
 SG_ OBJ_CLS_TYPE6_PROB_045 : 343|8@0+ (0.004,0) [0|1] "NA" ASDM
 SG_ OBJ_RCS_045 : 351|7@0+ (1,-64) [-64|63] "dBsm" ASDM
 SG_ OBJ_REF_PT_LONG_OFFSET_045 : 357|14@0+ (0.0001,0) [0|1] "NA" ASDM
 SG_ OBJ_REF_PT_LAT_OFFSET_045 : 370|14@0+ (0.0001,0) [0|1] "NA" ASDM
 SG_ OBJ_YAW_RATE_045 : 399|10@0+ (0.005,-2.24) [-2.24|2.24] "rad/s" ASDM
 SG_ OBJ_YAW_RATE_ERR_045 : 388|5@0+ (0.025,0) [0|0.775] "rad/s" ASDM
 SG_ OBJ_GROUP_ID_045 : 405|6@0+ (1,0) [0|63] "NA" ASDM
 SG_ OBJ_POS_ERR_CRR_COEF_045 : 415|8@0+ (0.01,-1.2) [-1.2|1] "NA" ASDM
 SG_ OBJ_VELOCITY_ERR_CRR_COEF_045 : 423|8@0+ (0.01,-1.2) [-1.2|1] "NA" ASDM
 SG_ OBJ_ACCEL_ERR_CRR_COEF_045 : 431|8@0+ (0.01,-1.2) [-1.2|1] "NA" ASDM

BO_ 621 RDR_TRACKER_OBJ_046: 64 G5_RDR03
 SG_ OBJ_ALIVE_TIME_046 : 255|16@0+ (1,0) [0|65535] "ms" ASDM
 SG_ OBJ_ACCELERATION_LONG_ERR_046 : 215|8@0+ (0.025,0) [0|6.375] "m/s^2" ASDM
 SG_ OBJ_ACCELERATION_LAT_ERR_046 : 223|8@0+ (0.025,0) [0|6.375] "m/s^2" ASDM
 SG_ OBJ_VELOCITY_LONG_ERR_046 : 143|8@0+ (0.05,0) [0|12.75] "m/s" ASDM
 SG_ OBJ_VELOCITY_LAT_ERR_046 : 151|8@0+ (0.05,0) [0|12.75] "m/s" ASDM
 SG_ OBJ_POS_LONG_ERR_046 : 95|8@0+ (0.025,0) [0|6.375] "m" ASDM
 SG_ OBJ_POS_LAT_ERR_046 : 103|8@0+ (0.025,0) [0|6.375] "m" ASDM
 SG_ OBJ_TRACK_MOTION_MODEL_046 : 9|2@0+ (1,0) [1|3] "NA" ASDM
 SG_ OBJ_DIMENSION_WIDTH_046 : 17|10@0+ (0.01,0) [0|10.23] "m" ASDM
 SG_ OBJ_DIMENSION_LENGTH_046 : 37|12@0+ (0.01,0) [0|40.95] "m" ASDM
 SG_ OBJ_EXISTENCE_PROB_046 : 229|14@0+ (0.0001,0) [0|1] "NA" ASDM
 SG_ OBJ_YAW_ANGLE_046 : 155|12@0+ (0.005,-10) [-10|10.475] "rad" ASDM
 SG_ OBJ_YAW_ANGLE_ERR_046 : 175|7@0+ (0.01,0) [0|1.27] "rad" ASDM
 SG_ OBJ_ID_046 : 7|8@0+ (1,0) [0|255] "NA" ASDM
 SG_ OBJ_MOVEMENT_STATUS_046 : 196|3@0+ (1,0) [0|3] "NA" ASDM
 SG_ OBJ_MEASUREMENT_STATUS_046 : 14|3@0+ (1,0) [0|7] "NA" ASDM
 SG_ OBJ_POS_LONG_046 : 63|16@0+ (0.01,-327) [-327|327] "m" ASDM
 SG_ OBJ_POS_LAT_046 : 79|16@0+ (0.01,-327) [-327|327] "m" ASDM
 SG_ OBJ_VELOCITY_LONG_046 : 110|15@0+ (0.01,-163) [-163|163] "m/s" ASDM
 SG_ OBJ_VELOCITY_LAT_046 : 126|15@0+ (0.01,-163) [-163|163] "m/s" ASDM
 SG_ OBJ_ACCELERATION_LONG_046 : 193|10@0+ (0.05,-20) [-20|20] "m/s^2" ASDM
 SG_ OBJ_ACCELERATION_LAT_046 : 177|10@0+ (0.05,-20) [-20|20] "m/s^2" ASDM
 SG_ OBJ_VEH_TRACK_FLAG_046 : 10|1@0+ (1,0) [0|1] "NA" ASDM
 SG_ OBJ_MH_CYCLE_COUNTER_046 : 487|8@0+ (1,0) [0|255] "NA" ASDM
 SG_ OBJ_MH_CRC16_046 : 495|16@0+ (1,0) [0|65535] "NA" ASDM
 SG_ OBJ_TIMESTAMP_OFFSET_046 : 247|8@0+ (1,-127) [-127|128] "ms" ASDM
 SG_ OBJ_DIMENSION_WIDTH_ERR_046 : 23|6@0+ (0.01,0) [0|0.63] "m" ASDM
 SG_ OBJ_DIMENSION_LENGTH_ERR_046 : 41|10@0+ (0.01,0) [0|10.23] "m" ASDM
 SG_ OBJ_CLS_TYPE1_046 : 271|4@0+ (1,0) [0|15] "NA" ASDM
 SG_ OBJ_CLS_TYPE1_PROB_046 : 303|8@0+ (0.004,0) [0|1] "NA" ASDM
 SG_ OBJ_CLS_TYPE2_046 : 267|4@0+ (1,0) [0|15] "NA" ASDM
 SG_ OBJ_CLS_TYPE2_PROB_046 : 311|8@0+ (0.004,0) [0|1] "NA" ASDM
 SG_ OBJ_CLS_TYPE3_046 : 279|4@0+ (1,0) [0|15] "NA" ASDM
 SG_ OBJ_CLS_TYPE3_PROB_046 : 319|8@0+ (0.004,0) [0|1] "NA" ASDM
 SG_ OBJ_CLS_TYPE4_046 : 275|4@0+ (1,0) [0|15] "NA" ASDM
 SG_ OBJ_CLS_TYPE4_PROB_046 : 327|8@0+ (0.004,0) [0|1] "NA" ASDM
 SG_ OBJ_CLS_TYPE5_046 : 287|4@0+ (1,0) [0|15] "NA" ASDM
 SG_ OBJ_CLS_TYPE5_PROB_046 : 335|8@0+ (0.004,0) [0|1] "NA" ASDM
 SG_ OBJ_CLS_TYPE6_046 : 282|4@0+ (1,0) [0|15] "NA" ASDM
 SG_ OBJ_CLS_TYPE6_PROB_046 : 343|8@0+ (0.004,0) [0|1] "NA" ASDM
 SG_ OBJ_RCS_046 : 351|7@0+ (1,-64) [-64|63] "dBsm" ASDM
 SG_ OBJ_REF_PT_LONG_OFFSET_046 : 357|14@0+ (0.0001,0) [0|1] "NA" ASDM
 SG_ OBJ_REF_PT_LAT_OFFSET_046 : 370|14@0+ (0.0001,0) [0|1] "NA" ASDM
 SG_ OBJ_YAW_RATE_046 : 399|10@0+ (0.005,-2.24) [-2.24|2.24] "rad/s" ASDM
 SG_ OBJ_YAW_RATE_ERR_046 : 388|5@0+ (0.025,0) [0|0.775] "rad/s" ASDM
 SG_ OBJ_GROUP_ID_046 : 405|6@0+ (1,0) [0|63] "NA" ASDM
 SG_ OBJ_POS_ERR_CRR_COEF_046 : 415|8@0+ (0.01,-1.2) [-1.2|1] "NA" ASDM
 SG_ OBJ_VELOCITY_ERR_CRR_COEF_046 : 423|8@0+ (0.01,-1.2) [-1.2|1] "NA" ASDM
 SG_ OBJ_ACCEL_ERR_CRR_COEF_046 : 431|8@0+ (0.01,-1.2) [-1.2|1] "NA" ASDM

BO_ 622 RDR_TRACKER_OBJ_047: 64 G5_RDR03
 SG_ OBJ_ALIVE_TIME_047 : 255|16@0+ (1,0) [0|65535] "ms" ASDM
 SG_ OBJ_ACCELERATION_LONG_ERR_047 : 215|8@0+ (0.025,0) [0|6.375] "m/s^2" ASDM
 SG_ OBJ_ACCELERATION_LAT_ERR_047 : 223|8@0+ (0.025,0) [0|6.375] "m/s^2" ASDM
 SG_ OBJ_VELOCITY_LONG_ERR_047 : 143|8@0+ (0.05,0) [0|12.75] "m/s" ASDM
 SG_ OBJ_VELOCITY_LAT_ERR_047 : 151|8@0+ (0.05,0) [0|12.75] "m/s" ASDM
 SG_ OBJ_POS_LONG_ERR_047 : 95|8@0+ (0.025,0) [0|6.375] "m" ASDM
 SG_ OBJ_POS_LAT_ERR_047 : 103|8@0+ (0.025,0) [0|6.375] "m" ASDM
 SG_ OBJ_TRACK_MOTION_MODEL_047 : 9|2@0+ (1,0) [1|3] "NA" ASDM
 SG_ OBJ_DIMENSION_WIDTH_047 : 17|10@0+ (0.01,0) [0|10.23] "m" ASDM
 SG_ OBJ_DIMENSION_LENGTH_047 : 37|12@0+ (0.01,0) [0|40.95] "m" ASDM
 SG_ OBJ_EXISTENCE_PROB_047 : 229|14@0+ (0.0001,0) [0|1] "NA" ASDM
 SG_ OBJ_YAW_ANGLE_047 : 155|12@0+ (0.005,-10) [-10|10.475] "rad" ASDM
 SG_ OBJ_YAW_ANGLE_ERR_047 : 175|7@0+ (0.01,0) [0|1.27] "rad" ASDM
 SG_ OBJ_ID_047 : 7|8@0+ (1,0) [0|255] "NA" ASDM
 SG_ OBJ_MOVEMENT_STATUS_047 : 196|3@0+ (1,0) [0|3] "NA" ASDM
 SG_ OBJ_MEASUREMENT_STATUS_047 : 14|3@0+ (1,0) [0|7] "NA" ASDM
 SG_ OBJ_POS_LONG_047 : 63|16@0+ (0.01,-327) [-327|327] "m" ASDM
 SG_ OBJ_POS_LAT_047 : 79|16@0+ (0.01,-327) [-327|327] "m" ASDM
 SG_ OBJ_VELOCITY_LONG_047 : 110|15@0+ (0.01,-163) [-163|163] "m/s" ASDM
 SG_ OBJ_VELOCITY_LAT_047 : 126|15@0+ (0.01,-163) [-163|163] "m/s" ASDM
 SG_ OBJ_ACCELERATION_LONG_047 : 193|10@0+ (0.05,-20) [-20|20] "m/s^2" ASDM
 SG_ OBJ_ACCELERATION_LAT_047 : 177|10@0+ (0.05,-20) [-20|20] "m/s^2" ASDM
 SG_ OBJ_VEH_TRACK_FLAG_047 : 10|1@0+ (1,0) [0|1] "NA" ASDM
 SG_ OBJ_MH_CYCLE_COUNTER_047 : 487|8@0+ (1,0) [0|255] "NA" ASDM
 SG_ OBJ_MH_CRC16_047 : 495|16@0+ (1,0) [0|65535] "NA" ASDM
 SG_ OBJ_TIMESTAMP_OFFSET_047 : 247|8@0+ (1,-127) [-127|128] "ms" ASDM
 SG_ OBJ_DIMENSION_WIDTH_ERR_047 : 23|6@0+ (0.01,0) [0|0.63] "m" ASDM
 SG_ OBJ_DIMENSION_LENGTH_ERR_047 : 41|10@0+ (0.01,0) [0|10.23] "m" ASDM
 SG_ OBJ_CLS_TYPE1_047 : 271|4@0+ (1,0) [0|15] "NA" ASDM
 SG_ OBJ_CLS_TYPE1_PROB_047 : 303|8@0+ (0.004,0) [0|1] "NA" ASDM
 SG_ OBJ_CLS_TYPE2_047 : 267|4@0+ (1,0) [0|15] "NA" ASDM
 SG_ OBJ_CLS_TYPE2_PROB_047 : 311|8@0+ (0.004,0) [0|1] "NA" ASDM
 SG_ OBJ_CLS_TYPE3_047 : 279|4@0+ (1,0) [0|15] "NA" ASDM
 SG_ OBJ_CLS_TYPE3_PROB_047 : 319|8@0+ (0.004,0) [0|1] "NA" ASDM
 SG_ OBJ_CLS_TYPE4_047 : 275|4@0+ (1,0) [0|15] "NA" ASDM
 SG_ OBJ_CLS_TYPE4_PROB_047 : 327|8@0+ (0.004,0) [0|1] "NA" ASDM
 SG_ OBJ_CLS_TYPE5_047 : 287|4@0+ (1,0) [0|15] "NA" ASDM
 SG_ OBJ_CLS_TYPE5_PROB_047 : 335|8@0+ (0.004,0) [0|1] "NA" ASDM
 SG_ OBJ_CLS_TYPE6_047 : 282|4@0+ (1,0) [0|15] "NA" ASDM
 SG_ OBJ_CLS_TYPE6_PROB_047 : 343|8@0+ (0.004,0) [0|1] "NA" ASDM
 SG_ OBJ_RCS_047 : 351|7@0+ (1,-64) [-64|63] "dBsm" ASDM
 SG_ OBJ_REF_PT_LONG_OFFSET_047 : 357|14@0+ (0.0001,0) [0|1] "NA" ASDM
 SG_ OBJ_REF_PT_LAT_OFFSET_047 : 370|14@0+ (0.0001,0) [0|1] "NA" ASDM
 SG_ OBJ_YAW_RATE_047 : 399|10@0+ (0.005,-2.24) [-2.24|2.24] "rad/s" ASDM
 SG_ OBJ_YAW_RATE_ERR_047 : 388|5@0+ (0.025,0) [0|0.775] "rad/s" ASDM
 SG_ OBJ_GROUP_ID_047 : 405|6@0+ (1,0) [0|63] "NA" ASDM
 SG_ OBJ_POS_ERR_CRR_COEF_047 : 415|8@0+ (0.01,-1.2) [-1.2|1] "NA" ASDM
 SG_ OBJ_VELOCITY_ERR_CRR_COEF_047 : 423|8@0+ (0.01,-1.2) [-1.2|1] "NA" ASDM
 SG_ OBJ_ACCEL_ERR_CRR_COEF_047 : 431|8@0+ (0.01,-1.2) [-1.2|1] "NA" ASDM

BO_ 623 RDR_TRACKER_OBJ_048: 64 G5_RDR03
 SG_ OBJ_ALIVE_TIME_048 : 255|16@0+ (1,0) [0|65535] "ms" ASDM
 SG_ OBJ_ACCELERATION_LONG_ERR_048 : 215|8@0+ (0.025,0) [0|6.375] "m/s^2" ASDM
 SG_ OBJ_ACCELERATION_LAT_ERR_048 : 223|8@0+ (0.025,0) [0|6.375] "m/s^2" ASDM
 SG_ OBJ_VELOCITY_LONG_ERR_048 : 143|8@0+ (0.05,0) [0|12.75] "m/s" ASDM
 SG_ OBJ_VELOCITY_LAT_ERR_048 : 151|8@0+ (0.05,0) [0|12.75] "m/s" ASDM
 SG_ OBJ_POS_LONG_ERR_048 : 95|8@0+ (0.025,0) [0|6.375] "m" ASDM
 SG_ OBJ_POS_LAT_ERR_048 : 103|8@0+ (0.025,0) [0|6.375] "m" ASDM
 SG_ OBJ_TRACK_MOTION_MODEL_048 : 9|2@0+ (1,0) [1|3] "NA" ASDM
 SG_ OBJ_DIMENSION_WIDTH_048 : 17|10@0+ (0.01,0) [0|10.23] "m" ASDM
 SG_ OBJ_DIMENSION_LENGTH_048 : 37|12@0+ (0.01,0) [0|40.95] "m" ASDM
 SG_ OBJ_EXISTENCE_PROB_048 : 229|14@0+ (0.0001,0) [0|1] "NA" ASDM
 SG_ OBJ_YAW_ANGLE_048 : 155|12@0+ (0.005,-10) [-10|10.475] "rad" ASDM
 SG_ OBJ_YAW_ANGLE_ERR_048 : 175|7@0+ (0.01,0) [0|1.27] "rad" ASDM
 SG_ OBJ_ID_048 : 7|8@0+ (1,0) [0|255] "NA" ASDM
 SG_ OBJ_MOVEMENT_STATUS_048 : 196|3@0+ (1,0) [0|3] "NA" ASDM
 SG_ OBJ_MEASUREMENT_STATUS_048 : 14|3@0+ (1,0) [0|7] "NA" ASDM
 SG_ OBJ_POS_LONG_048 : 63|16@0+ (0.01,-327) [-327|327] "m" ASDM
 SG_ OBJ_POS_LAT_048 : 79|16@0+ (0.01,-327) [-327|327] "m" ASDM
 SG_ OBJ_VELOCITY_LONG_048 : 110|15@0+ (0.01,-163) [-163|163] "m/s" ASDM
 SG_ OBJ_VELOCITY_LAT_048 : 126|15@0+ (0.01,-163) [-163|163] "m/s" ASDM
 SG_ OBJ_ACCELERATION_LONG_048 : 193|10@0+ (0.05,-20) [-20|20] "m/s^2" ASDM
 SG_ OBJ_ACCELERATION_LAT_048 : 177|10@0+ (0.05,-20) [-20|20] "m/s^2" ASDM
 SG_ OBJ_VEH_TRACK_FLAG_048 : 10|1@0+ (1,0) [0|1] "NA" ASDM
 SG_ OBJ_MH_CYCLE_COUNTER_048 : 487|8@0+ (1,0) [0|255] "NA" ASDM
 SG_ OBJ_MH_CRC16_048 : 495|16@0+ (1,0) [0|65535] "NA" ASDM
 SG_ OBJ_TIMESTAMP_OFFSET_048 : 247|8@0+ (1,-127) [-127|128] "ms" ASDM
 SG_ OBJ_DIMENSION_WIDTH_ERR_048 : 23|6@0+ (0.01,0) [0|0.63] "m" ASDM
 SG_ OBJ_DIMENSION_LENGTH_ERR_048 : 41|10@0+ (0.01,0) [0|10.23] "m" ASDM
 SG_ OBJ_CLS_TYPE1_048 : 271|4@0+ (1,0) [0|15] "NA" ASDM
 SG_ OBJ_CLS_TYPE1_PROB_048 : 303|8@0+ (0.004,0) [0|1] "NA" ASDM
 SG_ OBJ_CLS_TYPE2_048 : 267|4@0+ (1,0) [0|15] "NA" ASDM
 SG_ OBJ_CLS_TYPE2_PROB_048 : 311|8@0+ (0.004,0) [0|1] "NA" ASDM
 SG_ OBJ_CLS_TYPE3_048 : 279|4@0+ (1,0) [0|15] "NA" ASDM
 SG_ OBJ_CLS_TYPE3_PROB_048 : 319|8@0+ (0.004,0) [0|1] "NA" ASDM
 SG_ OBJ_CLS_TYPE4_048 : 275|4@0+ (1,0) [0|15] "NA" ASDM
 SG_ OBJ_CLS_TYPE4_PROB_048 : 327|8@0+ (0.004,0) [0|1] "NA" ASDM
 SG_ OBJ_CLS_TYPE5_048 : 287|4@0+ (1,0) [0|15] "NA" ASDM
 SG_ OBJ_CLS_TYPE5_PROB_048 : 335|8@0+ (0.004,0) [0|1] "NA" ASDM
 SG_ OBJ_CLS_TYPE6_048 : 282|4@0+ (1,0) [0|15] "NA" ASDM
 SG_ OBJ_CLS_TYPE6_PROB_048 : 343|8@0+ (0.004,0) [0|1] "NA" ASDM
 SG_ OBJ_RCS_048 : 351|7@0+ (1,-64) [-64|63] "dBsm" ASDM
 SG_ OBJ_REF_PT_LONG_OFFSET_048 : 357|14@0+ (0.0001,0) [0|1] "NA" ASDM
 SG_ OBJ_REF_PT_LAT_OFFSET_048 : 370|14@0+ (0.0001,0) [0|1] "NA" ASDM
 SG_ OBJ_YAW_RATE_048 : 399|10@0+ (0.005,-2.24) [-2.24|2.24] "rad/s" ASDM
 SG_ OBJ_YAW_RATE_ERR_048 : 388|5@0+ (0.025,0) [0|0.775] "rad/s" ASDM
 SG_ OBJ_GROUP_ID_048 : 405|6@0+ (1,0) [0|63] "NA" ASDM
 SG_ OBJ_POS_ERR_CRR_COEF_048 : 415|8@0+ (0.01,-1.2) [-1.2|1] "NA" ASDM
 SG_ OBJ_VELOCITY_ERR_CRR_COEF_048 : 423|8@0+ (0.01,-1.2) [-1.2|1] "NA" ASDM
 SG_ OBJ_ACCEL_ERR_CRR_COEF_048 : 431|8@0+ (0.01,-1.2) [-1.2|1] "NA" ASDM

CM_ SG_ 607 OBJ_ALIVE_TIME_032 "Time since object initialization in msec. Tracker internal may have bigger values. On the output interface, we should saturate the signal in that case.";
CM_ SG_ 607 OBJ_ACCELERATION_LONG_ERR_032 "acceleration along Longi  direction";
CM_ SG_ 607 OBJ_ACCELERATION_LAT_ERR_032 "acceleration along Lat direction error";
CM_ SG_ 607 OBJ_POS_LONG_ERR_032 "Lat-position error of object track's centroid in VCS coordinate";
CM_ SG_ 607 OBJ_POS_LAT_ERR_032 "Lat-position error of object track's centroid in VCS coordinate";
CM_ SG_ 607 OBJ_TRACK_MOTION_MODEL_032 "Object tracking uses a motion model for tracking moving items";
CM_ SG_ 607 OBJ_DIMENSION_WIDTH_032 "Lat distance from centroid to edge of bounding box.";
CM_ SG_ 607 OBJ_DIMENSION_LENGTH_032 "Longi distance from centroid to edge of bounding box.";
CM_ SG_ 607 OBJ_EXISTENCE_PROB_032 "Probability that the target is an actual target";
CM_ SG_ 607 OBJ_YAW_ANGLE_032 "Orientation of track's bounding box in VCS coordinate";
CM_ SG_ 607 OBJ_ID_032 "ID of object tracks, zero-ID represents an inactive track";
CM_ SG_ 607 OBJ_MOVEMENT_STATUS_032 "Information about a possible movement of the object during tracking";
CM_ SG_ 607 OBJ_MEASUREMENT_STATUS_032 "Objects should be sent out as fast as possible, even if not all statuses are observed and the object’s
signals might not be fully filled.";
CM_ SG_ 607 OBJ_POS_LONG_032 "Long-position of object track's centroid in VCS coordinate";
CM_ SG_ 607 OBJ_POS_LAT_032 "Lat-position of object track's centroid in VCS coordinate";
CM_ SG_ 607 OBJ_VELOCITY_LONG_032 "Over-the-ground velocity of object track's centroid along Long direction (in VCS coordinate)";
CM_ SG_ 607 OBJ_VELOCITY_LAT_032 "Over-the-ground velocity of object track's centroid along Lat direction (in VCS coordinate)";
CM_ SG_ 607 OBJ_ACCELERATION_LONG_032 "Over-the-ground track acceleration along Longi direction (in VCS coordinate)";
CM_ SG_ 607 OBJ_ACCELERATION_LAT_032 "Over-the-ground track acceleration along Lat direction (in VCS coordinate)";
CM_ SG_ 607 OBJ_VEH_TRACK_FLAG_032 "Indicates if current track is a vehicle";
CM_ SG_ 607 OBJ_TIMESTAMP_OFFSET_032 "A timestamp offset from the object list header timestamp for each object as we have different timestamps from different sensors leading to different timestamps on each object";
CM_ SG_ 607 OBJ_DIMENSION_WIDTH_ERR_032 "Lat distance or length error";
CM_ SG_ 607 OBJ_DIMENSION_LENGTH_ERR_032 "Longi distance or length error";
CM_ SG_ 607 OBJ_CLS_TYPE1_032 "Classification Type 1(Highest Prob), selected from ENUM list";
CM_ SG_ 607 OBJ_CLS_TYPE1_PROB_032 "Classification Type 1 probablity";
CM_ SG_ 607 OBJ_CLS_TYPE6_032 "Classification Type 6(Lowest Prob), selected from ENUM list";
CM_ SG_ 607 OBJ_CLS_TYPE6_PROB_032 "Classification Type 1 probablity";
CM_ SG_ 607 OBJ_RCS_032 "Representative RCS of the complete recognized object, Not implemented";
CM_ SG_ 607 OBJ_REF_PT_LONG_OFFSET_032 "Outer edges of the recognized object’s bounding box in Y axis";
CM_ SG_ 607 OBJ_REF_PT_LAT_OFFSET_032 "Outer edges of the recognized object’s bounding box in X axis";
CM_ SG_ 607 OBJ_YAW_RATE_032 "Orientation rate of track's bounding box in VCS coordinate";
CM_ SG_ 607 OBJ_GROUP_ID_032 "Objects which are linked together shall have same group ID";
CM_ SG_ 607 OBJ_POS_ERR_CRR_COEF_032 "vx-vy correlation due to small error in radial direction and big in cross radial - position Correlation Coefficient Error";
CM_ SG_ 607 OBJ_VELOCITY_ERR_CRR_COEF_032 "vx-vy correlation due to small error in radial direction and big in cross radial - velocity Correlation Coefficient Error";
CM_ SG_ 607 OBJ_ACCEL_ERR_CRR_COEF_032 "vx-vy correlation due to small error in radial direction and big in cross radial - Acceleration Correlation Coefficient Error";
CM_ SG_ 608 OBJ_ALIVE_TIME_033 "Time since object initialization in msec. Tracker internal may have bigger values. On the output interface, we should saturate the signal in that case.";
CM_ SG_ 608 OBJ_ACCELERATION_LONG_ERR_033 "acceleration along Longi  direction";
CM_ SG_ 608 OBJ_ACCELERATION_LAT_ERR_033 "acceleration along Lat direction error";
CM_ SG_ 608 OBJ_POS_LONG_ERR_033 "Lat-position error of object track's centroid in VCS coordinate";
CM_ SG_ 608 OBJ_POS_LAT_ERR_033 "Lat-position error of object track's centroid in VCS coordinate";
CM_ SG_ 608 OBJ_TRACK_MOTION_MODEL_033 "Object tracking uses a motion model for tracking moving items";
CM_ SG_ 608 OBJ_DIMENSION_WIDTH_033 "Lat distance from centroid to edge of bounding box.";
CM_ SG_ 608 OBJ_DIMENSION_LENGTH_033 "Longi distance from centroid to edge of bounding box.";
CM_ SG_ 608 OBJ_EXISTENCE_PROB_033 "Probability that the target is an actual target";
CM_ SG_ 608 OBJ_YAW_ANGLE_033 "Orientation of track's bounding box in VCS coordinate";
CM_ SG_ 608 OBJ_ID_033 "ID of object tracks, zero-ID represents an inactive track";
CM_ SG_ 608 OBJ_MOVEMENT_STATUS_033 "Information about a possible movement of the object during tracking";
CM_ SG_ 608 OBJ_MEASUREMENT_STATUS_033 "Objects should be sent out as fast as possible, even if not all statuses are observed and the object’s
signals might not be fully filled.";
CM_ SG_ 608 OBJ_POS_LONG_033 "Long-position of object track's centroid in VCS coordinate";
CM_ SG_ 608 OBJ_POS_LAT_033 "Lat-position of object track's centroid in VCS coordinate";
CM_ SG_ 608 OBJ_VELOCITY_LONG_033 "Over-the-ground velocity of object track's centroid along Long direction (in VCS coordinate)";
CM_ SG_ 608 OBJ_VELOCITY_LAT_033 "Over-the-ground velocity of object track's centroid along Lat direction (in VCS coordinate)";
CM_ SG_ 608 OBJ_ACCELERATION_LONG_033 "Over-the-ground track acceleration along Longi direction (in VCS coordinate)";
CM_ SG_ 608 OBJ_ACCELERATION_LAT_033 "Over-the-ground track acceleration along Lat direction (in VCS coordinate)";
CM_ SG_ 608 OBJ_VEH_TRACK_FLAG_033 "Indicates if current track is a vehicle";
CM_ SG_ 608 OBJ_TIMESTAMP_OFFSET_033 "A timestamp offset from the object list header timestamp for each object as we have different timestamps from different sensors leading to different timestamps on each object";
CM_ SG_ 608 OBJ_DIMENSION_WIDTH_ERR_033 "Lat distance or length error";
CM_ SG_ 608 OBJ_DIMENSION_LENGTH_ERR_033 "Longi distance or length error";
CM_ SG_ 608 OBJ_CLS_TYPE1_033 "Classification Type 1(Highest Prob), selected from ENUM list";
CM_ SG_ 608 OBJ_CLS_TYPE1_PROB_033 "Classification Type 1 probablity";
CM_ SG_ 608 OBJ_CLS_TYPE6_033 "Classification Type 6(Lowest Prob), selected from ENUM list";
CM_ SG_ 608 OBJ_CLS_TYPE6_PROB_033 "Classification Type 1 probablity";
CM_ SG_ 608 OBJ_RCS_033 "Representative RCS of the complete recognized object, Not implemented";
CM_ SG_ 608 OBJ_REF_PT_LONG_OFFSET_033 "Outer edges of the recognized object’s bounding box in Y axis";
CM_ SG_ 608 OBJ_REF_PT_LAT_OFFSET_033 "Outer edges of the recognized object’s bounding box in X axis";
CM_ SG_ 608 OBJ_YAW_RATE_033 "Orientation rate of track's bounding box in VCS coordinate";
CM_ SG_ 608 OBJ_GROUP_ID_033 "Objects which are linked together shall have same group ID";
CM_ SG_ 608 OBJ_POS_ERR_CRR_COEF_033 "vx-vy correlation due to small error in radial direction and big in cross radial - position Correlation Coefficient Error";
CM_ SG_ 608 OBJ_VELOCITY_ERR_CRR_COEF_033 "vx-vy correlation due to small error in radial direction and big in cross radial - velocity Correlation Coefficient Error";
CM_ SG_ 608 OBJ_ACCEL_ERR_CRR_COEF_033 "vx-vy correlation due to small error in radial direction and big in cross radial - Acceleration Correlation Coefficient Error";
CM_ SG_ 609 OBJ_ALIVE_TIME_034 "Time since object initialization in msec. Tracker internal may have bigger values. On the output interface, we should saturate the signal in that case.";
CM_ SG_ 609 OBJ_ACCELERATION_LONG_ERR_034 "acceleration along Longi  direction";
CM_ SG_ 609 OBJ_ACCELERATION_LAT_ERR_034 "acceleration along Lat direction error";
CM_ SG_ 609 OBJ_POS_LONG_ERR_034 "Lat-position error of object track's centroid in VCS coordinate";
CM_ SG_ 609 OBJ_POS_LAT_ERR_034 "Lat-position error of object track's centroid in VCS coordinate";
CM_ SG_ 609 OBJ_TRACK_MOTION_MODEL_034 "Object tracking uses a motion model for tracking moving items";
CM_ SG_ 609 OBJ_DIMENSION_WIDTH_034 "Lat distance from centroid to edge of bounding box.";
CM_ SG_ 609 OBJ_DIMENSION_LENGTH_034 "Longi distance from centroid to edge of bounding box.";
CM_ SG_ 609 OBJ_EXISTENCE_PROB_034 "Probability that the target is an actual target";
CM_ SG_ 609 OBJ_YAW_ANGLE_034 "Orientation of track's bounding box in VCS coordinate";
CM_ SG_ 609 OBJ_ID_034 "ID of object tracks, zero-ID represents an inactive track";
CM_ SG_ 609 OBJ_MOVEMENT_STATUS_034 "Information about a possible movement of the object during tracking";
CM_ SG_ 609 OBJ_MEASUREMENT_STATUS_034 "Objects should be sent out as fast as possible, even if not all statuses are observed and the object’s
signals might not be fully filled.";
CM_ SG_ 609 OBJ_POS_LONG_034 "Long-position of object track's centroid in VCS coordinate";
CM_ SG_ 609 OBJ_POS_LAT_034 "Lat-position of object track's centroid in VCS coordinate";
CM_ SG_ 609 OBJ_VELOCITY_LONG_034 "Over-the-ground velocity of object track's centroid along Long direction (in VCS coordinate)";
CM_ SG_ 609 OBJ_VELOCITY_LAT_034 "Over-the-ground velocity of object track's centroid along Lat direction (in VCS coordinate)";
CM_ SG_ 609 OBJ_ACCELERATION_LONG_034 "Over-the-ground track acceleration along Longi direction (in VCS coordinate)";
CM_ SG_ 609 OBJ_ACCELERATION_LAT_034 "Over-the-ground track acceleration along Lat direction (in VCS coordinate)";
CM_ SG_ 609 OBJ_VEH_TRACK_FLAG_034 "Indicates if current track is a vehicle";
CM_ SG_ 609 OBJ_TIMESTAMP_OFFSET_034 "A timestamp offset from the object list header timestamp for each object as we have different timestamps from different sensors leading to different timestamps on each object";
CM_ SG_ 609 OBJ_DIMENSION_WIDTH_ERR_034 "Lat distance or length error";
CM_ SG_ 609 OBJ_DIMENSION_LENGTH_ERR_034 "Longi distance or length error";
CM_ SG_ 609 OBJ_CLS_TYPE1_034 "Classification Type 1(Highest Prob), selected from ENUM list";
CM_ SG_ 609 OBJ_CLS_TYPE1_PROB_034 "Classification Type 1 probablity";
CM_ SG_ 609 OBJ_CLS_TYPE6_034 "Classification Type 6(Lowest Prob), selected from ENUM list";
CM_ SG_ 609 OBJ_CLS_TYPE6_PROB_034 "Classification Type 1 probablity";
CM_ SG_ 609 OBJ_RCS_034 "Representative RCS of the complete recognized object, Not implemented";
CM_ SG_ 609 OBJ_REF_PT_LONG_OFFSET_034 "Outer edges of the recognized object’s bounding box in Y axis";
CM_ SG_ 609 OBJ_REF_PT_LAT_OFFSET_034 "Outer edges of the recognized object’s bounding box in X axis";
CM_ SG_ 609 OBJ_YAW_RATE_034 "Orientation rate of track's bounding box in VCS coordinate";
CM_ SG_ 609 OBJ_GROUP_ID_034 "Objects which are linked together shall have same group ID";
CM_ SG_ 609 OBJ_POS_ERR_CRR_COEF_034 "vx-vy correlation due to small error in radial direction and big in cross radial - position Correlation Coefficient Error";
CM_ SG_ 609 OBJ_VELOCITY_ERR_CRR_COEF_034 "vx-vy correlation due to small error in radial direction and big in cross radial - velocity Correlation Coefficient Error";
CM_ SG_ 609 OBJ_ACCEL_ERR_CRR_COEF_034 "vx-vy correlation due to small error in radial direction and big in cross radial - Acceleration Correlation Coefficient Error";
CM_ SG_ 610 OBJ_ALIVE_TIME_035 "Time since object initialization in msec. Tracker internal may have bigger values. On the output interface, we should saturate the signal in that case.";
CM_ SG_ 610 OBJ_ACCELERATION_LONG_ERR_035 "acceleration along Longi  direction";
CM_ SG_ 610 OBJ_ACCELERATION_LAT_ERR_035 "acceleration along Lat direction error";
CM_ SG_ 610 OBJ_POS_LONG_ERR_035 "Lat-position error of object track's centroid in VCS coordinate";
CM_ SG_ 610 OBJ_POS_LAT_ERR_035 "Lat-position error of object track's centroid in VCS coordinate";
CM_ SG_ 610 OBJ_TRACK_MOTION_MODEL_035 "Object tracking uses a motion model for tracking moving items";
CM_ SG_ 610 OBJ_DIMENSION_WIDTH_035 "Lat distance from centroid to edge of bounding box.";
CM_ SG_ 610 OBJ_DIMENSION_LENGTH_035 "Longi distance from centroid to edge of bounding box.";
CM_ SG_ 610 OBJ_EXISTENCE_PROB_035 "Probability that the target is an actual target";
CM_ SG_ 610 OBJ_YAW_ANGLE_035 "Orientation of track's bounding box in VCS coordinate";
CM_ SG_ 610 OBJ_ID_035 "ID of object tracks, zero-ID represents an inactive track";
CM_ SG_ 610 OBJ_MOVEMENT_STATUS_035 "Information about a possible movement of the object during tracking";
CM_ SG_ 610 OBJ_MEASUREMENT_STATUS_035 "Objects should be sent out as fast as possible, even if not all statuses are observed and the object’s
signals might not be fully filled.";
CM_ SG_ 610 OBJ_POS_LONG_035 "Long-position of object track's centroid in VCS coordinate";
CM_ SG_ 610 OBJ_POS_LAT_035 "Lat-position of object track's centroid in VCS coordinate";
CM_ SG_ 610 OBJ_VELOCITY_LONG_035 "Over-the-ground velocity of object track's centroid along Long direction (in VCS coordinate)";
CM_ SG_ 610 OBJ_VELOCITY_LAT_035 "Over-the-ground velocity of object track's centroid along Lat direction (in VCS coordinate)";
CM_ SG_ 610 OBJ_ACCELERATION_LONG_035 "Over-the-ground track acceleration along Longi direction (in VCS coordinate)";
CM_ SG_ 610 OBJ_ACCELERATION_LAT_035 "Over-the-ground track acceleration along Lat direction (in VCS coordinate)";
CM_ SG_ 610 OBJ_VEH_TRACK_FLAG_035 "Indicates if current track is a vehicle";
CM_ SG_ 610 OBJ_TIMESTAMP_OFFSET_035 "A timestamp offset from the object list header timestamp for each object as we have different timestamps from different sensors leading to different timestamps on each object";
CM_ SG_ 610 OBJ_DIMENSION_WIDTH_ERR_035 "Lat distance or length error";
CM_ SG_ 610 OBJ_DIMENSION_LENGTH_ERR_035 "Longi distance or length error";
CM_ SG_ 610 OBJ_CLS_TYPE1_035 "Classification Type 1(Highest Prob), selected from ENUM list";
CM_ SG_ 610 OBJ_CLS_TYPE1_PROB_035 "Classification Type 1 probablity";
CM_ SG_ 610 OBJ_CLS_TYPE6_035 "Classification Type 6(Lowest Prob), selected from ENUM list";
CM_ SG_ 610 OBJ_CLS_TYPE6_PROB_035 "Classification Type 1 probablity";
CM_ SG_ 610 OBJ_RCS_035 "Representative RCS of the complete recognized object, Not implemented";
CM_ SG_ 610 OBJ_REF_PT_LONG_OFFSET_035 "Outer edges of the recognized object’s bounding box in Y axis";
CM_ SG_ 610 OBJ_REF_PT_LAT_OFFSET_035 "Outer edges of the recognized object’s bounding box in X axis";
CM_ SG_ 610 OBJ_YAW_RATE_035 "Orientation rate of track's bounding box in VCS coordinate";
CM_ SG_ 610 OBJ_GROUP_ID_035 "Objects which are linked together shall have same group ID";
CM_ SG_ 610 OBJ_POS_ERR_CRR_COEF_035 "vx-vy correlation due to small error in radial direction and big in cross radial - position Correlation Coefficient Error";
CM_ SG_ 610 OBJ_VELOCITY_ERR_CRR_COEF_035 "vx-vy correlation due to small error in radial direction and big in cross radial - velocity Correlation Coefficient Error";
CM_ SG_ 610 OBJ_ACCEL_ERR_CRR_COEF_035 "vx-vy correlation due to small error in radial direction and big in cross radial - Acceleration Correlation Coefficient Error";
CM_ SG_ 611 OBJ_ALIVE_TIME_036 "Time since object initialization in msec. Tracker internal may have bigger values. On the output interface, we should saturate the signal in that case.";
CM_ SG_ 611 OBJ_ACCELERATION_LONG_ERR_036 "acceleration along Longi  direction";
CM_ SG_ 611 OBJ_ACCELERATION_LAT_ERR_036 "acceleration along Lat direction error";
CM_ SG_ 611 OBJ_POS_LONG_ERR_036 "Lat-position error of object track's centroid in VCS coordinate";
CM_ SG_ 611 OBJ_POS_LAT_ERR_036 "Lat-position error of object track's centroid in VCS coordinate";
CM_ SG_ 611 OBJ_TRACK_MOTION_MODEL_036 "Object tracking uses a motion model for tracking moving items";
CM_ SG_ 611 OBJ_DIMENSION_WIDTH_036 "Lat distance from centroid to edge of bounding box.";
CM_ SG_ 611 OBJ_DIMENSION_LENGTH_036 "Longi distance from centroid to edge of bounding box.";
CM_ SG_ 611 OBJ_EXISTENCE_PROB_036 "Probability that the target is an actual target";
CM_ SG_ 611 OBJ_YAW_ANGLE_036 "Orientation of track's bounding box in VCS coordinate";
CM_ SG_ 611 OBJ_ID_036 "ID of object tracks, zero-ID represents an inactive track";
CM_ SG_ 611 OBJ_MOVEMENT_STATUS_036 "Information about a possible movement of the object during tracking";
CM_ SG_ 611 OBJ_MEASUREMENT_STATUS_036 "Objects should be sent out as fast as possible, even if not all statuses are observed and the object’s
signals might not be fully filled.";
CM_ SG_ 611 OBJ_POS_LONG_036 "Long-position of object track's centroid in VCS coordinate";
CM_ SG_ 611 OBJ_POS_LAT_036 "Lat-position of object track's centroid in VCS coordinate";
CM_ SG_ 611 OBJ_VELOCITY_LONG_036 "Over-the-ground velocity of object track's centroid along Long direction (in VCS coordinate)";
CM_ SG_ 611 OBJ_VELOCITY_LAT_036 "Over-the-ground velocity of object track's centroid along Lat direction (in VCS coordinate)";
CM_ SG_ 611 OBJ_ACCELERATION_LONG_036 "Over-the-ground track acceleration along Longi direction (in VCS coordinate)";
CM_ SG_ 611 OBJ_ACCELERATION_LAT_036 "Over-the-ground track acceleration along Lat direction (in VCS coordinate)";
CM_ SG_ 611 OBJ_VEH_TRACK_FLAG_036 "Indicates if current track is a vehicle";
CM_ SG_ 611 OBJ_TIMESTAMP_OFFSET_036 "A timestamp offset from the object list header timestamp for each object as we have different timestamps from different sensors leading to different timestamps on each object";
CM_ SG_ 611 OBJ_DIMENSION_WIDTH_ERR_036 "Lat distance or length error";
CM_ SG_ 611 OBJ_DIMENSION_LENGTH_ERR_036 "Longi distance or length error";
CM_ SG_ 611 OBJ_CLS_TYPE1_036 "Classification Type 1(Highest Prob), selected from ENUM list";
CM_ SG_ 611 OBJ_CLS_TYPE1_PROB_036 "Classification Type 1 probablity";
CM_ SG_ 611 OBJ_CLS_TYPE6_036 "Classification Type 6(Lowest Prob), selected from ENUM list";
CM_ SG_ 611 OBJ_CLS_TYPE6_PROB_036 "Classification Type 1 probablity";
CM_ SG_ 611 OBJ_RCS_036 "Representative RCS of the complete recognized object, Not implemented";
CM_ SG_ 611 OBJ_REF_PT_LONG_OFFSET_036 "Outer edges of the recognized object’s bounding box in Y axis";
CM_ SG_ 611 OBJ_REF_PT_LAT_OFFSET_036 "Outer edges of the recognized object’s bounding box in X axis";
CM_ SG_ 611 OBJ_YAW_RATE_036 "Orientation rate of track's bounding box in VCS coordinate";
CM_ SG_ 611 OBJ_GROUP_ID_036 "Objects which are linked together shall have same group ID";
CM_ SG_ 611 OBJ_POS_ERR_CRR_COEF_036 "vx-vy correlation due to small error in radial direction and big in cross radial - position Correlation Coefficient Error";
CM_ SG_ 611 OBJ_VELOCITY_ERR_CRR_COEF_036 "vx-vy correlation due to small error in radial direction and big in cross radial - velocity Correlation Coefficient Error";
CM_ SG_ 611 OBJ_ACCEL_ERR_CRR_COEF_036 "vx-vy correlation due to small error in radial direction and big in cross radial - Acceleration Correlation Coefficient Error";
CM_ SG_ 612 OBJ_ALIVE_TIME_037 "Time since object initialization in msec. Tracker internal may have bigger values. On the output interface, we should saturate the signal in that case.";
CM_ SG_ 612 OBJ_ACCELERATION_LONG_ERR_037 "acceleration along Longi  direction";
CM_ SG_ 612 OBJ_ACCELERATION_LAT_ERR_037 "acceleration along Lat direction error";
CM_ SG_ 612 OBJ_POS_LONG_ERR_037 "Lat-position error of object track's centroid in VCS coordinate";
CM_ SG_ 612 OBJ_POS_LAT_ERR_037 "Lat-position error of object track's centroid in VCS coordinate";
CM_ SG_ 612 OBJ_TRACK_MOTION_MODEL_037 "Object tracking uses a motion model for tracking moving items";
CM_ SG_ 612 OBJ_DIMENSION_WIDTH_037 "Lat distance from centroid to edge of bounding box.";
CM_ SG_ 612 OBJ_DIMENSION_LENGTH_037 "Longi distance from centroid to edge of bounding box.";
CM_ SG_ 612 OBJ_EXISTENCE_PROB_037 "Probability that the target is an actual target";
CM_ SG_ 612 OBJ_YAW_ANGLE_037 "Orientation of track's bounding box in VCS coordinate";
CM_ SG_ 612 OBJ_ID_037 "ID of object tracks, zero-ID represents an inactive track";
CM_ SG_ 612 OBJ_MOVEMENT_STATUS_037 "Information about a possible movement of the object during tracking";
CM_ SG_ 612 OBJ_MEASUREMENT_STATUS_037 "Objects should be sent out as fast as possible, even if not all statuses are observed and the object’s
signals might not be fully filled.";
CM_ SG_ 612 OBJ_POS_LONG_037 "Long-position of object track's centroid in VCS coordinate";
CM_ SG_ 612 OBJ_POS_LAT_037 "Lat-position of object track's centroid in VCS coordinate";
CM_ SG_ 612 OBJ_VELOCITY_LONG_037 "Over-the-ground velocity of object track's centroid along Long direction (in VCS coordinate)";
CM_ SG_ 612 OBJ_VELOCITY_LAT_037 "Over-the-ground velocity of object track's centroid along Lat direction (in VCS coordinate)";
CM_ SG_ 612 OBJ_ACCELERATION_LONG_037 "Over-the-ground track acceleration along Longi direction (in VCS coordinate)";
CM_ SG_ 612 OBJ_ACCELERATION_LAT_037 "Over-the-ground track acceleration along Lat direction (in VCS coordinate)";
CM_ SG_ 612 OBJ_VEH_TRACK_FLAG_037 "Indicates if current track is a vehicle";
CM_ SG_ 612 OBJ_TIMESTAMP_OFFSET_037 "A timestamp offset from the object list header timestamp for each object as we have different timestamps from different sensors leading to different timestamps on each object";
CM_ SG_ 612 OBJ_DIMENSION_WIDTH_ERR_037 "Lat distance or length error";
CM_ SG_ 612 OBJ_DIMENSION_LENGTH_ERR_037 "Longi distance or length error";
CM_ SG_ 612 OBJ_CLS_TYPE1_037 "Classification Type 1(Highest Prob), selected from ENUM list";
CM_ SG_ 612 OBJ_CLS_TYPE1_PROB_037 "Classification Type 1 probablity";
CM_ SG_ 612 OBJ_CLS_TYPE6_037 "Classification Type 6(Lowest Prob), selected from ENUM list";
CM_ SG_ 612 OBJ_CLS_TYPE6_PROB_037 "Classification Type 1 probablity";
CM_ SG_ 612 OBJ_RCS_037 "Representative RCS of the complete recognized object, Not implemented";
CM_ SG_ 612 OBJ_REF_PT_LONG_OFFSET_037 "Outer edges of the recognized object’s bounding box in Y axis";
CM_ SG_ 612 OBJ_REF_PT_LAT_OFFSET_037 "Outer edges of the recognized object’s bounding box in X axis";
CM_ SG_ 612 OBJ_YAW_RATE_037 "Orientation rate of track's bounding box in VCS coordinate";
CM_ SG_ 612 OBJ_GROUP_ID_037 "Objects which are linked together shall have same group ID";
CM_ SG_ 612 OBJ_POS_ERR_CRR_COEF_037 "vx-vy correlation due to small error in radial direction and big in cross radial - position Correlation Coefficient Error";
CM_ SG_ 612 OBJ_VELOCITY_ERR_CRR_COEF_037 "vx-vy correlation due to small error in radial direction and big in cross radial - velocity Correlation Coefficient Error";
CM_ SG_ 612 OBJ_ACCEL_ERR_CRR_COEF_037 "vx-vy correlation due to small error in radial direction and big in cross radial - Acceleration Correlation Coefficient Error";
CM_ SG_ 613 OBJ_ALIVE_TIME_038 "Time since object initialization in msec. Tracker internal may have bigger values. On the output interface, we should saturate the signal in that case.";
CM_ SG_ 613 OBJ_ACCELERATION_LONG_ERR_038 "acceleration along Longi  direction";
CM_ SG_ 613 OBJ_ACCELERATION_LAT_ERR_038 "acceleration along Lat direction error";
CM_ SG_ 613 OBJ_POS_LONG_ERR_038 "Lat-position error of object track's centroid in VCS coordinate";
CM_ SG_ 613 OBJ_POS_LAT_ERR_038 "Lat-position error of object track's centroid in VCS coordinate";
CM_ SG_ 613 OBJ_TRACK_MOTION_MODEL_038 "Object tracking uses a motion model for tracking moving items";
CM_ SG_ 613 OBJ_DIMENSION_WIDTH_038 "Lat distance from centroid to edge of bounding box.";
CM_ SG_ 613 OBJ_DIMENSION_LENGTH_038 "Longi distance from centroid to edge of bounding box.";
CM_ SG_ 613 OBJ_EXISTENCE_PROB_038 "Probability that the target is an actual target";
CM_ SG_ 613 OBJ_YAW_ANGLE_038 "Orientation of track's bounding box in VCS coordinate";
CM_ SG_ 613 OBJ_ID_038 "ID of object tracks, zero-ID represents an inactive track";
CM_ SG_ 613 OBJ_MOVEMENT_STATUS_038 "Information about a possible movement of the object during tracking";
CM_ SG_ 613 OBJ_MEASUREMENT_STATUS_038 "Objects should be sent out as fast as possible, even if not all statuses are observed and the object’s
signals might not be fully filled.";
CM_ SG_ 613 OBJ_POS_LONG_038 "Long-position of object track's centroid in VCS coordinate";
CM_ SG_ 613 OBJ_POS_LAT_038 "Lat-position of object track's centroid in VCS coordinate";
CM_ SG_ 613 OBJ_VELOCITY_LONG_038 "Over-the-ground velocity of object track's centroid along Long direction (in VCS coordinate)";
CM_ SG_ 613 OBJ_VELOCITY_LAT_038 "Over-the-ground velocity of object track's centroid along Lat direction (in VCS coordinate)";
CM_ SG_ 613 OBJ_ACCELERATION_LONG_038 "Over-the-ground track acceleration along Longi direction (in VCS coordinate)";
CM_ SG_ 613 OBJ_ACCELERATION_LAT_038 "Over-the-ground track acceleration along Lat direction (in VCS coordinate)";
CM_ SG_ 613 OBJ_VEH_TRACK_FLAG_038 "Indicates if current track is a vehicle";
CM_ SG_ 613 OBJ_TIMESTAMP_OFFSET_038 "A timestamp offset from the object list header timestamp for each object as we have different timestamps from different sensors leading to different timestamps on each object";
CM_ SG_ 613 OBJ_DIMENSION_WIDTH_ERR_038 "Lat distance or length error";
CM_ SG_ 613 OBJ_DIMENSION_LENGTH_ERR_038 "Longi distance or length error";
CM_ SG_ 613 OBJ_CLS_TYPE1_038 "Classification Type 1(Highest Prob), selected from ENUM list";
CM_ SG_ 613 OBJ_CLS_TYPE1_PROB_038 "Classification Type 1 probablity";
CM_ SG_ 613 OBJ_CLS_TYPE6_038 "Classification Type 6(Lowest Prob), selected from ENUM list";
CM_ SG_ 613 OBJ_CLS_TYPE6_PROB_038 "Classification Type 1 probablity";
CM_ SG_ 613 OBJ_RCS_038 "Representative RCS of the complete recognized object, Not implemented";
CM_ SG_ 613 OBJ_REF_PT_LONG_OFFSET_038 "Outer edges of the recognized object’s bounding box in Y axis";
CM_ SG_ 613 OBJ_REF_PT_LAT_OFFSET_038 "Outer edges of the recognized object’s bounding box in X axis";
CM_ SG_ 613 OBJ_YAW_RATE_038 "Orientation rate of track's bounding box in VCS coordinate";
CM_ SG_ 613 OBJ_GROUP_ID_038 "Objects which are linked together shall have same group ID";
CM_ SG_ 613 OBJ_POS_ERR_CRR_COEF_038 "vx-vy correlation due to small error in radial direction and big in cross radial - position Correlation Coefficient Error";
CM_ SG_ 613 OBJ_VELOCITY_ERR_CRR_COEF_038 "vx-vy correlation due to small error in radial direction and big in cross radial - velocity Correlation Coefficient Error";
CM_ SG_ 613 OBJ_ACCEL_ERR_CRR_COEF_038 "vx-vy correlation due to small error in radial direction and big in cross radial - Acceleration Correlation Coefficient Error";
CM_ SG_ 614 OBJ_ALIVE_TIME_039 "Time since object initialization in msec. Tracker internal may have bigger values. On the output interface, we should saturate the signal in that case.";
CM_ SG_ 614 OBJ_ACCELERATION_LONG_ERR_039 "acceleration along Longi  direction";
CM_ SG_ 614 OBJ_ACCELERATION_LAT_ERR_039 "acceleration along Lat direction error";
CM_ SG_ 614 OBJ_POS_LONG_ERR_039 "Lat-position error of object track's centroid in VCS coordinate";
CM_ SG_ 614 OBJ_POS_LAT_ERR_039 "Lat-position error of object track's centroid in VCS coordinate";
CM_ SG_ 614 OBJ_TRACK_MOTION_MODEL_039 "Object tracking uses a motion model for tracking moving items";
CM_ SG_ 614 OBJ_DIMENSION_WIDTH_039 "Lat distance from centroid to edge of bounding box.";
CM_ SG_ 614 OBJ_DIMENSION_LENGTH_039 "Longi distance from centroid to edge of bounding box.";
CM_ SG_ 614 OBJ_EXISTENCE_PROB_039 "Probability that the target is an actual target";
CM_ SG_ 614 OBJ_YAW_ANGLE_039 "Orientation of track's bounding box in VCS coordinate";
CM_ SG_ 614 OBJ_ID_039 "ID of object tracks, zero-ID represents an inactive track";
CM_ SG_ 614 OBJ_MOVEMENT_STATUS_039 "Information about a possible movement of the object during tracking";
CM_ SG_ 614 OBJ_MEASUREMENT_STATUS_039 "Objects should be sent out as fast as possible, even if not all statuses are observed and the object’s
signals might not be fully filled.";
CM_ SG_ 614 OBJ_POS_LONG_039 "Long-position of object track's centroid in VCS coordinate";
CM_ SG_ 614 OBJ_POS_LAT_039 "Lat-position of object track's centroid in VCS coordinate";
CM_ SG_ 614 OBJ_VELOCITY_LONG_039 "Over-the-ground velocity of object track's centroid along Long direction (in VCS coordinate)";
CM_ SG_ 614 OBJ_VELOCITY_LAT_039 "Over-the-ground velocity of object track's centroid along Lat direction (in VCS coordinate)";
CM_ SG_ 614 OBJ_ACCELERATION_LONG_039 "Over-the-ground track acceleration along Longi direction (in VCS coordinate)";
CM_ SG_ 614 OBJ_ACCELERATION_LAT_039 "Over-the-ground track acceleration along Lat direction (in VCS coordinate)";
CM_ SG_ 614 OBJ_VEH_TRACK_FLAG_039 "Indicates if current track is a vehicle";
CM_ SG_ 614 OBJ_TIMESTAMP_OFFSET_039 "A timestamp offset from the object list header timestamp for each object as we have different timestamps from different sensors leading to different timestamps on each object";
CM_ SG_ 614 OBJ_DIMENSION_WIDTH_ERR_039 "Lat distance or length error";
CM_ SG_ 614 OBJ_DIMENSION_LENGTH_ERR_039 "Longi distance or length error";
CM_ SG_ 614 OBJ_CLS_TYPE1_039 "Classification Type 1(Highest Prob), selected from ENUM list";
CM_ SG_ 614 OBJ_CLS_TYPE1_PROB_039 "Classification Type 1 probablity";
CM_ SG_ 614 OBJ_CLS_TYPE6_039 "Classification Type 6(Lowest Prob), selected from ENUM list";
CM_ SG_ 614 OBJ_CLS_TYPE6_PROB_039 "Classification Type 1 probablity";
CM_ SG_ 614 OBJ_RCS_039 "Representative RCS of the complete recognized object, Not implemented";
CM_ SG_ 614 OBJ_REF_PT_LONG_OFFSET_039 "Outer edges of the recognized object’s bounding box in Y axis";
CM_ SG_ 614 OBJ_REF_PT_LAT_OFFSET_039 "Outer edges of the recognized object’s bounding box in X axis";
CM_ SG_ 614 OBJ_YAW_RATE_039 "Orientation rate of track's bounding box in VCS coordinate";
CM_ SG_ 614 OBJ_GROUP_ID_039 "Objects which are linked together shall have same group ID";
CM_ SG_ 614 OBJ_POS_ERR_CRR_COEF_039 "vx-vy correlation due to small error in radial direction and big in cross radial - position Correlation Coefficient Error";
CM_ SG_ 614 OBJ_VELOCITY_ERR_CRR_COEF_039 "vx-vy correlation due to small error in radial direction and big in cross radial - velocity Correlation Coefficient Error";
CM_ SG_ 614 OBJ_ACCEL_ERR_CRR_COEF_039 "vx-vy correlation due to small error in radial direction and big in cross radial - Acceleration Correlation Coefficient Error";
CM_ SG_ 615 OBJ_ALIVE_TIME_040 "Time since object initialization in msec. Tracker internal may have bigger values. On the output interface, we should saturate the signal in that case.";
CM_ SG_ 615 OBJ_ACCELERATION_LONG_ERR_040 "acceleration along Longi  direction";
CM_ SG_ 615 OBJ_ACCELERATION_LAT_ERR_040 "acceleration along Lat direction error";
CM_ SG_ 615 OBJ_POS_LONG_ERR_040 "Lat-position error of object track's centroid in VCS coordinate";
CM_ SG_ 615 OBJ_POS_LAT_ERR_040 "Lat-position error of object track's centroid in VCS coordinate";
CM_ SG_ 615 OBJ_TRACK_MOTION_MODEL_040 "Object tracking uses a motion model for tracking moving items";
CM_ SG_ 615 OBJ_DIMENSION_WIDTH_040 "Lat distance from centroid to edge of bounding box.";
CM_ SG_ 615 OBJ_DIMENSION_LENGTH_040 "Longi distance from centroid to edge of bounding box.";
CM_ SG_ 615 OBJ_EXISTENCE_PROB_040 "Probability that the target is an actual target";
CM_ SG_ 615 OBJ_YAW_ANGLE_040 "Orientation of track's bounding box in VCS coordinate";
CM_ SG_ 615 OBJ_ID_040 "ID of object tracks, zero-ID represents an inactive track";
CM_ SG_ 615 OBJ_MOVEMENT_STATUS_040 "Information about a possible movement of the object during tracking";
CM_ SG_ 615 OBJ_MEASUREMENT_STATUS_040 "Objects should be sent out as fast as possible, even if not all statuses are observed and the object’s
signals might not be fully filled.";
CM_ SG_ 615 OBJ_POS_LONG_040 "Long-position of object track's centroid in VCS coordinate";
CM_ SG_ 615 OBJ_POS_LAT_040 "Lat-position of object track's centroid in VCS coordinate";
CM_ SG_ 615 OBJ_VELOCITY_LONG_040 "Over-the-ground velocity of object track's centroid along Long direction (in VCS coordinate)";
CM_ SG_ 615 OBJ_VELOCITY_LAT_040 "Over-the-ground velocity of object track's centroid along Lat direction (in VCS coordinate)";
CM_ SG_ 615 OBJ_ACCELERATION_LONG_040 "Over-the-ground track acceleration along Longi direction (in VCS coordinate)";
CM_ SG_ 615 OBJ_ACCELERATION_LAT_040 "Over-the-ground track acceleration along Lat direction (in VCS coordinate)";
CM_ SG_ 615 OBJ_VEH_TRACK_FLAG_040 "Indicates if current track is a vehicle";
CM_ SG_ 615 OBJ_TIMESTAMP_OFFSET_040 "A timestamp offset from the object list header timestamp for each object as we have different timestamps from different sensors leading to different timestamps on each object";
CM_ SG_ 615 OBJ_DIMENSION_WIDTH_ERR_040 "Lat distance or length error";
CM_ SG_ 615 OBJ_DIMENSION_LENGTH_ERR_040 "Longi distance or length error";
CM_ SG_ 615 OBJ_CLS_TYPE1_040 "Classification Type 1(Highest Prob), selected from ENUM list";
CM_ SG_ 615 OBJ_CLS_TYPE1_PROB_040 "Classification Type 1 probablity";
CM_ SG_ 615 OBJ_CLS_TYPE6_040 "Classification Type 6(Lowest Prob), selected from ENUM list";
CM_ SG_ 615 OBJ_CLS_TYPE6_PROB_040 "Classification Type 1 probablity";
CM_ SG_ 615 OBJ_RCS_040 "Representative RCS of the complete recognized object, Not implemented";
CM_ SG_ 615 OBJ_REF_PT_LONG_OFFSET_040 "Outer edges of the recognized object’s bounding box in Y axis";
CM_ SG_ 615 OBJ_REF_PT_LAT_OFFSET_040 "Outer edges of the recognized object’s bounding box in X axis";
CM_ SG_ 615 OBJ_YAW_RATE_040 "Orientation rate of track's bounding box in VCS coordinate";
CM_ SG_ 615 OBJ_GROUP_ID_040 "Objects which are linked together shall have same group ID";
CM_ SG_ 615 OBJ_POS_ERR_CRR_COEF_040 "vx-vy correlation due to small error in radial direction and big in cross radial - position Correlation Coefficient Error";
CM_ SG_ 615 OBJ_VELOCITY_ERR_CRR_COEF_040 "vx-vy correlation due to small error in radial direction and big in cross radial - velocity Correlation Coefficient Error";
CM_ SG_ 615 OBJ_ACCEL_ERR_CRR_COEF_040 "vx-vy correlation due to small error in radial direction and big in cross radial - Acceleration Correlation Coefficient Error";
CM_ SG_ 616 OBJ_ALIVE_TIME_041 "Time since object initialization in msec. Tracker internal may have bigger values. On the output interface, we should saturate the signal in that case.";
CM_ SG_ 616 OBJ_ACCELERATION_LONG_ERR_041 "acceleration along Longi  direction";
CM_ SG_ 616 OBJ_ACCELERATION_LAT_ERR_041 "acceleration along Lat direction error";
CM_ SG_ 616 OBJ_POS_LONG_ERR_041 "Lat-position error of object track's centroid in VCS coordinate";
CM_ SG_ 616 OBJ_POS_LAT_ERR_041 "Lat-position error of object track's centroid in VCS coordinate";
CM_ SG_ 616 OBJ_TRACK_MOTION_MODEL_041 "Object tracking uses a motion model for tracking moving items";
CM_ SG_ 616 OBJ_DIMENSION_WIDTH_041 "Lat distance from centroid to edge of bounding box.";
CM_ SG_ 616 OBJ_DIMENSION_LENGTH_041 "Longi distance from centroid to edge of bounding box.";
CM_ SG_ 616 OBJ_EXISTENCE_PROB_041 "Probability that the target is an actual target";
CM_ SG_ 616 OBJ_YAW_ANGLE_041 "Orientation of track's bounding box in VCS coordinate";
CM_ SG_ 616 OBJ_ID_041 "ID of object tracks, zero-ID represents an inactive track";
CM_ SG_ 616 OBJ_MOVEMENT_STATUS_041 "Information about a possible movement of the object during tracking";
CM_ SG_ 616 OBJ_MEASUREMENT_STATUS_041 "Objects should be sent out as fast as possible, even if not all statuses are observed and the object’s
signals might not be fully filled.";
CM_ SG_ 616 OBJ_POS_LONG_041 "Long-position of object track's centroid in VCS coordinate";
CM_ SG_ 616 OBJ_POS_LAT_041 "Lat-position of object track's centroid in VCS coordinate";
CM_ SG_ 616 OBJ_VELOCITY_LONG_041 "Over-the-ground velocity of object track's centroid along Long direction (in VCS coordinate)";
CM_ SG_ 616 OBJ_VELOCITY_LAT_041 "Over-the-ground velocity of object track's centroid along Lat direction (in VCS coordinate)";
CM_ SG_ 616 OBJ_ACCELERATION_LONG_041 "Over-the-ground track acceleration along Longi direction (in VCS coordinate)";
CM_ SG_ 616 OBJ_ACCELERATION_LAT_041 "Over-the-ground track acceleration along Lat direction (in VCS coordinate)";
CM_ SG_ 616 OBJ_VEH_TRACK_FLAG_041 "Indicates if current track is a vehicle";
CM_ SG_ 616 OBJ_TIMESTAMP_OFFSET_041 "A timestamp offset from the object list header timestamp for each object as we have different timestamps from different sensors leading to different timestamps on each object";
CM_ SG_ 616 OBJ_DIMENSION_WIDTH_ERR_041 "Lat distance or length error";
CM_ SG_ 616 OBJ_DIMENSION_LENGTH_ERR_041 "Longi distance or length error";
CM_ SG_ 616 OBJ_CLS_TYPE1_041 "Classification Type 1(Highest Prob), selected from ENUM list";
CM_ SG_ 616 OBJ_CLS_TYPE1_PROB_041 "Classification Type 1 probablity";
CM_ SG_ 616 OBJ_CLS_TYPE6_041 "Classification Type 6(Lowest Prob), selected from ENUM list";
CM_ SG_ 616 OBJ_CLS_TYPE6_PROB_041 "Classification Type 1 probablity";
CM_ SG_ 616 OBJ_RCS_041 "Representative RCS of the complete recognized object, Not implemented";
CM_ SG_ 616 OBJ_REF_PT_LONG_OFFSET_041 "Outer edges of the recognized object’s bounding box in Y axis";
CM_ SG_ 616 OBJ_REF_PT_LAT_OFFSET_041 "Outer edges of the recognized object’s bounding box in X axis";
CM_ SG_ 616 OBJ_YAW_RATE_041 "Orientation rate of track's bounding box in VCS coordinate";
CM_ SG_ 616 OBJ_GROUP_ID_041 "Objects which are linked together shall have same group ID";
CM_ SG_ 616 OBJ_POS_ERR_CRR_COEF_041 "vx-vy correlation due to small error in radial direction and big in cross radial - position Correlation Coefficient Error";
CM_ SG_ 616 OBJ_VELOCITY_ERR_CRR_COEF_041 "vx-vy correlation due to small error in radial direction and big in cross radial - velocity Correlation Coefficient Error";
CM_ SG_ 616 OBJ_ACCEL_ERR_CRR_COEF_041 "vx-vy correlation due to small error in radial direction and big in cross radial - Acceleration Correlation Coefficient Error";
CM_ SG_ 617 OBJ_ALIVE_TIME_042 "Time since object initialization in msec. Tracker internal may have bigger values. On the output interface, we should saturate the signal in that case.";
CM_ SG_ 617 OBJ_ACCELERATION_LONG_ERR_042 "acceleration along Longi  direction";
CM_ SG_ 617 OBJ_ACCELERATION_LAT_ERR_042 "acceleration along Lat direction error";
CM_ SG_ 617 OBJ_POS_LONG_ERR_042 "Lat-position error of object track's centroid in VCS coordinate";
CM_ SG_ 617 OBJ_POS_LAT_ERR_042 "Lat-position error of object track's centroid in VCS coordinate";
CM_ SG_ 617 OBJ_TRACK_MOTION_MODEL_042 "Object tracking uses a motion model for tracking moving items";
CM_ SG_ 617 OBJ_DIMENSION_WIDTH_042 "Lat distance from centroid to edge of bounding box.";
CM_ SG_ 617 OBJ_DIMENSION_LENGTH_042 "Longi distance from centroid to edge of bounding box.";
CM_ SG_ 617 OBJ_EXISTENCE_PROB_042 "Probability that the target is an actual target";
CM_ SG_ 617 OBJ_YAW_ANGLE_042 "Orientation of track's bounding box in VCS coordinate";
CM_ SG_ 617 OBJ_ID_042 "ID of object tracks, zero-ID represents an inactive track";
CM_ SG_ 617 OBJ_MOVEMENT_STATUS_042 "Information about a possible movement of the object during tracking";
CM_ SG_ 617 OBJ_MEASUREMENT_STATUS_042 "Objects should be sent out as fast as possible, even if not all statuses are observed and the object’s
signals might not be fully filled.";
CM_ SG_ 617 OBJ_POS_LONG_042 "Long-position of object track's centroid in VCS coordinate";
CM_ SG_ 617 OBJ_POS_LAT_042 "Lat-position of object track's centroid in VCS coordinate";
CM_ SG_ 617 OBJ_VELOCITY_LONG_042 "Over-the-ground velocity of object track's centroid along Long direction (in VCS coordinate)";
CM_ SG_ 617 OBJ_VELOCITY_LAT_042 "Over-the-ground velocity of object track's centroid along Lat direction (in VCS coordinate)";
CM_ SG_ 617 OBJ_ACCELERATION_LONG_042 "Over-the-ground track acceleration along Longi direction (in VCS coordinate)";
CM_ SG_ 617 OBJ_ACCELERATION_LAT_042 "Over-the-ground track acceleration along Lat direction (in VCS coordinate)";
CM_ SG_ 617 OBJ_VEH_TRACK_FLAG_042 "Indicates if current track is a vehicle";
CM_ SG_ 617 OBJ_TIMESTAMP_OFFSET_042 "A timestamp offset from the object list header timestamp for each object as we have different timestamps from different sensors leading to different timestamps on each object";
CM_ SG_ 617 OBJ_DIMENSION_WIDTH_ERR_042 "Lat distance or length error";
CM_ SG_ 617 OBJ_DIMENSION_LENGTH_ERR_042 "Longi distance or length error";
CM_ SG_ 617 OBJ_CLS_TYPE1_042 "Classification Type 1(Highest Prob), selected from ENUM list";
CM_ SG_ 617 OBJ_CLS_TYPE1_PROB_042 "Classification Type 1 probablity";
CM_ SG_ 617 OBJ_CLS_TYPE6_042 "Classification Type 6(Lowest Prob), selected from ENUM list";
CM_ SG_ 617 OBJ_CLS_TYPE6_PROB_042 "Classification Type 1 probablity";
CM_ SG_ 617 OBJ_RCS_042 "Representative RCS of the complete recognized object, Not implemented";
CM_ SG_ 617 OBJ_REF_PT_LONG_OFFSET_042 "Outer edges of the recognized object’s bounding box in Y axis";
CM_ SG_ 617 OBJ_REF_PT_LAT_OFFSET_042 "Outer edges of the recognized object’s bounding box in X axis";
CM_ SG_ 617 OBJ_YAW_RATE_042 "Orientation rate of track's bounding box in VCS coordinate";
CM_ SG_ 617 OBJ_GROUP_ID_042 "Objects which are linked together shall have same group ID";
CM_ SG_ 617 OBJ_POS_ERR_CRR_COEF_042 "vx-vy correlation due to small error in radial direction and big in cross radial - position Correlation Coefficient Error";
CM_ SG_ 617 OBJ_VELOCITY_ERR_CRR_COEF_042 "vx-vy correlation due to small error in radial direction and big in cross radial - velocity Correlation Coefficient Error";
CM_ SG_ 617 OBJ_ACCEL_ERR_CRR_COEF_042 "vx-vy correlation due to small error in radial direction and big in cross radial - Acceleration Correlation Coefficient Error";
CM_ SG_ 618 OBJ_ALIVE_TIME_043 "Time since object initialization in msec. Tracker internal may have bigger values. On the output interface, we should saturate the signal in that case.";
CM_ SG_ 618 OBJ_ACCELERATION_LONG_ERR_043 "acceleration along Longi  direction";
CM_ SG_ 618 OBJ_ACCELERATION_LAT_ERR_043 "acceleration along Lat direction error";
CM_ SG_ 618 OBJ_POS_LONG_ERR_043 "Lat-position error of object track's centroid in VCS coordinate";
CM_ SG_ 618 OBJ_POS_LAT_ERR_043 "Lat-position error of object track's centroid in VCS coordinate";
CM_ SG_ 618 OBJ_TRACK_MOTION_MODEL_043 "Object tracking uses a motion model for tracking moving items";
CM_ SG_ 618 OBJ_DIMENSION_WIDTH_043 "Lat distance from centroid to edge of bounding box.";
CM_ SG_ 618 OBJ_DIMENSION_LENGTH_043 "Longi distance from centroid to edge of bounding box.";
CM_ SG_ 618 OBJ_EXISTENCE_PROB_043 "Probability that the target is an actual target";
CM_ SG_ 618 OBJ_YAW_ANGLE_043 "Orientation of track's bounding box in VCS coordinate";
CM_ SG_ 618 OBJ_ID_043 "ID of object tracks, zero-ID represents an inactive track";
CM_ SG_ 618 OBJ_MOVEMENT_STATUS_043 "Information about a possible movement of the object during tracking";
CM_ SG_ 618 OBJ_MEASUREMENT_STATUS_043 "Objects should be sent out as fast as possible, even if not all statuses are observed and the object’s
signals might not be fully filled.";
CM_ SG_ 618 OBJ_POS_LONG_043 "Long-position of object track's centroid in VCS coordinate";
CM_ SG_ 618 OBJ_POS_LAT_043 "Lat-position of object track's centroid in VCS coordinate";
CM_ SG_ 618 OBJ_VELOCITY_LONG_043 "Over-the-ground velocity of object track's centroid along Long direction (in VCS coordinate)";
CM_ SG_ 618 OBJ_VELOCITY_LAT_043 "Over-the-ground velocity of object track's centroid along Lat direction (in VCS coordinate)";
CM_ SG_ 618 OBJ_ACCELERATION_LONG_043 "Over-the-ground track acceleration along Longi direction (in VCS coordinate)";
CM_ SG_ 618 OBJ_ACCELERATION_LAT_043 "Over-the-ground track acceleration along Lat direction (in VCS coordinate)";
CM_ SG_ 618 OBJ_VEH_TRACK_FLAG_043 "Indicates if current track is a vehicle";
CM_ SG_ 618 OBJ_TIMESTAMP_OFFSET_043 "A timestamp offset from the object list header timestamp for each object as we have different timestamps from different sensors leading to different timestamps on each object";
CM_ SG_ 618 OBJ_DIMENSION_WIDTH_ERR_043 "Lat distance or length error";
CM_ SG_ 618 OBJ_DIMENSION_LENGTH_ERR_043 "Longi distance or length error";
CM_ SG_ 618 OBJ_CLS_TYPE1_043 "Classification Type 1(Highest Prob), selected from ENUM list";
CM_ SG_ 618 OBJ_CLS_TYPE1_PROB_043 "Classification Type 1 probablity";
CM_ SG_ 618 OBJ_CLS_TYPE6_043 "Classification Type 6(Lowest Prob), selected from ENUM list";
CM_ SG_ 618 OBJ_CLS_TYPE6_PROB_043 "Classification Type 1 probablity";
CM_ SG_ 618 OBJ_RCS_043 "Representative RCS of the complete recognized object, Not implemented";
CM_ SG_ 618 OBJ_REF_PT_LONG_OFFSET_043 "Outer edges of the recognized object’s bounding box in Y axis";
CM_ SG_ 618 OBJ_REF_PT_LAT_OFFSET_043 "Outer edges of the recognized object’s bounding box in X axis";
CM_ SG_ 618 OBJ_YAW_RATE_043 "Orientation rate of track's bounding box in VCS coordinate";
CM_ SG_ 618 OBJ_GROUP_ID_043 "Objects which are linked together shall have same group ID";
CM_ SG_ 618 OBJ_POS_ERR_CRR_COEF_043 "vx-vy correlation due to small error in radial direction and big in cross radial - position Correlation Coefficient Error";
CM_ SG_ 618 OBJ_VELOCITY_ERR_CRR_COEF_043 "vx-vy correlation due to small error in radial direction and big in cross radial - velocity Correlation Coefficient Error";
CM_ SG_ 618 OBJ_ACCEL_ERR_CRR_COEF_043 "vx-vy correlation due to small error in radial direction and big in cross radial - Acceleration Correlation Coefficient Error";
CM_ SG_ 619 OBJ_ALIVE_TIME_044 "Time since object initialization in msec. Tracker internal may have bigger values. On the output interface, we should saturate the signal in that case.";
CM_ SG_ 619 OBJ_ACCELERATION_LONG_ERR_044 "acceleration along Longi  direction";
CM_ SG_ 619 OBJ_ACCELERATION_LAT_ERR_044 "acceleration along Lat direction error";
CM_ SG_ 619 OBJ_POS_LONG_ERR_044 "Lat-position error of object track's centroid in VCS coordinate";
CM_ SG_ 619 OBJ_POS_LAT_ERR_044 "Lat-position error of object track's centroid in VCS coordinate";
CM_ SG_ 619 OBJ_TRACK_MOTION_MODEL_044 "Object tracking uses a motion model for tracking moving items";
CM_ SG_ 619 OBJ_DIMENSION_WIDTH_044 "Lat distance from centroid to edge of bounding box.";
CM_ SG_ 619 OBJ_DIMENSION_LENGTH_044 "Longi distance from centroid to edge of bounding box.";
CM_ SG_ 619 OBJ_EXISTENCE_PROB_044 "Probability that the target is an actual target";
CM_ SG_ 619 OBJ_YAW_ANGLE_044 "Orientation of track's bounding box in VCS coordinate";
CM_ SG_ 619 OBJ_ID_044 "ID of object tracks, zero-ID represents an inactive track";
CM_ SG_ 619 OBJ_MOVEMENT_STATUS_044 "Information about a possible movement of the object during tracking";
CM_ SG_ 619 OBJ_MEASUREMENT_STATUS_044 "Objects should be sent out as fast as possible, even if not all statuses are observed and the object’s
signals might not be fully filled.";
CM_ SG_ 619 OBJ_POS_LONG_044 "Long-position of object track's centroid in VCS coordinate";
CM_ SG_ 619 OBJ_POS_LAT_044 "Lat-position of object track's centroid in VCS coordinate";
CM_ SG_ 619 OBJ_VELOCITY_LONG_044 "Over-the-ground velocity of object track's centroid along Long direction (in VCS coordinate)";
CM_ SG_ 619 OBJ_VELOCITY_LAT_044 "Over-the-ground velocity of object track's centroid along Lat direction (in VCS coordinate)";
CM_ SG_ 619 OBJ_ACCELERATION_LONG_044 "Over-the-ground track acceleration along Longi direction (in VCS coordinate)";
CM_ SG_ 619 OBJ_ACCELERATION_LAT_044 "Over-the-ground track acceleration along Lat direction (in VCS coordinate)";
CM_ SG_ 619 OBJ_VEH_TRACK_FLAG_044 "Indicates if current track is a vehicle";
CM_ SG_ 619 OBJ_TIMESTAMP_OFFSET_044 "A timestamp offset from the object list header timestamp for each object as we have different timestamps from different sensors leading to different timestamps on each object";
CM_ SG_ 619 OBJ_DIMENSION_WIDTH_ERR_044 "Lat distance or length error";
CM_ SG_ 619 OBJ_DIMENSION_LENGTH_ERR_044 "Longi distance or length error";
CM_ SG_ 619 OBJ_CLS_TYPE1_044 "Classification Type 1(Highest Prob), selected from ENUM list";
CM_ SG_ 619 OBJ_CLS_TYPE1_PROB_044 "Classification Type 1 probablity";
CM_ SG_ 619 OBJ_CLS_TYPE6_044 "Classification Type 6(Lowest Prob), selected from ENUM list";
CM_ SG_ 619 OBJ_CLS_TYPE6_PROB_044 "Classification Type 1 probablity";
CM_ SG_ 619 OBJ_RCS_044 "Representative RCS of the complete recognized object, Not implemented";
CM_ SG_ 619 OBJ_REF_PT_LONG_OFFSET_044 "Outer edges of the recognized object’s bounding box in Y axis";
CM_ SG_ 619 OBJ_REF_PT_LAT_OFFSET_044 "Outer edges of the recognized object’s bounding box in X axis";
CM_ SG_ 619 OBJ_YAW_RATE_044 "Orientation rate of track's bounding box in VCS coordinate";
CM_ SG_ 619 OBJ_GROUP_ID_044 "Objects which are linked together shall have same group ID";
CM_ SG_ 619 OBJ_POS_ERR_CRR_COEF_044 "vx-vy correlation due to small error in radial direction and big in cross radial - position Correlation Coefficient Error";
CM_ SG_ 619 OBJ_VELOCITY_ERR_CRR_COEF_044 "vx-vy correlation due to small error in radial direction and big in cross radial - velocity Correlation Coefficient Error";
CM_ SG_ 619 OBJ_ACCEL_ERR_CRR_COEF_044 "vx-vy correlation due to small error in radial direction and big in cross radial - Acceleration Correlation Coefficient Error";
CM_ SG_ 620 OBJ_ALIVE_TIME_045 "Time since object initialization in msec. Tracker internal may have bigger values. On the output interface, we should saturate the signal in that case.";
CM_ SG_ 620 OBJ_ACCELERATION_LONG_ERR_045 "acceleration along Longi  direction";
CM_ SG_ 620 OBJ_ACCELERATION_LAT_ERR_045 "acceleration along Lat direction error";
CM_ SG_ 620 OBJ_POS_LONG_ERR_045 "Lat-position error of object track's centroid in VCS coordinate";
CM_ SG_ 620 OBJ_POS_LAT_ERR_045 "Lat-position error of object track's centroid in VCS coordinate";
CM_ SG_ 620 OBJ_TRACK_MOTION_MODEL_045 "Object tracking uses a motion model for tracking moving items";
CM_ SG_ 620 OBJ_DIMENSION_WIDTH_045 "Lat distance from centroid to edge of bounding box.";
CM_ SG_ 620 OBJ_DIMENSION_LENGTH_045 "Longi distance from centroid to edge of bounding box.";
CM_ SG_ 620 OBJ_EXISTENCE_PROB_045 "Probability that the target is an actual target";
CM_ SG_ 620 OBJ_YAW_ANGLE_045 "Orientation of track's bounding box in VCS coordinate";
CM_ SG_ 620 OBJ_ID_045 "ID of object tracks, zero-ID represents an inactive track";
CM_ SG_ 620 OBJ_MOVEMENT_STATUS_045 "Information about a possible movement of the object during tracking";
CM_ SG_ 620 OBJ_MEASUREMENT_STATUS_045 "Objects should be sent out as fast as possible, even if not all statuses are observed and the object’s
signals might not be fully filled.";
CM_ SG_ 620 OBJ_POS_LONG_045 "Long-position of object track's centroid in VCS coordinate";
CM_ SG_ 620 OBJ_POS_LAT_045 "Lat-position of object track's centroid in VCS coordinate";
CM_ SG_ 620 OBJ_VELOCITY_LONG_045 "Over-the-ground velocity of object track's centroid along Long direction (in VCS coordinate)";
CM_ SG_ 620 OBJ_VELOCITY_LAT_045 "Over-the-ground velocity of object track's centroid along Lat direction (in VCS coordinate)";
CM_ SG_ 620 OBJ_ACCELERATION_LONG_045 "Over-the-ground track acceleration along Longi direction (in VCS coordinate)";
CM_ SG_ 620 OBJ_ACCELERATION_LAT_045 "Over-the-ground track acceleration along Lat direction (in VCS coordinate)";
CM_ SG_ 620 OBJ_VEH_TRACK_FLAG_045 "Indicates if current track is a vehicle";
CM_ SG_ 620 OBJ_TIMESTAMP_OFFSET_045 "A timestamp offset from the object list header timestamp for each object as we have different timestamps from different sensors leading to different timestamps on each object";
CM_ SG_ 620 OBJ_DIMENSION_WIDTH_ERR_045 "Lat distance or length error";
CM_ SG_ 620 OBJ_DIMENSION_LENGTH_ERR_045 "Longi distance or length error";
CM_ SG_ 620 OBJ_CLS_TYPE1_045 "Classification Type 1(Highest Prob), selected from ENUM list";
CM_ SG_ 620 OBJ_CLS_TYPE1_PROB_045 "Classification Type 1 probablity";
CM_ SG_ 620 OBJ_CLS_TYPE6_045 "Classification Type 6(Lowest Prob), selected from ENUM list";
CM_ SG_ 620 OBJ_CLS_TYPE6_PROB_045 "Classification Type 1 probablity";
CM_ SG_ 620 OBJ_RCS_045 "Representative RCS of the complete recognized object, Not implemented";
CM_ SG_ 620 OBJ_REF_PT_LONG_OFFSET_045 "Outer edges of the recognized object’s bounding box in Y axis";
CM_ SG_ 620 OBJ_REF_PT_LAT_OFFSET_045 "Outer edges of the recognized object’s bounding box in X axis";
CM_ SG_ 620 OBJ_YAW_RATE_045 "Orientation rate of track's bounding box in VCS coordinate";
CM_ SG_ 620 OBJ_GROUP_ID_045 "Objects which are linked together shall have same group ID";
CM_ SG_ 620 OBJ_POS_ERR_CRR_COEF_045 "vx-vy correlation due to small error in radial direction and big in cross radial - position Correlation Coefficient Error";
CM_ SG_ 620 OBJ_VELOCITY_ERR_CRR_COEF_045 "vx-vy correlation due to small error in radial direction and big in cross radial - velocity Correlation Coefficient Error";
CM_ SG_ 620 OBJ_ACCEL_ERR_CRR_COEF_045 "vx-vy correlation due to small error in radial direction and big in cross radial - Acceleration Correlation Coefficient Error";
CM_ SG_ 621 OBJ_ALIVE_TIME_046 "Time since object initialization in msec. Tracker internal may have bigger values. On the output interface, we should saturate the signal in that case.";
CM_ SG_ 621 OBJ_ACCELERATION_LONG_ERR_046 "acceleration along Longi  direction";
CM_ SG_ 621 OBJ_ACCELERATION_LAT_ERR_046 "acceleration along Lat direction error";
CM_ SG_ 621 OBJ_POS_LONG_ERR_046 "Lat-position error of object track's centroid in VCS coordinate";
CM_ SG_ 621 OBJ_POS_LAT_ERR_046 "Lat-position error of object track's centroid in VCS coordinate";
CM_ SG_ 621 OBJ_TRACK_MOTION_MODEL_046 "Object tracking uses a motion model for tracking moving items";
CM_ SG_ 621 OBJ_DIMENSION_WIDTH_046 "Lat distance from centroid to edge of bounding box.";
CM_ SG_ 621 OBJ_DIMENSION_LENGTH_046 "Longi distance from centroid to edge of bounding box.";
CM_ SG_ 621 OBJ_EXISTENCE_PROB_046 "Probability that the target is an actual target";
CM_ SG_ 621 OBJ_YAW_ANGLE_046 "Orientation of track's bounding box in VCS coordinate";
CM_ SG_ 621 OBJ_ID_046 "ID of object tracks, zero-ID represents an inactive track";
CM_ SG_ 621 OBJ_MOVEMENT_STATUS_046 "Information about a possible movement of the object during tracking";
CM_ SG_ 621 OBJ_MEASUREMENT_STATUS_046 "Objects should be sent out as fast as possible, even if not all statuses are observed and the object’s
signals might not be fully filled.";
CM_ SG_ 621 OBJ_POS_LONG_046 "Long-position of object track's centroid in VCS coordinate";
CM_ SG_ 621 OBJ_POS_LAT_046 "Lat-position of object track's centroid in VCS coordinate";
CM_ SG_ 621 OBJ_VELOCITY_LONG_046 "Over-the-ground velocity of object track's centroid along Long direction (in VCS coordinate)";
CM_ SG_ 621 OBJ_VELOCITY_LAT_046 "Over-the-ground velocity of object track's centroid along Lat direction (in VCS coordinate)";
CM_ SG_ 621 OBJ_ACCELERATION_LONG_046 "Over-the-ground track acceleration along Longi direction (in VCS coordinate)";
CM_ SG_ 621 OBJ_ACCELERATION_LAT_046 "Over-the-ground track acceleration along Lat direction (in VCS coordinate)";
CM_ SG_ 621 OBJ_VEH_TRACK_FLAG_046 "Indicates if current track is a vehicle";
CM_ SG_ 621 OBJ_TIMESTAMP_OFFSET_046 "A timestamp offset from the object list header timestamp for each object as we have different timestamps from different sensors leading to different timestamps on each object";
CM_ SG_ 621 OBJ_DIMENSION_WIDTH_ERR_046 "Lat distance or length error";
CM_ SG_ 621 OBJ_DIMENSION_LENGTH_ERR_046 "Longi distance or length error";
CM_ SG_ 621 OBJ_CLS_TYPE1_046 "Classification Type 1(Highest Prob), selected from ENUM list";
CM_ SG_ 621 OBJ_CLS_TYPE1_PROB_046 "Classification Type 1 probablity";
CM_ SG_ 621 OBJ_CLS_TYPE6_046 "Classification Type 6(Lowest Prob), selected from ENUM list";
CM_ SG_ 621 OBJ_CLS_TYPE6_PROB_046 "Classification Type 1 probablity";
CM_ SG_ 621 OBJ_RCS_046 "Representative RCS of the complete recognized object, Not implemented";
CM_ SG_ 621 OBJ_REF_PT_LONG_OFFSET_046 "Outer edges of the recognized object’s bounding box in Y axis";
CM_ SG_ 621 OBJ_REF_PT_LAT_OFFSET_046 "Outer edges of the recognized object’s bounding box in X axis";
CM_ SG_ 621 OBJ_YAW_RATE_046 "Orientation rate of track's bounding box in VCS coordinate";
CM_ SG_ 621 OBJ_GROUP_ID_046 "Objects which are linked together shall have same group ID";
CM_ SG_ 621 OBJ_POS_ERR_CRR_COEF_046 "vx-vy correlation due to small error in radial direction and big in cross radial - position Correlation Coefficient Error";
CM_ SG_ 621 OBJ_VELOCITY_ERR_CRR_COEF_046 "vx-vy correlation due to small error in radial direction and big in cross radial - velocity Correlation Coefficient Error";
CM_ SG_ 621 OBJ_ACCEL_ERR_CRR_COEF_046 "vx-vy correlation due to small error in radial direction and big in cross radial - Acceleration Correlation Coefficient Error";
CM_ SG_ 622 OBJ_ALIVE_TIME_047 "Time since object initialization in msec. Tracker internal may have bigger values. On the output interface, we should saturate the signal in that case.";
CM_ SG_ 622 OBJ_ACCELERATION_LONG_ERR_047 "acceleration along Longi  direction";
CM_ SG_ 622 OBJ_ACCELERATION_LAT_ERR_047 "acceleration along Lat direction error";
CM_ SG_ 622 OBJ_POS_LONG_ERR_047 "Lat-position error of object track's centroid in VCS coordinate";
CM_ SG_ 622 OBJ_POS_LAT_ERR_047 "Lat-position error of object track's centroid in VCS coordinate";
CM_ SG_ 622 OBJ_TRACK_MOTION_MODEL_047 "Object tracking uses a motion model for tracking moving items";
CM_ SG_ 622 OBJ_DIMENSION_WIDTH_047 "Lat distance from centroid to edge of bounding box.";
CM_ SG_ 622 OBJ_DIMENSION_LENGTH_047 "Longi distance from centroid to edge of bounding box.";
CM_ SG_ 622 OBJ_EXISTENCE_PROB_047 "Probability that the target is an actual target";
CM_ SG_ 622 OBJ_YAW_ANGLE_047 "Orientation of track's bounding box in VCS coordinate";
CM_ SG_ 622 OBJ_ID_047 "ID of object tracks, zero-ID represents an inactive track";
CM_ SG_ 622 OBJ_MOVEMENT_STATUS_047 "Information about a possible movement of the object during tracking";
CM_ SG_ 622 OBJ_MEASUREMENT_STATUS_047 "Objects should be sent out as fast as possible, even if not all statuses are observed and the object’s
signals might not be fully filled.";
CM_ SG_ 622 OBJ_POS_LONG_047 "Long-position of object track's centroid in VCS coordinate";
CM_ SG_ 622 OBJ_POS_LAT_047 "Lat-position of object track's centroid in VCS coordinate";
CM_ SG_ 622 OBJ_VELOCITY_LONG_047 "Over-the-ground velocity of object track's centroid along Long direction (in VCS coordinate)";
CM_ SG_ 622 OBJ_VELOCITY_LAT_047 "Over-the-ground velocity of object track's centroid along Lat direction (in VCS coordinate)";
CM_ SG_ 622 OBJ_ACCELERATION_LONG_047 "Over-the-ground track acceleration along Longi direction (in VCS coordinate)";
CM_ SG_ 622 OBJ_ACCELERATION_LAT_047 "Over-the-ground track acceleration along Lat direction (in VCS coordinate)";
CM_ SG_ 622 OBJ_VEH_TRACK_FLAG_047 "Indicates if current track is a vehicle";
CM_ SG_ 622 OBJ_TIMESTAMP_OFFSET_047 "A timestamp offset from the object list header timestamp for each object as we have different timestamps from different sensors leading to different timestamps on each object";
CM_ SG_ 622 OBJ_DIMENSION_WIDTH_ERR_047 "Lat distance or length error";
CM_ SG_ 622 OBJ_DIMENSION_LENGTH_ERR_047 "Longi distance or length error";
CM_ SG_ 622 OBJ_CLS_TYPE1_047 "Classification Type 1(Highest Prob), selected from ENUM list";
CM_ SG_ 622 OBJ_CLS_TYPE1_PROB_047 "Classification Type 1 probablity";
CM_ SG_ 622 OBJ_CLS_TYPE6_047 "Classification Type 6(Lowest Prob), selected from ENUM list";
CM_ SG_ 622 OBJ_CLS_TYPE6_PROB_047 "Classification Type 1 probablity";
CM_ SG_ 622 OBJ_RCS_047 "Representative RCS of the complete recognized object, Not implemented";
CM_ SG_ 622 OBJ_REF_PT_LONG_OFFSET_047 "Outer edges of the recognized object’s bounding box in Y axis";
CM_ SG_ 622 OBJ_REF_PT_LAT_OFFSET_047 "Outer edges of the recognized object’s bounding box in X axis";
CM_ SG_ 622 OBJ_YAW_RATE_047 "Orientation rate of track's bounding box in VCS coordinate";
CM_ SG_ 622 OBJ_GROUP_ID_047 "Objects which are linked together shall have same group ID";
CM_ SG_ 622 OBJ_POS_ERR_CRR_COEF_047 "vx-vy correlation due to small error in radial direction and big in cross radial - position Correlation Coefficient Error";
CM_ SG_ 622 OBJ_VELOCITY_ERR_CRR_COEF_047 "vx-vy correlation due to small error in radial direction and big in cross radial - velocity Correlation Coefficient Error";
CM_ SG_ 622 OBJ_ACCEL_ERR_CRR_COEF_047 "vx-vy correlation due to small error in radial direction and big in cross radial - Acceleration Correlation Coefficient Error";
CM_ SG_ 623 OBJ_ALIVE_TIME_048 "Time since object initialization in msec. Tracker internal may have bigger values. On the output interface, we should saturate the signal in that case.";
CM_ SG_ 623 OBJ_ACCELERATION_LONG_ERR_048 "acceleration along Longi  direction";
CM_ SG_ 623 OBJ_ACCELERATION_LAT_ERR_048 "acceleration along Lat direction error";
CM_ SG_ 623 OBJ_POS_LONG_ERR_048 "Lat-position error of object track's centroid in VCS coordinate";
CM_ SG_ 623 OBJ_POS_LAT_ERR_048 "Lat-position error of object track's centroid in VCS coordinate";
CM_ SG_ 623 OBJ_TRACK_MOTION_MODEL_048 "Object tracking uses a motion model for tracking moving items";
CM_ SG_ 623 OBJ_DIMENSION_WIDTH_048 "Lat distance from centroid to edge of bounding box.";
CM_ SG_ 623 OBJ_DIMENSION_LENGTH_048 "Longi distance from centroid to edge of bounding box.";
CM_ SG_ 623 OBJ_EXISTENCE_PROB_048 "Probability that the target is an actual target";
CM_ SG_ 623 OBJ_YAW_ANGLE_048 "Orientation of track's bounding box in VCS coordinate";
CM_ SG_ 623 OBJ_ID_048 "ID of object tracks, zero-ID represents an inactive track";
CM_ SG_ 623 OBJ_MOVEMENT_STATUS_048 "Information about a possible movement of the object during tracking";
CM_ SG_ 623 OBJ_MEASUREMENT_STATUS_048 "Objects should be sent out as fast as possible, even if not all statuses are observed and the object’s
signals might not be fully filled.";
CM_ SG_ 623 OBJ_POS_LONG_048 "Long-position of object track's centroid in VCS coordinate";
CM_ SG_ 623 OBJ_POS_LAT_048 "Lat-position of object track's centroid in VCS coordinate";
CM_ SG_ 623 OBJ_VELOCITY_LONG_048 "Over-the-ground velocity of object track's centroid along Long direction (in VCS coordinate)";
CM_ SG_ 623 OBJ_VELOCITY_LAT_048 "Over-the-ground velocity of object track's centroid along Lat direction (in VCS coordinate)";
CM_ SG_ 623 OBJ_ACCELERATION_LONG_048 "Over-the-ground track acceleration along Longi direction (in VCS coordinate)";
CM_ SG_ 623 OBJ_ACCELERATION_LAT_048 "Over-the-ground track acceleration along Lat direction (in VCS coordinate)";
CM_ SG_ 623 OBJ_VEH_TRACK_FLAG_048 "Indicates if current track is a vehicle";
CM_ SG_ 623 OBJ_TIMESTAMP_OFFSET_048 "A timestamp offset from the object list header timestamp for each object as we have different timestamps from different sensors leading to different timestamps on each object";
CM_ SG_ 623 OBJ_DIMENSION_WIDTH_ERR_048 "Lat distance or length error";
CM_ SG_ 623 OBJ_DIMENSION_LENGTH_ERR_048 "Longi distance or length error";
CM_ SG_ 623 OBJ_CLS_TYPE1_048 "Classification Type 1(Highest Prob), selected from ENUM list";
CM_ SG_ 623 OBJ_CLS_TYPE1_PROB_048 "Classification Type 1 probablity";
CM_ SG_ 623 OBJ_CLS_TYPE6_048 "Classification Type 6(Lowest Prob), selected from ENUM list";
CM_ SG_ 623 OBJ_CLS_TYPE6_PROB_048 "Classification Type 1 probablity";
CM_ SG_ 623 OBJ_RCS_048 "Representative RCS of the complete recognized object, Not implemented";
CM_ SG_ 623 OBJ_REF_PT_LONG_OFFSET_048 "Outer edges of the recognized object’s bounding box in Y axis";
CM_ SG_ 623 OBJ_REF_PT_LAT_OFFSET_048 "Outer edges of the recognized object’s bounding box in X axis";
CM_ SG_ 623 OBJ_YAW_RATE_048 "Orientation rate of track's bounding box in VCS coordinate";
CM_ SG_ 623 OBJ_GROUP_ID_048 "Objects which are linked together shall have same group ID";
CM_ SG_ 623 OBJ_POS_ERR_CRR_COEF_048 "vx-vy correlation due to small error in radial direction and big in cross radial - position Correlation Coefficient Error";
CM_ SG_ 623 OBJ_VELOCITY_ERR_CRR_COEF_048 "vx-vy correlation due to small error in radial direction and big in cross radial - velocity Correlation Coefficient Error";
CM_ SG_ 623 OBJ_ACCEL_ERR_CRR_COEF_048 "vx-vy correlation due to small error in radial direction and big in cross radial - Acceleration Correlation Coefficient Error";

BA_DEF_ BO_ "CanTpBs" INT 0 255;
BA_DEF_ BO_ "EventRateOfChange" INT 10 10000;
BA_DEF_ BO_ "GenMsgCycleTime" INT 0 100000;
BA_DEF_ BO_ "GenMsgILSupport" ENUM  "No","Yes";
BA_DEF_ BO_ "GenMsgNrOfRepetition" INT 0 100;
BA_DEF_ BO_ "GenMsgSendType" ENUM  "FixedPeriodic","Event","EnabledPeriodic","NotUsed","NotUsed","EventPeriodic","NotUsed","NotUsed","NoMsgSendType";
BA_DEF_ BO_ "NetworkInitialization" ENUM  "No","Yes";
BA_DEF_ BO_ "VFrameFormat" ENUM  "StandardCAN","ExtendedCAN","reserved","reserved","reserved","reserved","reserved","reserved","reserved","reserved","reserved","reserved","reserved","reserved","StandardCAN_FD","ExtendedCAN_FD";
BA_DEF_ SG_ "GenSigCmt" STRING;
BA_DEF_ SG_ "GenSigCycleTime" INT 0 0;
BA_DEF_ SG_ "GenSigSendType" ENUM  "Cyclic","OnWrite","vector_leerstring","OnChange","vector_leerstring","IfActive","vector_leerstring","NoSigSendType";
BA_DEF_ SG_ "GenSigStartValue" INT 0 1000000000;
BA_DEF_ SG_ "GenSigTimeoutTime" INT 0 0;
BA_DEF_ SG_ "GenSigVtEn" STRING;
BA_DEF_ SG_ "GenSigVtName" STRING;
BA_DEF_DEF_ "CanTpBs" 255;
BA_DEF_DEF_ "EventRateOfChange" 10000;
BA_DEF_DEF_ "GenMsgCycleTime" 0;
BA_DEF_DEF_ "GenMsgILSupport" "Yes";
BA_DEF_DEF_ "GenMsgNrOfRepetition" 0;
BA_DEF_DEF_ "GenMsgSendType" "NoMsgSendType";
BA_DEF_DEF_ "GenSigCmt" "";
BA_DEF_DEF_ "GenSigCycleTime" 0;
BA_DEF_DEF_ "GenSigSendType" "NoSigSendType";
BA_DEF_DEF_ "GenSigStartValue" 0;
BA_DEF_DEF_ "GenSigTimeoutTime" 0;
BA_DEF_DEF_ "GenSigVtEn" "";
BA_DEF_DEF_ "GenSigVtName" "";
BA_DEF_DEF_ "NetworkInitialization" "Yes";
BA_DEF_DEF_ "VFrameFormat" "StandardCAN_FD";
BA_ "GenMsgSendType" BO_ 607 1;
BA_ "GenMsgSendType" BO_ 608 1;
BA_ "GenMsgSendType" BO_ 609 1;
BA_ "GenMsgSendType" BO_ 610 1;
BA_ "GenMsgSendType" BO_ 611 1;
BA_ "GenMsgSendType" BO_ 612 1;
BA_ "GenMsgSendType" BO_ 613 1;
BA_ "GenMsgSendType" BO_ 614 1;
BA_ "GenMsgSendType" BO_ 615 1;
BA_ "GenMsgSendType" BO_ 616 1;
BA_ "GenMsgSendType" BO_ 617 1;
BA_ "GenMsgSendType" BO_ 618 1;
BA_ "GenMsgSendType" BO_ 619 1;
BA_ "GenMsgSendType" BO_ 620 1;
BA_ "GenMsgSendType" BO_ 621 1;
BA_ "GenMsgSendType" BO_ 622 1;
BA_ "GenMsgSendType" BO_ 623 1;
BA_ "GenSigStartValue" SG_ 607 OBJ_YAW_ANGLE_032 2000;
BA_ "GenSigStartValue" SG_ 607 OBJ_POS_LONG_032 32700;
BA_ "GenSigStartValue" SG_ 607 OBJ_POS_LAT_032 32700;
BA_ "GenSigStartValue" SG_ 607 OBJ_VELOCITY_LONG_032 16300;
BA_ "GenSigStartValue" SG_ 607 OBJ_VELOCITY_LAT_032 16300;
BA_ "GenSigStartValue" SG_ 607 OBJ_ACCELERATION_LONG_032 400;
BA_ "GenSigStartValue" SG_ 607 OBJ_ACCELERATION_LAT_032 400;
BA_ "GenSigStartValue" SG_ 607 OBJ_TIMESTAMP_OFFSET_032 127;
BA_ "GenSigStartValue" SG_ 607 OBJ_RCS_032 64;
BA_ "GenSigStartValue" SG_ 607 OBJ_YAW_RATE_032 448;
BA_ "GenSigStartValue" SG_ 607 OBJ_POS_ERR_CRR_COEF_032 120;
BA_ "GenSigStartValue" SG_ 607 OBJ_VELOCITY_ERR_CRR_COEF_032 120;
BA_ "GenSigStartValue" SG_ 607 OBJ_ACCEL_ERR_CRR_COEF_032 120;
BA_ "GenSigStartValue" SG_ 608 OBJ_YAW_ANGLE_033 2000;
BA_ "GenSigStartValue" SG_ 608 OBJ_POS_LONG_033 32700;
BA_ "GenSigStartValue" SG_ 608 OBJ_POS_LAT_033 32700;
BA_ "GenSigStartValue" SG_ 608 OBJ_VELOCITY_LONG_033 16300;
BA_ "GenSigStartValue" SG_ 608 OBJ_VELOCITY_LAT_033 16300;
BA_ "GenSigStartValue" SG_ 608 OBJ_ACCELERATION_LONG_033 400;
BA_ "GenSigStartValue" SG_ 608 OBJ_ACCELERATION_LAT_033 400;
BA_ "GenSigStartValue" SG_ 608 OBJ_TIMESTAMP_OFFSET_033 127;
BA_ "GenSigStartValue" SG_ 608 OBJ_RCS_033 64;
BA_ "GenSigStartValue" SG_ 608 OBJ_YAW_RATE_033 448;
BA_ "GenSigStartValue" SG_ 608 OBJ_POS_ERR_CRR_COEF_033 120;
BA_ "GenSigStartValue" SG_ 608 OBJ_VELOCITY_ERR_CRR_COEF_033 120;
BA_ "GenSigStartValue" SG_ 608 OBJ_ACCEL_ERR_CRR_COEF_033 120;
BA_ "GenSigStartValue" SG_ 609 OBJ_YAW_ANGLE_034 2000;
BA_ "GenSigStartValue" SG_ 609 OBJ_POS_LONG_034 32700;
BA_ "GenSigStartValue" SG_ 609 OBJ_POS_LAT_034 32700;
BA_ "GenSigStartValue" SG_ 609 OBJ_VELOCITY_LONG_034 16300;
BA_ "GenSigStartValue" SG_ 609 OBJ_VELOCITY_LAT_034 16300;
BA_ "GenSigStartValue" SG_ 609 OBJ_ACCELERATION_LONG_034 400;
BA_ "GenSigStartValue" SG_ 609 OBJ_ACCELERATION_LAT_034 400;
BA_ "GenSigStartValue" SG_ 609 OBJ_TIMESTAMP_OFFSET_034 127;
BA_ "GenSigStartValue" SG_ 609 OBJ_RCS_034 64;
BA_ "GenSigStartValue" SG_ 609 OBJ_YAW_RATE_034 448;
BA_ "GenSigStartValue" SG_ 609 OBJ_POS_ERR_CRR_COEF_034 120;
BA_ "GenSigStartValue" SG_ 609 OBJ_VELOCITY_ERR_CRR_COEF_034 120;
BA_ "GenSigStartValue" SG_ 609 OBJ_ACCEL_ERR_CRR_COEF_034 120;
BA_ "GenSigStartValue" SG_ 610 OBJ_YAW_ANGLE_035 2000;
BA_ "GenSigStartValue" SG_ 610 OBJ_POS_LONG_035 32700;
BA_ "GenSigStartValue" SG_ 610 OBJ_POS_LAT_035 32700;
BA_ "GenSigStartValue" SG_ 610 OBJ_VELOCITY_LONG_035 16300;
BA_ "GenSigStartValue" SG_ 610 OBJ_VELOCITY_LAT_035 16300;
BA_ "GenSigStartValue" SG_ 610 OBJ_ACCELERATION_LONG_035 400;
BA_ "GenSigStartValue" SG_ 610 OBJ_ACCELERATION_LAT_035 400;
BA_ "GenSigStartValue" SG_ 610 OBJ_TIMESTAMP_OFFSET_035 127;
BA_ "GenSigStartValue" SG_ 610 OBJ_RCS_035 64;
BA_ "GenSigStartValue" SG_ 610 OBJ_YAW_RATE_035 448;
BA_ "GenSigStartValue" SG_ 610 OBJ_POS_ERR_CRR_COEF_035 120;
BA_ "GenSigStartValue" SG_ 610 OBJ_VELOCITY_ERR_CRR_COEF_035 120;
BA_ "GenSigStartValue" SG_ 610 OBJ_ACCEL_ERR_CRR_COEF_035 120;
BA_ "GenSigStartValue" SG_ 611 OBJ_YAW_ANGLE_036 2000;
BA_ "GenSigStartValue" SG_ 611 OBJ_POS_LONG_036 32700;
BA_ "GenSigStartValue" SG_ 611 OBJ_POS_LAT_036 32700;
BA_ "GenSigStartValue" SG_ 611 OBJ_VELOCITY_LONG_036 16300;
BA_ "GenSigStartValue" SG_ 611 OBJ_VELOCITY_LAT_036 16300;
BA_ "GenSigStartValue" SG_ 611 OBJ_ACCELERATION_LONG_036 400;
BA_ "GenSigStartValue" SG_ 611 OBJ_ACCELERATION_LAT_036 400;
BA_ "GenSigStartValue" SG_ 611 OBJ_TIMESTAMP_OFFSET_036 127;
BA_ "GenSigStartValue" SG_ 611 OBJ_RCS_036 64;
BA_ "GenSigStartValue" SG_ 611 OBJ_YAW_RATE_036 448;
BA_ "GenSigStartValue" SG_ 611 OBJ_POS_ERR_CRR_COEF_036 120;
BA_ "GenSigStartValue" SG_ 611 OBJ_VELOCITY_ERR_CRR_COEF_036 120;
BA_ "GenSigStartValue" SG_ 611 OBJ_ACCEL_ERR_CRR_COEF_036 120;
BA_ "GenSigStartValue" SG_ 612 OBJ_YAW_ANGLE_037 2000;
BA_ "GenSigStartValue" SG_ 612 OBJ_POS_LONG_037 32700;
BA_ "GenSigStartValue" SG_ 612 OBJ_POS_LAT_037 32700;
BA_ "GenSigStartValue" SG_ 612 OBJ_VELOCITY_LONG_037 16300;
BA_ "GenSigStartValue" SG_ 612 OBJ_VELOCITY_LAT_037 16300;
BA_ "GenSigStartValue" SG_ 612 OBJ_ACCELERATION_LONG_037 400;
BA_ "GenSigStartValue" SG_ 612 OBJ_ACCELERATION_LAT_037 400;
BA_ "GenSigStartValue" SG_ 612 OBJ_TIMESTAMP_OFFSET_037 127;
BA_ "GenSigStartValue" SG_ 612 OBJ_RCS_037 64;
BA_ "GenSigStartValue" SG_ 612 OBJ_YAW_RATE_037 448;
BA_ "GenSigStartValue" SG_ 612 OBJ_POS_ERR_CRR_COEF_037 120;
BA_ "GenSigStartValue" SG_ 612 OBJ_VELOCITY_ERR_CRR_COEF_037 120;
BA_ "GenSigStartValue" SG_ 612 OBJ_ACCEL_ERR_CRR_COEF_037 120;
BA_ "GenSigStartValue" SG_ 613 OBJ_YAW_ANGLE_038 2000;
BA_ "GenSigStartValue" SG_ 613 OBJ_POS_LONG_038 32700;
BA_ "GenSigStartValue" SG_ 613 OBJ_POS_LAT_038 32700;
BA_ "GenSigStartValue" SG_ 613 OBJ_VELOCITY_LONG_038 16300;
BA_ "GenSigStartValue" SG_ 613 OBJ_VELOCITY_LAT_038 16300;
BA_ "GenSigStartValue" SG_ 613 OBJ_ACCELERATION_LONG_038 400;
BA_ "GenSigStartValue" SG_ 613 OBJ_ACCELERATION_LAT_038 400;
BA_ "GenSigStartValue" SG_ 613 OBJ_TIMESTAMP_OFFSET_038 127;
BA_ "GenSigStartValue" SG_ 613 OBJ_RCS_038 64;
BA_ "GenSigStartValue" SG_ 613 OBJ_YAW_RATE_038 448;
BA_ "GenSigStartValue" SG_ 613 OBJ_POS_ERR_CRR_COEF_038 120;
BA_ "GenSigStartValue" SG_ 613 OBJ_VELOCITY_ERR_CRR_COEF_038 120;
BA_ "GenSigStartValue" SG_ 613 OBJ_ACCEL_ERR_CRR_COEF_038 120;
BA_ "GenSigStartValue" SG_ 614 OBJ_YAW_ANGLE_039 2000;
BA_ "GenSigStartValue" SG_ 614 OBJ_POS_LONG_039 32700;
BA_ "GenSigStartValue" SG_ 614 OBJ_POS_LAT_039 32700;
BA_ "GenSigStartValue" SG_ 614 OBJ_VELOCITY_LONG_039 16300;
BA_ "GenSigStartValue" SG_ 614 OBJ_VELOCITY_LAT_039 16300;
BA_ "GenSigStartValue" SG_ 614 OBJ_ACCELERATION_LONG_039 400;
BA_ "GenSigStartValue" SG_ 614 OBJ_ACCELERATION_LAT_039 400;
BA_ "GenSigStartValue" SG_ 614 OBJ_TIMESTAMP_OFFSET_039 127;
BA_ "GenSigStartValue" SG_ 614 OBJ_RCS_039 64;
BA_ "GenSigStartValue" SG_ 614 OBJ_YAW_RATE_039 448;
BA_ "GenSigStartValue" SG_ 614 OBJ_POS_ERR_CRR_COEF_039 120;
BA_ "GenSigStartValue" SG_ 614 OBJ_VELOCITY_ERR_CRR_COEF_039 120;
BA_ "GenSigStartValue" SG_ 614 OBJ_ACCEL_ERR_CRR_COEF_039 120;
BA_ "GenSigStartValue" SG_ 615 OBJ_YAW_ANGLE_040 2000;
BA_ "GenSigStartValue" SG_ 615 OBJ_POS_LONG_040 32700;
BA_ "GenSigStartValue" SG_ 615 OBJ_POS_LAT_040 32700;
BA_ "GenSigStartValue" SG_ 615 OBJ_VELOCITY_LONG_040 16300;
BA_ "GenSigStartValue" SG_ 615 OBJ_VELOCITY_LAT_040 16300;
BA_ "GenSigStartValue" SG_ 615 OBJ_ACCELERATION_LONG_040 400;
BA_ "GenSigStartValue" SG_ 615 OBJ_ACCELERATION_LAT_040 400;
BA_ "GenSigStartValue" SG_ 615 OBJ_TIMESTAMP_OFFSET_040 127;
BA_ "GenSigStartValue" SG_ 615 OBJ_RCS_040 64;
BA_ "GenSigStartValue" SG_ 615 OBJ_YAW_RATE_040 448;
BA_ "GenSigStartValue" SG_ 615 OBJ_POS_ERR_CRR_COEF_040 120;
BA_ "GenSigStartValue" SG_ 615 OBJ_VELOCITY_ERR_CRR_COEF_040 120;
BA_ "GenSigStartValue" SG_ 615 OBJ_ACCEL_ERR_CRR_COEF_040 120;
BA_ "GenSigStartValue" SG_ 616 OBJ_YAW_ANGLE_041 2000;
BA_ "GenSigStartValue" SG_ 616 OBJ_POS_LONG_041 32700;
BA_ "GenSigStartValue" SG_ 616 OBJ_POS_LAT_041 32700;
BA_ "GenSigStartValue" SG_ 616 OBJ_VELOCITY_LONG_041 16300;
BA_ "GenSigStartValue" SG_ 616 OBJ_VELOCITY_LAT_041 16300;
BA_ "GenSigStartValue" SG_ 616 OBJ_ACCELERATION_LONG_041 400;
BA_ "GenSigStartValue" SG_ 616 OBJ_ACCELERATION_LAT_041 400;
BA_ "GenSigStartValue" SG_ 616 OBJ_TIMESTAMP_OFFSET_041 127;
BA_ "GenSigStartValue" SG_ 616 OBJ_RCS_041 64;
BA_ "GenSigStartValue" SG_ 616 OBJ_YAW_RATE_041 448;
BA_ "GenSigStartValue" SG_ 616 OBJ_POS_ERR_CRR_COEF_041 120;
BA_ "GenSigStartValue" SG_ 616 OBJ_VELOCITY_ERR_CRR_COEF_041 120;
BA_ "GenSigStartValue" SG_ 616 OBJ_ACCEL_ERR_CRR_COEF_041 120;
BA_ "GenSigStartValue" SG_ 617 OBJ_YAW_ANGLE_042 2000;
BA_ "GenSigStartValue" SG_ 617 OBJ_POS_LONG_042 32700;
BA_ "GenSigStartValue" SG_ 617 OBJ_POS_LAT_042 32700;
BA_ "GenSigStartValue" SG_ 617 OBJ_VELOCITY_LONG_042 16300;
BA_ "GenSigStartValue" SG_ 617 OBJ_VELOCITY_LAT_042 16300;
BA_ "GenSigStartValue" SG_ 617 OBJ_ACCELERATION_LONG_042 400;
BA_ "GenSigStartValue" SG_ 617 OBJ_ACCELERATION_LAT_042 400;
BA_ "GenSigStartValue" SG_ 617 OBJ_TIMESTAMP_OFFSET_042 127;
BA_ "GenSigStartValue" SG_ 617 OBJ_RCS_042 64;
BA_ "GenSigStartValue" SG_ 617 OBJ_YAW_RATE_042 448;
BA_ "GenSigStartValue" SG_ 617 OBJ_POS_ERR_CRR_COEF_042 120;
BA_ "GenSigStartValue" SG_ 617 OBJ_VELOCITY_ERR_CRR_COEF_042 120;
BA_ "GenSigStartValue" SG_ 617 OBJ_ACCEL_ERR_CRR_COEF_042 120;
BA_ "GenSigStartValue" SG_ 618 OBJ_YAW_ANGLE_043 2000;
BA_ "GenSigStartValue" SG_ 618 OBJ_POS_LONG_043 32700;
BA_ "GenSigStartValue" SG_ 618 OBJ_POS_LAT_043 32700;
BA_ "GenSigStartValue" SG_ 618 OBJ_VELOCITY_LONG_043 16300;
BA_ "GenSigStartValue" SG_ 618 OBJ_VELOCITY_LAT_043 16300;
BA_ "GenSigStartValue" SG_ 618 OBJ_ACCELERATION_LONG_043 400;
BA_ "GenSigStartValue" SG_ 618 OBJ_ACCELERATION_LAT_043 400;
BA_ "GenSigStartValue" SG_ 618 OBJ_TIMESTAMP_OFFSET_043 127;
BA_ "GenSigStartValue" SG_ 618 OBJ_RCS_043 64;
BA_ "GenSigStartValue" SG_ 618 OBJ_YAW_RATE_043 448;
BA_ "GenSigStartValue" SG_ 618 OBJ_POS_ERR_CRR_COEF_043 120;
BA_ "GenSigStartValue" SG_ 618 OBJ_VELOCITY_ERR_CRR_COEF_043 120;
BA_ "GenSigStartValue" SG_ 618 OBJ_ACCEL_ERR_CRR_COEF_043 120;
BA_ "GenSigStartValue" SG_ 619 OBJ_YAW_ANGLE_044 2000;
BA_ "GenSigStartValue" SG_ 619 OBJ_POS_LONG_044 32700;
BA_ "GenSigStartValue" SG_ 619 OBJ_POS_LAT_044 32700;
BA_ "GenSigStartValue" SG_ 619 OBJ_VELOCITY_LONG_044 16300;
BA_ "GenSigStartValue" SG_ 619 OBJ_VELOCITY_LAT_044 16300;
BA_ "GenSigStartValue" SG_ 619 OBJ_ACCELERATION_LONG_044 400;
BA_ "GenSigStartValue" SG_ 619 OBJ_ACCELERATION_LAT_044 400;
BA_ "GenSigStartValue" SG_ 619 OBJ_TIMESTAMP_OFFSET_044 127;
BA_ "GenSigStartValue" SG_ 619 OBJ_RCS_044 64;
BA_ "GenSigStartValue" SG_ 619 OBJ_YAW_RATE_044 448;
BA_ "GenSigStartValue" SG_ 619 OBJ_POS_ERR_CRR_COEF_044 120;
BA_ "GenSigStartValue" SG_ 619 OBJ_VELOCITY_ERR_CRR_COEF_044 120;
BA_ "GenSigStartValue" SG_ 619 OBJ_ACCEL_ERR_CRR_COEF_044 120;
BA_ "GenSigStartValue" SG_ 620 OBJ_YAW_ANGLE_045 2000;
BA_ "GenSigStartValue" SG_ 620 OBJ_POS_LONG_045 32700;
BA_ "GenSigStartValue" SG_ 620 OBJ_POS_LAT_045 32700;
BA_ "GenSigStartValue" SG_ 620 OBJ_VELOCITY_LONG_045 16300;
BA_ "GenSigStartValue" SG_ 620 OBJ_VELOCITY_LAT_045 16300;
BA_ "GenSigStartValue" SG_ 620 OBJ_ACCELERATION_LONG_045 400;
BA_ "GenSigStartValue" SG_ 620 OBJ_ACCELERATION_LAT_045 400;
BA_ "GenSigStartValue" SG_ 620 OBJ_TIMESTAMP_OFFSET_045 127;
BA_ "GenSigStartValue" SG_ 620 OBJ_RCS_045 64;
BA_ "GenSigStartValue" SG_ 620 OBJ_YAW_RATE_045 448;
BA_ "GenSigStartValue" SG_ 620 OBJ_POS_ERR_CRR_COEF_045 120;
BA_ "GenSigStartValue" SG_ 620 OBJ_VELOCITY_ERR_CRR_COEF_045 120;
BA_ "GenSigStartValue" SG_ 620 OBJ_ACCEL_ERR_CRR_COEF_045 120;
BA_ "GenSigStartValue" SG_ 621 OBJ_YAW_ANGLE_046 2000;
BA_ "GenSigStartValue" SG_ 621 OBJ_POS_LONG_046 32700;
BA_ "GenSigStartValue" SG_ 621 OBJ_POS_LAT_046 32700;
BA_ "GenSigStartValue" SG_ 621 OBJ_VELOCITY_LONG_046 16300;
BA_ "GenSigStartValue" SG_ 621 OBJ_VELOCITY_LAT_046 16300;
BA_ "GenSigStartValue" SG_ 621 OBJ_ACCELERATION_LONG_046 400;
BA_ "GenSigStartValue" SG_ 621 OBJ_ACCELERATION_LAT_046 400;
BA_ "GenSigStartValue" SG_ 621 OBJ_TIMESTAMP_OFFSET_046 127;
BA_ "GenSigStartValue" SG_ 621 OBJ_RCS_046 64;
BA_ "GenSigStartValue" SG_ 621 OBJ_YAW_RATE_046 448;
BA_ "GenSigStartValue" SG_ 621 OBJ_POS_ERR_CRR_COEF_046 120;
BA_ "GenSigStartValue" SG_ 621 OBJ_VELOCITY_ERR_CRR_COEF_046 120;
BA_ "GenSigStartValue" SG_ 621 OBJ_ACCEL_ERR_CRR_COEF_046 120;
BA_ "GenSigStartValue" SG_ 622 OBJ_YAW_ANGLE_047 2000;
BA_ "GenSigStartValue" SG_ 622 OBJ_POS_LONG_047 32700;
BA_ "GenSigStartValue" SG_ 622 OBJ_POS_LAT_047 32700;
BA_ "GenSigStartValue" SG_ 622 OBJ_VELOCITY_LONG_047 16300;
BA_ "GenSigStartValue" SG_ 622 OBJ_VELOCITY_LAT_047 16300;
BA_ "GenSigStartValue" SG_ 622 OBJ_ACCELERATION_LONG_047 400;
BA_ "GenSigStartValue" SG_ 622 OBJ_ACCELERATION_LAT_047 400;
BA_ "GenSigStartValue" SG_ 622 OBJ_TIMESTAMP_OFFSET_047 127;
BA_ "GenSigStartValue" SG_ 622 OBJ_RCS_047 64;
BA_ "GenSigStartValue" SG_ 622 OBJ_YAW_RATE_047 448;
BA_ "GenSigStartValue" SG_ 622 OBJ_POS_ERR_CRR_COEF_047 120;
BA_ "GenSigStartValue" SG_ 622 OBJ_VELOCITY_ERR_CRR_COEF_047 120;
BA_ "GenSigStartValue" SG_ 622 OBJ_ACCEL_ERR_CRR_COEF_047 120;
BA_ "GenSigStartValue" SG_ 623 OBJ_YAW_ANGLE_048 2000;
BA_ "GenSigStartValue" SG_ 623 OBJ_POS_LONG_048 32700;
BA_ "GenSigStartValue" SG_ 623 OBJ_POS_LAT_048 32700;
BA_ "GenSigStartValue" SG_ 623 OBJ_VELOCITY_LONG_048 16300;
BA_ "GenSigStartValue" SG_ 623 OBJ_VELOCITY_LAT_048 16300;
BA_ "GenSigStartValue" SG_ 623 OBJ_ACCELERATION_LONG_048 400;
BA_ "GenSigStartValue" SG_ 623 OBJ_ACCELERATION_LAT_048 400;
BA_ "GenSigStartValue" SG_ 623 OBJ_TIMESTAMP_OFFSET_048 127;
BA_ "GenSigStartValue" SG_ 623 OBJ_RCS_048 64;
BA_ "GenSigStartValue" SG_ 623 OBJ_YAW_RATE_048 448;
BA_ "GenSigStartValue" SG_ 623 OBJ_POS_ERR_CRR_COEF_048 120;
BA_ "GenSigStartValue" SG_ 623 OBJ_VELOCITY_ERR_CRR_COEF_048 120;
BA_ "GenSigStartValue" SG_ 623 OBJ_ACCEL_ERR_CRR_COEF_048 120;
VAL_ 607 OBJ_TRACK_MOTION_MODEL_032 0 "INVALID" 1 "CCV" 2 "CTCA" 3 "CCA";
VAL_ 607 OBJ_MOVEMENT_STATUS_032 0 "UNKNOWN" 1 "MOVING" 2 "SLOW_MOVING" 3 "FAST_MOVING" 4 "STATIONARY" 5 "STOPPED" 6 "RESERVED1" 7 "RESERVED2";
VAL_ 607 OBJ_MEASUREMENT_STATUS_032 0 "Invalid" 1 "New" 2 "Predicted" 3 "PartlyMeasured" 4 "Measured" 5 "Occluded";
VAL_ 607 OBJ_CLS_TYPE1_032 0 "UNKNOWN_MOVING_OBJ" 1 "CAR" 2 "TRUCK" 3 "MOTOR_BIKE" 4 "BICYCLE" 5 "PEDESTRIAN" 6 "ROAD_BOUNDRY" 7 "STATIC_OBJECT" 8 "TRAFFIC_LIGHT" 9 "TRAFFIC_SIGN" 10 "TWO_WHEELERS" 11 "RESERVED" 12 "RESERVED" 14 "OBJECT_UNDETERMIND" 15 "VEHICLE_UNDETERMIND";
VAL_ 607 OBJ_CLS_TYPE2_032 0 "UNKNOWN_MOVING_OBJ" 1 "CAR" 2 "TRUCK" 3 "MOTOR_BIKE" 4 "BICYCLE" 5 "PEDESTRIAN" 6 "ROAD_BOUNDRY" 7 "STATIC_OBJECT" 8 "TRAFFIC_LIGHT" 9 "TRAFFIC_SIGN" 10 "TWO_WHEELERS" 11 "RESERVED" 12 "RESERVED" 14 "OBJECT_UNDETERMIND" 15 "VEHICLE_UNDETERMIND";
VAL_ 607 OBJ_CLS_TYPE3_032 0 "UNKNOWN_MOVING_OBJ" 1 "CAR" 2 "TRUCK" 3 "MOTOR_BIKE" 4 "BICYCLE" 5 "PEDESTRIAN" 6 "ROAD_BOUNDRY" 7 "STATIC_OBJECT" 8 "TRAFFIC_LIGHT" 9 "TRAFFIC_SIGN" 10 "TWO_WHEELERS" 11 "RESERVED" 12 "RESERVED" 14 "OBJECT_UNDETERMIND" 15 "VEHICLE_UNDETERMIND";
VAL_ 607 OBJ_CLS_TYPE4_032 0 "UNKNOWN_MOVING_OBJ" 1 "CAR" 2 "TRUCK" 3 "MOTOR_BIKE" 4 "BICYCLE" 5 "PEDESTRIAN" 6 "ROAD_BOUNDRY" 7 "STATIC_OBJECT" 8 "TRAFFIC_LIGHT" 9 "TRAFFIC_SIGN" 10 "TWO_WHEELERS" 11 "RESERVED" 12 "RESERVED" 14 "OBJECT_UNDETERMIND" 15 "VEHICLE_UNDETERMIND";
VAL_ 607 OBJ_CLS_TYPE5_032 0 "UNKNOWN_MOVING_OBJ" 1 "CAR" 2 "TRUCK" 3 "MOTOR_BIKE" 4 "BICYCLE" 5 "PEDESTRIAN" 6 "ROAD_BOUNDRY" 7 "STATIC_OBJECT" 8 "TRAFFIC_LIGHT" 9 "TRAFFIC_SIGN" 10 "TWO_WHEELERS" 11 "RESERVED" 12 "RESERVED" 14 "OBJECT_UNDETERMIND" 15 "VEHICLE_UNDETERMIND";
VAL_ 607 OBJ_CLS_TYPE6_032 0 "UNKNOWN_MOVING_OBJ" 1 "CAR" 2 "TRUCK" 3 "MOTOR_BIKE" 4 "BICYCLE" 5 "PEDESTRIAN" 6 "ROAD_BOUNDRY" 7 "STATIC_OBJECT" 8 "TRAFFIC_LIGHT" 9 "TRAFFIC_SIGN" 10 "TWO_WHEELERS" 11 "RESERVED" 12 "RESERVED" 14 "OBJECT_UNDETERMIND" 15 "VEHICLE_UNDETERMIND";
VAL_ 608 OBJ_TRACK_MOTION_MODEL_033 0 "INVALID" 1 "CCV" 2 "CTCA" 3 "CCA";
VAL_ 608 OBJ_MOVEMENT_STATUS_033 0 "UNKNOWN" 1 "MOVING" 2 "SLOW_MOVING" 3 "FAST_MOVING" 4 "STATIONARY" 5 "STOPPED" 6 "RESERVED1" 7 "RESERVED2";
VAL_ 608 OBJ_MEASUREMENT_STATUS_033 0 "Invalid" 1 "New" 2 "Predicted" 3 "PartlyMeasured" 4 "Measured" 5 "Occluded";
VAL_ 608 OBJ_CLS_TYPE1_033 0 "UNKNOWN_MOVING_OBJ" 1 "CAR" 2 "TRUCK" 3 "MOTOR_BIKE" 4 "BICYCLE" 5 "PEDESTRIAN" 6 "ROAD_BOUNDRY" 7 "STATIC_OBJECT" 8 "TRAFFIC_LIGHT" 9 "TRAFFIC_SIGN" 10 "TWO_WHEELERS" 11 "RESERVED" 12 "RESERVED" 14 "OBJECT_UNDETERMIND" 15 "VEHICLE_UNDETERMIND";
VAL_ 608 OBJ_CLS_TYPE2_033 0 "UNKNOWN_MOVING_OBJ" 1 "CAR" 2 "TRUCK" 3 "MOTOR_BIKE" 4 "BICYCLE" 5 "PEDESTRIAN" 6 "ROAD_BOUNDRY" 7 "STATIC_OBJECT" 8 "TRAFFIC_LIGHT" 9 "TRAFFIC_SIGN" 10 "TWO_WHEELERS" 11 "RESERVED" 12 "RESERVED" 14 "OBJECT_UNDETERMIND" 15 "VEHICLE_UNDETERMIND";
VAL_ 608 OBJ_CLS_TYPE3_033 0 "UNKNOWN_MOVING_OBJ" 1 "CAR" 2 "TRUCK" 3 "MOTOR_BIKE" 4 "BICYCLE" 5 "PEDESTRIAN" 6 "ROAD_BOUNDRY" 7 "STATIC_OBJECT" 8 "TRAFFIC_LIGHT" 9 "TRAFFIC_SIGN" 10 "TWO_WHEELERS" 11 "RESERVED" 12 "RESERVED" 14 "OBJECT_UNDETERMIND" 15 "VEHICLE_UNDETERMIND";
VAL_ 608 OBJ_CLS_TYPE4_033 0 "UNKNOWN_MOVING_OBJ" 1 "CAR" 2 "TRUCK" 3 "MOTOR_BIKE" 4 "BICYCLE" 5 "PEDESTRIAN" 6 "ROAD_BOUNDRY" 7 "STATIC_OBJECT" 8 "TRAFFIC_LIGHT" 9 "TRAFFIC_SIGN" 10 "TWO_WHEELERS" 11 "RESERVED" 12 "RESERVED" 14 "OBJECT_UNDETERMIND" 15 "VEHICLE_UNDETERMIND";
VAL_ 608 OBJ_CLS_TYPE5_033 0 "UNKNOWN_MOVING_OBJ" 1 "CAR" 2 "TRUCK" 3 "MOTOR_BIKE" 4 "BICYCLE" 5 "PEDESTRIAN" 6 "ROAD_BOUNDRY" 7 "STATIC_OBJECT" 8 "TRAFFIC_LIGHT" 9 "TRAFFIC_SIGN" 10 "TWO_WHEELERS" 11 "RESERVED" 12 "RESERVED" 14 "OBJECT_UNDETERMIND" 15 "VEHICLE_UNDETERMIND";
VAL_ 608 OBJ_CLS_TYPE6_033 0 "UNKNOWN_MOVING_OBJ" 1 "CAR" 2 "TRUCK" 3 "MOTOR_BIKE" 4 "BICYCLE" 5 "PEDESTRIAN" 6 "ROAD_BOUNDRY" 7 "STATIC_OBJECT" 8 "TRAFFIC_LIGHT" 9 "TRAFFIC_SIGN" 10 "TWO_WHEELERS" 11 "RESERVED" 12 "RESERVED" 14 "OBJECT_UNDETERMIND" 15 "VEHICLE_UNDETERMIND";
VAL_ 609 OBJ_TRACK_MOTION_MODEL_034 0 "INVALID" 1 "CCV" 2 "CTCA" 3 "CCA";
VAL_ 609 OBJ_MOVEMENT_STATUS_034 0 "UNKNOWN" 1 "MOVING" 2 "SLOW_MOVING" 3 "FAST_MOVING" 4 "STATIONARY" 5 "STOPPED" 6 "RESERVED1" 7 "RESERVED2";
VAL_ 609 OBJ_MEASUREMENT_STATUS_034 0 "Invalid" 1 "New" 2 "Predicted" 3 "PartlyMeasured" 4 "Measured" 5 "Occluded";
VAL_ 609 OBJ_CLS_TYPE1_034 0 "UNKNOWN_MOVING_OBJ" 1 "CAR" 2 "TRUCK" 3 "MOTOR_BIKE" 4 "BICYCLE" 5 "PEDESTRIAN" 6 "ROAD_BOUNDRY" 7 "STATIC_OBJECT" 8 "TRAFFIC_LIGHT" 9 "TRAFFIC_SIGN" 10 "TWO_WHEELERS" 11 "RESERVED" 12 "RESERVED" 14 "OBJECT_UNDETERMIND" 15 "VEHICLE_UNDETERMIND";
VAL_ 609 OBJ_CLS_TYPE2_034 0 "UNKNOWN_MOVING_OBJ" 1 "CAR" 2 "TRUCK" 3 "MOTOR_BIKE" 4 "BICYCLE" 5 "PEDESTRIAN" 6 "ROAD_BOUNDRY" 7 "STATIC_OBJECT" 8 "TRAFFIC_LIGHT" 9 "TRAFFIC_SIGN" 10 "TWO_WHEELERS" 11 "RESERVED" 12 "RESERVED" 14 "OBJECT_UNDETERMIND" 15 "VEHICLE_UNDETERMIND";
VAL_ 609 OBJ_CLS_TYPE3_034 0 "UNKNOWN_MOVING_OBJ" 1 "CAR" 2 "TRUCK" 3 "MOTOR_BIKE" 4 "BICYCLE" 5 "PEDESTRIAN" 6 "ROAD_BOUNDRY" 7 "STATIC_OBJECT" 8 "TRAFFIC_LIGHT" 9 "TRAFFIC_SIGN" 10 "TWO_WHEELERS" 11 "RESERVED" 12 "RESERVED" 14 "OBJECT_UNDETERMIND" 15 "VEHICLE_UNDETERMIND";
VAL_ 609 OBJ_CLS_TYPE4_034 0 "UNKNOWN_MOVING_OBJ" 1 "CAR" 2 "TRUCK" 3 "MOTOR_BIKE" 4 "BICYCLE" 5 "PEDESTRIAN" 6 "ROAD_BOUNDRY" 7 "STATIC_OBJECT" 8 "TRAFFIC_LIGHT" 9 "TRAFFIC_SIGN" 10 "TWO_WHEELERS" 11 "RESERVED" 12 "RESERVED" 14 "OBJECT_UNDETERMIND" 15 "VEHICLE_UNDETERMIND";
VAL_ 609 OBJ_CLS_TYPE5_034 0 "UNKNOWN_MOVING_OBJ" 1 "CAR" 2 "TRUCK" 3 "MOTOR_BIKE" 4 "BICYCLE" 5 "PEDESTRIAN" 6 "ROAD_BOUNDRY" 7 "STATIC_OBJECT" 8 "TRAFFIC_LIGHT" 9 "TRAFFIC_SIGN" 10 "TWO_WHEELERS" 11 "RESERVED" 12 "RESERVED" 14 "OBJECT_UNDETERMIND" 15 "VEHICLE_UNDETERMIND";
VAL_ 609 OBJ_CLS_TYPE6_034 0 "UNKNOWN_MOVING_OBJ" 1 "CAR" 2 "TRUCK" 3 "MOTOR_BIKE" 4 "BICYCLE" 5 "PEDESTRIAN" 6 "ROAD_BOUNDRY" 7 "STATIC_OBJECT" 8 "TRAFFIC_LIGHT" 9 "TRAFFIC_SIGN" 10 "TWO_WHEELERS" 11 "RESERVED" 12 "RESERVED" 14 "OBJECT_UNDETERMIND" 15 "VEHICLE_UNDETERMIND";
VAL_ 610 OBJ_TRACK_MOTION_MODEL_035 0 "INVALID" 1 "CCV" 2 "CTCA" 3 "CCA";
VAL_ 610 OBJ_MOVEMENT_STATUS_035 0 "UNKNOWN" 1 "MOVING" 2 "SLOW_MOVING" 3 "FAST_MOVING" 4 "STATIONARY" 5 "STOPPED" 6 "RESERVED1" 7 "RESERVED2";
VAL_ 610 OBJ_MEASUREMENT_STATUS_035 0 "Invalid" 1 "New" 2 "Predicted" 3 "PartlyMeasured" 4 "Measured" 5 "Occluded";
VAL_ 610 OBJ_CLS_TYPE1_035 0 "UNKNOWN_MOVING_OBJ" 1 "CAR" 2 "TRUCK" 3 "MOTOR_BIKE" 4 "BICYCLE" 5 "PEDESTRIAN" 6 "ROAD_BOUNDRY" 7 "STATIC_OBJECT" 8 "TRAFFIC_LIGHT" 9 "TRAFFIC_SIGN" 10 "TWO_WHEELERS" 11 "RESERVED" 12 "RESERVED" 14 "OBJECT_UNDETERMIND" 15 "VEHICLE_UNDETERMIND";
VAL_ 610 OBJ_CLS_TYPE2_035 0 "UNKNOWN_MOVING_OBJ" 1 "CAR" 2 "TRUCK" 3 "MOTOR_BIKE" 4 "BICYCLE" 5 "PEDESTRIAN" 6 "ROAD_BOUNDRY" 7 "STATIC_OBJECT" 8 "TRAFFIC_LIGHT" 9 "TRAFFIC_SIGN" 10 "TWO_WHEELERS" 11 "RESERVED" 12 "RESERVED" 14 "OBJECT_UNDETERMIND" 15 "VEHICLE_UNDETERMIND";
VAL_ 610 OBJ_CLS_TYPE3_035 0 "UNKNOWN_MOVING_OBJ" 1 "CAR" 2 "TRUCK" 3 "MOTOR_BIKE" 4 "BICYCLE" 5 "PEDESTRIAN" 6 "ROAD_BOUNDRY" 7 "STATIC_OBJECT" 8 "TRAFFIC_LIGHT" 9 "TRAFFIC_SIGN" 10 "TWO_WHEELERS" 11 "RESERVED" 12 "RESERVED" 14 "OBJECT_UNDETERMIND" 15 "VEHICLE_UNDETERMIND";
VAL_ 610 OBJ_CLS_TYPE4_035 0 "UNKNOWN_MOVING_OBJ" 1 "CAR" 2 "TRUCK" 3 "MOTOR_BIKE" 4 "BICYCLE" 5 "PEDESTRIAN" 6 "ROAD_BOUNDRY" 7 "STATIC_OBJECT" 8 "TRAFFIC_LIGHT" 9 "TRAFFIC_SIGN" 10 "TWO_WHEELERS" 11 "RESERVED" 12 "RESERVED" 14 "OBJECT_UNDETERMIND" 15 "VEHICLE_UNDETERMIND";
VAL_ 610 OBJ_CLS_TYPE5_035 0 "UNKNOWN_MOVING_OBJ" 1 "CAR" 2 "TRUCK" 3 "MOTOR_BIKE" 4 "BICYCLE" 5 "PEDESTRIAN" 6 "ROAD_BOUNDRY" 7 "STATIC_OBJECT" 8 "TRAFFIC_LIGHT" 9 "TRAFFIC_SIGN" 10 "TWO_WHEELERS" 11 "RESERVED" 12 "RESERVED" 14 "OBJECT_UNDETERMIND" 15 "VEHICLE_UNDETERMIND";
VAL_ 610 OBJ_CLS_TYPE6_035 0 "UNKNOWN_MOVING_OBJ" 1 "CAR" 2 "TRUCK" 3 "MOTOR_BIKE" 4 "BICYCLE" 5 "PEDESTRIAN" 6 "ROAD_BOUNDRY" 7 "STATIC_OBJECT" 8 "TRAFFIC_LIGHT" 9 "TRAFFIC_SIGN" 10 "TWO_WHEELERS" 11 "RESERVED" 12 "RESERVED" 14 "OBJECT_UNDETERMIND" 15 "VEHICLE_UNDETERMIND";
VAL_ 611 OBJ_TRACK_MOTION_MODEL_036 0 "INVALID" 1 "CCV" 2 "CTCA" 3 "CCA";
VAL_ 611 OBJ_MOVEMENT_STATUS_036 0 "UNKNOWN" 1 "MOVING" 2 "SLOW_MOVING" 3 "FAST_MOVING" 4 "STATIONARY" 5 "STOPPED" 6 "RESERVED1" 7 "RESERVED2";
VAL_ 611 OBJ_MEASUREMENT_STATUS_036 0 "Invalid" 1 "New" 2 "Predicted" 3 "PartlyMeasured" 4 "Measured" 5 "Occluded";
VAL_ 611 OBJ_CLS_TYPE1_036 0 "UNKNOWN_MOVING_OBJ" 1 "CAR" 2 "TRUCK" 3 "MOTOR_BIKE" 4 "BICYCLE" 5 "PEDESTRIAN" 6 "ROAD_BOUNDRY" 7 "STATIC_OBJECT" 8 "TRAFFIC_LIGHT" 9 "TRAFFIC_SIGN" 10 "TWO_WHEELERS" 11 "RESERVED" 12 "RESERVED" 14 "OBJECT_UNDETERMIND" 15 "VEHICLE_UNDETERMIND";
VAL_ 611 OBJ_CLS_TYPE2_036 0 "UNKNOWN_MOVING_OBJ" 1 "CAR" 2 "TRUCK" 3 "MOTOR_BIKE" 4 "BICYCLE" 5 "PEDESTRIAN" 6 "ROAD_BOUNDRY" 7 "STATIC_OBJECT" 8 "TRAFFIC_LIGHT" 9 "TRAFFIC_SIGN" 10 "TWO_WHEELERS" 11 "RESERVED" 12 "RESERVED" 14 "OBJECT_UNDETERMIND" 15 "VEHICLE_UNDETERMIND";
VAL_ 611 OBJ_CLS_TYPE3_036 0 "UNKNOWN_MOVING_OBJ" 1 "CAR" 2 "TRUCK" 3 "MOTOR_BIKE" 4 "BICYCLE" 5 "PEDESTRIAN" 6 "ROAD_BOUNDRY" 7 "STATIC_OBJECT" 8 "TRAFFIC_LIGHT" 9 "TRAFFIC_SIGN" 10 "TWO_WHEELERS" 11 "RESERVED" 12 "RESERVED" 14 "OBJECT_UNDETERMIND" 15 "VEHICLE_UNDETERMIND";
VAL_ 611 OBJ_CLS_TYPE4_036 0 "UNKNOWN_MOVING_OBJ" 1 "CAR" 2 "TRUCK" 3 "MOTOR_BIKE" 4 "BICYCLE" 5 "PEDESTRIAN" 6 "ROAD_BOUNDRY" 7 "STATIC_OBJECT" 8 "TRAFFIC_LIGHT" 9 "TRAFFIC_SIGN" 10 "TWO_WHEELERS" 11 "RESERVED" 12 "RESERVED" 14 "OBJECT_UNDETERMIND" 15 "VEHICLE_UNDETERMIND";
VAL_ 611 OBJ_CLS_TYPE5_036 0 "UNKNOWN_MOVING_OBJ" 1 "CAR" 2 "TRUCK" 3 "MOTOR_BIKE" 4 "BICYCLE" 5 "PEDESTRIAN" 6 "ROAD_BOUNDRY" 7 "STATIC_OBJECT" 8 "TRAFFIC_LIGHT" 9 "TRAFFIC_SIGN" 10 "TWO_WHEELERS" 11 "RESERVED" 12 "RESERVED" 14 "OBJECT_UNDETERMIND" 15 "VEHICLE_UNDETERMIND";
VAL_ 611 OBJ_CLS_TYPE6_036 0 "UNKNOWN_MOVING_OBJ" 1 "CAR" 2 "TRUCK" 3 "MOTOR_BIKE" 4 "BICYCLE" 5 "PEDESTRIAN" 6 "ROAD_BOUNDRY" 7 "STATIC_OBJECT" 8 "TRAFFIC_LIGHT" 9 "TRAFFIC_SIGN" 10 "TWO_WHEELERS" 11 "RESERVED" 12 "RESERVED" 14 "OBJECT_UNDETERMIND" 15 "VEHICLE_UNDETERMIND";
VAL_ 612 OBJ_TRACK_MOTION_MODEL_037 0 "INVALID" 1 "CCV" 2 "CTCA" 3 "CCA";
VAL_ 612 OBJ_MOVEMENT_STATUS_037 0 "UNKNOWN" 1 "MOVING" 2 "SLOW_MOVING" 3 "FAST_MOVING" 4 "STATIONARY" 5 "STOPPED" 6 "RESERVED1" 7 "RESERVED2";
VAL_ 612 OBJ_MEASUREMENT_STATUS_037 0 "Invalid" 1 "New" 2 "Predicted" 3 "PartlyMeasured" 4 "Measured" 5 "Occluded";
VAL_ 612 OBJ_CLS_TYPE1_037 0 "UNKNOWN_MOVING_OBJ" 1 "CAR" 2 "TRUCK" 3 "MOTOR_BIKE" 4 "BICYCLE" 5 "PEDESTRIAN" 6 "ROAD_BOUNDRY" 7 "STATIC_OBJECT" 8 "TRAFFIC_LIGHT" 9 "TRAFFIC_SIGN" 10 "TWO_WHEELERS" 11 "RESERVED" 12 "RESERVED" 14 "OBJECT_UNDETERMIND" 15 "VEHICLE_UNDETERMIND";
VAL_ 612 OBJ_CLS_TYPE2_037 0 "UNKNOWN_MOVING_OBJ" 1 "CAR" 2 "TRUCK" 3 "MOTOR_BIKE" 4 "BICYCLE" 5 "PEDESTRIAN" 6 "ROAD_BOUNDRY" 7 "STATIC_OBJECT" 8 "TRAFFIC_LIGHT" 9 "TRAFFIC_SIGN" 10 "TWO_WHEELERS" 11 "RESERVED" 12 "RESERVED" 14 "OBJECT_UNDETERMIND" 15 "VEHICLE_UNDETERMIND";
VAL_ 612 OBJ_CLS_TYPE3_037 0 "UNKNOWN_MOVING_OBJ" 1 "CAR" 2 "TRUCK" 3 "MOTOR_BIKE" 4 "BICYCLE" 5 "PEDESTRIAN" 6 "ROAD_BOUNDRY" 7 "STATIC_OBJECT" 8 "TRAFFIC_LIGHT" 9 "TRAFFIC_SIGN" 10 "TWO_WHEELERS" 11 "RESERVED" 12 "RESERVED" 14 "OBJECT_UNDETERMIND" 15 "VEHICLE_UNDETERMIND";
VAL_ 612 OBJ_CLS_TYPE4_037 0 "UNKNOWN_MOVING_OBJ" 1 "CAR" 2 "TRUCK" 3 "MOTOR_BIKE" 4 "BICYCLE" 5 "PEDESTRIAN" 6 "ROAD_BOUNDRY" 7 "STATIC_OBJECT" 8 "TRAFFIC_LIGHT" 9 "TRAFFIC_SIGN" 10 "TWO_WHEELERS" 11 "RESERVED" 12 "RESERVED" 14 "OBJECT_UNDETERMIND" 15 "VEHICLE_UNDETERMIND";
VAL_ 612 OBJ_CLS_TYPE5_037 0 "UNKNOWN_MOVING_OBJ" 1 "CAR" 2 "TRUCK" 3 "MOTOR_BIKE" 4 "BICYCLE" 5 "PEDESTRIAN" 6 "ROAD_BOUNDRY" 7 "STATIC_OBJECT" 8 "TRAFFIC_LIGHT" 9 "TRAFFIC_SIGN" 10 "TWO_WHEELERS" 11 "RESERVED" 12 "RESERVED" 14 "OBJECT_UNDETERMIND" 15 "VEHICLE_UNDETERMIND";
VAL_ 612 OBJ_CLS_TYPE6_037 0 "UNKNOWN_MOVING_OBJ" 1 "CAR" 2 "TRUCK" 3 "MOTOR_BIKE" 4 "BICYCLE" 5 "PEDESTRIAN" 6 "ROAD_BOUNDRY" 7 "STATIC_OBJECT" 8 "TRAFFIC_LIGHT" 9 "TRAFFIC_SIGN" 10 "TWO_WHEELERS" 11 "RESERVED" 12 "RESERVED" 14 "OBJECT_UNDETERMIND" 15 "VEHICLE_UNDETERMIND";
VAL_ 613 OBJ_TRACK_MOTION_MODEL_038 0 "INVALID" 1 "CCV" 2 "CTCA" 3 "CCA";
VAL_ 613 OBJ_MOVEMENT_STATUS_038 0 "UNKNOWN" 1 "MOVING" 2 "SLOW_MOVING" 3 "FAST_MOVING" 4 "STATIONARY" 5 "STOPPED" 6 "RESERVED1" 7 "RESERVED2";
VAL_ 613 OBJ_MEASUREMENT_STATUS_038 0 "Invalid" 1 "New" 2 "Predicted" 3 "PartlyMeasured" 4 "Measured" 5 "Occluded";
VAL_ 613 OBJ_CLS_TYPE1_038 0 "UNKNOWN_MOVING_OBJ" 1 "CAR" 2 "TRUCK" 3 "MOTOR_BIKE" 4 "BICYCLE" 5 "PEDESTRIAN" 6 "ROAD_BOUNDRY" 7 "STATIC_OBJECT" 8 "TRAFFIC_LIGHT" 9 "TRAFFIC_SIGN" 10 "TWO_WHEELERS" 11 "RESERVED" 12 "RESERVED" 14 "OBJECT_UNDETERMIND" 15 "VEHICLE_UNDETERMIND";
VAL_ 613 OBJ_CLS_TYPE2_038 0 "UNKNOWN_MOVING_OBJ" 1 "CAR" 2 "TRUCK" 3 "MOTOR_BIKE" 4 "BICYCLE" 5 "PEDESTRIAN" 6 "ROAD_BOUNDRY" 7 "STATIC_OBJECT" 8 "TRAFFIC_LIGHT" 9 "TRAFFIC_SIGN" 10 "TWO_WHEELERS" 11 "RESERVED" 12 "RESERVED" 14 "OBJECT_UNDETERMIND" 15 "VEHICLE_UNDETERMIND";
VAL_ 613 OBJ_CLS_TYPE3_038 0 "UNKNOWN_MOVING_OBJ" 1 "CAR" 2 "TRUCK" 3 "MOTOR_BIKE" 4 "BICYCLE" 5 "PEDESTRIAN" 6 "ROAD_BOUNDRY" 7 "STATIC_OBJECT" 8 "TRAFFIC_LIGHT" 9 "TRAFFIC_SIGN" 10 "TWO_WHEELERS" 11 "RESERVED" 12 "RESERVED" 14 "OBJECT_UNDETERMIND" 15 "VEHICLE_UNDETERMIND";
VAL_ 613 OBJ_CLS_TYPE4_038 0 "UNKNOWN_MOVING_OBJ" 1 "CAR" 2 "TRUCK" 3 "MOTOR_BIKE" 4 "BICYCLE" 5 "PEDESTRIAN" 6 "ROAD_BOUNDRY" 7 "STATIC_OBJECT" 8 "TRAFFIC_LIGHT" 9 "TRAFFIC_SIGN" 10 "TWO_WHEELERS" 11 "RESERVED" 12 "RESERVED" 14 "OBJECT_UNDETERMIND" 15 "VEHICLE_UNDETERMIND";
VAL_ 613 OBJ_CLS_TYPE5_038 0 "UNKNOWN_MOVING_OBJ" 1 "CAR" 2 "TRUCK" 3 "MOTOR_BIKE" 4 "BICYCLE" 5 "PEDESTRIAN" 6 "ROAD_BOUNDRY" 7 "STATIC_OBJECT" 8 "TRAFFIC_LIGHT" 9 "TRAFFIC_SIGN" 10 "TWO_WHEELERS" 11 "RESERVED" 12 "RESERVED" 14 "OBJECT_UNDETERMIND" 15 "VEHICLE_UNDETERMIND";
VAL_ 613 OBJ_CLS_TYPE6_038 0 "UNKNOWN_MOVING_OBJ" 1 "CAR" 2 "TRUCK" 3 "MOTOR_BIKE" 4 "BICYCLE" 5 "PEDESTRIAN" 6 "ROAD_BOUNDRY" 7 "STATIC_OBJECT" 8 "TRAFFIC_LIGHT" 9 "TRAFFIC_SIGN" 10 "TWO_WHEELERS" 11 "RESERVED" 12 "RESERVED" 14 "OBJECT_UNDETERMIND" 15 "VEHICLE_UNDETERMIND";
VAL_ 614 OBJ_TRACK_MOTION_MODEL_039 0 "INVALID" 1 "CCV" 2 "CTCA" 3 "CCA";
VAL_ 614 OBJ_MOVEMENT_STATUS_039 0 "UNKNOWN" 1 "MOVING" 2 "SLOW_MOVING" 3 "FAST_MOVING" 4 "STATIONARY" 5 "STOPPED" 6 "RESERVED1" 7 "RESERVED2";
VAL_ 614 OBJ_MEASUREMENT_STATUS_039 0 "Invalid" 1 "New" 2 "Predicted" 3 "PartlyMeasured" 4 "Measured" 5 "Occluded";
VAL_ 614 OBJ_CLS_TYPE1_039 0 "UNKNOWN_MOVING_OBJ" 1 "CAR" 2 "TRUCK" 3 "MOTOR_BIKE" 4 "BICYCLE" 5 "PEDESTRIAN" 6 "ROAD_BOUNDRY" 7 "STATIC_OBJECT" 8 "TRAFFIC_LIGHT" 9 "TRAFFIC_SIGN" 10 "TWO_WHEELERS" 11 "RESERVED" 12 "RESERVED" 14 "OBJECT_UNDETERMIND" 15 "VEHICLE_UNDETERMIND";
VAL_ 614 OBJ_CLS_TYPE2_039 0 "UNKNOWN_MOVING_OBJ" 1 "CAR" 2 "TRUCK" 3 "MOTOR_BIKE" 4 "BICYCLE" 5 "PEDESTRIAN" 6 "ROAD_BOUNDRY" 7 "STATIC_OBJECT" 8 "TRAFFIC_LIGHT" 9 "TRAFFIC_SIGN" 10 "TWO_WHEELERS" 11 "RESERVED" 12 "RESERVED" 14 "OBJECT_UNDETERMIND" 15 "VEHICLE_UNDETERMIND";
VAL_ 614 OBJ_CLS_TYPE3_039 0 "UNKNOWN_MOVING_OBJ" 1 "CAR" 2 "TRUCK" 3 "MOTOR_BIKE" 4 "BICYCLE" 5 "PEDESTRIAN" 6 "ROAD_BOUNDRY" 7 "STATIC_OBJECT" 8 "TRAFFIC_LIGHT" 9 "TRAFFIC_SIGN" 10 "TWO_WHEELERS" 11 "RESERVED" 12 "RESERVED" 14 "OBJECT_UNDETERMIND" 15 "VEHICLE_UNDETERMIND";
VAL_ 614 OBJ_CLS_TYPE4_039 0 "UNKNOWN_MOVING_OBJ" 1 "CAR" 2 "TRUCK" 3 "MOTOR_BIKE" 4 "BICYCLE" 5 "PEDESTRIAN" 6 "ROAD_BOUNDRY" 7 "STATIC_OBJECT" 8 "TRAFFIC_LIGHT" 9 "TRAFFIC_SIGN" 10 "TWO_WHEELERS" 11 "RESERVED" 12 "RESERVED" 14 "OBJECT_UNDETERMIND" 15 "VEHICLE_UNDETERMIND";
VAL_ 614 OBJ_CLS_TYPE5_039 0 "UNKNOWN_MOVING_OBJ" 1 "CAR" 2 "TRUCK" 3 "MOTOR_BIKE" 4 "BICYCLE" 5 "PEDESTRIAN" 6 "ROAD_BOUNDRY" 7 "STATIC_OBJECT" 8 "TRAFFIC_LIGHT" 9 "TRAFFIC_SIGN" 10 "TWO_WHEELERS" 11 "RESERVED" 12 "RESERVED" 14 "OBJECT_UNDETERMIND" 15 "VEHICLE_UNDETERMIND";
VAL_ 614 OBJ_CLS_TYPE6_039 0 "UNKNOWN_MOVING_OBJ" 1 "CAR" 2 "TRUCK" 3 "MOTOR_BIKE" 4 "BICYCLE" 5 "PEDESTRIAN" 6 "ROAD_BOUNDRY" 7 "STATIC_OBJECT" 8 "TRAFFIC_LIGHT" 9 "TRAFFIC_SIGN" 10 "TWO_WHEELERS" 11 "RESERVED" 12 "RESERVED" 14 "OBJECT_UNDETERMIND" 15 "VEHICLE_UNDETERMIND";
VAL_ 615 OBJ_TRACK_MOTION_MODEL_040 0 "INVALID" 1 "CCV" 2 "CTCA" 3 "CCA";
VAL_ 615 OBJ_MOVEMENT_STATUS_040 0 "UNKNOWN" 1 "MOVING" 2 "SLOW_MOVING" 3 "FAST_MOVING" 4 "STATIONARY" 5 "STOPPED" 6 "RESERVED1" 7 "RESERVED2";
VAL_ 615 OBJ_MEASUREMENT_STATUS_040 0 "Invalid" 1 "New" 2 "Predicted" 3 "PartlyMeasured" 4 "Measured" 5 "Occluded";
VAL_ 615 OBJ_CLS_TYPE1_040 0 "UNKNOWN_MOVING_OBJ" 1 "CAR" 2 "TRUCK" 3 "MOTOR_BIKE" 4 "BICYCLE" 5 "PEDESTRIAN" 6 "ROAD_BOUNDRY" 7 "STATIC_OBJECT" 8 "TRAFFIC_LIGHT" 9 "TRAFFIC_SIGN" 10 "TWO_WHEELERS" 11 "RESERVED" 12 "RESERVED" 14 "OBJECT_UNDETERMIND" 15 "VEHICLE_UNDETERMIND";
VAL_ 615 OBJ_CLS_TYPE2_040 0 "UNKNOWN_MOVING_OBJ" 1 "CAR" 2 "TRUCK" 3 "MOTOR_BIKE" 4 "BICYCLE" 5 "PEDESTRIAN" 6 "ROAD_BOUNDRY" 7 "STATIC_OBJECT" 8 "TRAFFIC_LIGHT" 9 "TRAFFIC_SIGN" 10 "TWO_WHEELERS" 11 "RESERVED" 12 "RESERVED" 14 "OBJECT_UNDETERMIND" 15 "VEHICLE_UNDETERMIND";
VAL_ 615 OBJ_CLS_TYPE3_040 0 "UNKNOWN_MOVING_OBJ" 1 "CAR" 2 "TRUCK" 3 "MOTOR_BIKE" 4 "BICYCLE" 5 "PEDESTRIAN" 6 "ROAD_BOUNDRY" 7 "STATIC_OBJECT" 8 "TRAFFIC_LIGHT" 9 "TRAFFIC_SIGN" 10 "TWO_WHEELERS" 11 "RESERVED" 12 "RESERVED" 14 "OBJECT_UNDETERMIND" 15 "VEHICLE_UNDETERMIND";
VAL_ 615 OBJ_CLS_TYPE4_040 0 "UNKNOWN_MOVING_OBJ" 1 "CAR" 2 "TRUCK" 3 "MOTOR_BIKE" 4 "BICYCLE" 5 "PEDESTRIAN" 6 "ROAD_BOUNDRY" 7 "STATIC_OBJECT" 8 "TRAFFIC_LIGHT" 9 "TRAFFIC_SIGN" 10 "TWO_WHEELERS" 11 "RESERVED" 12 "RESERVED" 14 "OBJECT_UNDETERMIND" 15 "VEHICLE_UNDETERMIND";
VAL_ 615 OBJ_CLS_TYPE5_040 0 "UNKNOWN_MOVING_OBJ" 1 "CAR" 2 "TRUCK" 3 "MOTOR_BIKE" 4 "BICYCLE" 5 "PEDESTRIAN" 6 "ROAD_BOUNDRY" 7 "STATIC_OBJECT" 8 "TRAFFIC_LIGHT" 9 "TRAFFIC_SIGN" 10 "TWO_WHEELERS" 11 "RESERVED" 12 "RESERVED" 14 "OBJECT_UNDETERMIND" 15 "VEHICLE_UNDETERMIND";
VAL_ 615 OBJ_CLS_TYPE6_040 0 "UNKNOWN_MOVING_OBJ" 1 "CAR" 2 "TRUCK" 3 "MOTOR_BIKE" 4 "BICYCLE" 5 "PEDESTRIAN" 6 "ROAD_BOUNDRY" 7 "STATIC_OBJECT" 8 "TRAFFIC_LIGHT" 9 "TRAFFIC_SIGN" 10 "TWO_WHEELERS" 11 "RESERVED" 12 "RESERVED" 14 "OBJECT_UNDETERMIND" 15 "VEHICLE_UNDETERMIND";
VAL_ 616 OBJ_TRACK_MOTION_MODEL_041 0 "INVALID" 1 "CCV" 2 "CTCA" 3 "CCA";
VAL_ 616 OBJ_MOVEMENT_STATUS_041 0 "UNKNOWN" 1 "MOVING" 2 "SLOW_MOVING" 3 "FAST_MOVING" 4 "STATIONARY" 5 "STOPPED" 6 "RESERVED1" 7 "RESERVED2";
VAL_ 616 OBJ_MEASUREMENT_STATUS_041 0 "Invalid" 1 "New" 2 "Predicted" 3 "PartlyMeasured" 4 "Measured" 5 "Occluded";
VAL_ 616 OBJ_CLS_TYPE1_041 0 "UNKNOWN_MOVING_OBJ" 1 "CAR" 2 "TRUCK" 3 "MOTOR_BIKE" 4 "BICYCLE" 5 "PEDESTRIAN" 6 "ROAD_BOUNDRY" 7 "STATIC_OBJECT" 8 "TRAFFIC_LIGHT" 9 "TRAFFIC_SIGN" 10 "TWO_WHEELERS" 11 "RESERVED" 12 "RESERVED" 14 "OBJECT_UNDETERMIND" 15 "VEHICLE_UNDETERMIND";
VAL_ 616 OBJ_CLS_TYPE2_041 0 "UNKNOWN_MOVING_OBJ" 1 "CAR" 2 "TRUCK" 3 "MOTOR_BIKE" 4 "BICYCLE" 5 "PEDESTRIAN" 6 "ROAD_BOUNDRY" 7 "STATIC_OBJECT" 8 "TRAFFIC_LIGHT" 9 "TRAFFIC_SIGN" 10 "TWO_WHEELERS" 11 "RESERVED" 12 "RESERVED" 14 "OBJECT_UNDETERMIND" 15 "VEHICLE_UNDETERMIND";
VAL_ 616 OBJ_CLS_TYPE3_041 0 "UNKNOWN_MOVING_OBJ" 1 "CAR" 2 "TRUCK" 3 "MOTOR_BIKE" 4 "BICYCLE" 5 "PEDESTRIAN" 6 "ROAD_BOUNDRY" 7 "STATIC_OBJECT" 8 "TRAFFIC_LIGHT" 9 "TRAFFIC_SIGN" 10 "TWO_WHEELERS" 11 "RESERVED" 12 "RESERVED" 14 "OBJECT_UNDETERMIND" 15 "VEHICLE_UNDETERMIND";
VAL_ 616 OBJ_CLS_TYPE4_041 0 "UNKNOWN_MOVING_OBJ" 1 "CAR" 2 "TRUCK" 3 "MOTOR_BIKE" 4 "BICYCLE" 5 "PEDESTRIAN" 6 "ROAD_BOUNDRY" 7 "STATIC_OBJECT" 8 "TRAFFIC_LIGHT" 9 "TRAFFIC_SIGN" 10 "TWO_WHEELERS" 11 "RESERVED" 12 "RESERVED" 14 "OBJECT_UNDETERMIND" 15 "VEHICLE_UNDETERMIND";
VAL_ 616 OBJ_CLS_TYPE5_041 0 "UNKNOWN_MOVING_OBJ" 1 "CAR" 2 "TRUCK" 3 "MOTOR_BIKE" 4 "BICYCLE" 5 "PEDESTRIAN" 6 "ROAD_BOUNDRY" 7 "STATIC_OBJECT" 8 "TRAFFIC_LIGHT" 9 "TRAFFIC_SIGN" 10 "TWO_WHEELERS" 11 "RESERVED" 12 "RESERVED" 14 "OBJECT_UNDETERMIND" 15 "VEHICLE_UNDETERMIND";
VAL_ 616 OBJ_CLS_TYPE6_041 0 "UNKNOWN_MOVING_OBJ" 1 "CAR" 2 "TRUCK" 3 "MOTOR_BIKE" 4 "BICYCLE" 5 "PEDESTRIAN" 6 "ROAD_BOUNDRY" 7 "STATIC_OBJECT" 8 "TRAFFIC_LIGHT" 9 "TRAFFIC_SIGN" 10 "TWO_WHEELERS" 11 "RESERVED" 12 "RESERVED" 14 "OBJECT_UNDETERMIND" 15 "VEHICLE_UNDETERMIND";
VAL_ 617 OBJ_TRACK_MOTION_MODEL_042 0 "INVALID" 1 "CCV" 2 "CTCA" 3 "CCA";
VAL_ 617 OBJ_MOVEMENT_STATUS_042 0 "UNKNOWN" 1 "MOVING" 2 "SLOW_MOVING" 3 "FAST_MOVING" 4 "STATIONARY" 5 "STOPPED" 6 "RESERVED1" 7 "RESERVED2";
VAL_ 617 OBJ_MEASUREMENT_STATUS_042 0 "Invalid" 1 "New" 2 "Predicted" 3 "PartlyMeasured" 4 "Measured" 5 "Occluded";
VAL_ 617 OBJ_CLS_TYPE1_042 0 "UNKNOWN_MOVING_OBJ" 1 "CAR" 2 "TRUCK" 3 "MOTOR_BIKE" 4 "BICYCLE" 5 "PEDESTRIAN" 6 "ROAD_BOUNDRY" 7 "STATIC_OBJECT" 8 "TRAFFIC_LIGHT" 9 "TRAFFIC_SIGN" 10 "TWO_WHEELERS" 11 "RESERVED" 12 "RESERVED" 14 "OBJECT_UNDETERMIND" 15 "VEHICLE_UNDETERMIND";
VAL_ 617 OBJ_CLS_TYPE2_042 0 "UNKNOWN_MOVING_OBJ" 1 "CAR" 2 "TRUCK" 3 "MOTOR_BIKE" 4 "BICYCLE" 5 "PEDESTRIAN" 6 "ROAD_BOUNDRY" 7 "STATIC_OBJECT" 8 "TRAFFIC_LIGHT" 9 "TRAFFIC_SIGN" 10 "TWO_WHEELERS" 11 "RESERVED" 12 "RESERVED" 14 "OBJECT_UNDETERMIND" 15 "VEHICLE_UNDETERMIND";
VAL_ 617 OBJ_CLS_TYPE3_042 0 "UNKNOWN_MOVING_OBJ" 1 "CAR" 2 "TRUCK" 3 "MOTOR_BIKE" 4 "BICYCLE" 5 "PEDESTRIAN" 6 "ROAD_BOUNDRY" 7 "STATIC_OBJECT" 8 "TRAFFIC_LIGHT" 9 "TRAFFIC_SIGN" 10 "TWO_WHEELERS" 11 "RESERVED" 12 "RESERVED" 14 "OBJECT_UNDETERMIND" 15 "VEHICLE_UNDETERMIND";
VAL_ 617 OBJ_CLS_TYPE4_042 0 "UNKNOWN_MOVING_OBJ" 1 "CAR" 2 "TRUCK" 3 "MOTOR_BIKE" 4 "BICYCLE" 5 "PEDESTRIAN" 6 "ROAD_BOUNDRY" 7 "STATIC_OBJECT" 8 "TRAFFIC_LIGHT" 9 "TRAFFIC_SIGN" 10 "TWO_WHEELERS" 11 "RESERVED" 12 "RESERVED" 14 "OBJECT_UNDETERMIND" 15 "VEHICLE_UNDETERMIND";
VAL_ 617 OBJ_CLS_TYPE5_042 0 "UNKNOWN_MOVING_OBJ" 1 "CAR" 2 "TRUCK" 3 "MOTOR_BIKE" 4 "BICYCLE" 5 "PEDESTRIAN" 6 "ROAD_BOUNDRY" 7 "STATIC_OBJECT" 8 "TRAFFIC_LIGHT" 9 "TRAFFIC_SIGN" 10 "TWO_WHEELERS" 11 "RESERVED" 12 "RESERVED" 14 "OBJECT_UNDETERMIND" 15 "VEHICLE_UNDETERMIND";
VAL_ 617 OBJ_CLS_TYPE6_042 0 "UNKNOWN_MOVING_OBJ" 1 "CAR" 2 "TRUCK" 3 "MOTOR_BIKE" 4 "BICYCLE" 5 "PEDESTRIAN" 6 "ROAD_BOUNDRY" 7 "STATIC_OBJECT" 8 "TRAFFIC_LIGHT" 9 "TRAFFIC_SIGN" 10 "TWO_WHEELERS" 11 "RESERVED" 12 "RESERVED" 14 "OBJECT_UNDETERMIND" 15 "VEHICLE_UNDETERMIND";
VAL_ 618 OBJ_TRACK_MOTION_MODEL_043 0 "INVALID" 1 "CCV" 2 "CTCA" 3 "CCA";
VAL_ 618 OBJ_MOVEMENT_STATUS_043 0 "UNKNOWN" 1 "MOVING" 2 "SLOW_MOVING" 3 "FAST_MOVING" 4 "STATIONARY" 5 "STOPPED" 6 "RESERVED1" 7 "RESERVED2";
VAL_ 618 OBJ_MEASUREMENT_STATUS_043 0 "Invalid" 1 "New" 2 "Predicted" 3 "PartlyMeasured" 4 "Measured" 5 "Occluded";
VAL_ 618 OBJ_CLS_TYPE1_043 0 "UNKNOWN_MOVING_OBJ" 1 "CAR" 2 "TRUCK" 3 "MOTOR_BIKE" 4 "BICYCLE" 5 "PEDESTRIAN" 6 "ROAD_BOUNDRY" 7 "STATIC_OBJECT" 8 "TRAFFIC_LIGHT" 9 "TRAFFIC_SIGN" 10 "TWO_WHEELERS" 11 "RESERVED" 12 "RESERVED" 14 "OBJECT_UNDETERMIND" 15 "VEHICLE_UNDETERMIND";
VAL_ 618 OBJ_CLS_TYPE2_043 0 "UNKNOWN_MOVING_OBJ" 1 "CAR" 2 "TRUCK" 3 "MOTOR_BIKE" 4 "BICYCLE" 5 "PEDESTRIAN" 6 "ROAD_BOUNDRY" 7 "STATIC_OBJECT" 8 "TRAFFIC_LIGHT" 9 "TRAFFIC_SIGN" 10 "TWO_WHEELERS" 11 "RESERVED" 12 "RESERVED" 14 "OBJECT_UNDETERMIND" 15 "VEHICLE_UNDETERMIND";
VAL_ 618 OBJ_CLS_TYPE3_043 0 "UNKNOWN_MOVING_OBJ" 1 "CAR" 2 "TRUCK" 3 "MOTOR_BIKE" 4 "BICYCLE" 5 "PEDESTRIAN" 6 "ROAD_BOUNDRY" 7 "STATIC_OBJECT" 8 "TRAFFIC_LIGHT" 9 "TRAFFIC_SIGN" 10 "TWO_WHEELERS" 11 "RESERVED" 12 "RESERVED" 14 "OBJECT_UNDETERMIND" 15 "VEHICLE_UNDETERMIND";
VAL_ 618 OBJ_CLS_TYPE4_043 0 "UNKNOWN_MOVING_OBJ" 1 "CAR" 2 "TRUCK" 3 "MOTOR_BIKE" 4 "BICYCLE" 5 "PEDESTRIAN" 6 "ROAD_BOUNDRY" 7 "STATIC_OBJECT" 8 "TRAFFIC_LIGHT" 9 "TRAFFIC_SIGN" 10 "TWO_WHEELERS" 11 "RESERVED" 12 "RESERVED" 14 "OBJECT_UNDETERMIND" 15 "VEHICLE_UNDETERMIND";
VAL_ 618 OBJ_CLS_TYPE5_043 0 "UNKNOWN_MOVING_OBJ" 1 "CAR" 2 "TRUCK" 3 "MOTOR_BIKE" 4 "BICYCLE" 5 "PEDESTRIAN" 6 "ROAD_BOUNDRY" 7 "STATIC_OBJECT" 8 "TRAFFIC_LIGHT" 9 "TRAFFIC_SIGN" 10 "TWO_WHEELERS" 11 "RESERVED" 12 "RESERVED" 14 "OBJECT_UNDETERMIND" 15 "VEHICLE_UNDETERMIND";
VAL_ 618 OBJ_CLS_TYPE6_043 0 "UNKNOWN_MOVING_OBJ" 1 "CAR" 2 "TRUCK" 3 "MOTOR_BIKE" 4 "BICYCLE" 5 "PEDESTRIAN" 6 "ROAD_BOUNDRY" 7 "STATIC_OBJECT" 8 "TRAFFIC_LIGHT" 9 "TRAFFIC_SIGN" 10 "TWO_WHEELERS" 11 "RESERVED" 12 "RESERVED" 14 "OBJECT_UNDETERMIND" 15 "VEHICLE_UNDETERMIND";
VAL_ 619 OBJ_TRACK_MOTION_MODEL_044 0 "INVALID" 1 "CCV" 2 "CTCA" 3 "CCA";
VAL_ 619 OBJ_MOVEMENT_STATUS_044 0 "UNKNOWN" 1 "MOVING" 2 "SLOW_MOVING" 3 "FAST_MOVING" 4 "STATIONARY" 5 "STOPPED" 6 "RESERVED1" 7 "RESERVED2";
VAL_ 619 OBJ_MEASUREMENT_STATUS_044 0 "Invalid" 1 "New" 2 "Predicted" 3 "PartlyMeasured" 4 "Measured" 5 "Occluded";
VAL_ 619 OBJ_CLS_TYPE1_044 0 "UNKNOWN_MOVING_OBJ" 1 "CAR" 2 "TRUCK" 3 "MOTOR_BIKE" 4 "BICYCLE" 5 "PEDESTRIAN" 6 "ROAD_BOUNDRY" 7 "STATIC_OBJECT" 8 "TRAFFIC_LIGHT" 9 "TRAFFIC_SIGN" 10 "TWO_WHEELERS" 11 "RESERVED" 12 "RESERVED" 14 "OBJECT_UNDETERMIND" 15 "VEHICLE_UNDETERMIND";
VAL_ 619 OBJ_CLS_TYPE2_044 0 "UNKNOWN_MOVING_OBJ" 1 "CAR" 2 "TRUCK" 3 "MOTOR_BIKE" 4 "BICYCLE" 5 "PEDESTRIAN" 6 "ROAD_BOUNDRY" 7 "STATIC_OBJECT" 8 "TRAFFIC_LIGHT" 9 "TRAFFIC_SIGN" 10 "TWO_WHEELERS" 11 "RESERVED" 12 "RESERVED" 14 "OBJECT_UNDETERMIND" 15 "VEHICLE_UNDETERMIND";
VAL_ 619 OBJ_CLS_TYPE3_044 0 "UNKNOWN_MOVING_OBJ" 1 "CAR" 2 "TRUCK" 3 "MOTOR_BIKE" 4 "BICYCLE" 5 "PEDESTRIAN" 6 "ROAD_BOUNDRY" 7 "STATIC_OBJECT" 8 "TRAFFIC_LIGHT" 9 "TRAFFIC_SIGN" 10 "TWO_WHEELERS" 11 "RESERVED" 12 "RESERVED" 14 "OBJECT_UNDETERMIND" 15 "VEHICLE_UNDETERMIND";
VAL_ 619 OBJ_CLS_TYPE4_044 0 "UNKNOWN_MOVING_OBJ" 1 "CAR" 2 "TRUCK" 3 "MOTOR_BIKE" 4 "BICYCLE" 5 "PEDESTRIAN" 6 "ROAD_BOUNDRY" 7 "STATIC_OBJECT" 8 "TRAFFIC_LIGHT" 9 "TRAFFIC_SIGN" 10 "TWO_WHEELERS" 11 "RESERVED" 12 "RESERVED" 14 "OBJECT_UNDETERMIND" 15 "VEHICLE_UNDETERMIND";
VAL_ 619 OBJ_CLS_TYPE5_044 0 "UNKNOWN_MOVING_OBJ" 1 "CAR" 2 "TRUCK" 3 "MOTOR_BIKE" 4 "BICYCLE" 5 "PEDESTRIAN" 6 "ROAD_BOUNDRY" 7 "STATIC_OBJECT" 8 "TRAFFIC_LIGHT" 9 "TRAFFIC_SIGN" 10 "TWO_WHEELERS" 11 "RESERVED" 12 "RESERVED" 14 "OBJECT_UNDETERMIND" 15 "VEHICLE_UNDETERMIND";
VAL_ 619 OBJ_CLS_TYPE6_044 0 "UNKNOWN_MOVING_OBJ" 1 "CAR" 2 "TRUCK" 3 "MOTOR_BIKE" 4 "BICYCLE" 5 "PEDESTRIAN" 6 "ROAD_BOUNDRY" 7 "STATIC_OBJECT" 8 "TRAFFIC_LIGHT" 9 "TRAFFIC_SIGN" 10 "TWO_WHEELERS" 11 "RESERVED" 12 "RESERVED" 14 "OBJECT_UNDETERMIND" 15 "VEHICLE_UNDETERMIND";
VAL_ 620 OBJ_TRACK_MOTION_MODEL_045 0 "INVALID" 1 "CCV" 2 "CTCA" 3 "CCA";
VAL_ 620 OBJ_MOVEMENT_STATUS_045 0 "UNKNOWN" 1 "MOVING" 2 "SLOW_MOVING" 3 "FAST_MOVING" 4 "STATIONARY" 5 "STOPPED" 6 "RESERVED1" 7 "RESERVED2";
VAL_ 620 OBJ_MEASUREMENT_STATUS_045 0 "Invalid" 1 "New" 2 "Predicted" 3 "PartlyMeasured" 4 "Measured" 5 "Occluded";
VAL_ 620 OBJ_CLS_TYPE1_045 0 "UNKNOWN_MOVING_OBJ" 1 "CAR" 2 "TRUCK" 3 "MOTOR_BIKE" 4 "BICYCLE" 5 "PEDESTRIAN" 6 "ROAD_BOUNDRY" 7 "STATIC_OBJECT" 8 "TRAFFIC_LIGHT" 9 "TRAFFIC_SIGN" 10 "TWO_WHEELERS" 11 "RESERVED" 12 "RESERVED" 14 "OBJECT_UNDETERMIND" 15 "VEHICLE_UNDETERMIND";
VAL_ 620 OBJ_CLS_TYPE2_045 0 "UNKNOWN_MOVING_OBJ" 1 "CAR" 2 "TRUCK" 3 "MOTOR_BIKE" 4 "BICYCLE" 5 "PEDESTRIAN" 6 "ROAD_BOUNDRY" 7 "STATIC_OBJECT" 8 "TRAFFIC_LIGHT" 9 "TRAFFIC_SIGN" 10 "TWO_WHEELERS" 11 "RESERVED" 12 "RESERVED" 14 "OBJECT_UNDETERMIND" 15 "VEHICLE_UNDETERMIND";
VAL_ 620 OBJ_CLS_TYPE3_045 0 "UNKNOWN_MOVING_OBJ" 1 "CAR" 2 "TRUCK" 3 "MOTOR_BIKE" 4 "BICYCLE" 5 "PEDESTRIAN" 6 "ROAD_BOUNDRY" 7 "STATIC_OBJECT" 8 "TRAFFIC_LIGHT" 9 "TRAFFIC_SIGN" 10 "TWO_WHEELERS" 11 "RESERVED" 12 "RESERVED" 14 "OBJECT_UNDETERMIND" 15 "VEHICLE_UNDETERMIND";
VAL_ 620 OBJ_CLS_TYPE4_045 0 "UNKNOWN_MOVING_OBJ" 1 "CAR" 2 "TRUCK" 3 "MOTOR_BIKE" 4 "BICYCLE" 5 "PEDESTRIAN" 6 "ROAD_BOUNDRY" 7 "STATIC_OBJECT" 8 "TRAFFIC_LIGHT" 9 "TRAFFIC_SIGN" 10 "TWO_WHEELERS" 11 "RESERVED" 12 "RESERVED" 14 "OBJECT_UNDETERMIND" 15 "VEHICLE_UNDETERMIND";
VAL_ 620 OBJ_CLS_TYPE5_045 0 "UNKNOWN_MOVING_OBJ" 1 "CAR" 2 "TRUCK" 3 "MOTOR_BIKE" 4 "BICYCLE" 5 "PEDESTRIAN" 6 "ROAD_BOUNDRY" 7 "STATIC_OBJECT" 8 "TRAFFIC_LIGHT" 9 "TRAFFIC_SIGN" 10 "TWO_WHEELERS" 11 "RESERVED" 12 "RESERVED" 14 "OBJECT_UNDETERMIND" 15 "VEHICLE_UNDETERMIND";
VAL_ 620 OBJ_CLS_TYPE6_045 0 "UNKNOWN_MOVING_OBJ" 1 "CAR" 2 "TRUCK" 3 "MOTOR_BIKE" 4 "BICYCLE" 5 "PEDESTRIAN" 6 "ROAD_BOUNDRY" 7 "STATIC_OBJECT" 8 "TRAFFIC_LIGHT" 9 "TRAFFIC_SIGN" 10 "TWO_WHEELERS" 11 "RESERVED" 12 "RESERVED" 14 "OBJECT_UNDETERMIND" 15 "VEHICLE_UNDETERMIND";
VAL_ 621 OBJ_TRACK_MOTION_MODEL_046 0 "INVALID" 1 "CCV" 2 "CTCA" 3 "CCA";
VAL_ 621 OBJ_MOVEMENT_STATUS_046 0 "UNKNOWN" 1 "MOVING" 2 "SLOW_MOVING" 3 "FAST_MOVING" 4 "STATIONARY" 5 "STOPPED" 6 "RESERVED1" 7 "RESERVED2";
VAL_ 621 OBJ_MEASUREMENT_STATUS_046 0 "Invalid" 1 "New" 2 "Predicted" 3 "PartlyMeasured" 4 "Measured" 5 "Occluded";
VAL_ 621 OBJ_CLS_TYPE1_046 0 "UNKNOWN_MOVING_OBJ" 1 "CAR" 2 "TRUCK" 3 "MOTOR_BIKE" 4 "BICYCLE" 5 "PEDESTRIAN" 6 "ROAD_BOUNDRY" 7 "STATIC_OBJECT" 8 "TRAFFIC_LIGHT" 9 "TRAFFIC_SIGN" 10 "TWO_WHEELERS" 11 "RESERVED" 12 "RESERVED" 14 "OBJECT_UNDETERMIND" 15 "VEHICLE_UNDETERMIND";
VAL_ 621 OBJ_CLS_TYPE2_046 0 "UNKNOWN_MOVING_OBJ" 1 "CAR" 2 "TRUCK" 3 "MOTOR_BIKE" 4 "BICYCLE" 5 "PEDESTRIAN" 6 "ROAD_BOUNDRY" 7 "STATIC_OBJECT" 8 "TRAFFIC_LIGHT" 9 "TRAFFIC_SIGN" 10 "TWO_WHEELERS" 11 "RESERVED" 12 "RESERVED" 14 "OBJECT_UNDETERMIND" 15 "VEHICLE_UNDETERMIND";
VAL_ 621 OBJ_CLS_TYPE3_046 0 "UNKNOWN_MOVING_OBJ" 1 "CAR" 2 "TRUCK" 3 "MOTOR_BIKE" 4 "BICYCLE" 5 "PEDESTRIAN" 6 "ROAD_BOUNDRY" 7 "STATIC_OBJECT" 8 "TRAFFIC_LIGHT" 9 "TRAFFIC_SIGN" 10 "TWO_WHEELERS" 11 "RESERVED" 12 "RESERVED" 14 "OBJECT_UNDETERMIND" 15 "VEHICLE_UNDETERMIND";
VAL_ 621 OBJ_CLS_TYPE4_046 0 "UNKNOWN_MOVING_OBJ" 1 "CAR" 2 "TRUCK" 3 "MOTOR_BIKE" 4 "BICYCLE" 5 "PEDESTRIAN" 6 "ROAD_BOUNDRY" 7 "STATIC_OBJECT" 8 "TRAFFIC_LIGHT" 9 "TRAFFIC_SIGN" 10 "TWO_WHEELERS" 11 "RESERVED" 12 "RESERVED" 14 "OBJECT_UNDETERMIND" 15 "VEHICLE_UNDETERMIND";
VAL_ 621 OBJ_CLS_TYPE5_046 0 "UNKNOWN_MOVING_OBJ" 1 "CAR" 2 "TRUCK" 3 "MOTOR_BIKE" 4 "BICYCLE" 5 "PEDESTRIAN" 6 "ROAD_BOUNDRY" 7 "STATIC_OBJECT" 8 "TRAFFIC_LIGHT" 9 "TRAFFIC_SIGN" 10 "TWO_WHEELERS" 11 "RESERVED" 12 "RESERVED" 14 "OBJECT_UNDETERMIND" 15 "VEHICLE_UNDETERMIND";
VAL_ 621 OBJ_CLS_TYPE6_046 0 "UNKNOWN_MOVING_OBJ" 1 "CAR" 2 "TRUCK" 3 "MOTOR_BIKE" 4 "BICYCLE" 5 "PEDESTRIAN" 6 "ROAD_BOUNDRY" 7 "STATIC_OBJECT" 8 "TRAFFIC_LIGHT" 9 "TRAFFIC_SIGN" 10 "TWO_WHEELERS" 11 "RESERVED" 12 "RESERVED" 14 "OBJECT_UNDETERMIND" 15 "VEHICLE_UNDETERMIND";
VAL_ 622 OBJ_TRACK_MOTION_MODEL_047 0 "INVALID" 1 "CCV" 2 "CTCA" 3 "CCA";
VAL_ 622 OBJ_MOVEMENT_STATUS_047 0 "UNKNOWN" 1 "MOVING" 2 "SLOW_MOVING" 3 "FAST_MOVING" 4 "STATIONARY" 5 "STOPPED" 6 "RESERVED1" 7 "RESERVED2";
VAL_ 622 OBJ_MEASUREMENT_STATUS_047 0 "Invalid" 1 "New" 2 "Predicted" 3 "PartlyMeasured" 4 "Measured" 5 "Occluded";
VAL_ 622 OBJ_CLS_TYPE1_047 0 "UNKNOWN_MOVING_OBJ" 1 "CAR" 2 "TRUCK" 3 "MOTOR_BIKE" 4 "BICYCLE" 5 "PEDESTRIAN" 6 "ROAD_BOUNDRY" 7 "STATIC_OBJECT" 8 "TRAFFIC_LIGHT" 9 "TRAFFIC_SIGN" 10 "TWO_WHEELERS" 11 "RESERVED" 12 "RESERVED" 14 "OBJECT_UNDETERMIND" 15 "VEHICLE_UNDETERMIND";
VAL_ 622 OBJ_CLS_TYPE2_047 0 "UNKNOWN_MOVING_OBJ" 1 "CAR" 2 "TRUCK" 3 "MOTOR_BIKE" 4 "BICYCLE" 5 "PEDESTRIAN" 6 "ROAD_BOUNDRY" 7 "STATIC_OBJECT" 8 "TRAFFIC_LIGHT" 9 "TRAFFIC_SIGN" 10 "TWO_WHEELERS" 11 "RESERVED" 12 "RESERVED" 14 "OBJECT_UNDETERMIND" 15 "VEHICLE_UNDETERMIND";
VAL_ 622 OBJ_CLS_TYPE3_047 0 "UNKNOWN_MOVING_OBJ" 1 "CAR" 2 "TRUCK" 3 "MOTOR_BIKE" 4 "BICYCLE" 5 "PEDESTRIAN" 6 "ROAD_BOUNDRY" 7 "STATIC_OBJECT" 8 "TRAFFIC_LIGHT" 9 "TRAFFIC_SIGN" 10 "TWO_WHEELERS" 11 "RESERVED" 12 "RESERVED" 14 "OBJECT_UNDETERMIND" 15 "VEHICLE_UNDETERMIND";
VAL_ 622 OBJ_CLS_TYPE4_047 0 "UNKNOWN_MOVING_OBJ" 1 "CAR" 2 "TRUCK" 3 "MOTOR_BIKE" 4 "BICYCLE" 5 "PEDESTRIAN" 6 "ROAD_BOUNDRY" 7 "STATIC_OBJECT" 8 "TRAFFIC_LIGHT" 9 "TRAFFIC_SIGN" 10 "TWO_WHEELERS" 11 "RESERVED" 12 "RESERVED" 14 "OBJECT_UNDETERMIND" 15 "VEHICLE_UNDETERMIND";
VAL_ 622 OBJ_CLS_TYPE5_047 0 "UNKNOWN_MOVING_OBJ" 1 "CAR" 2 "TRUCK" 3 "MOTOR_BIKE" 4 "BICYCLE" 5 "PEDESTRIAN" 6 "ROAD_BOUNDRY" 7 "STATIC_OBJECT" 8 "TRAFFIC_LIGHT" 9 "TRAFFIC_SIGN" 10 "TWO_WHEELERS" 11 "RESERVED" 12 "RESERVED" 14 "OBJECT_UNDETERMIND" 15 "VEHICLE_UNDETERMIND";
VAL_ 622 OBJ_CLS_TYPE6_047 0 "UNKNOWN_MOVING_OBJ" 1 "CAR" 2 "TRUCK" 3 "MOTOR_BIKE" 4 "BICYCLE" 5 "PEDESTRIAN" 6 "ROAD_BOUNDRY" 7 "STATIC_OBJECT" 8 "TRAFFIC_LIGHT" 9 "TRAFFIC_SIGN" 10 "TWO_WHEELERS" 11 "RESERVED" 12 "RESERVED" 14 "OBJECT_UNDETERMIND" 15 "VEHICLE_UNDETERMIND";
VAL_ 623 OBJ_TRACK_MOTION_MODEL_048 0 "INVALID" 1 "CCV" 2 "CTCA" 3 "CCA";
VAL_ 623 OBJ_MOVEMENT_STATUS_048 0 "UNKNOWN" 1 "MOVING" 2 "SLOW_MOVING" 3 "FAST_MOVING" 4 "STATIONARY" 5 "STOPPED" 6 "RESERVED1" 7 "RESERVED2";
VAL_ 623 OBJ_MEASUREMENT_STATUS_048 0 "Invalid" 1 "New" 2 "Predicted" 3 "PartlyMeasured" 4 "Measured" 5 "Occluded";
VAL_ 623 OBJ_CLS_TYPE1_048 0 "UNKNOWN_MOVING_OBJ" 1 "CAR" 2 "TRUCK" 3 "MOTOR_BIKE" 4 "BICYCLE" 5 "PEDESTRIAN" 6 "ROAD_BOUNDRY" 7 "STATIC_OBJECT" 8 "TRAFFIC_LIGHT" 9 "TRAFFIC_SIGN" 10 "TWO_WHEELERS" 11 "RESERVED" 12 "RESERVED" 14 "OBJECT_UNDETERMIND" 15 "VEHICLE_UNDETERMIND";
VAL_ 623 OBJ_CLS_TYPE2_048 0 "UNKNOWN_MOVING_OBJ" 1 "CAR" 2 "TRUCK" 3 "MOTOR_BIKE" 4 "BICYCLE" 5 "PEDESTRIAN" 6 "ROAD_BOUNDRY" 7 "STATIC_OBJECT" 8 "TRAFFIC_LIGHT" 9 "TRAFFIC_SIGN" 10 "TWO_WHEELERS" 11 "RESERVED" 12 "RESERVED" 14 "OBJECT_UNDETERMIND" 15 "VEHICLE_UNDETERMIND";
VAL_ 623 OBJ_CLS_TYPE3_048 0 "UNKNOWN_MOVING_OBJ" 1 "CAR" 2 "TRUCK" 3 "MOTOR_BIKE" 4 "BICYCLE" 5 "PEDESTRIAN" 6 "ROAD_BOUNDRY" 7 "STATIC_OBJECT" 8 "TRAFFIC_LIGHT" 9 "TRAFFIC_SIGN" 10 "TWO_WHEELERS" 11 "RESERVED" 12 "RESERVED" 14 "OBJECT_UNDETERMIND" 15 "VEHICLE_UNDETERMIND";
VAL_ 623 OBJ_CLS_TYPE4_048 0 "UNKNOWN_MOVING_OBJ" 1 "CAR" 2 "TRUCK" 3 "MOTOR_BIKE" 4 "BICYCLE" 5 "PEDESTRIAN" 6 "ROAD_BOUNDRY" 7 "STATIC_OBJECT" 8 "TRAFFIC_LIGHT" 9 "TRAFFIC_SIGN" 10 "TWO_WHEELERS" 11 "RESERVED" 12 "RESERVED" 14 "OBJECT_UNDETERMIND" 15 "VEHICLE_UNDETERMIND";
VAL_ 623 OBJ_CLS_TYPE5_048 0 "UNKNOWN_MOVING_OBJ" 1 "CAR" 2 "TRUCK" 3 "MOTOR_BIKE" 4 "BICYCLE" 5 "PEDESTRIAN" 6 "ROAD_BOUNDRY" 7 "STATIC_OBJECT" 8 "TRAFFIC_LIGHT" 9 "TRAFFIC_SIGN" 10 "TWO_WHEELERS" 11 "RESERVED" 12 "RESERVED" 14 "OBJECT_UNDETERMIND" 15 "VEHICLE_UNDETERMIND";
VAL_ 623 OBJ_CLS_TYPE6_048 0 "UNKNOWN_MOVING_OBJ" 1 "CAR" 2 "TRUCK" 3 "MOTOR_BIKE" 4 "BICYCLE" 5 "PEDESTRIAN" 6 "ROAD_BOUNDRY" 7 "STATIC_OBJECT" 8 "TRAFFIC_LIGHT" 9 "TRAFFIC_SIGN" 10 "TWO_WHEELERS" 11 "RESERVED" 12 "RESERVED" 14 "OBJECT_UNDETERMIND" 15 "VEHICLE_UNDETERMIND";
SIG_GROUP_ 607 TrackerObject032 1 : OBJ_ACCEL_ERR_CRR_COEF_032 OBJ_VELOCITY_ERR_CRR_COEF_032 OBJ_POS_ERR_CRR_COEF_032 OBJ_YAW_RATE_032 OBJ_YAW_RATE_ERR_032 OBJ_GROUP_ID_032 OBJ_REF_PT_LAT_OFFSET_032 OBJ_REF_PT_LONG_OFFSET_032 OBJ_RCS_032 OBJ_YAW_ANGLE_ERR_032 OBJ_CLS_TYPE6_032 OBJ_CLS_TYPE6_PROB_032 OBJ_CLS_TYPE5_PROB_032 OBJ_CLS_TYPE5_032 OBJ_CLS_TYPE4_PROB_032 OBJ_CLS_TYPE4_032 OBJ_CLS_TYPE3_PROB_032 OBJ_CLS_TYPE3_032 OBJ_CLS_TYPE2_PROB_032 OBJ_CLS_TYPE2_032 OBJ_DIMENSION_WIDTH_ERR_032 OBJ_DIMENSION_LENGTH_ERR_032 OBJ_TIMESTAMP_OFFSET_032 OBJ_CLS_TYPE1_PROB_032 OBJ_VEH_TRACK_FLAG_032 OBJ_ACCELERATION_LAT_032 OBJ_ACCELERATION_LONG_032 OBJ_VELOCITY_LAT_032 OBJ_VELOCITY_LONG_032 OBJ_POS_LAT_032 OBJ_POS_LONG_032 OBJ_MEASUREMENT_STATUS_032 OBJ_MOVEMENT_STATUS_032 OBJ_CLS_TYPE1_032 OBJ_ID_032 OBJ_YAW_ANGLE_032 OBJ_EXISTENCE_PROB_032 OBJ_DIMENSION_LENGTH_032 OBJ_DIMENSION_WIDTH_032 OBJ_TRACK_MOTION_MODEL_032 OBJ_POS_LAT_ERR_032 OBJ_POS_LONG_ERR_032 OBJ_VELOCITY_LAT_ERR_032 OBJ_VELOCITY_LONG_ERR_032 OBJ_ACCELERATION_LAT_ERR_032 OBJ_ACCELERATION_LONG_ERR_032 OBJ_ALIVE_TIME_032;
SIG_GROUP_ 608 TrackerObject033 1 : OBJ_ACCEL_ERR_CRR_COEF_033 OBJ_VELOCITY_ERR_CRR_COEF_033 OBJ_POS_ERR_CRR_COEF_033 OBJ_YAW_RATE_033 OBJ_YAW_RATE_ERR_033 OBJ_GROUP_ID_033 OBJ_REF_PT_LAT_OFFSET_033 OBJ_REF_PT_LONG_OFFSET_033 OBJ_RCS_033 OBJ_YAW_ANGLE_ERR_033 OBJ_CLS_TYPE6_033 OBJ_CLS_TYPE6_PROB_033 OBJ_CLS_TYPE5_PROB_033 OBJ_CLS_TYPE5_033 OBJ_CLS_TYPE4_PROB_033 OBJ_CLS_TYPE4_033 OBJ_CLS_TYPE3_PROB_033 OBJ_CLS_TYPE3_033 OBJ_CLS_TYPE2_PROB_033 OBJ_CLS_TYPE2_033 OBJ_DIMENSION_WIDTH_ERR_033 OBJ_DIMENSION_LENGTH_ERR_033 OBJ_TIMESTAMP_OFFSET_033 OBJ_CLS_TYPE1_PROB_033 OBJ_VEH_TRACK_FLAG_033 OBJ_ACCELERATION_LAT_033 OBJ_ACCELERATION_LONG_033 OBJ_VELOCITY_LAT_033 OBJ_VELOCITY_LONG_033 OBJ_POS_LAT_033 OBJ_POS_LONG_033 OBJ_MEASUREMENT_STATUS_033 OBJ_MOVEMENT_STATUS_033 OBJ_CLS_TYPE1_033 OBJ_ID_033 OBJ_YAW_ANGLE_033 OBJ_EXISTENCE_PROB_033 OBJ_DIMENSION_LENGTH_033 OBJ_DIMENSION_WIDTH_033 OBJ_TRACK_MOTION_MODEL_033 OBJ_POS_LAT_ERR_033 OBJ_POS_LONG_ERR_033 OBJ_VELOCITY_LAT_ERR_033 OBJ_VELOCITY_LONG_ERR_033 OBJ_ACCELERATION_LAT_ERR_033 OBJ_ACCELERATION_LONG_ERR_033 OBJ_ALIVE_TIME_033;
SIG_GROUP_ 609 TrackerObject034 1 : OBJ_ACCEL_ERR_CRR_COEF_034 OBJ_VELOCITY_ERR_CRR_COEF_034 OBJ_POS_ERR_CRR_COEF_034 OBJ_YAW_RATE_034 OBJ_YAW_RATE_ERR_034 OBJ_GROUP_ID_034 OBJ_REF_PT_LAT_OFFSET_034 OBJ_REF_PT_LONG_OFFSET_034 OBJ_RCS_034 OBJ_YAW_ANGLE_ERR_034 OBJ_CLS_TYPE6_034 OBJ_CLS_TYPE6_PROB_034 OBJ_CLS_TYPE5_PROB_034 OBJ_CLS_TYPE5_034 OBJ_CLS_TYPE4_PROB_034 OBJ_CLS_TYPE4_034 OBJ_CLS_TYPE3_PROB_034 OBJ_CLS_TYPE3_034 OBJ_CLS_TYPE2_PROB_034 OBJ_CLS_TYPE2_034 OBJ_DIMENSION_WIDTH_ERR_034 OBJ_DIMENSION_LENGTH_ERR_034 OBJ_TIMESTAMP_OFFSET_034 OBJ_CLS_TYPE1_PROB_034 OBJ_VEH_TRACK_FLAG_034 OBJ_ACCELERATION_LAT_034 OBJ_ACCELERATION_LONG_034 OBJ_VELOCITY_LAT_034 OBJ_VELOCITY_LONG_034 OBJ_POS_LAT_034 OBJ_POS_LONG_034 OBJ_MEASUREMENT_STATUS_034 OBJ_MOVEMENT_STATUS_034 OBJ_CLS_TYPE1_034 OBJ_ID_034 OBJ_YAW_ANGLE_034 OBJ_EXISTENCE_PROB_034 OBJ_DIMENSION_LENGTH_034 OBJ_DIMENSION_WIDTH_034 OBJ_TRACK_MOTION_MODEL_034 OBJ_POS_LAT_ERR_034 OBJ_POS_LONG_ERR_034 OBJ_VELOCITY_LAT_ERR_034 OBJ_VELOCITY_LONG_ERR_034 OBJ_ACCELERATION_LAT_ERR_034 OBJ_ACCELERATION_LONG_ERR_034 OBJ_ALIVE_TIME_034;
SIG_GROUP_ 610 TrackerObject035 1 : OBJ_ACCEL_ERR_CRR_COEF_035 OBJ_VELOCITY_ERR_CRR_COEF_035 OBJ_POS_ERR_CRR_COEF_035 OBJ_YAW_RATE_035 OBJ_YAW_RATE_ERR_035 OBJ_GROUP_ID_035 OBJ_REF_PT_LAT_OFFSET_035 OBJ_REF_PT_LONG_OFFSET_035 OBJ_RCS_035 OBJ_YAW_ANGLE_ERR_035 OBJ_CLS_TYPE6_035 OBJ_CLS_TYPE6_PROB_035 OBJ_CLS_TYPE5_PROB_035 OBJ_CLS_TYPE5_035 OBJ_CLS_TYPE4_PROB_035 OBJ_CLS_TYPE4_035 OBJ_CLS_TYPE3_PROB_035 OBJ_CLS_TYPE3_035 OBJ_CLS_TYPE2_PROB_035 OBJ_CLS_TYPE2_035 OBJ_DIMENSION_WIDTH_ERR_035 OBJ_DIMENSION_LENGTH_ERR_035 OBJ_TIMESTAMP_OFFSET_035 OBJ_CLS_TYPE1_PROB_035 OBJ_VEH_TRACK_FLAG_035 OBJ_ACCELERATION_LAT_035 OBJ_ACCELERATION_LONG_035 OBJ_VELOCITY_LAT_035 OBJ_VELOCITY_LONG_035 OBJ_POS_LAT_035 OBJ_POS_LONG_035 OBJ_MEASUREMENT_STATUS_035 OBJ_MOVEMENT_STATUS_035 OBJ_CLS_TYPE1_035 OBJ_ID_035 OBJ_YAW_ANGLE_035 OBJ_EXISTENCE_PROB_035 OBJ_DIMENSION_LENGTH_035 OBJ_DIMENSION_WIDTH_035 OBJ_TRACK_MOTION_MODEL_035 OBJ_POS_LAT_ERR_035 OBJ_POS_LONG_ERR_035 OBJ_VELOCITY_LAT_ERR_035 OBJ_VELOCITY_LONG_ERR_035 OBJ_ACCELERATION_LAT_ERR_035 OBJ_ACCELERATION_LONG_ERR_035 OBJ_ALIVE_TIME_035;
SIG_GROUP_ 611 TrackerObject036 1 : OBJ_ACCEL_ERR_CRR_COEF_036 OBJ_VELOCITY_ERR_CRR_COEF_036 OBJ_POS_ERR_CRR_COEF_036 OBJ_YAW_RATE_036 OBJ_YAW_RATE_ERR_036 OBJ_GROUP_ID_036 OBJ_REF_PT_LAT_OFFSET_036 OBJ_REF_PT_LONG_OFFSET_036 OBJ_RCS_036 OBJ_YAW_ANGLE_ERR_036 OBJ_CLS_TYPE6_036 OBJ_CLS_TYPE6_PROB_036 OBJ_CLS_TYPE5_PROB_036 OBJ_CLS_TYPE5_036 OBJ_CLS_TYPE4_PROB_036 OBJ_CLS_TYPE4_036 OBJ_CLS_TYPE3_PROB_036 OBJ_CLS_TYPE3_036 OBJ_CLS_TYPE2_PROB_036 OBJ_CLS_TYPE2_036 OBJ_DIMENSION_WIDTH_ERR_036 OBJ_DIMENSION_LENGTH_ERR_036 OBJ_TIMESTAMP_OFFSET_036 OBJ_CLS_TYPE1_PROB_036 OBJ_VEH_TRACK_FLAG_036 OBJ_ACCELERATION_LAT_036 OBJ_ACCELERATION_LONG_036 OBJ_VELOCITY_LAT_036 OBJ_VELOCITY_LONG_036 OBJ_POS_LAT_036 OBJ_POS_LONG_036 OBJ_MEASUREMENT_STATUS_036 OBJ_MOVEMENT_STATUS_036 OBJ_CLS_TYPE1_036 OBJ_ID_036 OBJ_YAW_ANGLE_036 OBJ_EXISTENCE_PROB_036 OBJ_DIMENSION_LENGTH_036 OBJ_DIMENSION_WIDTH_036 OBJ_TRACK_MOTION_MODEL_036 OBJ_POS_LAT_ERR_036 OBJ_POS_LONG_ERR_036 OBJ_VELOCITY_LAT_ERR_036 OBJ_VELOCITY_LONG_ERR_036 OBJ_ACCELERATION_LAT_ERR_036 OBJ_ACCELERATION_LONG_ERR_036 OBJ_ALIVE_TIME_036;
SIG_GROUP_ 612 TrackerObject037 1 : OBJ_ACCEL_ERR_CRR_COEF_037 OBJ_VELOCITY_ERR_CRR_COEF_037 OBJ_POS_ERR_CRR_COEF_037 OBJ_YAW_RATE_037 OBJ_YAW_RATE_ERR_037 OBJ_GROUP_ID_037 OBJ_REF_PT_LAT_OFFSET_037 OBJ_REF_PT_LONG_OFFSET_037 OBJ_RCS_037 OBJ_YAW_ANGLE_ERR_037 OBJ_CLS_TYPE6_037 OBJ_CLS_TYPE6_PROB_037 OBJ_CLS_TYPE5_PROB_037 OBJ_CLS_TYPE5_037 OBJ_CLS_TYPE4_PROB_037 OBJ_CLS_TYPE4_037 OBJ_CLS_TYPE3_PROB_037 OBJ_CLS_TYPE3_037 OBJ_CLS_TYPE2_PROB_037 OBJ_CLS_TYPE2_037 OBJ_DIMENSION_WIDTH_ERR_037 OBJ_DIMENSION_LENGTH_ERR_037 OBJ_TIMESTAMP_OFFSET_037 OBJ_CLS_TYPE1_PROB_037 OBJ_VEH_TRACK_FLAG_037 OBJ_ACCELERATION_LAT_037 OBJ_ACCELERATION_LONG_037 OBJ_VELOCITY_LAT_037 OBJ_VELOCITY_LONG_037 OBJ_POS_LAT_037 OBJ_POS_LONG_037 OBJ_MEASUREMENT_STATUS_037 OBJ_MOVEMENT_STATUS_037 OBJ_CLS_TYPE1_037 OBJ_ID_037 OBJ_YAW_ANGLE_037 OBJ_EXISTENCE_PROB_037 OBJ_DIMENSION_LENGTH_037 OBJ_DIMENSION_WIDTH_037 OBJ_TRACK_MOTION_MODEL_037 OBJ_POS_LAT_ERR_037 OBJ_POS_LONG_ERR_037 OBJ_VELOCITY_LAT_ERR_037 OBJ_VELOCITY_LONG_ERR_037 OBJ_ACCELERATION_LAT_ERR_037 OBJ_ACCELERATION_LONG_ERR_037 OBJ_ALIVE_TIME_037;
SIG_GROUP_ 613 TrackerObject038 1 : OBJ_ACCEL_ERR_CRR_COEF_038 OBJ_VELOCITY_ERR_CRR_COEF_038 OBJ_POS_ERR_CRR_COEF_038 OBJ_YAW_RATE_038 OBJ_YAW_RATE_ERR_038 OBJ_GROUP_ID_038 OBJ_REF_PT_LAT_OFFSET_038 OBJ_REF_PT_LONG_OFFSET_038 OBJ_RCS_038 OBJ_YAW_ANGLE_ERR_038 OBJ_CLS_TYPE6_038 OBJ_CLS_TYPE6_PROB_038 OBJ_CLS_TYPE5_PROB_038 OBJ_CLS_TYPE5_038 OBJ_CLS_TYPE4_PROB_038 OBJ_CLS_TYPE4_038 OBJ_CLS_TYPE3_PROB_038 OBJ_CLS_TYPE3_038 OBJ_CLS_TYPE2_PROB_038 OBJ_CLS_TYPE2_038 OBJ_DIMENSION_WIDTH_ERR_038 OBJ_DIMENSION_LENGTH_ERR_038 OBJ_TIMESTAMP_OFFSET_038 OBJ_CLS_TYPE1_PROB_038 OBJ_VEH_TRACK_FLAG_038 OBJ_ACCELERATION_LAT_038 OBJ_ACCELERATION_LONG_038 OBJ_VELOCITY_LAT_038 OBJ_VELOCITY_LONG_038 OBJ_POS_LAT_038 OBJ_POS_LONG_038 OBJ_MEASUREMENT_STATUS_038 OBJ_MOVEMENT_STATUS_038 OBJ_CLS_TYPE1_038 OBJ_ID_038 OBJ_YAW_ANGLE_038 OBJ_EXISTENCE_PROB_038 OBJ_DIMENSION_LENGTH_038 OBJ_DIMENSION_WIDTH_038 OBJ_TRACK_MOTION_MODEL_038 OBJ_POS_LAT_ERR_038 OBJ_POS_LONG_ERR_038 OBJ_VELOCITY_LAT_ERR_038 OBJ_VELOCITY_LONG_ERR_038 OBJ_ACCELERATION_LAT_ERR_038 OBJ_ACCELERATION_LONG_ERR_038 OBJ_ALIVE_TIME_038;
SIG_GROUP_ 614 TrackerObject039 1 : OBJ_ACCEL_ERR_CRR_COEF_039 OBJ_VELOCITY_ERR_CRR_COEF_039 OBJ_POS_ERR_CRR_COEF_039 OBJ_YAW_RATE_039 OBJ_YAW_RATE_ERR_039 OBJ_GROUP_ID_039 OBJ_REF_PT_LAT_OFFSET_039 OBJ_REF_PT_LONG_OFFSET_039 OBJ_RCS_039 OBJ_YAW_ANGLE_ERR_039 OBJ_CLS_TYPE6_039 OBJ_CLS_TYPE6_PROB_039 OBJ_CLS_TYPE5_PROB_039 OBJ_CLS_TYPE5_039 OBJ_CLS_TYPE4_PROB_039 OBJ_CLS_TYPE4_039 OBJ_CLS_TYPE3_PROB_039 OBJ_CLS_TYPE3_039 OBJ_CLS_TYPE2_PROB_039 OBJ_CLS_TYPE2_039 OBJ_DIMENSION_WIDTH_ERR_039 OBJ_DIMENSION_LENGTH_ERR_039 OBJ_TIMESTAMP_OFFSET_039 OBJ_CLS_TYPE1_PROB_039 OBJ_VEH_TRACK_FLAG_039 OBJ_ACCELERATION_LAT_039 OBJ_ACCELERATION_LONG_039 OBJ_VELOCITY_LAT_039 OBJ_VELOCITY_LONG_039 OBJ_POS_LAT_039 OBJ_POS_LONG_039 OBJ_MEASUREMENT_STATUS_039 OBJ_MOVEMENT_STATUS_039 OBJ_CLS_TYPE1_039 OBJ_ID_039 OBJ_YAW_ANGLE_039 OBJ_EXISTENCE_PROB_039 OBJ_DIMENSION_LENGTH_039 OBJ_DIMENSION_WIDTH_039 OBJ_TRACK_MOTION_MODEL_039 OBJ_POS_LAT_ERR_039 OBJ_POS_LONG_ERR_039 OBJ_VELOCITY_LAT_ERR_039 OBJ_VELOCITY_LONG_ERR_039 OBJ_ACCELERATION_LAT_ERR_039 OBJ_ACCELERATION_LONG_ERR_039 OBJ_ALIVE_TIME_039;
SIG_GROUP_ 615 TrackerObject040 1 : OBJ_ACCEL_ERR_CRR_COEF_040 OBJ_VELOCITY_ERR_CRR_COEF_040 OBJ_POS_ERR_CRR_COEF_040 OBJ_YAW_RATE_040 OBJ_YAW_RATE_ERR_040 OBJ_GROUP_ID_040 OBJ_REF_PT_LAT_OFFSET_040 OBJ_REF_PT_LONG_OFFSET_040 OBJ_RCS_040 OBJ_YAW_ANGLE_ERR_040 OBJ_CLS_TYPE6_040 OBJ_CLS_TYPE6_PROB_040 OBJ_CLS_TYPE5_PROB_040 OBJ_CLS_TYPE5_040 OBJ_CLS_TYPE4_PROB_040 OBJ_CLS_TYPE4_040 OBJ_CLS_TYPE3_PROB_040 OBJ_CLS_TYPE3_040 OBJ_CLS_TYPE2_PROB_040 OBJ_CLS_TYPE2_040 OBJ_DIMENSION_WIDTH_ERR_040 OBJ_DIMENSION_LENGTH_ERR_040 OBJ_TIMESTAMP_OFFSET_040 OBJ_CLS_TYPE1_PROB_040 OBJ_VEH_TRACK_FLAG_040 OBJ_ACCELERATION_LAT_040 OBJ_ACCELERATION_LONG_040 OBJ_VELOCITY_LAT_040 OBJ_VELOCITY_LONG_040 OBJ_POS_LAT_040 OBJ_POS_LONG_040 OBJ_MEASUREMENT_STATUS_040 OBJ_MOVEMENT_STATUS_040 OBJ_CLS_TYPE1_040 OBJ_ID_040 OBJ_YAW_ANGLE_040 OBJ_EXISTENCE_PROB_040 OBJ_DIMENSION_LENGTH_040 OBJ_DIMENSION_WIDTH_040 OBJ_TRACK_MOTION_MODEL_040 OBJ_POS_LAT_ERR_040 OBJ_POS_LONG_ERR_040 OBJ_VELOCITY_LAT_ERR_040 OBJ_VELOCITY_LONG_ERR_040 OBJ_ACCELERATION_LAT_ERR_040 OBJ_ACCELERATION_LONG_ERR_040 OBJ_ALIVE_TIME_040;
SIG_GROUP_ 616 TrackerObject041 1 : OBJ_ACCEL_ERR_CRR_COEF_041 OBJ_VELOCITY_ERR_CRR_COEF_041 OBJ_POS_ERR_CRR_COEF_041 OBJ_YAW_RATE_041 OBJ_YAW_RATE_ERR_041 OBJ_GROUP_ID_041 OBJ_REF_PT_LAT_OFFSET_041 OBJ_REF_PT_LONG_OFFSET_041 OBJ_RCS_041 OBJ_YAW_ANGLE_ERR_041 OBJ_CLS_TYPE6_041 OBJ_CLS_TYPE6_PROB_041 OBJ_CLS_TYPE5_PROB_041 OBJ_CLS_TYPE5_041 OBJ_CLS_TYPE4_PROB_041 OBJ_CLS_TYPE4_041 OBJ_CLS_TYPE3_PROB_041 OBJ_CLS_TYPE3_041 OBJ_CLS_TYPE2_PROB_041 OBJ_CLS_TYPE2_041 OBJ_DIMENSION_WIDTH_ERR_041 OBJ_DIMENSION_LENGTH_ERR_041 OBJ_TIMESTAMP_OFFSET_041 OBJ_CLS_TYPE1_PROB_041 OBJ_VEH_TRACK_FLAG_041 OBJ_ACCELERATION_LAT_041 OBJ_ACCELERATION_LONG_041 OBJ_VELOCITY_LAT_041 OBJ_VELOCITY_LONG_041 OBJ_POS_LAT_041 OBJ_POS_LONG_041 OBJ_MEASUREMENT_STATUS_041 OBJ_MOVEMENT_STATUS_041 OBJ_CLS_TYPE1_041 OBJ_ID_041 OBJ_YAW_ANGLE_041 OBJ_EXISTENCE_PROB_041 OBJ_DIMENSION_LENGTH_041 OBJ_DIMENSION_WIDTH_041 OBJ_TRACK_MOTION_MODEL_041 OBJ_POS_LAT_ERR_041 OBJ_POS_LONG_ERR_041 OBJ_VELOCITY_LAT_ERR_041 OBJ_VELOCITY_LONG_ERR_041 OBJ_ACCELERATION_LAT_ERR_041 OBJ_ACCELERATION_LONG_ERR_041 OBJ_ALIVE_TIME_041;
SIG_GROUP_ 617 TrackerObject042 1 : OBJ_ACCEL_ERR_CRR_COEF_042 OBJ_VELOCITY_ERR_CRR_COEF_042 OBJ_POS_ERR_CRR_COEF_042 OBJ_YAW_RATE_042 OBJ_YAW_RATE_ERR_042 OBJ_GROUP_ID_042 OBJ_REF_PT_LAT_OFFSET_042 OBJ_REF_PT_LONG_OFFSET_042 OBJ_RCS_042 OBJ_YAW_ANGLE_ERR_042 OBJ_CLS_TYPE6_042 OBJ_CLS_TYPE6_PROB_042 OBJ_CLS_TYPE5_PROB_042 OBJ_CLS_TYPE5_042 OBJ_CLS_TYPE4_PROB_042 OBJ_CLS_TYPE4_042 OBJ_CLS_TYPE3_PROB_042 OBJ_CLS_TYPE3_042 OBJ_CLS_TYPE2_PROB_042 OBJ_CLS_TYPE2_042 OBJ_DIMENSION_WIDTH_ERR_042 OBJ_DIMENSION_LENGTH_ERR_042 OBJ_TIMESTAMP_OFFSET_042 OBJ_CLS_TYPE1_PROB_042 OBJ_VEH_TRACK_FLAG_042 OBJ_ACCELERATION_LAT_042 OBJ_ACCELERATION_LONG_042 OBJ_VELOCITY_LAT_042 OBJ_VELOCITY_LONG_042 OBJ_POS_LAT_042 OBJ_POS_LONG_042 OBJ_MEASUREMENT_STATUS_042 OBJ_MOVEMENT_STATUS_042 OBJ_CLS_TYPE1_042 OBJ_ID_042 OBJ_YAW_ANGLE_042 OBJ_EXISTENCE_PROB_042 OBJ_DIMENSION_LENGTH_042 OBJ_DIMENSION_WIDTH_042 OBJ_TRACK_MOTION_MODEL_042 OBJ_POS_LAT_ERR_042 OBJ_POS_LONG_ERR_042 OBJ_VELOCITY_LAT_ERR_042 OBJ_VELOCITY_LONG_ERR_042 OBJ_ACCELERATION_LAT_ERR_042 OBJ_ACCELERATION_LONG_ERR_042 OBJ_ALIVE_TIME_042;
SIG_GROUP_ 618 TrackerObject043 1 : OBJ_ACCEL_ERR_CRR_COEF_043 OBJ_VELOCITY_ERR_CRR_COEF_043 OBJ_POS_ERR_CRR_COEF_043 OBJ_YAW_RATE_043 OBJ_YAW_RATE_ERR_043 OBJ_GROUP_ID_043 OBJ_REF_PT_LAT_OFFSET_043 OBJ_REF_PT_LONG_OFFSET_043 OBJ_RCS_043 OBJ_YAW_ANGLE_ERR_043 OBJ_CLS_TYPE6_043 OBJ_CLS_TYPE6_PROB_043 OBJ_CLS_TYPE5_PROB_043 OBJ_CLS_TYPE5_043 OBJ_CLS_TYPE4_PROB_043 OBJ_CLS_TYPE4_043 OBJ_CLS_TYPE3_PROB_043 OBJ_CLS_TYPE3_043 OBJ_CLS_TYPE2_PROB_043 OBJ_CLS_TYPE2_043 OBJ_DIMENSION_WIDTH_ERR_043 OBJ_DIMENSION_LENGTH_ERR_043 OBJ_TIMESTAMP_OFFSET_043 OBJ_CLS_TYPE1_PROB_043 OBJ_VEH_TRACK_FLAG_043 OBJ_ACCELERATION_LAT_043 OBJ_ACCELERATION_LONG_043 OBJ_VELOCITY_LAT_043 OBJ_VELOCITY_LONG_043 OBJ_POS_LAT_043 OBJ_POS_LONG_043 OBJ_MEASUREMENT_STATUS_043 OBJ_MOVEMENT_STATUS_043 OBJ_CLS_TYPE1_043 OBJ_ID_043 OBJ_YAW_ANGLE_043 OBJ_EXISTENCE_PROB_043 OBJ_DIMENSION_LENGTH_043 OBJ_DIMENSION_WIDTH_043 OBJ_TRACK_MOTION_MODEL_043 OBJ_POS_LAT_ERR_043 OBJ_POS_LONG_ERR_043 OBJ_VELOCITY_LAT_ERR_043 OBJ_VELOCITY_LONG_ERR_043 OBJ_ACCELERATION_LAT_ERR_043 OBJ_ACCELERATION_LONG_ERR_043 OBJ_ALIVE_TIME_043;
SIG_GROUP_ 619 TrackerObject044 1 : OBJ_ACCEL_ERR_CRR_COEF_044 OBJ_VELOCITY_ERR_CRR_COEF_044 OBJ_POS_ERR_CRR_COEF_044 OBJ_YAW_RATE_044 OBJ_YAW_RATE_ERR_044 OBJ_GROUP_ID_044 OBJ_REF_PT_LAT_OFFSET_044 OBJ_REF_PT_LONG_OFFSET_044 OBJ_RCS_044 OBJ_YAW_ANGLE_ERR_044 OBJ_CLS_TYPE6_044 OBJ_CLS_TYPE6_PROB_044 OBJ_CLS_TYPE5_PROB_044 OBJ_CLS_TYPE5_044 OBJ_CLS_TYPE4_PROB_044 OBJ_CLS_TYPE4_044 OBJ_CLS_TYPE3_PROB_044 OBJ_CLS_TYPE3_044 OBJ_CLS_TYPE2_PROB_044 OBJ_CLS_TYPE2_044 OBJ_DIMENSION_WIDTH_ERR_044 OBJ_DIMENSION_LENGTH_ERR_044 OBJ_TIMESTAMP_OFFSET_044 OBJ_CLS_TYPE1_PROB_044 OBJ_VEH_TRACK_FLAG_044 OBJ_ACCELERATION_LAT_044 OBJ_ACCELERATION_LONG_044 OBJ_VELOCITY_LAT_044 OBJ_VELOCITY_LONG_044 OBJ_POS_LAT_044 OBJ_POS_LONG_044 OBJ_MEASUREMENT_STATUS_044 OBJ_MOVEMENT_STATUS_044 OBJ_CLS_TYPE1_044 OBJ_ID_044 OBJ_YAW_ANGLE_044 OBJ_EXISTENCE_PROB_044 OBJ_DIMENSION_LENGTH_044 OBJ_DIMENSION_WIDTH_044 OBJ_TRACK_MOTION_MODEL_044 OBJ_POS_LAT_ERR_044 OBJ_POS_LONG_ERR_044 OBJ_VELOCITY_LAT_ERR_044 OBJ_VELOCITY_LONG_ERR_044 OBJ_ACCELERATION_LAT_ERR_044 OBJ_ACCELERATION_LONG_ERR_044 OBJ_ALIVE_TIME_044;
SIG_GROUP_ 620 TrackerObject045 1 : OBJ_ACCEL_ERR_CRR_COEF_045 OBJ_VELOCITY_ERR_CRR_COEF_045 OBJ_POS_ERR_CRR_COEF_045 OBJ_YAW_RATE_045 OBJ_YAW_RATE_ERR_045 OBJ_GROUP_ID_045 OBJ_REF_PT_LAT_OFFSET_045 OBJ_REF_PT_LONG_OFFSET_045 OBJ_RCS_045 OBJ_YAW_ANGLE_ERR_045 OBJ_CLS_TYPE6_045 OBJ_CLS_TYPE6_PROB_045 OBJ_CLS_TYPE5_PROB_045 OBJ_CLS_TYPE5_045 OBJ_CLS_TYPE4_PROB_045 OBJ_CLS_TYPE4_045 OBJ_CLS_TYPE3_PROB_045 OBJ_CLS_TYPE3_045 OBJ_CLS_TYPE2_PROB_045 OBJ_CLS_TYPE2_045 OBJ_DIMENSION_WIDTH_ERR_045 OBJ_DIMENSION_LENGTH_ERR_045 OBJ_TIMESTAMP_OFFSET_045 OBJ_CLS_TYPE1_PROB_045 OBJ_VEH_TRACK_FLAG_045 OBJ_ACCELERATION_LAT_045 OBJ_ACCELERATION_LONG_045 OBJ_VELOCITY_LAT_045 OBJ_VELOCITY_LONG_045 OBJ_POS_LAT_045 OBJ_POS_LONG_045 OBJ_MEASUREMENT_STATUS_045 OBJ_MOVEMENT_STATUS_045 OBJ_CLS_TYPE1_045 OBJ_ID_045 OBJ_YAW_ANGLE_045 OBJ_EXISTENCE_PROB_045 OBJ_DIMENSION_LENGTH_045 OBJ_DIMENSION_WIDTH_045 OBJ_TRACK_MOTION_MODEL_045 OBJ_POS_LAT_ERR_045 OBJ_POS_LONG_ERR_045 OBJ_VELOCITY_LAT_ERR_045 OBJ_VELOCITY_LONG_ERR_045 OBJ_ACCELERATION_LAT_ERR_045 OBJ_ACCELERATION_LONG_ERR_045 OBJ_ALIVE_TIME_045;
SIG_GROUP_ 621 TrackerObject046 1 : OBJ_ACCEL_ERR_CRR_COEF_046 OBJ_VELOCITY_ERR_CRR_COEF_046 OBJ_POS_ERR_CRR_COEF_046 OBJ_YAW_RATE_046 OBJ_YAW_RATE_ERR_046 OBJ_GROUP_ID_046 OBJ_REF_PT_LAT_OFFSET_046 OBJ_REF_PT_LONG_OFFSET_046 OBJ_RCS_046 OBJ_YAW_ANGLE_ERR_046 OBJ_CLS_TYPE6_046 OBJ_CLS_TYPE6_PROB_046 OBJ_CLS_TYPE5_PROB_046 OBJ_CLS_TYPE5_046 OBJ_CLS_TYPE4_PROB_046 OBJ_CLS_TYPE4_046 OBJ_CLS_TYPE3_PROB_046 OBJ_CLS_TYPE3_046 OBJ_CLS_TYPE2_PROB_046 OBJ_CLS_TYPE2_046 OBJ_DIMENSION_WIDTH_ERR_046 OBJ_DIMENSION_LENGTH_ERR_046 OBJ_TIMESTAMP_OFFSET_046 OBJ_CLS_TYPE1_PROB_046 OBJ_VEH_TRACK_FLAG_046 OBJ_ACCELERATION_LAT_046 OBJ_ACCELERATION_LONG_046 OBJ_VELOCITY_LAT_046 OBJ_VELOCITY_LONG_046 OBJ_POS_LAT_046 OBJ_POS_LONG_046 OBJ_MEASUREMENT_STATUS_046 OBJ_MOVEMENT_STATUS_046 OBJ_CLS_TYPE1_046 OBJ_ID_046 OBJ_YAW_ANGLE_046 OBJ_EXISTENCE_PROB_046 OBJ_DIMENSION_LENGTH_046 OBJ_DIMENSION_WIDTH_046 OBJ_TRACK_MOTION_MODEL_046 OBJ_POS_LAT_ERR_046 OBJ_POS_LONG_ERR_046 OBJ_VELOCITY_LAT_ERR_046 OBJ_VELOCITY_LONG_ERR_046 OBJ_ACCELERATION_LAT_ERR_046 OBJ_ACCELERATION_LONG_ERR_046 OBJ_ALIVE_TIME_046;
SIG_GROUP_ 622 TrackerObject047 1 : OBJ_ACCEL_ERR_CRR_COEF_047 OBJ_VELOCITY_ERR_CRR_COEF_047 OBJ_POS_ERR_CRR_COEF_047 OBJ_YAW_RATE_047 OBJ_YAW_RATE_ERR_047 OBJ_GROUP_ID_047 OBJ_REF_PT_LAT_OFFSET_047 OBJ_REF_PT_LONG_OFFSET_047 OBJ_RCS_047 OBJ_YAW_ANGLE_ERR_047 OBJ_CLS_TYPE6_047 OBJ_CLS_TYPE6_PROB_047 OBJ_CLS_TYPE5_PROB_047 OBJ_CLS_TYPE5_047 OBJ_CLS_TYPE4_PROB_047 OBJ_CLS_TYPE4_047 OBJ_CLS_TYPE3_PROB_047 OBJ_CLS_TYPE3_047 OBJ_CLS_TYPE2_PROB_047 OBJ_CLS_TYPE2_047 OBJ_DIMENSION_WIDTH_ERR_047 OBJ_DIMENSION_LENGTH_ERR_047 OBJ_TIMESTAMP_OFFSET_047 OBJ_CLS_TYPE1_PROB_047 OBJ_VEH_TRACK_FLAG_047 OBJ_ACCELERATION_LAT_047 OBJ_ACCELERATION_LONG_047 OBJ_VELOCITY_LAT_047 OBJ_VELOCITY_LONG_047 OBJ_POS_LAT_047 OBJ_POS_LONG_047 OBJ_MEASUREMENT_STATUS_047 OBJ_MOVEMENT_STATUS_047 OBJ_CLS_TYPE1_047 OBJ_ID_047 OBJ_YAW_ANGLE_047 OBJ_EXISTENCE_PROB_047 OBJ_DIMENSION_LENGTH_047 OBJ_DIMENSION_WIDTH_047 OBJ_TRACK_MOTION_MODEL_047 OBJ_POS_LAT_ERR_047 OBJ_POS_LONG_ERR_047 OBJ_VELOCITY_LAT_ERR_047 OBJ_VELOCITY_LONG_ERR_047 OBJ_ACCELERATION_LAT_ERR_047 OBJ_ACCELERATION_LONG_ERR_047 OBJ_ALIVE_TIME_047;
SIG_GROUP_ 623 TrackerObject048 1 : OBJ_ACCEL_ERR_CRR_COEF_048 OBJ_VELOCITY_ERR_CRR_COEF_048 OBJ_POS_ERR_CRR_COEF_048 OBJ_YAW_RATE_048 OBJ_YAW_RATE_ERR_048 OBJ_GROUP_ID_048 OBJ_REF_PT_LAT_OFFSET_048 OBJ_REF_PT_LONG_OFFSET_048 OBJ_RCS_048 OBJ_YAW_ANGLE_ERR_048 OBJ_CLS_TYPE6_048 OBJ_CLS_TYPE6_PROB_048 OBJ_CLS_TYPE5_PROB_048 OBJ_CLS_TYPE5_048 OBJ_CLS_TYPE4_PROB_048 OBJ_CLS_TYPE4_048 OBJ_CLS_TYPE3_PROB_048 OBJ_CLS_TYPE3_048 OBJ_CLS_TYPE2_PROB_048 OBJ_CLS_TYPE2_048 OBJ_DIMENSION_WIDTH_ERR_048 OBJ_DIMENSION_LENGTH_ERR_048 OBJ_TIMESTAMP_OFFSET_048 OBJ_CLS_TYPE1_PROB_048 OBJ_VEH_TRACK_FLAG_048 OBJ_ACCELERATION_LAT_048 OBJ_ACCELERATION_LONG_048 OBJ_VELOCITY_LAT_048 OBJ_VELOCITY_LONG_048 OBJ_POS_LAT_048 OBJ_POS_LONG_048 OBJ_MEASUREMENT_STATUS_048 OBJ_MOVEMENT_STATUS_048 OBJ_CLS_TYPE1_048 OBJ_ID_048 OBJ_YAW_ANGLE_048 OBJ_EXISTENCE_PROB_048 OBJ_DIMENSION_LENGTH_048 OBJ_DIMENSION_WIDTH_048 OBJ_TRACK_MOTION_MODEL_048 OBJ_POS_LAT_ERR_048 OBJ_POS_LONG_ERR_048 OBJ_VELOCITY_LAT_ERR_048 OBJ_VELOCITY_LONG_ERR_048 OBJ_ACCELERATION_LAT_ERR_048 OBJ_ACCELERATION_LONG_ERR_048 OBJ_ALIVE_TIME_048;

VERSION "created by canmatrix"

NS_ :

BS_:

BU_: External_Tool ASDM G5_RDR04

BO_ 649 RDR_DETECTION_037_040: 64 G5_RDR04
 SG_ DET_RANGE_037 : 7|15@0+ (0.015625,0) [0|500] "m" ASDM
 SG_ DET_RANGE_ERR_037 : 8|7@0+ (0.0075,0) [0|0.9525] "m" ASDM
 SG_ DET_RANGE_VELOCITY_037 : 17|15@0+ (0.0078125,-128) [-128|127.9921875] "m/s" ASDM
 SG_ DET_RANGE_VELOCITY_ERR_037 : 34|8@0+ (0.003,0) [0|0.765] "m/s" ASDM
 SG_ DET_AZIMUTH_037 : 60|13@0+ (0.0004,-1.5708) [-1.5708|1.5708] "rad" ASDM
 SG_ DET_AZIMUTH_ERR_037 : 78|7@0+ (0.00087267,0) [0|0.11082909] "rad" ASDM
 SG_ DET_ELEVATION_037 : 42|8@0+ (0.00275,-0.34925) [-0.34925|0.34925] "rad" ASDM
 SG_ DET_ELEVATION_ERR_037 : 50|6@0+ (0.00174533,0) [0|0.10995579] "rad" ASDM
 SG_ DET_RCS_037 : 119|8@0+ (0.5,-64) [-64|63.5] "dBsm" ASDM
 SG_ DET_VALID_FLAG_037 : 100|1@0+ (1,0) [0|1] "" ASDM
 SG_ DET_BI_STATIC_FLAG_037 : 487|1@0+ (1,0) [0|1] "" ASDM
 SG_ DET_SUPER_RES_TARGET_037 : 79|1@0+ (1,0) [0|1] "" ASDM
 SG_ DET_SNR_037 : 111|8@0+ (0.35156,0) [0|89.6478] "dB" ASDM
 SG_ DET_POINT_TARGET_PROB_037 : 95|4@0+ (6.67,0) [0|100] "%" ASDM
 SG_ DET_EXISTENCE_PROB_037 : 91|6@0+ (1.588,0) [0|100] "%" ASDM
 SG_ DET_OUTSIDE_SECTOR_037 : 101|1@0+ (1,0) [0|1] "" ASDM
 SG_ DET_HVC_FLAG_037 : 87|1@0+ (1,0) [0|1] "" ASDM
 SG_ DET_CONFD_AZIMUTH_037 : 97|2@0+ (1,0) [0|3] "" ASDM
 SG_ DET_CONFD_ELEVATION_037 : 99|2@0+ (1,0) [0|3] "" ASDM
 SG_ DET_AZIMUTH_AMB_ID_037 : 82|3@0+ (1,0) [0|7] "" ASDM
 SG_ DET_AMBG_AZIMUTH_PROB_037 : 86|4@0+ (6.67,0) [0|100] "%" ASDM
 SG_ DET_RANGE_038 : 127|15@0+ (0.015625,0) [0|500] "m" ASDM
 SG_ DET_RANGE_ERR_038 : 128|7@0+ (0.0075,0) [0|0.9525] "m" ASDM
 SG_ DET_RANGE_VELOCITY_038 : 137|15@0+ (0.0078125,-128) [-128|127.9921875] "m/s" ASDM
 SG_ DET_RANGE_VELOCITY_ERR_038 : 154|8@0+ (0.003,0) [0|0.765] "m/s" ASDM
 SG_ DET_AZIMUTH_038 : 180|13@0+ (0.0004,-1.5708) [-1.5708|1.5708] "rad" ASDM
 SG_ DET_AZIMUTH_ERR_038 : 198|7@0+ (0.00087267,0) [0|0.11082909] "rad" ASDM
 SG_ DET_ELEVATION_038 : 162|8@0+ (0.00275,-0.34925) [-0.34925|0.34925] "rad" ASDM
 SG_ DET_ELEVATION_ERR_038 : 170|6@0+ (0.00174533,0) [0|0.10995579] "rad" ASDM
 SG_ DET_RCS_038 : 239|8@0+ (0.5,-64) [-64|63.5] "dBsm" ASDM
 SG_ DET_VALID_FLAG_038 : 220|1@0+ (1,0) [0|1] "" ASDM
 SG_ DET_BI_STATIC_FLAG_038 : 486|1@0+ (1,0) [0|1] "" ASDM
 SG_ DET_SUPER_RES_TARGET_038 : 199|1@0+ (1,0) [0|1] "" ASDM
 SG_ DET_SNR_038 : 231|8@0+ (0.35156,0) [0|89.6478] "dB" ASDM
 SG_ DET_POINT_TARGET_PROB_038 : 215|4@0+ (6.67,0) [0|100] "%" ASDM
 SG_ DET_EXISTENCE_PROB_038 : 211|6@0+ (1.588,0) [0|100] "%" ASDM
 SG_ DET_OUTSIDE_SECTOR_038 : 221|1@0+ (1,0) [0|1] "" ASDM
 SG_ DET_HVC_FLAG_038 : 207|1@0+ (1,0) [0|1] "" ASDM
 SG_ DET_CONFD_AZIMUTH_038 : 217|2@0+ (1,0) [0|3] "" ASDM
 SG_ DET_CONFD_ELEVATION_038 : 219|2@0+ (1,0) [0|3] "" ASDM
 SG_ DET_AZIMUTH_AMB_ID_038 : 202|3@0+ (1,0) [0|7] "" ASDM
 SG_ DET_AMBG_AZIMUTH_PROB_038 : 206|4@0+ (6.67,0) [0|100] "%" ASDM
 SG_ DET_RANGE_039 : 247|15@0+ (0.015625,0) [0|500] "m" ASDM
 SG_ DET_RANGE_ERR_039 : 248|7@0+ (0.0075,0) [0|0.9525] "m" ASDM
 SG_ DET_RANGE_VELOCITY_039 : 257|15@0+ (0.0078125,-128) [-128|127.9921875] "m/s" ASDM
 SG_ DET_RANGE_VELOCITY_ERR_039 : 274|8@0+ (0.003,0) [0|0.765] "m/s" ASDM
 SG_ DET_AZIMUTH_039 : 300|13@0+ (0.0004,-1.5708) [-1.5708|1.5708] "rad" ASDM
 SG_ DET_AZIMUTH_ERR_039 : 318|7@0+ (0.00087267,0) [0|0.11082909] "rad" ASDM
 SG_ DET_ELEVATION_039 : 282|8@0+ (0.00275,-0.34925) [-0.34925|0.34925] "rad" ASDM
 SG_ DET_ELEVATION_ERR_039 : 290|6@0+ (0.00174533,0) [0|0.10995579] "rad" ASDM
 SG_ DET_RCS_039 : 359|8@0+ (0.5,-64) [-64|63.5] "dBsm" ASDM
 SG_ DET_VALID_FLAG_039 : 340|1@0+ (1,0) [0|1] "" ASDM
 SG_ DET_BI_STATIC_FLAG_039 : 485|1@0+ (1,0) [0|1] "" ASDM
 SG_ DET_SUPER_RES_TARGET_039 : 319|1@0+ (1,0) [0|1] "" ASDM
 SG_ DET_SNR_039 : 351|8@0+ (0.35156,0) [0|89.6478] "dB" ASDM
 SG_ DET_POINT_TARGET_PROB_039 : 335|4@0+ (6.67,0) [0|100] "%" ASDM
 SG_ DET_EXISTENCE_PROB_039 : 331|6@0+ (1.588,0) [0|100] "%" ASDM
 SG_ DET_OUTSIDE_SECTOR_039 : 341|1@0+ (1,0) [0|1] "" ASDM
 SG_ DET_HVC_FLAG_039 : 327|1@0+ (1,0) [0|1] "" ASDM
 SG_ DET_CONFD_AZIMUTH_039 : 337|2@0+ (1,0) [0|3] "" ASDM
 SG_ DET_CONFD_ELEVATION_039 : 339|2@0+ (1,0) [0|3] "" ASDM
 SG_ DET_AZIMUTH_AMB_ID_039 : 322|3@0+ (1,0) [0|7] "" ASDM
 SG_ DET_AMBG_AZIMUTH_PROB_039 : 326|4@0+ (6.67,0) [0|100] "%" ASDM
 SG_ DET_RANGE_040 : 367|15@0+ (0.015625,0) [0|500] "m" ASDM
 SG_ DET_RANGE_ERR_040 : 368|7@0+ (0.0075,0) [0|0.9525] "m" ASDM
 SG_ DET_RANGE_VELOCITY_040 : 377|15@0+ (0.0078125,-128) [-128|127.9921875] "m/s" ASDM
 SG_ DET_RANGE_VELOCITY_ERR_040 : 394|8@0+ (0.003,0) [0|0.765] "m/s" ASDM
 SG_ DET_AZIMUTH_040 : 420|13@0+ (0.0004,-1.5708) [-1.5708|1.5708] "rad" ASDM
 SG_ DET_AZIMUTH_ERR_040 : 438|7@0+ (0.00087267,0) [0|0.11082909] "rad" ASDM
 SG_ DET_ELEVATION_040 : 402|8@0+ (0.00275,-0.34925) [-0.34925|0.34925] "rad" ASDM
 SG_ DET_ELEVATION_ERR_040 : 410|6@0+ (0.00174533,0) [0|0.10995579] "rad" ASDM
 SG_ DET_RCS_040 : 479|8@0+ (0.5,-64) [-64|63.5] "dBsm" ASDM
 SG_ DET_VALID_FLAG_040 : 460|1@0+ (1,0) [0|1] "" ASDM
 SG_ DET_BI_STATIC_FLAG_040 : 484|1@0+ (1,0) [0|1] "" ASDM
 SG_ DET_SUPER_RES_TARGET_040 : 439|1@0+ (1,0) [0|1] "" ASDM
 SG_ DET_SNR_040 : 471|8@0+ (0.35156,0) [0|89.6478] "dB" ASDM
 SG_ DET_POINT_TARGET_PROB_040 : 455|4@0+ (6.67,0) [0|100] "%" ASDM
 SG_ DET_EXISTENCE_PROB_040 : 451|6@0+ (1.588,0) [0|100] "%" ASDM
 SG_ DET_OUTSIDE_SECTOR_040 : 461|1@0+ (1,0) [0|1] "" ASDM
 SG_ DET_HVC_FLAG_040 : 447|1@0+ (1,0) [0|1] "" ASDM
 SG_ DET_CONFD_AZIMUTH_040 : 457|2@0+ (1,0) [0|3] "" ASDM
 SG_ DET_CONFD_ELEVATION_040 : 459|2@0+ (1,0) [0|3] "" ASDM
 SG_ DET_AZIMUTH_AMB_ID_040 : 442|3@0+ (1,0) [0|7] "" ASDM
 SG_ DET_AMBG_AZIMUTH_PROB_040 : 446|4@0+ (6.67,0) [0|100] "%" ASDM
 SG_ DET_MH_SCAN_INDEX_4LSB_037_040 : 483|4@0+ (1,0) [0|15] "" ASDM
 SG_ DET_MH_CYCLE_COUNTER_037_040 : 495|8@0+ (1,0) [0|255] "" ASDM
 SG_ DET_MH_CRC16_037_040 : 503|16@0+ (1,0) [0|65535] "" ASDM

BO_ 650 RDR_DETECTION_041_044: 64 G5_RDR04
 SG_ DET_RANGE_041 : 7|15@0+ (0.015625,0) [0|500] "m" ASDM
 SG_ DET_RANGE_ERR_041 : 8|7@0+ (0.0075,0) [0|0.9525] "m" ASDM
 SG_ DET_RANGE_VELOCITY_041 : 17|15@0+ (0.0078125,-128) [-128|127.9921875] "m/s" ASDM
 SG_ DET_RANGE_VELOCITY_ERR_041 : 34|8@0+ (0.003,0) [0|0.765] "m/s" ASDM
 SG_ DET_AZIMUTH_041 : 60|13@0+ (0.0004,-1.5708) [-1.5708|1.5708] "rad" ASDM
 SG_ DET_AZIMUTH_ERR_041 : 78|7@0+ (0.00087267,0) [0|0.11082909] "rad" ASDM
 SG_ DET_ELEVATION_041 : 42|8@0+ (0.00275,-0.34925) [-0.34925|0.34925] "rad" ASDM
 SG_ DET_ELEVATION_ERR_041 : 50|6@0+ (0.00174533,0) [0|0.10995579] "rad" ASDM
 SG_ DET_RCS_041 : 119|8@0+ (0.5,-64) [-64|63.5] "dBsm" ASDM
 SG_ DET_VALID_FLAG_041 : 100|1@0+ (1,0) [0|1] "" ASDM
 SG_ DET_BI_STATIC_FLAG_041 : 487|1@0+ (1,0) [0|1] "" ASDM
 SG_ DET_SUPER_RES_TARGET_041 : 79|1@0+ (1,0) [0|1] "" ASDM
 SG_ DET_SNR_041 : 111|8@0+ (0.35156,0) [0|89.6478] "dB" ASDM
 SG_ DET_POINT_TARGET_PROB_041 : 95|4@0+ (6.67,0) [0|100] "%" ASDM
 SG_ DET_EXISTENCE_PROB_041 : 91|6@0+ (1.588,0) [0|100] "%" ASDM
 SG_ DET_OUTSIDE_SECTOR_041 : 101|1@0+ (1,0) [0|1] "" ASDM
 SG_ DET_HVC_FLAG_041 : 87|1@0+ (1,0) [0|1] "" ASDM
 SG_ DET_CONFD_AZIMUTH_041 : 97|2@0+ (1,0) [0|3] "" ASDM
 SG_ DET_CONFD_ELEVATION_041 : 99|2@0+ (1,0) [0|3] "" ASDM
 SG_ DET_AZIMUTH_AMB_ID_041 : 82|3@0+ (1,0) [0|7] "" ASDM
 SG_ DET_AMBG_AZIMUTH_PROB_041 : 86|4@0+ (6.67,0) [0|100] "%" ASDM
 SG_ DET_RANGE_042 : 127|15@0+ (0.015625,0) [0|500] "m" ASDM
 SG_ DET_RANGE_ERR_042 : 128|7@0+ (0.0075,0) [0|0.9525] "m" ASDM
 SG_ DET_RANGE_VELOCITY_042 : 137|15@0+ (0.0078125,-128) [-128|127.9921875] "m/s" ASDM
 SG_ DET_RANGE_VELOCITY_ERR_042 : 154|8@0+ (0.003,0) [0|0.765] "m/s" ASDM
 SG_ DET_AZIMUTH_042 : 180|13@0+ (0.0004,-1.5708) [-1.5708|1.5708] "rad" ASDM
 SG_ DET_AZIMUTH_ERR_042 : 198|7@0+ (0.00087267,0) [0|0.11082909] "rad" ASDM
 SG_ DET_ELEVATION_042 : 162|8@0+ (0.00275,-0.34925) [-0.34925|0.34925] "rad" ASDM
 SG_ DET_ELEVATION_ERR_042 : 170|6@0+ (0.00174533,0) [0|0.10995579] "rad" ASDM
 SG_ DET_RCS_042 : 239|8@0+ (0.5,-64) [-64|63.5] "dBsm" ASDM
 SG_ DET_VALID_FLAG_042 : 220|1@0+ (1,0) [0|1] "" ASDM
 SG_ DET_BI_STATIC_FLAG_042 : 486|1@0+ (1,0) [0|1] "" ASDM
 SG_ DET_SUPER_RES_TARGET_042 : 199|1@0+ (1,0) [0|1] "" ASDM
 SG_ DET_SNR_042 : 231|8@0+ (0.35156,0) [0|89.6478] "dB" ASDM
 SG_ DET_POINT_TARGET_PROB_042 : 215|4@0+ (6.67,0) [0|100] "%" ASDM
 SG_ DET_EXISTENCE_PROB_042 : 211|6@0+ (1.588,0) [0|100] "%" ASDM
 SG_ DET_OUTSIDE_SECTOR_042 : 221|1@0+ (1,0) [0|1] "" ASDM
 SG_ DET_HVC_FLAG_042 : 207|1@0+ (1,0) [0|1] "" ASDM
 SG_ DET_CONFD_AZIMUTH_042 : 217|2@0+ (1,0) [0|3] "" ASDM
 SG_ DET_CONFD_ELEVATION_042 : 219|2@0+ (1,0) [0|3] "" ASDM
 SG_ DET_AZIMUTH_AMB_ID_042 : 202|3@0+ (1,0) [0|7] "" ASDM
 SG_ DET_AMBG_AZIMUTH_PROB_042 : 206|4@0+ (6.67,0) [0|100] "%" ASDM
 SG_ DET_RANGE_043 : 247|15@0+ (0.015625,0) [0|500] "m" ASDM
 SG_ DET_RANGE_ERR_043 : 248|7@0+ (0.0075,0) [0|0.9525] "m" ASDM
 SG_ DET_RANGE_VELOCITY_043 : 257|15@0+ (0.0078125,-128) [-128|127.9921875] "m/s" ASDM
 SG_ DET_RANGE_VELOCITY_ERR_043 : 274|8@0+ (0.003,0) [0|0.765] "m/s" ASDM
 SG_ DET_AZIMUTH_043 : 300|13@0+ (0.0004,-1.5708) [-1.5708|1.5708] "rad" ASDM
 SG_ DET_AZIMUTH_ERR_043 : 318|7@0+ (0.00087267,0) [0|0.11082909] "rad" ASDM
 SG_ DET_ELEVATION_043 : 282|8@0+ (0.00275,-0.34925) [-0.34925|0.34925] "rad" ASDM
 SG_ DET_ELEVATION_ERR_043 : 290|6@0+ (0.00174533,0) [0|0.10995579] "rad" ASDM
 SG_ DET_RCS_043 : 359|8@0+ (0.5,-64) [-64|63.5] "dBsm" ASDM
 SG_ DET_VALID_FLAG_043 : 340|1@0+ (1,0) [0|1] "" ASDM
 SG_ DET_BI_STATIC_FLAG_043 : 485|1@0+ (1,0) [0|1] "" ASDM
 SG_ DET_SUPER_RES_TARGET_043 : 319|1@0+ (1,0) [0|1] "" ASDM
 SG_ DET_SNR_043 : 351|8@0+ (0.35156,0) [0|89.6478] "dB" ASDM
 SG_ DET_POINT_TARGET_PROB_043 : 335|4@0+ (6.67,0) [0|100] "%" ASDM
 SG_ DET_EXISTENCE_PROB_043 : 331|6@0+ (1.588,0) [0|100] "%" ASDM
 SG_ DET_OUTSIDE_SECTOR_043 : 341|1@0+ (1,0) [0|1] "" ASDM
 SG_ DET_HVC_FLAG_043 : 327|1@0+ (1,0) [0|1] "" ASDM
 SG_ DET_CONFD_AZIMUTH_043 : 337|2@0+ (1,0) [0|3] "" ASDM
 SG_ DET_CONFD_ELEVATION_043 : 339|2@0+ (1,0) [0|3] "" ASDM
 SG_ DET_AZIMUTH_AMB_ID_043 : 322|3@0+ (1,0) [0|7] "" ASDM
 SG_ DET_AMBG_AZIMUTH_PROB_043 : 326|4@0+ (6.67,0) [0|100] "%" ASDM
 SG_ DET_RANGE_044 : 367|15@0+ (0.015625,0) [0|500] "m" ASDM
 SG_ DET_RANGE_ERR_044 : 368|7@0+ (0.0075,0) [0|0.9525] "m" ASDM
 SG_ DET_RANGE_VELOCITY_044 : 377|15@0+ (0.0078125,-128) [-128|127.9921875] "m/s" ASDM
 SG_ DET_RANGE_VELOCITY_ERR_044 : 394|8@0+ (0.003,0) [0|0.765] "m/s" ASDM
 SG_ DET_AZIMUTH_044 : 420|13@0+ (0.0004,-1.5708) [-1.5708|1.5708] "rad" ASDM
 SG_ DET_AZIMUTH_ERR_044 : 438|7@0+ (0.00087267,0) [0|0.11082909] "rad" ASDM
 SG_ DET_ELEVATION_044 : 402|8@0+ (0.00275,-0.34925) [-0.34925|0.34925] "rad" ASDM
 SG_ DET_ELEVATION_ERR_044 : 410|6@0+ (0.00174533,0) [0|0.10995579] "rad" ASDM
 SG_ DET_RCS_044 : 479|8@0+ (0.5,-64) [-64|63.5] "dBsm" ASDM
 SG_ DET_VALID_FLAG_044 : 460|1@0+ (1,0) [0|1] "" ASDM
 SG_ DET_BI_STATIC_FLAG_044 : 484|1@0+ (1,0) [0|1] "" ASDM
 SG_ DET_SUPER_RES_TARGET_044 : 439|1@0+ (1,0) [0|1] "" ASDM
 SG_ DET_SNR_044 : 471|8@0+ (0.35156,0) [0|89.6478] "dB" ASDM
 SG_ DET_POINT_TARGET_PROB_044 : 455|4@0+ (6.67,0) [0|100] "%" ASDM
 SG_ DET_EXISTENCE_PROB_044 : 451|6@0+ (1.588,0) [0|100] "%" ASDM
 SG_ DET_OUTSIDE_SECTOR_044 : 461|1@0+ (1,0) [0|1] "" ASDM
 SG_ DET_HVC_FLAG_044 : 447|1@0+ (1,0) [0|1] "" ASDM
 SG_ DET_CONFD_AZIMUTH_044 : 457|2@0+ (1,0) [0|3] "" ASDM
 SG_ DET_CONFD_ELEVATION_044 : 459|2@0+ (1,0) [0|3] "" ASDM
 SG_ DET_AZIMUTH_AMB_ID_044 : 442|3@0+ (1,0) [0|7] "" ASDM
 SG_ DET_AMBG_AZIMUTH_PROB_044 : 446|4@0+ (6.67,0) [0|100] "%" ASDM
 SG_ DET_MH_SCAN_INDEX_4LSB_041_044 : 483|4@0+ (1,0) [0|15] "" ASDM
 SG_ DET_MH_CYCLE_COUNTER_041_044 : 495|8@0+ (1,0) [0|255] "" ASDM
 SG_ DET_MH_CRC16_041_044 : 503|16@0+ (1,0) [0|65535] "" ASDM

BO_ 651 RDR_DETECTION_045_048: 64 G5_RDR04
 SG_ DET_RANGE_045 : 7|15@0+ (0.015625,0) [0|500] "m" ASDM
 SG_ DET_RANGE_ERR_045 : 8|7@0+ (0.0075,0) [0|0.9525] "m" ASDM
 SG_ DET_RANGE_VELOCITY_045 : 17|15@0+ (0.0078125,-128) [-128|127.9921875] "m/s" ASDM
 SG_ DET_RANGE_VELOCITY_ERR_045 : 34|8@0+ (0.003,0) [0|0.765] "m/s" ASDM
 SG_ DET_AZIMUTH_045 : 60|13@0+ (0.0004,-1.5708) [-1.5708|1.5708] "rad" ASDM
 SG_ DET_AZIMUTH_ERR_045 : 78|7@0+ (0.00087267,0) [0|0.11082909] "rad" ASDM
 SG_ DET_ELEVATION_045 : 42|8@0+ (0.00275,-0.34925) [-0.34925|0.34925] "rad" ASDM
 SG_ DET_ELEVATION_ERR_045 : 50|6@0+ (0.00174533,0) [0|0.10995579] "rad" ASDM
 SG_ DET_RCS_045 : 119|8@0+ (0.5,-64) [-64|63.5] "dBsm" ASDM
 SG_ DET_VALID_FLAG_045 : 100|1@0+ (1,0) [0|1] "" ASDM
 SG_ DET_BI_STATIC_FLAG_045 : 487|1@0+ (1,0) [0|1] "" ASDM
 SG_ DET_SUPER_RES_TARGET_045 : 79|1@0+ (1,0) [0|1] "" ASDM
 SG_ DET_SNR_045 : 111|8@0+ (0.35156,0) [0|89.6478] "dB" ASDM
 SG_ DET_POINT_TARGET_PROB_045 : 95|4@0+ (6.67,0) [0|100] "%" ASDM
 SG_ DET_EXISTENCE_PROB_045 : 91|6@0+ (1.588,0) [0|100] "%" ASDM
 SG_ DET_OUTSIDE_SECTOR_045 : 101|1@0+ (1,0) [0|1] "" ASDM
 SG_ DET_HVC_FLAG_045 : 87|1@0+ (1,0) [0|1] "" ASDM
 SG_ DET_CONFD_AZIMUTH_045 : 97|2@0+ (1,0) [0|3] "" ASDM
 SG_ DET_CONFD_ELEVATION_045 : 99|2@0+ (1,0) [0|3] "" ASDM
 SG_ DET_AZIMUTH_AMB_ID_045 : 82|3@0+ (1,0) [0|7] "" ASDM
 SG_ DET_AMBG_AZIMUTH_PROB_045 : 86|4@0+ (6.67,0) [0|100] "%" ASDM
 SG_ DET_RANGE_046 : 127|15@0+ (0.015625,0) [0|500] "m" ASDM
 SG_ DET_RANGE_ERR_046 : 128|7@0+ (0.0075,0) [0|0.9525] "m" ASDM
 SG_ DET_RANGE_VELOCITY_046 : 137|15@0+ (0.0078125,-128) [-128|127.9921875] "m/s" ASDM
 SG_ DET_RANGE_VELOCITY_ERR_046 : 154|8@0+ (0.003,0) [0|0.765] "m/s" ASDM
 SG_ DET_AZIMUTH_046 : 180|13@0+ (0.0004,-1.5708) [-1.5708|1.5708] "rad" ASDM
 SG_ DET_AZIMUTH_ERR_046 : 198|7@0+ (0.00087267,0) [0|0.11082909] "rad" ASDM
 SG_ DET_ELEVATION_046 : 162|8@0+ (0.00275,-0.34925) [-0.34925|0.34925] "rad" ASDM
 SG_ DET_ELEVATION_ERR_046 : 170|6@0+ (0.00174533,0) [0|0.10995579] "rad" ASDM
 SG_ DET_RCS_046 : 239|8@0+ (0.5,-64) [-64|63.5] "dBsm" ASDM
 SG_ DET_VALID_FLAG_046 : 220|1@0+ (1,0) [0|1] "" ASDM
 SG_ DET_BI_STATIC_FLAG_046 : 486|1@0+ (1,0) [0|1] "" ASDM
 SG_ DET_SUPER_RES_TARGET_046 : 199|1@0+ (1,0) [0|1] "" ASDM
 SG_ DET_SNR_046 : 231|8@0+ (0.35156,0) [0|89.6478] "dB" ASDM
 SG_ DET_POINT_TARGET_PROB_046 : 215|4@0+ (6.67,0) [0|100] "%" ASDM
 SG_ DET_EXISTENCE_PROB_046 : 211|6@0+ (1.588,0) [0|100] "%" ASDM
 SG_ DET_OUTSIDE_SECTOR_046 : 221|1@0+ (1,0) [0|1] "" ASDM
 SG_ DET_HVC_FLAG_046 : 207|1@0+ (1,0) [0|1] "" ASDM
 SG_ DET_CONFD_AZIMUTH_046 : 217|2@0+ (1,0) [0|3] "" ASDM
 SG_ DET_CONFD_ELEVATION_046 : 219|2@0+ (1,0) [0|3] "" ASDM
 SG_ DET_AZIMUTH_AMB_ID_046 : 202|3@0+ (1,0) [0|7] "" ASDM
 SG_ DET_AMBG_AZIMUTH_PROB_046 : 206|4@0+ (6.67,0) [0|100] "%" ASDM
 SG_ DET_RANGE_047 : 247|15@0+ (0.015625,0) [0|500] "m" ASDM
 SG_ DET_RANGE_ERR_047 : 248|7@0+ (0.0075,0) [0|0.9525] "m" ASDM
 SG_ DET_RANGE_VELOCITY_047 : 257|15@0+ (0.0078125,-128) [-128|127.9921875] "m/s" ASDM
 SG_ DET_RANGE_VELOCITY_ERR_047 : 274|8@0+ (0.003,0) [0|0.765] "m/s" ASDM
 SG_ DET_AZIMUTH_047 : 300|13@0+ (0.0004,-1.5708) [-1.5708|1.5708] "rad" ASDM
 SG_ DET_AZIMUTH_ERR_047 : 318|7@0+ (0.00087267,0) [0|0.11082909] "rad" ASDM
 SG_ DET_ELEVATION_047 : 282|8@0+ (0.00275,-0.34925) [-0.34925|0.34925] "rad" ASDM
 SG_ DET_ELEVATION_ERR_047 : 290|6@0+ (0.00174533,0) [0|0.10995579] "rad" ASDM
 SG_ DET_RCS_047 : 359|8@0+ (0.5,-64) [-64|63.5] "dBsm" ASDM
 SG_ DET_VALID_FLAG_047 : 340|1@0+ (1,0) [0|1] "" ASDM
 SG_ DET_BI_STATIC_FLAG_047 : 485|1@0+ (1,0) [0|1] "" ASDM
 SG_ DET_SUPER_RES_TARGET_047 : 319|1@0+ (1,0) [0|1] "" ASDM
 SG_ DET_SNR_047 : 351|8@0+ (0.35156,0) [0|89.6478] "dB" ASDM
 SG_ DET_POINT_TARGET_PROB_047 : 335|4@0+ (6.67,0) [0|100] "%" ASDM
 SG_ DET_EXISTENCE_PROB_047 : 331|6@0+ (1.588,0) [0|100] "%" ASDM
 SG_ DET_OUTSIDE_SECTOR_047 : 341|1@0+ (1,0) [0|1] "" ASDM
 SG_ DET_HVC_FLAG_047 : 327|1@0+ (1,0) [0|1] "" ASDM
 SG_ DET_CONFD_AZIMUTH_047 : 337|2@0+ (1,0) [0|3] "" ASDM
 SG_ DET_CONFD_ELEVATION_047 : 339|2@0+ (1,0) [0|3] "" ASDM
 SG_ DET_AZIMUTH_AMB_ID_047 : 322|3@0+ (1,0) [0|7] "" ASDM
 SG_ DET_AMBG_AZIMUTH_PROB_047 : 326|4@0+ (6.67,0) [0|100] "%" ASDM
 SG_ DET_RANGE_048 : 367|15@0+ (0.015625,0) [0|500] "m" ASDM
 SG_ DET_RANGE_ERR_048 : 368|7@0+ (0.0075,0) [0|0.9525] "m" ASDM
 SG_ DET_RANGE_VELOCITY_048 : 377|15@0+ (0.0078125,-128) [-128|127.9921875] "m/s" ASDM
 SG_ DET_RANGE_VELOCITY_ERR_048 : 394|8@0+ (0.003,0) [0|0.765] "m/s" ASDM
 SG_ DET_AZIMUTH_048 : 420|13@0+ (0.0004,-1.5708) [-1.5708|1.5708] "rad" ASDM
 SG_ DET_AZIMUTH_ERR_048 : 438|7@0+ (0.00087267,0) [0|0.11082909] "rad" ASDM
 SG_ DET_ELEVATION_048 : 402|8@0+ (0.00275,-0.34925) [-0.34925|0.34925] "rad" ASDM
 SG_ DET_ELEVATION_ERR_048 : 410|6@0+ (0.00174533,0) [0|0.10995579] "rad" ASDM
 SG_ DET_RCS_048 : 479|8@0+ (0.5,-64) [-64|63.5] "dBsm" ASDM
 SG_ DET_VALID_FLAG_048 : 460|1@0+ (1,0) [0|1] "" ASDM
 SG_ DET_BI_STATIC_FLAG_048 : 484|1@0+ (1,0) [0|1] "" ASDM
 SG_ DET_SUPER_RES_TARGET_048 : 439|1@0+ (1,0) [0|1] "" ASDM
 SG_ DET_SNR_048 : 471|8@0+ (0.35156,0) [0|89.6478] "dB" ASDM
 SG_ DET_POINT_TARGET_PROB_048 : 455|4@0+ (6.67,0) [0|100] "%" ASDM
 SG_ DET_EXISTENCE_PROB_048 : 451|6@0+ (1.588,0) [0|100] "%" ASDM
 SG_ DET_OUTSIDE_SECTOR_048 : 461|1@0+ (1,0) [0|1] "" ASDM
 SG_ DET_HVC_FLAG_048 : 447|1@0+ (1,0) [0|1] "" ASDM
 SG_ DET_CONFD_AZIMUTH_048 : 457|2@0+ (1,0) [0|3] "" ASDM
 SG_ DET_CONFD_ELEVATION_048 : 459|2@0+ (1,0) [0|3] "" ASDM
 SG_ DET_AZIMUTH_AMB_ID_048 : 442|3@0+ (1,0) [0|7] "" ASDM
 SG_ DET_AMBG_AZIMUTH_PROB_048 : 446|4@0+ (6.67,0) [0|100] "%" ASDM
 SG_ DET_MH_SCAN_INDEX_4LSB_045_048 : 483|4@0+ (1,0) [0|15] "" ASDM
 SG_ DET_MH_CYCLE_COUNTER_045_048 : 495|8@0+ (1,0) [0|255] "" ASDM
 SG_ DET_MH_CRC16_045_048 : 503|16@0+ (1,0) [0|65535] "" ASDM

BO_ 652 RDR_DETECTION_049_052: 64 G5_RDR04
 SG_ DET_RANGE_049 : 7|15@0+ (0.015625,0) [0|500] "m" ASDM
 SG_ DET_RANGE_ERR_049 : 8|7@0+ (0.0075,0) [0|0.9525] "m" ASDM
 SG_ DET_RANGE_VELOCITY_049 : 17|15@0+ (0.0078125,-128) [-128|127.9921875] "m/s" ASDM
 SG_ DET_RANGE_VELOCITY_ERR_049 : 34|8@0+ (0.003,0) [0|0.765] "m/s" ASDM
 SG_ DET_AZIMUTH_049 : 60|13@0+ (0.0004,-1.5708) [-1.5708|1.5708] "rad" ASDM
 SG_ DET_AZIMUTH_ERR_049 : 78|7@0+ (0.00087267,0) [0|0.11082909] "rad" ASDM
 SG_ DET_ELEVATION_049 : 42|8@0+ (0.00275,-0.34925) [-0.34925|0.34925] "rad" ASDM
 SG_ DET_ELEVATION_ERR_049 : 50|6@0+ (0.00174533,0) [0|0.10995579] "rad" ASDM
 SG_ DET_RCS_049 : 119|8@0+ (0.5,-64) [-64|63.5] "dBsm" ASDM
 SG_ DET_VALID_FLAG_049 : 100|1@0+ (1,0) [0|1] "" ASDM
 SG_ DET_BI_STATIC_FLAG_049 : 487|1@0+ (1,0) [0|1] "" ASDM
 SG_ DET_SUPER_RES_TARGET_049 : 79|1@0+ (1,0) [0|1] "" ASDM
 SG_ DET_SNR_049 : 111|8@0+ (0.35156,0) [0|89.6478] "dB" ASDM
 SG_ DET_POINT_TARGET_PROB_049 : 95|4@0+ (6.67,0) [0|100] "%" ASDM
 SG_ DET_EXISTENCE_PROB_049 : 91|6@0+ (1.588,0) [0|100] "%" ASDM
 SG_ DET_OUTSIDE_SECTOR_049 : 101|1@0+ (1,0) [0|1] "" ASDM
 SG_ DET_HVC_FLAG_049 : 87|1@0+ (1,0) [0|1] "" ASDM
 SG_ DET_CONFD_AZIMUTH_049 : 97|2@0+ (1,0) [0|3] "" ASDM
 SG_ DET_CONFD_ELEVATION_049 : 99|2@0+ (1,0) [0|3] "" ASDM
 SG_ DET_AZIMUTH_AMB_ID_049 : 82|3@0+ (1,0) [0|7] "" ASDM
 SG_ DET_AMBG_AZIMUTH_PROB_049 : 86|4@0+ (6.67,0) [0|100] "%" ASDM
 SG_ DET_RANGE_050 : 127|15@0+ (0.015625,0) [0|500] "m" ASDM
 SG_ DET_RANGE_ERR_050 : 128|7@0+ (0.0075,0) [0|0.9525] "m" ASDM
 SG_ DET_RANGE_VELOCITY_050 : 137|15@0+ (0.0078125,-128) [-128|127.9921875] "m/s" ASDM
 SG_ DET_RANGE_VELOCITY_ERR_050 : 154|8@0+ (0.003,0) [0|0.765] "m/s" ASDM
 SG_ DET_AZIMUTH_050 : 180|13@0+ (0.0004,-1.5708) [-1.5708|1.5708] "rad" ASDM
 SG_ DET_AZIMUTH_ERR_050 : 198|7@0+ (0.00087267,0) [0|0.11082909] "rad" ASDM
 SG_ DET_ELEVATION_050 : 162|8@0+ (0.00275,-0.34925) [-0.34925|0.34925] "rad" ASDM
 SG_ DET_ELEVATION_ERR_050 : 170|6@0+ (0.00174533,0) [0|0.10995579] "rad" ASDM
 SG_ DET_RCS_050 : 239|8@0+ (0.5,-64) [-64|63.5] "dBsm" ASDM
 SG_ DET_VALID_FLAG_050 : 220|1@0+ (1,0) [0|1] "" ASDM
 SG_ DET_BI_STATIC_FLAG_050 : 486|1@0+ (1,0) [0|1] "" ASDM
 SG_ DET_SUPER_RES_TARGET_050 : 199|1@0+ (1,0) [0|1] "" ASDM
 SG_ DET_SNR_050 : 231|8@0+ (0.35156,0) [0|89.6478] "dB" ASDM
 SG_ DET_POINT_TARGET_PROB_050 : 215|4@0+ (6.67,0) [0|100] "%" ASDM
 SG_ DET_EXISTENCE_PROB_050 : 211|6@0+ (1.588,0) [0|100] "%" ASDM
 SG_ DET_OUTSIDE_SECTOR_050 : 221|1@0+ (1,0) [0|1] "" ASDM
 SG_ DET_HVC_FLAG_050 : 207|1@0+ (1,0) [0|1] "" ASDM
 SG_ DET_CONFD_AZIMUTH_050 : 217|2@0+ (1,0) [0|3] "" ASDM
 SG_ DET_CONFD_ELEVATION_050 : 219|2@0+ (1,0) [0|3] "" ASDM
 SG_ DET_AZIMUTH_AMB_ID_050 : 202|3@0+ (1,0) [0|7] "" ASDM
 SG_ DET_AMBG_AZIMUTH_PROB_050 : 206|4@0+ (6.67,0) [0|100] "%" ASDM
 SG_ DET_RANGE_051 : 247|15@0+ (0.015625,0) [0|500] "m" ASDM
 SG_ DET_RANGE_ERR_051 : 248|7@0+ (0.0075,0) [0|0.9525] "m" ASDM
 SG_ DET_RANGE_VELOCITY_051 : 257|15@0+ (0.0078125,-128) [-128|127.9921875] "m/s" ASDM
 SG_ DET_RANGE_VELOCITY_ERR_051 : 274|8@0+ (0.003,0) [0|0.765] "m/s" ASDM
 SG_ DET_AZIMUTH_051 : 300|13@0+ (0.0004,-1.5708) [-1.5708|1.5708] "rad" ASDM
 SG_ DET_AZIMUTH_ERR_051 : 318|7@0+ (0.00087267,0) [0|0.11082909] "rad" ASDM
 SG_ DET_ELEVATION_051 : 282|8@0+ (0.00275,-0.34925) [-0.34925|0.34925] "rad" ASDM
 SG_ DET_ELEVATION_ERR_051 : 290|6@0+ (0.00174533,0) [0|0.10995579] "rad" ASDM
 SG_ DET_RCS_051 : 359|8@0+ (0.5,-64) [-64|63.5] "dBsm" ASDM
 SG_ DET_VALID_FLAG_051 : 340|1@0+ (1,0) [0|1] "" ASDM
 SG_ DET_BI_STATIC_FLAG_051 : 485|1@0+ (1,0) [0|1] "" ASDM
 SG_ DET_SUPER_RES_TARGET_051 : 319|1@0+ (1,0) [0|1] "" ASDM
 SG_ DET_SNR_051 : 351|8@0+ (0.35156,0) [0|89.6478] "dB" ASDM
 SG_ DET_POINT_TARGET_PROB_051 : 335|4@0+ (6.67,0) [0|100] "%" ASDM
 SG_ DET_EXISTENCE_PROB_051 : 331|6@0+ (1.588,0) [0|100] "%" ASDM
 SG_ DET_OUTSIDE_SECTOR_051 : 341|1@0+ (1,0) [0|1] "" ASDM
 SG_ DET_HVC_FLAG_051 : 327|1@0+ (1,0) [0|1] "" ASDM
 SG_ DET_CONFD_AZIMUTH_051 : 337|2@0+ (1,0) [0|3] "" ASDM
 SG_ DET_CONFD_ELEVATION_051 : 339|2@0+ (1,0) [0|3] "" ASDM
 SG_ DET_AZIMUTH_AMB_ID_051 : 322|3@0+ (1,0) [0|7] "" ASDM
 SG_ DET_AMBG_AZIMUTH_PROB_051 : 326|4@0+ (6.67,0) [0|100] "%" ASDM
 SG_ DET_RANGE_052 : 367|15@0+ (0.015625,0) [0|500] "m" ASDM
 SG_ DET_RANGE_ERR_052 : 368|7@0+ (0.0075,0) [0|0.9525] "m" ASDM
 SG_ DET_RANGE_VELOCITY_052 : 377|15@0+ (0.0078125,-128) [-128|127.9921875] "m/s" ASDM
 SG_ DET_RANGE_VELOCITY_ERR_052 : 394|8@0+ (0.003,0) [0|0.765] "m/s" ASDM
 SG_ DET_AZIMUTH_052 : 420|13@0+ (0.0004,-1.5708) [-1.5708|1.5708] "rad" ASDM
 SG_ DET_AZIMUTH_ERR_052 : 438|7@0+ (0.00087267,0) [0|0.11082909] "rad" ASDM
 SG_ DET_ELEVATION_052 : 402|8@0+ (0.00275,-0.34925) [-0.34925|0.34925] "rad" ASDM
 SG_ DET_ELEVATION_ERR_052 : 410|6@0+ (0.00174533,0) [0|0.10995579] "rad" ASDM
 SG_ DET_RCS_052 : 479|8@0+ (0.5,-64) [-64|63.5] "dBsm" ASDM
 SG_ DET_VALID_FLAG_052 : 460|1@0+ (1,0) [0|1] "" ASDM
 SG_ DET_BI_STATIC_FLAG_052 : 484|1@0+ (1,0) [0|1] "" ASDM
 SG_ DET_SUPER_RES_TARGET_052 : 439|1@0+ (1,0) [0|1] "" ASDM
 SG_ DET_SNR_052 : 471|8@0+ (0.35156,0) [0|89.6478] "dB" ASDM
 SG_ DET_POINT_TARGET_PROB_052 : 455|4@0+ (6.67,0) [0|100] "%" ASDM
 SG_ DET_EXISTENCE_PROB_052 : 451|6@0+ (1.588,0) [0|100] "%" ASDM
 SG_ DET_OUTSIDE_SECTOR_052 : 461|1@0+ (1,0) [0|1] "" ASDM
 SG_ DET_HVC_FLAG_052 : 447|1@0+ (1,0) [0|1] "" ASDM
 SG_ DET_CONFD_AZIMUTH_052 : 457|2@0+ (1,0) [0|3] "" ASDM
 SG_ DET_CONFD_ELEVATION_052 : 459|2@0+ (1,0) [0|3] "" ASDM
 SG_ DET_AZIMUTH_AMB_ID_052 : 442|3@0+ (1,0) [0|7] "" ASDM
 SG_ DET_AMBG_AZIMUTH_PROB_052 : 446|4@0+ (6.67,0) [0|100] "%" ASDM
 SG_ DET_MH_SCAN_INDEX_4LSB_049_052 : 483|4@0+ (1,0) [0|15] "" ASDM
 SG_ DET_MH_CYCLE_COUNTER_049_052 : 495|8@0+ (1,0) [0|255] "" ASDM
 SG_ DET_MH_CRC16_049_052 : 503|16@0+ (1,0) [0|65535] "" ASDM

BO_ 653 RDR_DETECTION_053_056: 64 G5_RDR04
 SG_ DET_RANGE_053 : 7|15@0+ (0.015625,0) [0|500] "m" ASDM
 SG_ DET_RANGE_ERR_053 : 8|7@0+ (0.0075,0) [0|0.9525] "m" ASDM
 SG_ DET_RANGE_VELOCITY_053 : 17|15@0+ (0.0078125,-128) [-128|127.9921875] "m/s" ASDM
 SG_ DET_RANGE_VELOCITY_ERR_053 : 34|8@0+ (0.003,0) [0|0.765] "m/s" ASDM
 SG_ DET_AZIMUTH_053 : 60|13@0+ (0.0004,-1.5708) [-1.5708|1.5708] "rad" ASDM
 SG_ DET_AZIMUTH_ERR_053 : 78|7@0+ (0.00087267,0) [0|0.11082909] "rad" ASDM
 SG_ DET_ELEVATION_053 : 42|8@0+ (0.00275,-0.34925) [-0.34925|0.34925] "rad" ASDM
 SG_ DET_ELEVATION_ERR_053 : 50|6@0+ (0.00174533,0) [0|0.10995579] "rad" ASDM
 SG_ DET_RCS_053 : 119|8@0+ (0.5,-64) [-64|63.5] "dBsm" ASDM
 SG_ DET_VALID_FLAG_053 : 100|1@0+ (1,0) [0|1] "" ASDM
 SG_ DET_BI_STATIC_FLAG_053 : 487|1@0+ (1,0) [0|1] "" ASDM
 SG_ DET_SUPER_RES_TARGET_053 : 79|1@0+ (1,0) [0|1] "" ASDM
 SG_ DET_SNR_053 : 111|8@0+ (0.35156,0) [0|89.6478] "dB" ASDM
 SG_ DET_POINT_TARGET_PROB_053 : 95|4@0+ (6.67,0) [0|100] "%" ASDM
 SG_ DET_EXISTENCE_PROB_053 : 91|6@0+ (1.588,0) [0|100] "%" ASDM
 SG_ DET_OUTSIDE_SECTOR_053 : 101|1@0+ (1,0) [0|1] "" ASDM
 SG_ DET_HVC_FLAG_053 : 87|1@0+ (1,0) [0|1] "" ASDM
 SG_ DET_CONFD_AZIMUTH_053 : 97|2@0+ (1,0) [0|3] "" ASDM
 SG_ DET_CONFD_ELEVATION_053 : 99|2@0+ (1,0) [0|3] "" ASDM
 SG_ DET_AZIMUTH_AMB_ID_053 : 82|3@0+ (1,0) [0|7] "" ASDM
 SG_ DET_AMBG_AZIMUTH_PROB_053 : 86|4@0+ (6.67,0) [0|100] "%" ASDM
 SG_ DET_RANGE_054 : 127|15@0+ (0.015625,0) [0|500] "m" ASDM
 SG_ DET_RANGE_ERR_054 : 128|7@0+ (0.0075,0) [0|0.9525] "m" ASDM
 SG_ DET_RANGE_VELOCITY_054 : 137|15@0+ (0.0078125,-128) [-128|127.9921875] "m/s" ASDM
 SG_ DET_RANGE_VELOCITY_ERR_054 : 154|8@0+ (0.003,0) [0|0.765] "m/s" ASDM
 SG_ DET_AZIMUTH_054 : 180|13@0+ (0.0004,-1.5708) [-1.5708|1.5708] "rad" ASDM
 SG_ DET_AZIMUTH_ERR_054 : 198|7@0+ (0.00087267,0) [0|0.11082909] "rad" ASDM
 SG_ DET_ELEVATION_054 : 162|8@0+ (0.00275,-0.34925) [-0.34925|0.34925] "rad" ASDM
 SG_ DET_ELEVATION_ERR_054 : 170|6@0+ (0.00174533,0) [0|0.10995579] "rad" ASDM
 SG_ DET_RCS_054 : 239|8@0+ (0.5,-64) [-64|63.5] "dBsm" ASDM
 SG_ DET_VALID_FLAG_054 : 220|1@0+ (1,0) [0|1] "" ASDM
 SG_ DET_BI_STATIC_FLAG_054 : 486|1@0+ (1,0) [0|1] "" ASDM
 SG_ DET_SUPER_RES_TARGET_054 : 199|1@0+ (1,0) [0|1] "" ASDM
 SG_ DET_SNR_054 : 231|8@0+ (0.35156,0) [0|89.6478] "dB" ASDM
 SG_ DET_POINT_TARGET_PROB_054 : 215|4@0+ (6.67,0) [0|100] "%" ASDM
 SG_ DET_EXISTENCE_PROB_054 : 211|6@0+ (1.588,0) [0|100] "%" ASDM
 SG_ DET_OUTSIDE_SECTOR_054 : 221|1@0+ (1,0) [0|1] "" ASDM
 SG_ DET_HVC_FLAG_054 : 207|1@0+ (1,0) [0|1] "" ASDM
 SG_ DET_CONFD_AZIMUTH_054 : 217|2@0+ (1,0) [0|3] "" ASDM
 SG_ DET_CONFD_ELEVATION_054 : 219|2@0+ (1,0) [0|3] "" ASDM
 SG_ DET_AZIMUTH_AMB_ID_054 : 202|3@0+ (1,0) [0|7] "" ASDM
 SG_ DET_AMBG_AZIMUTH_PROB_054 : 206|4@0+ (6.67,0) [0|100] "%" ASDM
 SG_ DET_RANGE_055 : 247|15@0+ (0.015625,0) [0|500] "m" ASDM
 SG_ DET_RANGE_ERR_055 : 248|7@0+ (0.0075,0) [0|0.9525] "m" ASDM
 SG_ DET_RANGE_VELOCITY_055 : 257|15@0+ (0.0078125,-128) [-128|127.9921875] "m/s" ASDM
 SG_ DET_RANGE_VELOCITY_ERR_055 : 274|8@0+ (0.003,0) [0|0.765] "m/s" ASDM
 SG_ DET_AZIMUTH_055 : 300|13@0+ (0.0004,-1.5708) [-1.5708|1.5708] "rad" ASDM
 SG_ DET_AZIMUTH_ERR_055 : 318|7@0+ (0.00087267,0) [0|0.11082909] "rad" ASDM
 SG_ DET_ELEVATION_055 : 282|8@0+ (0.00275,-0.34925) [-0.34925|0.34925] "rad" ASDM
 SG_ DET_ELEVATION_ERR_055 : 290|6@0+ (0.00174533,0) [0|0.10995579] "rad" ASDM
 SG_ DET_RCS_055 : 359|8@0+ (0.5,-64) [-64|63.5] "dBsm" ASDM
 SG_ DET_VALID_FLAG_055 : 340|1@0+ (1,0) [0|1] "" ASDM
 SG_ DET_BI_STATIC_FLAG_055 : 485|1@0+ (1,0) [0|1] "" ASDM
 SG_ DET_SUPER_RES_TARGET_055 : 319|1@0+ (1,0) [0|1] "" ASDM
 SG_ DET_SNR_055 : 351|8@0+ (0.35156,0) [0|89.6478] "dB" ASDM
 SG_ DET_POINT_TARGET_PROB_055 : 335|4@0+ (6.67,0) [0|100] "%" ASDM
 SG_ DET_EXISTENCE_PROB_055 : 331|6@0+ (1.588,0) [0|100] "%" ASDM
 SG_ DET_OUTSIDE_SECTOR_055 : 341|1@0+ (1,0) [0|1] "" ASDM
 SG_ DET_HVC_FLAG_055 : 327|1@0+ (1,0) [0|1] "" ASDM
 SG_ DET_CONFD_AZIMUTH_055 : 337|2@0+ (1,0) [0|3] "" ASDM
 SG_ DET_CONFD_ELEVATION_055 : 339|2@0+ (1,0) [0|3] "" ASDM
 SG_ DET_AZIMUTH_AMB_ID_055 : 322|3@0+ (1,0) [0|7] "" ASDM
 SG_ DET_AMBG_AZIMUTH_PROB_055 : 326|4@0+ (6.67,0) [0|100] "%" ASDM
 SG_ DET_RANGE_056 : 367|15@0+ (0.015625,0) [0|500] "m" ASDM
 SG_ DET_RANGE_ERR_056 : 368|7@0+ (0.0075,0) [0|0.9525] "m" ASDM
 SG_ DET_RANGE_VELOCITY_056 : 377|15@0+ (0.0078125,-128) [-128|127.9921875] "m/s" ASDM
 SG_ DET_RANGE_VELOCITY_ERR_056 : 394|8@0+ (0.003,0) [0|0.765] "m/s" ASDM
 SG_ DET_AZIMUTH_056 : 420|13@0+ (0.0004,-1.5708) [-1.5708|1.5708] "rad" ASDM
 SG_ DET_AZIMUTH_ERR_056 : 438|7@0+ (0.00087267,0) [0|0.11082909] "rad" ASDM
 SG_ DET_ELEVATION_056 : 402|8@0+ (0.00275,-0.34925) [-0.34925|0.34925] "rad" ASDM
 SG_ DET_ELEVATION_ERR_056 : 410|6@0+ (0.00174533,0) [0|0.10995579] "rad" ASDM
 SG_ DET_RCS_056 : 479|8@0+ (0.5,-64) [-64|63.5] "dBsm" ASDM
 SG_ DET_VALID_FLAG_056 : 460|1@0+ (1,0) [0|1] "" ASDM
 SG_ DET_BI_STATIC_FLAG_056 : 484|1@0+ (1,0) [0|1] "" ASDM
 SG_ DET_SUPER_RES_TARGET_056 : 439|1@0+ (1,0) [0|1] "" ASDM
 SG_ DET_SNR_056 : 471|8@0+ (0.35156,0) [0|89.6478] "dB" ASDM
 SG_ DET_POINT_TARGET_PROB_056 : 455|4@0+ (6.67,0) [0|100] "%" ASDM
 SG_ DET_EXISTENCE_PROB_056 : 451|6@0+ (1.588,0) [0|100] "%" ASDM
 SG_ DET_OUTSIDE_SECTOR_056 : 461|1@0+ (1,0) [0|1] "" ASDM
 SG_ DET_HVC_FLAG_056 : 447|1@0+ (1,0) [0|1] "" ASDM
 SG_ DET_CONFD_AZIMUTH_056 : 457|2@0+ (1,0) [0|3] "" ASDM
 SG_ DET_CONFD_ELEVATION_056 : 459|2@0+ (1,0) [0|3] "" ASDM
 SG_ DET_AZIMUTH_AMB_ID_056 : 442|3@0+ (1,0) [0|7] "" ASDM
 SG_ DET_AMBG_AZIMUTH_PROB_056 : 446|4@0+ (6.67,0) [0|100] "%" ASDM
 SG_ DET_MH_SCAN_INDEX_4LSB_053_056 : 483|4@0+ (1,0) [0|15] "" ASDM
 SG_ DET_MH_CYCLE_COUNTER_053_056 : 495|8@0+ (1,0) [0|255] "" ASDM
 SG_ DET_MH_CRC16_053_056 : 503|16@0+ (1,0) [0|65535] "" ASDM

BO_ 654 RDR_DETECTION_057_060: 64 G5_RDR04
 SG_ DET_RANGE_057 : 7|15@0+ (0.015625,0) [0|500] "m" ASDM
 SG_ DET_RANGE_ERR_057 : 8|7@0+ (0.0075,0) [0|0.9525] "m" ASDM
 SG_ DET_RANGE_VELOCITY_057 : 17|15@0+ (0.0078125,-128) [-128|127.9921875] "m/s" ASDM
 SG_ DET_RANGE_VELOCITY_ERR_057 : 34|8@0+ (0.003,0) [0|0.765] "m/s" ASDM
 SG_ DET_AZIMUTH_057 : 60|13@0+ (0.0004,-1.5708) [-1.5708|1.5708] "rad" ASDM
 SG_ DET_AZIMUTH_ERR_057 : 78|7@0+ (0.00087267,0) [0|0.11082909] "rad" ASDM
 SG_ DET_ELEVATION_057 : 42|8@0+ (0.00275,-0.34925) [-0.34925|0.34925] "rad" ASDM
 SG_ DET_ELEVATION_ERR_057 : 50|6@0+ (0.00174533,0) [0|0.10995579] "rad" ASDM
 SG_ DET_RCS_057 : 119|8@0+ (0.5,-64) [-64|63.5] "dBsm" ASDM
 SG_ DET_VALID_FLAG_057 : 100|1@0+ (1,0) [0|1] "" ASDM
 SG_ DET_BI_STATIC_FLAG_057 : 487|1@0+ (1,0) [0|1] "" ASDM
 SG_ DET_SUPER_RES_TARGET_057 : 79|1@0+ (1,0) [0|1] "" ASDM
 SG_ DET_SNR_057 : 111|8@0+ (0.35156,0) [0|89.6478] "dB" ASDM
 SG_ DET_POINT_TARGET_PROB_057 : 95|4@0+ (6.67,0) [0|100] "%" ASDM
 SG_ DET_EXISTENCE_PROB_057 : 91|6@0+ (1.588,0) [0|100] "%" ASDM
 SG_ DET_OUTSIDE_SECTOR_057 : 101|1@0+ (1,0) [0|1] "" ASDM
 SG_ DET_HVC_FLAG_057 : 87|1@0+ (1,0) [0|1] "" ASDM
 SG_ DET_CONFD_AZIMUTH_057 : 97|2@0+ (1,0) [0|3] "" ASDM
 SG_ DET_CONFD_ELEVATION_057 : 99|2@0+ (1,0) [0|3] "" ASDM
 SG_ DET_AZIMUTH_AMB_ID_057 : 82|3@0+ (1,0) [0|7] "" ASDM
 SG_ DET_AMBG_AZIMUTH_PROB_057 : 86|4@0+ (6.67,0) [0|100] "%" ASDM
 SG_ DET_RANGE_058 : 127|15@0+ (0.015625,0) [0|500] "m" ASDM
 SG_ DET_RANGE_ERR_058 : 128|7@0+ (0.0075,0) [0|0.9525] "m" ASDM
 SG_ DET_RANGE_VELOCITY_058 : 137|15@0+ (0.0078125,-128) [-128|127.9921875] "m/s" ASDM
 SG_ DET_RANGE_VELOCITY_ERR_058 : 154|8@0+ (0.003,0) [0|0.765] "m/s" ASDM
 SG_ DET_AZIMUTH_058 : 180|13@0+ (0.0004,-1.5708) [-1.5708|1.5708] "rad" ASDM
 SG_ DET_AZIMUTH_ERR_058 : 198|7@0+ (0.00087267,0) [0|0.11082909] "rad" ASDM
 SG_ DET_ELEVATION_058 : 162|8@0+ (0.00275,-0.34925) [-0.34925|0.34925] "rad" ASDM
 SG_ DET_ELEVATION_ERR_058 : 170|6@0+ (0.00174533,0) [0|0.10995579] "rad" ASDM
 SG_ DET_RCS_058 : 239|8@0+ (0.5,-64) [-64|63.5] "dBsm" ASDM
 SG_ DET_VALID_FLAG_058 : 220|1@0+ (1,0) [0|1] "" ASDM
 SG_ DET_BI_STATIC_FLAG_058 : 486|1@0+ (1,0) [0|1] "" ASDM
 SG_ DET_SUPER_RES_TARGET_058 : 199|1@0+ (1,0) [0|1] "" ASDM
 SG_ DET_SNR_058 : 231|8@0+ (0.35156,0) [0|89.6478] "dB" ASDM
 SG_ DET_POINT_TARGET_PROB_058 : 215|4@0+ (6.67,0) [0|100] "%" ASDM
 SG_ DET_EXISTENCE_PROB_058 : 211|6@0+ (1.588,0) [0|100] "%" ASDM
 SG_ DET_OUTSIDE_SECTOR_058 : 221|1@0+ (1,0) [0|1] "" ASDM
 SG_ DET_HVC_FLAG_058 : 207|1@0+ (1,0) [0|1] "" ASDM
 SG_ DET_CONFD_AZIMUTH_058 : 217|2@0+ (1,0) [0|3] "" ASDM
 SG_ DET_CONFD_ELEVATION_058 : 219|2@0+ (1,0) [0|3] "" ASDM
 SG_ DET_AZIMUTH_AMB_ID_058 : 202|3@0+ (1,0) [0|7] "" ASDM
 SG_ DET_AMBG_AZIMUTH_PROB_058 : 206|4@0+ (6.67,0) [0|100] "%" ASDM
 SG_ DET_RANGE_059 : 247|15@0+ (0.015625,0) [0|500] "m" ASDM
 SG_ DET_RANGE_ERR_059 : 248|7@0+ (0.0075,0) [0|0.9525] "m" ASDM
 SG_ DET_RANGE_VELOCITY_059 : 257|15@0+ (0.0078125,-128) [-128|127.9921875] "m/s" ASDM
 SG_ DET_RANGE_VELOCITY_ERR_059 : 274|8@0+ (0.003,0) [0|0.765] "m/s" ASDM
 SG_ DET_AZIMUTH_059 : 300|13@0+ (0.0004,-1.5708) [-1.5708|1.5708] "rad" ASDM
 SG_ DET_AZIMUTH_ERR_059 : 318|7@0+ (0.00087267,0) [0|0.11082909] "rad" ASDM
 SG_ DET_ELEVATION_059 : 282|8@0+ (0.00275,-0.34925) [-0.34925|0.34925] "rad" ASDM
 SG_ DET_ELEVATION_ERR_059 : 290|6@0+ (0.00174533,0) [0|0.10995579] "rad" ASDM
 SG_ DET_RCS_059 : 359|8@0+ (0.5,-64) [-64|63.5] "dBsm" ASDM
 SG_ DET_VALID_FLAG_059 : 340|1@0+ (1,0) [0|1] "" ASDM
 SG_ DET_BI_STATIC_FLAG_059 : 485|1@0+ (1,0) [0|1] "" ASDM
 SG_ DET_SUPER_RES_TARGET_059 : 319|1@0+ (1,0) [0|1] "" ASDM
 SG_ DET_SNR_059 : 351|8@0+ (0.35156,0) [0|89.6478] "dB" ASDM
 SG_ DET_POINT_TARGET_PROB_059 : 335|4@0+ (6.67,0) [0|100] "%" ASDM
 SG_ DET_EXISTENCE_PROB_059 : 331|6@0+ (1.588,0) [0|100] "%" ASDM
 SG_ DET_OUTSIDE_SECTOR_059 : 341|1@0+ (1,0) [0|1] "" ASDM
 SG_ DET_HVC_FLAG_059 : 327|1@0+ (1,0) [0|1] "" ASDM
 SG_ DET_CONFD_AZIMUTH_059 : 337|2@0+ (1,0) [0|3] "" ASDM
 SG_ DET_CONFD_ELEVATION_059 : 339|2@0+ (1,0) [0|3] "" ASDM
 SG_ DET_AZIMUTH_AMB_ID_059 : 322|3@0+ (1,0) [0|7] "" ASDM
 SG_ DET_AMBG_AZIMUTH_PROB_059 : 326|4@0+ (6.67,0) [0|100] "%" ASDM
 SG_ DET_RANGE_060 : 367|15@0+ (0.015625,0) [0|500] "m" ASDM
 SG_ DET_RANGE_ERR_060 : 368|7@0+ (0.0075,0) [0|0.9525] "m" ASDM
 SG_ DET_RANGE_VELOCITY_060 : 377|15@0+ (0.0078125,-128) [-128|127.9921875] "m/s" ASDM
 SG_ DET_RANGE_VELOCITY_ERR_060 : 394|8@0+ (0.003,0) [0|0.765] "m/s" ASDM
 SG_ DET_AZIMUTH_060 : 420|13@0+ (0.0004,-1.5708) [-1.5708|1.5708] "rad" ASDM
 SG_ DET_AZIMUTH_ERR_060 : 438|7@0+ (0.00087267,0) [0|0.11082909] "rad" ASDM
 SG_ DET_ELEVATION_060 : 402|8@0+ (0.00275,-0.34925) [-0.34925|0.34925] "rad" ASDM
 SG_ DET_ELEVATION_ERR_060 : 410|6@0+ (0.00174533,0) [0|0.10995579] "rad" ASDM
 SG_ DET_RCS_060 : 479|8@0+ (0.5,-64) [-64|63.5] "dBsm" ASDM
 SG_ DET_VALID_FLAG_060 : 460|1@0+ (1,0) [0|1] "" ASDM
 SG_ DET_BI_STATIC_FLAG_060 : 484|1@0+ (1,0) [0|1] "" ASDM
 SG_ DET_SUPER_RES_TARGET_060 : 439|1@0+ (1,0) [0|1] "" ASDM
 SG_ DET_SNR_060 : 471|8@0+ (0.35156,0) [0|89.6478] "dB" ASDM
 SG_ DET_POINT_TARGET_PROB_060 : 455|4@0+ (6.67,0) [0|100] "%" ASDM
 SG_ DET_EXISTENCE_PROB_060 : 451|6@0+ (1.588,0) [0|100] "%" ASDM
 SG_ DET_OUTSIDE_SECTOR_060 : 461|1@0+ (1,0) [0|1] "" ASDM
 SG_ DET_HVC_FLAG_060 : 447|1@0+ (1,0) [0|1] "" ASDM
 SG_ DET_CONFD_AZIMUTH_060 : 457|2@0+ (1,0) [0|3] "" ASDM
 SG_ DET_CONFD_ELEVATION_060 : 459|2@0+ (1,0) [0|3] "" ASDM
 SG_ DET_AZIMUTH_AMB_ID_060 : 442|3@0+ (1,0) [0|7] "" ASDM
 SG_ DET_AMBG_AZIMUTH_PROB_060 : 446|4@0+ (6.67,0) [0|100] "%" ASDM
 SG_ DET_MH_SCAN_INDEX_4LSB_057_060 : 483|4@0+ (1,0) [0|15] "" ASDM
 SG_ DET_MH_CYCLE_COUNTER_057_060 : 495|8@0+ (1,0) [0|255] "" ASDM
 SG_ DET_MH_CRC16_057_060 : 503|16@0+ (1,0) [0|65535] "" ASDM

BO_ 655 RDR_DETECTION_061_064: 64 G5_RDR04
 SG_ DET_RANGE_061 : 7|15@0+ (0.015625,0) [0|500] "m" ASDM
 SG_ DET_RANGE_ERR_061 : 8|7@0+ (0.0075,0) [0|0.9525] "m" ASDM
 SG_ DET_RANGE_VELOCITY_061 : 17|15@0+ (0.0078125,-128) [-128|127.9921875] "m/s" ASDM
 SG_ DET_RANGE_VELOCITY_ERR_061 : 34|8@0+ (0.003,0) [0|0.765] "m/s" ASDM
 SG_ DET_AZIMUTH_061 : 60|13@0+ (0.0004,-1.5708) [-1.5708|1.5708] "rad" ASDM
 SG_ DET_AZIMUTH_ERR_061 : 78|7@0+ (0.00087267,0) [0|0.11082909] "rad" ASDM
 SG_ DET_ELEVATION_061 : 42|8@0+ (0.00275,-0.34925) [-0.34925|0.34925] "rad" ASDM
 SG_ DET_ELEVATION_ERR_061 : 50|6@0+ (0.00174533,0) [0|0.10995579] "rad" ASDM
 SG_ DET_RCS_061 : 119|8@0+ (0.5,-64) [-64|63.5] "dBsm" ASDM
 SG_ DET_VALID_FLAG_061 : 100|1@0+ (1,0) [0|1] "" ASDM
 SG_ DET_BI_STATIC_FLAG_061 : 487|1@0+ (1,0) [0|1] "" ASDM
 SG_ DET_SUPER_RES_TARGET_061 : 79|1@0+ (1,0) [0|1] "" ASDM
 SG_ DET_SNR_061 : 111|8@0+ (0.35156,0) [0|89.6478] "dB" ASDM
 SG_ DET_POINT_TARGET_PROB_061 : 95|4@0+ (6.67,0) [0|100] "%" ASDM
 SG_ DET_EXISTENCE_PROB_061 : 91|6@0+ (1.588,0) [0|100] "%" ASDM
 SG_ DET_OUTSIDE_SECTOR_061 : 101|1@0+ (1,0) [0|1] "" ASDM
 SG_ DET_HVC_FLAG_061 : 87|1@0+ (1,0) [0|1] "" ASDM
 SG_ DET_CONFD_AZIMUTH_061 : 97|2@0+ (1,0) [0|3] "" ASDM
 SG_ DET_CONFD_ELEVATION_061 : 99|2@0+ (1,0) [0|3] "" ASDM
 SG_ DET_AZIMUTH_AMB_ID_061 : 82|3@0+ (1,0) [0|7] "" ASDM
 SG_ DET_AMBG_AZIMUTH_PROB_061 : 86|4@0+ (6.67,0) [0|100] "%" ASDM
 SG_ DET_RANGE_062 : 127|15@0+ (0.015625,0) [0|500] "m" ASDM
 SG_ DET_RANGE_ERR_062 : 128|7@0+ (0.0075,0) [0|0.9525] "m" ASDM
 SG_ DET_RANGE_VELOCITY_062 : 137|15@0+ (0.0078125,-128) [-128|127.9921875] "m/s" ASDM
 SG_ DET_RANGE_VELOCITY_ERR_062 : 154|8@0+ (0.003,0) [0|0.765] "m/s" ASDM
 SG_ DET_AZIMUTH_062 : 180|13@0+ (0.0004,-1.5708) [-1.5708|1.5708] "rad" ASDM
 SG_ DET_AZIMUTH_ERR_062 : 198|7@0+ (0.00087267,0) [0|0.11082909] "rad" ASDM
 SG_ DET_ELEVATION_062 : 162|8@0+ (0.00275,-0.34925) [-0.34925|0.34925] "rad" ASDM
 SG_ DET_ELEVATION_ERR_062 : 170|6@0+ (0.00174533,0) [0|0.10995579] "rad" ASDM
 SG_ DET_RCS_062 : 239|8@0+ (0.5,-64) [-64|63.5] "dBsm" ASDM
 SG_ DET_VALID_FLAG_062 : 220|1@0+ (1,0) [0|1] "" ASDM
 SG_ DET_BI_STATIC_FLAG_062 : 486|1@0+ (1,0) [0|1] "" ASDM
 SG_ DET_SUPER_RES_TARGET_062 : 199|1@0+ (1,0) [0|1] "" ASDM
 SG_ DET_SNR_062 : 231|8@0+ (0.35156,0) [0|89.6478] "dB" ASDM
 SG_ DET_POINT_TARGET_PROB_062 : 215|4@0+ (6.67,0) [0|100] "%" ASDM
 SG_ DET_EXISTENCE_PROB_062 : 211|6@0+ (1.588,0) [0|100] "%" ASDM
 SG_ DET_OUTSIDE_SECTOR_062 : 221|1@0+ (1,0) [0|1] "" ASDM
 SG_ DET_HVC_FLAG_062 : 207|1@0+ (1,0) [0|1] "" ASDM
 SG_ DET_CONFD_AZIMUTH_062 : 217|2@0+ (1,0) [0|3] "" ASDM
 SG_ DET_CONFD_ELEVATION_062 : 219|2@0+ (1,0) [0|3] "" ASDM
 SG_ DET_AZIMUTH_AMB_ID_062 : 202|3@0+ (1,0) [0|7] "" ASDM
 SG_ DET_AMBG_AZIMUTH_PROB_062 : 206|4@0+ (6.67,0) [0|100] "%" ASDM
 SG_ DET_RANGE_063 : 247|15@0+ (0.015625,0) [0|500] "m" ASDM
 SG_ DET_RANGE_ERR_063 : 248|7@0+ (0.0075,0) [0|0.9525] "m" ASDM
 SG_ DET_RANGE_VELOCITY_063 : 257|15@0+ (0.0078125,-128) [-128|127.9921875] "m/s" ASDM
 SG_ DET_RANGE_VELOCITY_ERR_063 : 274|8@0+ (0.003,0) [0|0.765] "m/s" ASDM
 SG_ DET_AZIMUTH_063 : 300|13@0+ (0.0004,-1.5708) [-1.5708|1.5708] "rad" ASDM
 SG_ DET_AZIMUTH_ERR_063 : 318|7@0+ (0.00087267,0) [0|0.11082909] "rad" ASDM
 SG_ DET_ELEVATION_063 : 282|8@0+ (0.00275,-0.34925) [-0.34925|0.34925] "rad" ASDM
 SG_ DET_ELEVATION_ERR_063 : 290|6@0+ (0.00174533,0) [0|0.10995579] "rad" ASDM
 SG_ DET_RCS_063 : 359|8@0+ (0.5,-64) [-64|63.5] "dBsm" ASDM
 SG_ DET_VALID_FLAG_063 : 340|1@0+ (1,0) [0|1] "" ASDM
 SG_ DET_BI_STATIC_FLAG_063 : 485|1@0+ (1,0) [0|1] "" ASDM
 SG_ DET_SUPER_RES_TARGET_063 : 319|1@0+ (1,0) [0|1] "" ASDM
 SG_ DET_SNR_063 : 351|8@0+ (0.35156,0) [0|89.6478] "dB" ASDM
 SG_ DET_POINT_TARGET_PROB_063 : 335|4@0+ (6.67,0) [0|100] "%" ASDM
 SG_ DET_EXISTENCE_PROB_063 : 331|6@0+ (1.588,0) [0|100] "%" ASDM
 SG_ DET_OUTSIDE_SECTOR_063 : 341|1@0+ (1,0) [0|1] "" ASDM
 SG_ DET_HVC_FLAG_063 : 327|1@0+ (1,0) [0|1] "" ASDM
 SG_ DET_CONFD_AZIMUTH_063 : 337|2@0+ (1,0) [0|3] "" ASDM
 SG_ DET_CONFD_ELEVATION_063 : 339|2@0+ (1,0) [0|3] "" ASDM
 SG_ DET_AZIMUTH_AMB_ID_063 : 322|3@0+ (1,0) [0|7] "" ASDM
 SG_ DET_AMBG_AZIMUTH_PROB_063 : 326|4@0+ (6.67,0) [0|100] "%" ASDM
 SG_ DET_RANGE_064 : 367|15@0+ (0.015625,0) [0|500] "m" ASDM
 SG_ DET_RANGE_ERR_064 : 368|7@0+ (0.0075,0) [0|0.9525] "m" ASDM
 SG_ DET_RANGE_VELOCITY_064 : 377|15@0+ (0.0078125,-128) [-128|127.9921875] "m/s" ASDM
 SG_ DET_RANGE_VELOCITY_ERR_064 : 394|8@0+ (0.003,0) [0|0.765] "m/s" ASDM
 SG_ DET_AZIMUTH_064 : 420|13@0+ (0.0004,-1.5708) [-1.5708|1.5708] "rad" ASDM
 SG_ DET_AZIMUTH_ERR_064 : 438|7@0+ (0.00087267,0) [0|0.11082909] "rad" ASDM
 SG_ DET_ELEVATION_064 : 402|8@0+ (0.00275,-0.34925) [-0.34925|0.34925] "rad" ASDM
 SG_ DET_ELEVATION_ERR_064 : 410|6@0+ (0.00174533,0) [0|0.10995579] "rad" ASDM
 SG_ DET_RCS_064 : 479|8@0+ (0.5,-64) [-64|63.5] "dBsm" ASDM
 SG_ DET_VALID_FLAG_064 : 460|1@0+ (1,0) [0|1] "" ASDM
 SG_ DET_BI_STATIC_FLAG_064 : 484|1@0+ (1,0) [0|1] "" ASDM
 SG_ DET_SUPER_RES_TARGET_064 : 439|1@0+ (1,0) [0|1] "" ASDM
 SG_ DET_SNR_064 : 471|8@0+ (0.35156,0) [0|89.6478] "dB" ASDM
 SG_ DET_POINT_TARGET_PROB_064 : 455|4@0+ (6.67,0) [0|100] "%" ASDM
 SG_ DET_EXISTENCE_PROB_064 : 451|6@0+ (1.588,0) [0|100] "%" ASDM
 SG_ DET_OUTSIDE_SECTOR_064 : 461|1@0+ (1,0) [0|1] "" ASDM
 SG_ DET_HVC_FLAG_064 : 447|1@0+ (1,0) [0|1] "" ASDM
 SG_ DET_CONFD_AZIMUTH_064 : 457|2@0+ (1,0) [0|3] "" ASDM
 SG_ DET_CONFD_ELEVATION_064 : 459|2@0+ (1,0) [0|3] "" ASDM
 SG_ DET_AZIMUTH_AMB_ID_064 : 442|3@0+ (1,0) [0|7] "" ASDM
 SG_ DET_AMBG_AZIMUTH_PROB_064 : 446|4@0+ (6.67,0) [0|100] "%" ASDM
 SG_ DET_MH_SCAN_INDEX_4LSB_061_064 : 483|4@0+ (1,0) [0|15] "" ASDM
 SG_ DET_MH_CYCLE_COUNTER_061_064 : 495|8@0+ (1,0) [0|255] "" ASDM
 SG_ DET_MH_CRC16_061_064 : 503|16@0+ (1,0) [0|65535] "" ASDM

BO_ 656 RDR_DETECTION_065_068: 64 G5_RDR04
 SG_ DET_RANGE_065 : 7|15@0+ (0.015625,0) [0|500] "m" ASDM
 SG_ DET_RANGE_ERR_065 : 8|7@0+ (0.0075,0) [0|0.9525] "m" ASDM
 SG_ DET_RANGE_VELOCITY_065 : 17|15@0+ (0.0078125,-128) [-128|127.9921875] "m/s" ASDM
 SG_ DET_RANGE_VELOCITY_ERR_065 : 34|8@0+ (0.003,0) [0|0.765] "m/s" ASDM
 SG_ DET_AZIMUTH_065 : 60|13@0+ (0.0004,-1.5708) [-1.5708|1.5708] "rad" ASDM
 SG_ DET_AZIMUTH_ERR_065 : 78|7@0+ (0.00087267,0) [0|0.11082909] "rad" ASDM
 SG_ DET_ELEVATION_065 : 42|8@0+ (0.00275,-0.34925) [-0.34925|0.34925] "rad" ASDM
 SG_ DET_ELEVATION_ERR_065 : 50|6@0+ (0.00174533,0) [0|0.10995579] "rad" ASDM
 SG_ DET_RCS_065 : 119|8@0+ (0.5,-64) [-64|63.5] "dBsm" ASDM
 SG_ DET_VALID_FLAG_065 : 100|1@0+ (1,0) [0|1] "" ASDM
 SG_ DET_BI_STATIC_FLAG_065 : 487|1@0+ (1,0) [0|1] "" ASDM
 SG_ DET_SUPER_RES_TARGET_065 : 79|1@0+ (1,0) [0|1] "" ASDM
 SG_ DET_SNR_065 : 111|8@0+ (0.35156,0) [0|89.6478] "dB" ASDM
 SG_ DET_POINT_TARGET_PROB_065 : 95|4@0+ (6.67,0) [0|100] "%" ASDM
 SG_ DET_EXISTENCE_PROB_065 : 91|6@0+ (1.588,0) [0|100] "%" ASDM
 SG_ DET_OUTSIDE_SECTOR_065 : 101|1@0+ (1,0) [0|1] "" ASDM
 SG_ DET_HVC_FLAG_065 : 87|1@0+ (1,0) [0|1] "" ASDM
 SG_ DET_CONFD_AZIMUTH_065 : 97|2@0+ (1,0) [0|3] "" ASDM
 SG_ DET_CONFD_ELEVATION_065 : 99|2@0+ (1,0) [0|3] "" ASDM
 SG_ DET_AZIMUTH_AMB_ID_065 : 82|3@0+ (1,0) [0|7] "" ASDM
 SG_ DET_AMBG_AZIMUTH_PROB_065 : 86|4@0+ (6.67,0) [0|100] "%" ASDM
 SG_ DET_RANGE_066 : 127|15@0+ (0.015625,0) [0|500] "m" ASDM
 SG_ DET_RANGE_ERR_066 : 128|7@0+ (0.0075,0) [0|0.9525] "m" ASDM
 SG_ DET_RANGE_VELOCITY_066 : 137|15@0+ (0.0078125,-128) [-128|127.9921875] "m/s" ASDM
 SG_ DET_RANGE_VELOCITY_ERR_066 : 154|8@0+ (0.003,0) [0|0.765] "m/s" ASDM
 SG_ DET_AZIMUTH_066 : 180|13@0+ (0.0004,-1.5708) [-1.5708|1.5708] "rad" ASDM
 SG_ DET_AZIMUTH_ERR_066 : 198|7@0+ (0.00087267,0) [0|0.11082909] "rad" ASDM
 SG_ DET_ELEVATION_066 : 162|8@0+ (0.00275,-0.34925) [-0.34925|0.34925] "rad" ASDM
 SG_ DET_ELEVATION_ERR_066 : 170|6@0+ (0.00174533,0) [0|0.10995579] "rad" ASDM
 SG_ DET_RCS_066 : 239|8@0+ (0.5,-64) [-64|63.5] "dBsm" ASDM
 SG_ DET_VALID_FLAG_066 : 220|1@0+ (1,0) [0|1] "" ASDM
 SG_ DET_BI_STATIC_FLAG_066 : 486|1@0+ (1,0) [0|1] "" ASDM
 SG_ DET_SUPER_RES_TARGET_066 : 199|1@0+ (1,0) [0|1] "" ASDM
 SG_ DET_SNR_066 : 231|8@0+ (0.35156,0) [0|89.6478] "dB" ASDM
 SG_ DET_POINT_TARGET_PROB_066 : 215|4@0+ (6.67,0) [0|100] "%" ASDM
 SG_ DET_EXISTENCE_PROB_066 : 211|6@0+ (1.588,0) [0|100] "%" ASDM
 SG_ DET_OUTSIDE_SECTOR_066 : 221|1@0+ (1,0) [0|1] "" ASDM
 SG_ DET_HVC_FLAG_066 : 207|1@0+ (1,0) [0|1] "" ASDM
 SG_ DET_CONFD_AZIMUTH_066 : 217|2@0+ (1,0) [0|3] "" ASDM
 SG_ DET_CONFD_ELEVATION_066 : 219|2@0+ (1,0) [0|3] "" ASDM
 SG_ DET_AZIMUTH_AMB_ID_066 : 202|3@0+ (1,0) [0|7] "" ASDM
 SG_ DET_AMBG_AZIMUTH_PROB_066 : 206|4@0+ (6.67,0) [0|100] "%" ASDM
 SG_ DET_RANGE_067 : 247|15@0+ (0.015625,0) [0|500] "m" ASDM
 SG_ DET_RANGE_ERR_067 : 248|7@0+ (0.0075,0) [0|0.9525] "m" ASDM
 SG_ DET_RANGE_VELOCITY_067 : 257|15@0+ (0.0078125,-128) [-128|127.9921875] "m/s" ASDM
 SG_ DET_RANGE_VELOCITY_ERR_067 : 274|8@0+ (0.003,0) [0|0.765] "m/s" ASDM
 SG_ DET_AZIMUTH_067 : 300|13@0+ (0.0004,-1.5708) [-1.5708|1.5708] "rad" ASDM
 SG_ DET_AZIMUTH_ERR_067 : 318|7@0+ (0.00087267,0) [0|0.11082909] "rad" ASDM
 SG_ DET_ELEVATION_067 : 282|8@0+ (0.00275,-0.34925) [-0.34925|0.34925] "rad" ASDM
 SG_ DET_ELEVATION_ERR_067 : 290|6@0+ (0.00174533,0) [0|0.10995579] "rad" ASDM
 SG_ DET_RCS_067 : 359|8@0+ (0.5,-64) [-64|63.5] "dBsm" ASDM
 SG_ DET_VALID_FLAG_067 : 340|1@0+ (1,0) [0|1] "" ASDM
 SG_ DET_BI_STATIC_FLAG_067 : 485|1@0+ (1,0) [0|1] "" ASDM
 SG_ DET_SUPER_RES_TARGET_067 : 319|1@0+ (1,0) [0|1] "" ASDM
 SG_ DET_SNR_067 : 351|8@0+ (0.35156,0) [0|89.6478] "dB" ASDM
 SG_ DET_POINT_TARGET_PROB_067 : 335|4@0+ (6.67,0) [0|100] "%" ASDM
 SG_ DET_EXISTENCE_PROB_067 : 331|6@0+ (1.588,0) [0|100] "%" ASDM
 SG_ DET_OUTSIDE_SECTOR_067 : 341|1@0+ (1,0) [0|1] "" ASDM
 SG_ DET_HVC_FLAG_067 : 327|1@0+ (1,0) [0|1] "" ASDM
 SG_ DET_CONFD_AZIMUTH_067 : 337|2@0+ (1,0) [0|3] "" ASDM
 SG_ DET_CONFD_ELEVATION_067 : 339|2@0+ (1,0) [0|3] "" ASDM
 SG_ DET_AZIMUTH_AMB_ID_067 : 322|3@0+ (1,0) [0|7] "" ASDM
 SG_ DET_AMBG_AZIMUTH_PROB_067 : 326|4@0+ (6.67,0) [0|100] "%" ASDM
 SG_ DET_RANGE_068 : 367|15@0+ (0.015625,0) [0|500] "m" ASDM
 SG_ DET_RANGE_ERR_068 : 368|7@0+ (0.0075,0) [0|0.9525] "m" ASDM
 SG_ DET_RANGE_VELOCITY_068 : 377|15@0+ (0.0078125,-128) [-128|127.9921875] "m/s" ASDM
 SG_ DET_RANGE_VELOCITY_ERR_068 : 394|8@0+ (0.003,0) [0|0.765] "m/s" ASDM
 SG_ DET_AZIMUTH_068 : 420|13@0+ (0.0004,-1.5708) [-1.5708|1.5708] "rad" ASDM
 SG_ DET_AZIMUTH_ERR_068 : 438|7@0+ (0.00087267,0) [0|0.11082909] "rad" ASDM
 SG_ DET_ELEVATION_068 : 402|8@0+ (0.00275,-0.34925) [-0.34925|0.34925] "rad" ASDM
 SG_ DET_ELEVATION_ERR_068 : 410|6@0+ (0.00174533,0) [0|0.10995579] "rad" ASDM
 SG_ DET_RCS_068 : 479|8@0+ (0.5,-64) [-64|63.5] "dBsm" ASDM
 SG_ DET_VALID_FLAG_068 : 460|1@0+ (1,0) [0|1] "" ASDM
 SG_ DET_BI_STATIC_FLAG_068 : 484|1@0+ (1,0) [0|1] "" ASDM
 SG_ DET_SUPER_RES_TARGET_068 : 439|1@0+ (1,0) [0|1] "" ASDM
 SG_ DET_SNR_068 : 471|8@0+ (0.35156,0) [0|89.6478] "dB" ASDM
 SG_ DET_POINT_TARGET_PROB_068 : 455|4@0+ (6.67,0) [0|100] "%" ASDM
 SG_ DET_EXISTENCE_PROB_068 : 451|6@0+ (1.588,0) [0|100] "%" ASDM
 SG_ DET_OUTSIDE_SECTOR_068 : 461|1@0+ (1,0) [0|1] "" ASDM
 SG_ DET_HVC_FLAG_068 : 447|1@0+ (1,0) [0|1] "" ASDM
 SG_ DET_CONFD_AZIMUTH_068 : 457|2@0+ (1,0) [0|3] "" ASDM
 SG_ DET_CONFD_ELEVATION_068 : 459|2@0+ (1,0) [0|3] "" ASDM
 SG_ DET_AZIMUTH_AMB_ID_068 : 442|3@0+ (1,0) [0|7] "" ASDM
 SG_ DET_AMBG_AZIMUTH_PROB_068 : 446|4@0+ (6.67,0) [0|100] "%" ASDM
 SG_ DET_MH_SCAN_INDEX_4LSB_065_068 : 483|4@0+ (1,0) [0|15] "" ASDM
 SG_ DET_MH_CYCLE_COUNTER_065_068 : 495|8@0+ (1,0) [0|255] "" ASDM
 SG_ DET_MH_CRC16_065_068 : 503|16@0+ (1,0) [0|65535] "" ASDM

BO_ 657 RDR_DETECTION_069_072: 64 G5_RDR04
 SG_ DET_RANGE_069 : 7|15@0+ (0.015625,0) [0|500] "m" ASDM
 SG_ DET_RANGE_ERR_069 : 8|7@0+ (0.0075,0) [0|0.9525] "m" ASDM
 SG_ DET_RANGE_VELOCITY_069 : 17|15@0+ (0.0078125,-128) [-128|127.9921875] "m/s" ASDM
 SG_ DET_RANGE_VELOCITY_ERR_069 : 34|8@0+ (0.003,0) [0|0.765] "m/s" ASDM
 SG_ DET_AZIMUTH_069 : 60|13@0+ (0.0004,-1.5708) [-1.5708|1.5708] "rad" ASDM
 SG_ DET_AZIMUTH_ERR_069 : 78|7@0+ (0.00087267,0) [0|0.11082909] "rad" ASDM
 SG_ DET_ELEVATION_069 : 42|8@0+ (0.00275,-0.34925) [-0.34925|0.34925] "rad" ASDM
 SG_ DET_ELEVATION_ERR_069 : 50|6@0+ (0.00174533,0) [0|0.10995579] "rad" ASDM
 SG_ DET_RCS_069 : 119|8@0+ (0.5,-64) [-64|63.5] "dBsm" ASDM
 SG_ DET_VALID_FLAG_069 : 100|1@0+ (1,0) [0|1] "" ASDM
 SG_ DET_BI_STATIC_FLAG_069 : 487|1@0+ (1,0) [0|1] "" ASDM
 SG_ DET_SUPER_RES_TARGET_069 : 79|1@0+ (1,0) [0|1] "" ASDM
 SG_ DET_SNR_069 : 111|8@0+ (0.35156,0) [0|89.6478] "dB" ASDM
 SG_ DET_POINT_TARGET_PROB_069 : 95|4@0+ (6.67,0) [0|100] "%" ASDM
 SG_ DET_EXISTENCE_PROB_069 : 91|6@0+ (1.588,0) [0|100] "%" ASDM
 SG_ DET_OUTSIDE_SECTOR_069 : 101|1@0+ (1,0) [0|1] "" ASDM
 SG_ DET_HVC_FLAG_069 : 87|1@0+ (1,0) [0|1] "" ASDM
 SG_ DET_CONFD_AZIMUTH_069 : 97|2@0+ (1,0) [0|3] "" ASDM
 SG_ DET_CONFD_ELEVATION_069 : 99|2@0+ (1,0) [0|3] "" ASDM
 SG_ DET_AZIMUTH_AMB_ID_069 : 82|3@0+ (1,0) [0|7] "" ASDM
 SG_ DET_AMBG_AZIMUTH_PROB_069 : 86|4@0+ (6.67,0) [0|100] "%" ASDM
 SG_ DET_RANGE_070 : 127|15@0+ (0.015625,0) [0|500] "m" ASDM
 SG_ DET_RANGE_ERR_070 : 128|7@0+ (0.0075,0) [0|0.9525] "m" ASDM
 SG_ DET_RANGE_VELOCITY_070 : 137|15@0+ (0.0078125,-128) [-128|127.9921875] "m/s" ASDM
 SG_ DET_RANGE_VELOCITY_ERR_070 : 154|8@0+ (0.003,0) [0|0.765] "m/s" ASDM
 SG_ DET_AZIMUTH_070 : 180|13@0+ (0.0004,-1.5708) [-1.5708|1.5708] "rad" ASDM
 SG_ DET_AZIMUTH_ERR_070 : 198|7@0+ (0.00087267,0) [0|0.11082909] "rad" ASDM
 SG_ DET_ELEVATION_070 : 162|8@0+ (0.00275,-0.34925) [-0.34925|0.34925] "rad" ASDM
 SG_ DET_ELEVATION_ERR_070 : 170|6@0+ (0.00174533,0) [0|0.10995579] "rad" ASDM
 SG_ DET_RCS_070 : 239|8@0+ (0.5,-64) [-64|63.5] "dBsm" ASDM
 SG_ DET_VALID_FLAG_070 : 220|1@0+ (1,0) [0|1] "" ASDM
 SG_ DET_BI_STATIC_FLAG_070 : 486|1@0+ (1,0) [0|1] "" ASDM
 SG_ DET_SUPER_RES_TARGET_070 : 199|1@0+ (1,0) [0|1] "" ASDM
 SG_ DET_SNR_070 : 231|8@0+ (0.35156,0) [0|89.6478] "dB" ASDM
 SG_ DET_POINT_TARGET_PROB_070 : 215|4@0+ (6.67,0) [0|100] "%" ASDM
 SG_ DET_EXISTENCE_PROB_070 : 211|6@0+ (1.588,0) [0|100] "%" ASDM
 SG_ DET_OUTSIDE_SECTOR_070 : 221|1@0+ (1,0) [0|1] "" ASDM
 SG_ DET_HVC_FLAG_070 : 207|1@0+ (1,0) [0|1] "" ASDM
 SG_ DET_CONFD_AZIMUTH_070 : 217|2@0+ (1,0) [0|3] "" ASDM
 SG_ DET_CONFD_ELEVATION_070 : 219|2@0+ (1,0) [0|3] "" ASDM
 SG_ DET_AZIMUTH_AMB_ID_070 : 202|3@0+ (1,0) [0|7] "" ASDM
 SG_ DET_AMBG_AZIMUTH_PROB_070 : 206|4@0+ (6.67,0) [0|100] "%" ASDM
 SG_ DET_RANGE_071 : 247|15@0+ (0.015625,0) [0|500] "m" ASDM
 SG_ DET_RANGE_ERR_071 : 248|7@0+ (0.0075,0) [0|0.9525] "m" ASDM
 SG_ DET_RANGE_VELOCITY_071 : 257|15@0+ (0.0078125,-128) [-128|127.9921875] "m/s" ASDM
 SG_ DET_RANGE_VELOCITY_ERR_071 : 274|8@0+ (0.003,0) [0|0.765] "m/s" ASDM
 SG_ DET_AZIMUTH_071 : 300|13@0+ (0.0004,-1.5708) [-1.5708|1.5708] "rad" ASDM
 SG_ DET_AZIMUTH_ERR_071 : 318|7@0+ (0.00087267,0) [0|0.11082909] "rad" ASDM
 SG_ DET_ELEVATION_071 : 282|8@0+ (0.00275,-0.34925) [-0.34925|0.34925] "rad" ASDM
 SG_ DET_ELEVATION_ERR_071 : 290|6@0+ (0.00174533,0) [0|0.10995579] "rad" ASDM
 SG_ DET_RCS_071 : 359|8@0+ (0.5,-64) [-64|63.5] "dBsm" ASDM
 SG_ DET_VALID_FLAG_071 : 340|1@0+ (1,0) [0|1] "" ASDM
 SG_ DET_BI_STATIC_FLAG_071 : 485|1@0+ (1,0) [0|1] "" ASDM
 SG_ DET_SUPER_RES_TARGET_071 : 319|1@0+ (1,0) [0|1] "" ASDM
 SG_ DET_SNR_071 : 351|8@0+ (0.35156,0) [0|89.6478] "dB" ASDM
 SG_ DET_POINT_TARGET_PROB_071 : 335|4@0+ (6.67,0) [0|100] "%" ASDM
 SG_ DET_EXISTENCE_PROB_071 : 331|6@0+ (1.588,0) [0|100] "%" ASDM
 SG_ DET_OUTSIDE_SECTOR_071 : 341|1@0+ (1,0) [0|1] "" ASDM
 SG_ DET_HVC_FLAG_071 : 327|1@0+ (1,0) [0|1] "" ASDM
 SG_ DET_CONFD_AZIMUTH_071 : 337|2@0+ (1,0) [0|3] "" ASDM
 SG_ DET_CONFD_ELEVATION_071 : 339|2@0+ (1,0) [0|3] "" ASDM
 SG_ DET_AZIMUTH_AMB_ID_071 : 322|3@0+ (1,0) [0|7] "" ASDM
 SG_ DET_AMBG_AZIMUTH_PROB_071 : 326|4@0+ (6.67,0) [0|100] "%" ASDM
 SG_ DET_RANGE_072 : 367|15@0+ (0.015625,0) [0|500] "m" ASDM
 SG_ DET_RANGE_ERR_072 : 368|7@0+ (0.0075,0) [0|0.9525] "m" ASDM
 SG_ DET_RANGE_VELOCITY_072 : 377|15@0+ (0.0078125,-128) [-128|127.9921875] "m/s" ASDM
 SG_ DET_RANGE_VELOCITY_ERR_072 : 394|8@0+ (0.003,0) [0|0.765] "m/s" ASDM
 SG_ DET_AZIMUTH_072 : 420|13@0+ (0.0004,-1.5708) [-1.5708|1.5708] "rad" ASDM
 SG_ DET_AZIMUTH_ERR_072 : 438|7@0+ (0.00087267,0) [0|0.11082909] "rad" ASDM
 SG_ DET_ELEVATION_072 : 402|8@0+ (0.00275,-0.34925) [-0.34925|0.34925] "rad" ASDM
 SG_ DET_ELEVATION_ERR_072 : 410|6@0+ (0.00174533,0) [0|0.10995579] "rad" ASDM
 SG_ DET_RCS_072 : 479|8@0+ (0.5,-64) [-64|63.5] "dBsm" ASDM
 SG_ DET_VALID_FLAG_072 : 460|1@0+ (1,0) [0|1] "" ASDM
 SG_ DET_BI_STATIC_FLAG_072 : 484|1@0+ (1,0) [0|1] "" ASDM
 SG_ DET_SUPER_RES_TARGET_072 : 439|1@0+ (1,0) [0|1] "" ASDM
 SG_ DET_SNR_072 : 471|8@0+ (0.35156,0) [0|89.6478] "dB" ASDM
 SG_ DET_POINT_TARGET_PROB_072 : 455|4@0+ (6.67,0) [0|100] "%" ASDM
 SG_ DET_EXISTENCE_PROB_072 : 451|6@0+ (1.588,0) [0|100] "%" ASDM
 SG_ DET_OUTSIDE_SECTOR_072 : 461|1@0+ (1,0) [0|1] "" ASDM
 SG_ DET_HVC_FLAG_072 : 447|1@0+ (1,0) [0|1] "" ASDM
 SG_ DET_CONFD_AZIMUTH_072 : 457|2@0+ (1,0) [0|3] "" ASDM
 SG_ DET_CONFD_ELEVATION_072 : 459|2@0+ (1,0) [0|3] "" ASDM
 SG_ DET_AZIMUTH_AMB_ID_072 : 442|3@0+ (1,0) [0|7] "" ASDM
 SG_ DET_AMBG_AZIMUTH_PROB_072 : 446|4@0+ (6.67,0) [0|100] "%" ASDM
 SG_ DET_MH_SCAN_INDEX_4LSB_069_072 : 483|4@0+ (1,0) [0|15] "" ASDM
 SG_ DET_MH_CYCLE_COUNTER_069_072 : 495|8@0+ (1,0) [0|255] "" ASDM
 SG_ DET_MH_CRC16_069_072 : 503|16@0+ (1,0) [0|65535] "" ASDM

BO_ 658 RDR_DETECTION_073_076: 64 G5_RDR04
 SG_ DET_RANGE_073 : 7|15@0+ (0.015625,0) [0|500] "m" ASDM
 SG_ DET_RANGE_ERR_073 : 8|7@0+ (0.0075,0) [0|0.9525] "m" ASDM
 SG_ DET_RANGE_VELOCITY_073 : 17|15@0+ (0.0078125,-128) [-128|127.9921875] "m/s" ASDM
 SG_ DET_RANGE_VELOCITY_ERR_073 : 34|8@0+ (0.003,0) [0|0.765] "m/s" ASDM
 SG_ DET_AZIMUTH_073 : 60|13@0+ (0.0004,-1.5708) [-1.5708|1.5708] "rad" ASDM
 SG_ DET_AZIMUTH_ERR_073 : 78|7@0+ (0.00087267,0) [0|0.11082909] "rad" ASDM
 SG_ DET_ELEVATION_073 : 42|8@0+ (0.00275,-0.34925) [-0.34925|0.34925] "rad" ASDM
 SG_ DET_ELEVATION_ERR_073 : 50|6@0+ (0.00174533,0) [0|0.10995579] "rad" ASDM
 SG_ DET_RCS_073 : 119|8@0+ (0.5,-64) [-64|63.5] "dBsm" ASDM
 SG_ DET_VALID_FLAG_073 : 100|1@0+ (1,0) [0|1] "" ASDM
 SG_ DET_BI_STATIC_FLAG_073 : 487|1@0+ (1,0) [0|1] "" ASDM
 SG_ DET_SUPER_RES_TARGET_073 : 79|1@0+ (1,0) [0|1] "" ASDM
 SG_ DET_SNR_073 : 111|8@0+ (0.35156,0) [0|89.6478] "dB" ASDM
 SG_ DET_POINT_TARGET_PROB_073 : 95|4@0+ (6.67,0) [0|100] "%" ASDM
 SG_ DET_EXISTENCE_PROB_073 : 91|6@0+ (1.588,0) [0|100] "%" ASDM
 SG_ DET_OUTSIDE_SECTOR_073 : 101|1@0+ (1,0) [0|1] "" ASDM
 SG_ DET_HVC_FLAG_073 : 87|1@0+ (1,0) [0|1] "" ASDM
 SG_ DET_CONFD_AZIMUTH_073 : 97|2@0+ (1,0) [0|3] "" ASDM
 SG_ DET_CONFD_ELEVATION_073 : 99|2@0+ (1,0) [0|3] "" ASDM
 SG_ DET_AZIMUTH_AMB_ID_073 : 82|3@0+ (1,0) [0|7] "" ASDM
 SG_ DET_AMBG_AZIMUTH_PROB_073 : 86|4@0+ (6.67,0) [0|100] "%" ASDM
 SG_ DET_RANGE_074 : 127|15@0+ (0.015625,0) [0|500] "m" ASDM
 SG_ DET_RANGE_ERR_074 : 128|7@0+ (0.0075,0) [0|0.9525] "m" ASDM
 SG_ DET_RANGE_VELOCITY_074 : 137|15@0+ (0.0078125,-128) [-128|127.9921875] "m/s" ASDM
 SG_ DET_RANGE_VELOCITY_ERR_074 : 154|8@0+ (0.003,0) [0|0.765] "m/s" ASDM
 SG_ DET_AZIMUTH_074 : 180|13@0+ (0.0004,-1.5708) [-1.5708|1.5708] "rad" ASDM
 SG_ DET_AZIMUTH_ERR_074 : 198|7@0+ (0.00087267,0) [0|0.11082909] "rad" ASDM
 SG_ DET_ELEVATION_074 : 162|8@0+ (0.00275,-0.34925) [-0.34925|0.34925] "rad" ASDM
 SG_ DET_ELEVATION_ERR_074 : 170|6@0+ (0.00174533,0) [0|0.10995579] "rad" ASDM
 SG_ DET_RCS_074 : 239|8@0+ (0.5,-64) [-64|63.5] "dBsm" ASDM
 SG_ DET_VALID_FLAG_074 : 220|1@0+ (1,0) [0|1] "" ASDM
 SG_ DET_BI_STATIC_FLAG_074 : 486|1@0+ (1,0) [0|1] "" ASDM
 SG_ DET_SUPER_RES_TARGET_074 : 199|1@0+ (1,0) [0|1] "" ASDM
 SG_ DET_SNR_074 : 231|8@0+ (0.35156,0) [0|89.6478] "dB" ASDM
 SG_ DET_POINT_TARGET_PROB_074 : 215|4@0+ (6.67,0) [0|100] "%" ASDM
 SG_ DET_EXISTENCE_PROB_074 : 211|6@0+ (1.588,0) [0|100] "%" ASDM
 SG_ DET_OUTSIDE_SECTOR_074 : 221|1@0+ (1,0) [0|1] "" ASDM
 SG_ DET_HVC_FLAG_074 : 207|1@0+ (1,0) [0|1] "" ASDM
 SG_ DET_CONFD_AZIMUTH_074 : 217|2@0+ (1,0) [0|3] "" ASDM
 SG_ DET_CONFD_ELEVATION_074 : 219|2@0+ (1,0) [0|3] "" ASDM
 SG_ DET_AZIMUTH_AMB_ID_074 : 202|3@0+ (1,0) [0|7] "" ASDM
 SG_ DET_AMBG_AZIMUTH_PROB_074 : 206|4@0+ (6.67,0) [0|100] "%" ASDM
 SG_ DET_RANGE_075 : 247|15@0+ (0.015625,0) [0|500] "m" ASDM
 SG_ DET_RANGE_ERR_075 : 248|7@0+ (0.0075,0) [0|0.9525] "m" ASDM
 SG_ DET_RANGE_VELOCITY_075 : 257|15@0+ (0.0078125,-128) [-128|127.9921875] "m/s" ASDM
 SG_ DET_RANGE_VELOCITY_ERR_075 : 274|8@0+ (0.003,0) [0|0.765] "m/s" ASDM
 SG_ DET_AZIMUTH_075 : 300|13@0+ (0.0004,-1.5708) [-1.5708|1.5708] "rad" ASDM
 SG_ DET_AZIMUTH_ERR_075 : 318|7@0+ (0.00087267,0) [0|0.11082909] "rad" ASDM
 SG_ DET_ELEVATION_075 : 282|8@0+ (0.00275,-0.34925) [-0.34925|0.34925] "rad" ASDM
 SG_ DET_ELEVATION_ERR_075 : 290|6@0+ (0.00174533,0) [0|0.10995579] "rad" ASDM
 SG_ DET_RCS_075 : 359|8@0+ (0.5,-64) [-64|63.5] "dBsm" ASDM
 SG_ DET_VALID_FLAG_075 : 340|1@0+ (1,0) [0|1] "" ASDM
 SG_ DET_BI_STATIC_FLAG_075 : 485|1@0+ (1,0) [0|1] "" ASDM
 SG_ DET_SUPER_RES_TARGET_075 : 319|1@0+ (1,0) [0|1] "" ASDM
 SG_ DET_SNR_075 : 351|8@0+ (0.35156,0) [0|89.6478] "dB" ASDM
 SG_ DET_POINT_TARGET_PROB_075 : 335|4@0+ (6.67,0) [0|100] "%" ASDM
 SG_ DET_EXISTENCE_PROB_075 : 331|6@0+ (1.588,0) [0|100] "%" ASDM
 SG_ DET_OUTSIDE_SECTOR_075 : 341|1@0+ (1,0) [0|1] "" ASDM
 SG_ DET_HVC_FLAG_075 : 327|1@0+ (1,0) [0|1] "" ASDM
 SG_ DET_CONFD_AZIMUTH_075 : 337|2@0+ (1,0) [0|3] "" ASDM
 SG_ DET_CONFD_ELEVATION_075 : 339|2@0+ (1,0) [0|3] "" ASDM
 SG_ DET_AZIMUTH_AMB_ID_075 : 322|3@0+ (1,0) [0|7] "" ASDM
 SG_ DET_AMBG_AZIMUTH_PROB_075 : 326|4@0+ (6.67,0) [0|100] "%" ASDM
 SG_ DET_RANGE_076 : 367|15@0+ (0.015625,0) [0|500] "m" ASDM
 SG_ DET_RANGE_ERR_076 : 368|7@0+ (0.0075,0) [0|0.9525] "m" ASDM
 SG_ DET_RANGE_VELOCITY_076 : 377|15@0+ (0.0078125,-128) [-128|127.9921875] "m/s" ASDM
 SG_ DET_RANGE_VELOCITY_ERR_076 : 394|8@0+ (0.003,0) [0|0.765] "m/s" ASDM
 SG_ DET_AZIMUTH_076 : 420|13@0+ (0.0004,-1.5708) [-1.5708|1.5708] "rad" ASDM
 SG_ DET_AZIMUTH_ERR_076 : 438|7@0+ (0.00087267,0) [0|0.11082909] "rad" ASDM
 SG_ DET_ELEVATION_076 : 402|8@0+ (0.00275,-0.34925) [-0.34925|0.34925] "rad" ASDM
 SG_ DET_ELEVATION_ERR_076 : 410|6@0+ (0.00174533,0) [0|0.10995579] "rad" ASDM
 SG_ DET_RCS_076 : 479|8@0+ (0.5,-64) [-64|63.5] "dBsm" ASDM
 SG_ DET_VALID_FLAG_076 : 460|1@0+ (1,0) [0|1] "" ASDM
 SG_ DET_BI_STATIC_FLAG_076 : 484|1@0+ (1,0) [0|1] "" ASDM
 SG_ DET_SUPER_RES_TARGET_076 : 439|1@0+ (1,0) [0|1] "" ASDM
 SG_ DET_SNR_076 : 471|8@0+ (0.35156,0) [0|89.6478] "dB" ASDM
 SG_ DET_POINT_TARGET_PROB_076 : 455|4@0+ (6.67,0) [0|100] "%" ASDM
 SG_ DET_EXISTENCE_PROB_076 : 451|6@0+ (1.588,0) [0|100] "%" ASDM
 SG_ DET_OUTSIDE_SECTOR_076 : 461|1@0+ (1,0) [0|1] "" ASDM
 SG_ DET_HVC_FLAG_076 : 447|1@0+ (1,0) [0|1] "" ASDM
 SG_ DET_CONFD_AZIMUTH_076 : 457|2@0+ (1,0) [0|3] "" ASDM
 SG_ DET_CONFD_ELEVATION_076 : 459|2@0+ (1,0) [0|3] "" ASDM
 SG_ DET_AZIMUTH_AMB_ID_076 : 442|3@0+ (1,0) [0|7] "" ASDM
 SG_ DET_AMBG_AZIMUTH_PROB_076 : 446|4@0+ (6.67,0) [0|100] "%" ASDM
 SG_ DET_MH_SCAN_INDEX_4LSB_073_076 : 483|4@0+ (1,0) [0|15] "" ASDM
 SG_ DET_MH_CYCLE_COUNTER_073_076 : 495|8@0+ (1,0) [0|255] "" ASDM
 SG_ DET_MH_CRC16_073_076 : 503|16@0+ (1,0) [0|65535] "" ASDM

BO_ 659 RDR_DETECTION_077_080: 64 G5_RDR04
 SG_ DET_RANGE_077 : 7|15@0+ (0.015625,0) [0|500] "m" ASDM
 SG_ DET_RANGE_ERR_077 : 8|7@0+ (0.0075,0) [0|0.9525] "m" ASDM
 SG_ DET_RANGE_VELOCITY_077 : 17|15@0+ (0.0078125,-128) [-128|127.9921875] "m/s" ASDM
 SG_ DET_RANGE_VELOCITY_ERR_077 : 34|8@0+ (0.003,0) [0|0.765] "m/s" ASDM
 SG_ DET_AZIMUTH_077 : 60|13@0+ (0.0004,-1.5708) [-1.5708|1.5708] "rad" ASDM
 SG_ DET_AZIMUTH_ERR_077 : 78|7@0+ (0.00087267,0) [0|0.11082909] "rad" ASDM
 SG_ DET_ELEVATION_077 : 42|8@0+ (0.00275,-0.34925) [-0.34925|0.34925] "rad" ASDM
 SG_ DET_ELEVATION_ERR_077 : 50|6@0+ (0.00174533,0) [0|0.10995579] "rad" ASDM
 SG_ DET_RCS_077 : 119|8@0+ (0.5,-64) [-64|63.5] "dBsm" ASDM
 SG_ DET_VALID_FLAG_077 : 100|1@0+ (1,0) [0|1] "" ASDM
 SG_ DET_BI_STATIC_FLAG_077 : 487|1@0+ (1,0) [0|1] "" ASDM
 SG_ DET_SUPER_RES_TARGET_077 : 79|1@0+ (1,0) [0|1] "" ASDM
 SG_ DET_SNR_077 : 111|8@0+ (0.35156,0) [0|89.6478] "dB" ASDM
 SG_ DET_POINT_TARGET_PROB_077 : 95|4@0+ (6.67,0) [0|100] "%" ASDM
 SG_ DET_EXISTENCE_PROB_077 : 91|6@0+ (1.588,0) [0|100] "%" ASDM
 SG_ DET_OUTSIDE_SECTOR_077 : 101|1@0+ (1,0) [0|1] "" ASDM
 SG_ DET_HVC_FLAG_077 : 87|1@0+ (1,0) [0|1] "" ASDM
 SG_ DET_CONFD_AZIMUTH_077 : 97|2@0+ (1,0) [0|3] "" ASDM
 SG_ DET_CONFD_ELEVATION_077 : 99|2@0+ (1,0) [0|3] "" ASDM
 SG_ DET_AZIMUTH_AMB_ID_077 : 82|3@0+ (1,0) [0|7] "" ASDM
 SG_ DET_AMBG_AZIMUTH_PROB_077 : 86|4@0+ (6.67,0) [0|100] "%" ASDM
 SG_ DET_RANGE_078 : 127|15@0+ (0.015625,0) [0|500] "m" ASDM
 SG_ DET_RANGE_ERR_078 : 128|7@0+ (0.0075,0) [0|0.9525] "m" ASDM
 SG_ DET_RANGE_VELOCITY_078 : 137|15@0+ (0.0078125,-128) [-128|127.9921875] "m/s" ASDM
 SG_ DET_RANGE_VELOCITY_ERR_078 : 154|8@0+ (0.003,0) [0|0.765] "m/s" ASDM
 SG_ DET_AZIMUTH_078 : 180|13@0+ (0.0004,-1.5708) [-1.5708|1.5708] "rad" ASDM
 SG_ DET_AZIMUTH_ERR_078 : 198|7@0+ (0.00087267,0) [0|0.11082909] "rad" ASDM
 SG_ DET_ELEVATION_078 : 162|8@0+ (0.00275,-0.34925) [-0.34925|0.34925] "rad" ASDM
 SG_ DET_ELEVATION_ERR_078 : 170|6@0+ (0.00174533,0) [0|0.10995579] "rad" ASDM
 SG_ DET_RCS_078 : 239|8@0+ (0.5,-64) [-64|63.5] "dBsm" ASDM
 SG_ DET_VALID_FLAG_078 : 220|1@0+ (1,0) [0|1] "" ASDM
 SG_ DET_BI_STATIC_FLAG_078 : 486|1@0+ (1,0) [0|1] "" ASDM
 SG_ DET_SUPER_RES_TARGET_078 : 199|1@0+ (1,0) [0|1] "" ASDM
 SG_ DET_SNR_078 : 231|8@0+ (0.35156,0) [0|89.6478] "dB" ASDM
 SG_ DET_POINT_TARGET_PROB_078 : 215|4@0+ (6.67,0) [0|100] "%" ASDM
 SG_ DET_EXISTENCE_PROB_078 : 211|6@0+ (1.588,0) [0|100] "%" ASDM
 SG_ DET_OUTSIDE_SECTOR_078 : 221|1@0+ (1,0) [0|1] "" ASDM
 SG_ DET_HVC_FLAG_078 : 207|1@0+ (1,0) [0|1] "" ASDM
 SG_ DET_CONFD_AZIMUTH_078 : 217|2@0+ (1,0) [0|3] "" ASDM
 SG_ DET_CONFD_ELEVATION_078 : 219|2@0+ (1,0) [0|3] "" ASDM
 SG_ DET_AZIMUTH_AMB_ID_078 : 202|3@0+ (1,0) [0|7] "" ASDM
 SG_ DET_AMBG_AZIMUTH_PROB_078 : 206|4@0+ (6.67,0) [0|100] "%" ASDM
 SG_ DET_RANGE_079 : 247|15@0+ (0.015625,0) [0|500] "m" ASDM
 SG_ DET_RANGE_ERR_079 : 248|7@0+ (0.0075,0) [0|0.9525] "m" ASDM
 SG_ DET_RANGE_VELOCITY_079 : 257|15@0+ (0.0078125,-128) [-128|127.9921875] "m/s" ASDM
 SG_ DET_RANGE_VELOCITY_ERR_079 : 274|8@0+ (0.003,0) [0|0.765] "m/s" ASDM
 SG_ DET_AZIMUTH_079 : 300|13@0+ (0.0004,-1.5708) [-1.5708|1.5708] "rad" ASDM
 SG_ DET_AZIMUTH_ERR_079 : 318|7@0+ (0.00087267,0) [0|0.11082909] "rad" ASDM
 SG_ DET_ELEVATION_079 : 282|8@0+ (0.00275,-0.34925) [-0.34925|0.34925] "rad" ASDM
 SG_ DET_ELEVATION_ERR_079 : 290|6@0+ (0.00174533,0) [0|0.10995579] "rad" ASDM
 SG_ DET_RCS_079 : 359|8@0+ (0.5,-64) [-64|63.5] "dBsm" ASDM
 SG_ DET_VALID_FLAG_079 : 340|1@0+ (1,0) [0|1] "" ASDM
 SG_ DET_BI_STATIC_FLAG_079 : 485|1@0+ (1,0) [0|1] "" ASDM
 SG_ DET_SUPER_RES_TARGET_079 : 319|1@0+ (1,0) [0|1] "" ASDM
 SG_ DET_SNR_079 : 351|8@0+ (0.35156,0) [0|89.6478] "dB" ASDM
 SG_ DET_POINT_TARGET_PROB_079 : 335|4@0+ (6.67,0) [0|100] "%" ASDM
 SG_ DET_EXISTENCE_PROB_079 : 331|6@0+ (1.588,0) [0|100] "%" ASDM
 SG_ DET_OUTSIDE_SECTOR_079 : 341|1@0+ (1,0) [0|1] "" ASDM
 SG_ DET_HVC_FLAG_079 : 327|1@0+ (1,0) [0|1] "" ASDM
 SG_ DET_CONFD_AZIMUTH_079 : 337|2@0+ (1,0) [0|3] "" ASDM
 SG_ DET_CONFD_ELEVATION_079 : 339|2@0+ (1,0) [0|3] "" ASDM
 SG_ DET_AZIMUTH_AMB_ID_079 : 322|3@0+ (1,0) [0|7] "" ASDM
 SG_ DET_AMBG_AZIMUTH_PROB_079 : 326|4@0+ (6.67,0) [0|100] "%" ASDM
 SG_ DET_RANGE_080 : 367|15@0+ (0.015625,0) [0|500] "m" ASDM
 SG_ DET_RANGE_ERR_080 : 368|7@0+ (0.0075,0) [0|0.9525] "m" ASDM
 SG_ DET_RANGE_VELOCITY_080 : 377|15@0+ (0.0078125,-128) [-128|127.9921875] "m/s" ASDM
 SG_ DET_RANGE_VELOCITY_ERR_080 : 394|8@0+ (0.003,0) [0|0.765] "m/s" ASDM
 SG_ DET_AZIMUTH_080 : 420|13@0+ (0.0004,-1.5708) [-1.5708|1.5708] "rad" ASDM
 SG_ DET_AZIMUTH_ERR_080 : 438|7@0+ (0.00087267,0) [0|0.11082909] "rad" ASDM
 SG_ DET_ELEVATION_080 : 402|8@0+ (0.00275,-0.34925) [-0.34925|0.34925] "rad" ASDM
 SG_ DET_ELEVATION_ERR_080 : 410|6@0+ (0.00174533,0) [0|0.10995579] "rad" ASDM
 SG_ DET_RCS_080 : 479|8@0+ (0.5,-64) [-64|63.5] "dBsm" ASDM
 SG_ DET_VALID_FLAG_080 : 460|1@0+ (1,0) [0|1] "" ASDM
 SG_ DET_BI_STATIC_FLAG_080 : 484|1@0+ (1,0) [0|1] "" ASDM
 SG_ DET_SUPER_RES_TARGET_080 : 439|1@0+ (1,0) [0|1] "" ASDM
 SG_ DET_SNR_080 : 471|8@0+ (0.35156,0) [0|89.6478] "dB" ASDM
 SG_ DET_POINT_TARGET_PROB_080 : 455|4@0+ (6.67,0) [0|100] "%" ASDM
 SG_ DET_EXISTENCE_PROB_080 : 451|6@0+ (1.588,0) [0|100] "%" ASDM
 SG_ DET_OUTSIDE_SECTOR_080 : 461|1@0+ (1,0) [0|1] "" ASDM
 SG_ DET_HVC_FLAG_080 : 447|1@0+ (1,0) [0|1] "" ASDM
 SG_ DET_CONFD_AZIMUTH_080 : 457|2@0+ (1,0) [0|3] "" ASDM
 SG_ DET_CONFD_ELEVATION_080 : 459|2@0+ (1,0) [0|3] "" ASDM
 SG_ DET_AZIMUTH_AMB_ID_080 : 442|3@0+ (1,0) [0|7] "" ASDM
 SG_ DET_AMBG_AZIMUTH_PROB_080 : 446|4@0+ (6.67,0) [0|100] "%" ASDM
 SG_ DET_MH_SCAN_INDEX_4LSB_077_080 : 483|4@0+ (1,0) [0|15] "" ASDM
 SG_ DET_MH_CYCLE_COUNTER_077_080 : 495|8@0+ (1,0) [0|255] "" ASDM
 SG_ DET_MH_CRC16_077_080 : 503|16@0+ (1,0) [0|65535] "" ASDM

BO_ 660 RDR_DETECTION_081_084: 64 G5_RDR04
 SG_ DET_RANGE_081 : 7|15@0+ (0.015625,0) [0|500] "m" ASDM
 SG_ DET_RANGE_ERR_081 : 8|7@0+ (0.0075,0) [0|0.9525] "m" ASDM
 SG_ DET_RANGE_VELOCITY_081 : 17|15@0+ (0.0078125,-128) [-128|127.9921875] "m/s" ASDM
 SG_ DET_RANGE_VELOCITY_ERR_081 : 34|8@0+ (0.003,0) [0|0.765] "m/s" ASDM
 SG_ DET_AZIMUTH_081 : 60|13@0+ (0.0004,-1.5708) [-1.5708|1.5708] "rad" ASDM
 SG_ DET_AZIMUTH_ERR_081 : 78|7@0+ (0.00087267,0) [0|0.11082909] "rad" ASDM
 SG_ DET_ELEVATION_081 : 42|8@0+ (0.00275,-0.34925) [-0.34925|0.34925] "rad" ASDM
 SG_ DET_ELEVATION_ERR_081 : 50|6@0+ (0.00174533,0) [0|0.10995579] "rad" ASDM
 SG_ DET_RCS_081 : 119|8@0+ (0.5,-64) [-64|63.5] "dBsm" ASDM
 SG_ DET_VALID_FLAG_081 : 100|1@0+ (1,0) [0|1] "" ASDM
 SG_ DET_BI_STATIC_FLAG_081 : 487|1@0+ (1,0) [0|1] "" ASDM
 SG_ DET_SUPER_RES_TARGET_081 : 79|1@0+ (1,0) [0|1] "" ASDM
 SG_ DET_SNR_081 : 111|8@0+ (0.35156,0) [0|89.6478] "dB" ASDM
 SG_ DET_POINT_TARGET_PROB_081 : 95|4@0+ (6.67,0) [0|100] "%" ASDM
 SG_ DET_EXISTENCE_PROB_081 : 91|6@0+ (1.588,0) [0|100] "%" ASDM
 SG_ DET_OUTSIDE_SECTOR_081 : 101|1@0+ (1,0) [0|1] "" ASDM
 SG_ DET_HVC_FLAG_081 : 87|1@0+ (1,0) [0|1] "" ASDM
 SG_ DET_CONFD_AZIMUTH_081 : 97|2@0+ (1,0) [0|3] "" ASDM
 SG_ DET_CONFD_ELEVATION_081 : 99|2@0+ (1,0) [0|3] "" ASDM
 SG_ DET_AZIMUTH_AMB_ID_081 : 82|3@0+ (1,0) [0|7] "" ASDM
 SG_ DET_AMBG_AZIMUTH_PROB_081 : 86|4@0+ (6.67,0) [0|100] "%" ASDM
 SG_ DET_RANGE_082 : 127|15@0+ (0.015625,0) [0|500] "m" ASDM
 SG_ DET_RANGE_ERR_082 : 128|7@0+ (0.0075,0) [0|0.9525] "m" ASDM
 SG_ DET_RANGE_VELOCITY_082 : 137|15@0+ (0.0078125,-128) [-128|127.9921875] "m/s" ASDM
 SG_ DET_RANGE_VELOCITY_ERR_082 : 154|8@0+ (0.003,0) [0|0.765] "m/s" ASDM
 SG_ DET_AZIMUTH_082 : 180|13@0+ (0.0004,-1.5708) [-1.5708|1.5708] "rad" ASDM
 SG_ DET_AZIMUTH_ERR_082 : 198|7@0+ (0.00087267,0) [0|0.11082909] "rad" ASDM
 SG_ DET_ELEVATION_082 : 162|8@0+ (0.00275,-0.34925) [-0.34925|0.34925] "rad" ASDM
 SG_ DET_ELEVATION_ERR_082 : 170|6@0+ (0.00174533,0) [0|0.10995579] "rad" ASDM
 SG_ DET_RCS_082 : 239|8@0+ (0.5,-64) [-64|63.5] "dBsm" ASDM
 SG_ DET_VALID_FLAG_082 : 220|1@0+ (1,0) [0|1] "" ASDM
 SG_ DET_BI_STATIC_FLAG_082 : 486|1@0+ (1,0) [0|1] "" ASDM
 SG_ DET_SUPER_RES_TARGET_082 : 199|1@0+ (1,0) [0|1] "" ASDM
 SG_ DET_SNR_082 : 231|8@0+ (0.35156,0) [0|89.6478] "dB" ASDM
 SG_ DET_POINT_TARGET_PROB_082 : 215|4@0+ (6.67,0) [0|100] "%" ASDM
 SG_ DET_EXISTENCE_PROB_082 : 211|6@0+ (1.588,0) [0|100] "%" ASDM
 SG_ DET_OUTSIDE_SECTOR_082 : 221|1@0+ (1,0) [0|1] "" ASDM
 SG_ DET_HVC_FLAG_082 : 207|1@0+ (1,0) [0|1] "" ASDM
 SG_ DET_CONFD_AZIMUTH_082 : 217|2@0+ (1,0) [0|3] "" ASDM
 SG_ DET_CONFD_ELEVATION_082 : 219|2@0+ (1,0) [0|3] "" ASDM
 SG_ DET_AZIMUTH_AMB_ID_082 : 202|3@0+ (1,0) [0|7] "" ASDM
 SG_ DET_AMBG_AZIMUTH_PROB_082 : 206|4@0+ (6.67,0) [0|100] "%" ASDM
 SG_ DET_RANGE_083 : 247|15@0+ (0.015625,0) [0|500] "m" ASDM
 SG_ DET_RANGE_ERR_083 : 248|7@0+ (0.0075,0) [0|0.9525] "m" ASDM
 SG_ DET_RANGE_VELOCITY_083 : 257|15@0+ (0.0078125,-128) [-128|127.9921875] "m/s" ASDM
 SG_ DET_RANGE_VELOCITY_ERR_083 : 274|8@0+ (0.003,0) [0|0.765] "m/s" ASDM
 SG_ DET_AZIMUTH_083 : 300|13@0+ (0.0004,-1.5708) [-1.5708|1.5708] "rad" ASDM
 SG_ DET_AZIMUTH_ERR_083 : 318|7@0+ (0.00087267,0) [0|0.11082909] "rad" ASDM
 SG_ DET_ELEVATION_083 : 282|8@0+ (0.00275,-0.34925) [-0.34925|0.34925] "rad" ASDM
 SG_ DET_ELEVATION_ERR_083 : 290|6@0+ (0.00174533,0) [0|0.10995579] "rad" ASDM
 SG_ DET_RCS_083 : 359|8@0+ (0.5,-64) [-64|63.5] "dBsm" ASDM
 SG_ DET_VALID_FLAG_083 : 340|1@0+ (1,0) [0|1] "" ASDM
 SG_ DET_BI_STATIC_FLAG_083 : 485|1@0+ (1,0) [0|1] "" ASDM
 SG_ DET_SUPER_RES_TARGET_083 : 319|1@0+ (1,0) [0|1] "" ASDM
 SG_ DET_SNR_083 : 351|8@0+ (0.35156,0) [0|89.6478] "dB" ASDM
 SG_ DET_POINT_TARGET_PROB_083 : 335|4@0+ (6.67,0) [0|100] "%" ASDM
 SG_ DET_EXISTENCE_PROB_083 : 331|6@0+ (1.588,0) [0|100] "%" ASDM
 SG_ DET_OUTSIDE_SECTOR_083 : 341|1@0+ (1,0) [0|1] "" ASDM
 SG_ DET_HVC_FLAG_083 : 327|1@0+ (1,0) [0|1] "" ASDM
 SG_ DET_CONFD_AZIMUTH_083 : 337|2@0+ (1,0) [0|3] "" ASDM
 SG_ DET_CONFD_ELEVATION_083 : 339|2@0+ (1,0) [0|3] "" ASDM
 SG_ DET_AZIMUTH_AMB_ID_083 : 322|3@0+ (1,0) [0|7] "" ASDM
 SG_ DET_AMBG_AZIMUTH_PROB_083 : 326|4@0+ (6.67,0) [0|100] "%" ASDM
 SG_ DET_RANGE_084 : 367|15@0+ (0.015625,0) [0|500] "m" ASDM
 SG_ DET_RANGE_ERR_084 : 368|7@0+ (0.0075,0) [0|0.9525] "m" ASDM
 SG_ DET_RANGE_VELOCITY_084 : 377|15@0+ (0.0078125,-128) [-128|127.9921875] "m/s" ASDM
 SG_ DET_RANGE_VELOCITY_ERR_084 : 394|8@0+ (0.003,0) [0|0.765] "m/s" ASDM
 SG_ DET_AZIMUTH_084 : 420|13@0+ (0.0004,-1.5708) [-1.5708|1.5708] "rad" ASDM
 SG_ DET_AZIMUTH_ERR_084 : 438|7@0+ (0.00087267,0) [0|0.11082909] "rad" ASDM
 SG_ DET_ELEVATION_084 : 402|8@0+ (0.00275,-0.34925) [-0.34925|0.34925] "rad" ASDM
 SG_ DET_ELEVATION_ERR_084 : 410|6@0+ (0.00174533,0) [0|0.10995579] "rad" ASDM
 SG_ DET_RCS_084 : 479|8@0+ (0.5,-64) [-64|63.5] "dBsm" ASDM
 SG_ DET_VALID_FLAG_084 : 460|1@0+ (1,0) [0|1] "" ASDM
 SG_ DET_BI_STATIC_FLAG_084 : 484|1@0+ (1,0) [0|1] "" ASDM
 SG_ DET_SUPER_RES_TARGET_084 : 439|1@0+ (1,0) [0|1] "" ASDM
 SG_ DET_SNR_084 : 471|8@0+ (0.35156,0) [0|89.6478] "dB" ASDM
 SG_ DET_POINT_TARGET_PROB_084 : 455|4@0+ (6.67,0) [0|100] "%" ASDM
 SG_ DET_EXISTENCE_PROB_084 : 451|6@0+ (1.588,0) [0|100] "%" ASDM
 SG_ DET_OUTSIDE_SECTOR_084 : 461|1@0+ (1,0) [0|1] "" ASDM
 SG_ DET_HVC_FLAG_084 : 447|1@0+ (1,0) [0|1] "" ASDM
 SG_ DET_CONFD_AZIMUTH_084 : 457|2@0+ (1,0) [0|3] "" ASDM
 SG_ DET_CONFD_ELEVATION_084 : 459|2@0+ (1,0) [0|3] "" ASDM
 SG_ DET_AZIMUTH_AMB_ID_084 : 442|3@0+ (1,0) [0|7] "" ASDM
 SG_ DET_AMBG_AZIMUTH_PROB_084 : 446|4@0+ (6.67,0) [0|100] "%" ASDM
 SG_ DET_MH_SCAN_INDEX_4LSB_081_084 : 483|4@0+ (1,0) [0|15] "" ASDM
 SG_ DET_MH_CYCLE_COUNTER_081_084 : 495|8@0+ (1,0) [0|255] "" ASDM
 SG_ DET_MH_CRC16_081_084 : 503|16@0+ (1,0) [0|65535] "" ASDM

BO_ 661 RDR_DETECTION_085_088: 64 G5_RDR04
 SG_ DET_RANGE_085 : 7|15@0+ (0.015625,0) [0|500] "m" ASDM
 SG_ DET_RANGE_ERR_085 : 8|7@0+ (0.0075,0) [0|0.9525] "m" ASDM
 SG_ DET_RANGE_VELOCITY_085 : 17|15@0+ (0.0078125,-128) [-128|127.9921875] "m/s" ASDM
 SG_ DET_RANGE_VELOCITY_ERR_085 : 34|8@0+ (0.003,0) [0|0.765] "m/s" ASDM
 SG_ DET_AZIMUTH_085 : 60|13@0+ (0.0004,-1.5708) [-1.5708|1.5708] "rad" ASDM
 SG_ DET_AZIMUTH_ERR_085 : 78|7@0+ (0.00087267,0) [0|0.11082909] "rad" ASDM
 SG_ DET_ELEVATION_085 : 42|8@0+ (0.00275,-0.34925) [-0.34925|0.34925] "rad" ASDM
 SG_ DET_ELEVATION_ERR_085 : 50|6@0+ (0.00174533,0) [0|0.10995579] "rad" ASDM
 SG_ DET_RCS_085 : 119|8@0+ (0.5,-64) [-64|63.5] "dBsm" ASDM
 SG_ DET_VALID_FLAG_085 : 100|1@0+ (1,0) [0|1] "" ASDM
 SG_ DET_BI_STATIC_FLAG_085 : 487|1@0+ (1,0) [0|1] "" ASDM
 SG_ DET_SUPER_RES_TARGET_085 : 79|1@0+ (1,0) [0|1] "" ASDM
 SG_ DET_SNR_085 : 111|8@0+ (0.35156,0) [0|89.6478] "dB" ASDM
 SG_ DET_POINT_TARGET_PROB_085 : 95|4@0+ (6.67,0) [0|100] "%" ASDM
 SG_ DET_EXISTENCE_PROB_085 : 91|6@0+ (1.588,0) [0|100] "%" ASDM
 SG_ DET_OUTSIDE_SECTOR_085 : 101|1@0+ (1,0) [0|1] "" ASDM
 SG_ DET_HVC_FLAG_085 : 87|1@0+ (1,0) [0|1] "" ASDM
 SG_ DET_CONFD_AZIMUTH_085 : 97|2@0+ (1,0) [0|3] "" ASDM
 SG_ DET_CONFD_ELEVATION_085 : 99|2@0+ (1,0) [0|3] "" ASDM
 SG_ DET_AZIMUTH_AMB_ID_085 : 82|3@0+ (1,0) [0|7] "" ASDM
 SG_ DET_AMBG_AZIMUTH_PROB_085 : 86|4@0+ (6.67,0) [0|100] "%" ASDM
 SG_ DET_RANGE_086 : 127|15@0+ (0.015625,0) [0|500] "m" ASDM
 SG_ DET_RANGE_ERR_086 : 128|7@0+ (0.0075,0) [0|0.9525] "m" ASDM
 SG_ DET_RANGE_VELOCITY_086 : 137|15@0+ (0.0078125,-128) [-128|127.9921875] "m/s" ASDM
 SG_ DET_RANGE_VELOCITY_ERR_086 : 154|8@0+ (0.003,0) [0|0.765] "m/s" ASDM
 SG_ DET_AZIMUTH_086 : 180|13@0+ (0.0004,-1.5708) [-1.5708|1.5708] "rad" ASDM
 SG_ DET_AZIMUTH_ERR_086 : 198|7@0+ (0.00087267,0) [0|0.11082909] "rad" ASDM
 SG_ DET_ELEVATION_086 : 162|8@0+ (0.00275,-0.34925) [-0.34925|0.34925] "rad" ASDM
 SG_ DET_ELEVATION_ERR_086 : 170|6@0+ (0.00174533,0) [0|0.10995579] "rad" ASDM
 SG_ DET_RCS_086 : 239|8@0+ (0.5,-64) [-64|63.5] "dBsm" ASDM
 SG_ DET_VALID_FLAG_086 : 220|1@0+ (1,0) [0|1] "" ASDM
 SG_ DET_BI_STATIC_FLAG_086 : 486|1@0+ (1,0) [0|1] "" ASDM
 SG_ DET_SUPER_RES_TARGET_086 : 199|1@0+ (1,0) [0|1] "" ASDM
 SG_ DET_SNR_086 : 231|8@0+ (0.35156,0) [0|89.6478] "dB" ASDM
 SG_ DET_POINT_TARGET_PROB_086 : 215|4@0+ (6.67,0) [0|100] "%" ASDM
 SG_ DET_EXISTENCE_PROB_086 : 211|6@0+ (1.588,0) [0|100] "%" ASDM
 SG_ DET_OUTSIDE_SECTOR_086 : 221|1@0+ (1,0) [0|1] "" ASDM
 SG_ DET_HVC_FLAG_086 : 207|1@0+ (1,0) [0|1] "" ASDM
 SG_ DET_CONFD_AZIMUTH_086 : 217|2@0+ (1,0) [0|3] "" ASDM
 SG_ DET_CONFD_ELEVATION_086 : 219|2@0+ (1,0) [0|3] "" ASDM
 SG_ DET_AZIMUTH_AMB_ID_086 : 202|3@0+ (1,0) [0|7] "" ASDM
 SG_ DET_AMBG_AZIMUTH_PROB_086 : 206|4@0+ (6.67,0) [0|100] "%" ASDM
 SG_ DET_RANGE_087 : 247|15@0+ (0.015625,0) [0|500] "m" ASDM
 SG_ DET_RANGE_ERR_087 : 248|7@0+ (0.0075,0) [0|0.9525] "m" ASDM
 SG_ DET_RANGE_VELOCITY_087 : 257|15@0+ (0.0078125,-128) [-128|127.9921875] "m/s" ASDM
 SG_ DET_RANGE_VELOCITY_ERR_087 : 274|8@0+ (0.003,0) [0|0.765] "m/s" ASDM
 SG_ DET_AZIMUTH_087 : 300|13@0+ (0.0004,-1.5708) [-1.5708|1.5708] "rad" ASDM
 SG_ DET_AZIMUTH_ERR_087 : 318|7@0+ (0.00087267,0) [0|0.11082909] "rad" ASDM
 SG_ DET_ELEVATION_087 : 282|8@0+ (0.00275,-0.34925) [-0.34925|0.34925] "rad" ASDM
 SG_ DET_ELEVATION_ERR_087 : 290|6@0+ (0.00174533,0) [0|0.10995579] "rad" ASDM
 SG_ DET_RCS_087 : 359|8@0+ (0.5,-64) [-64|63.5] "dBsm" ASDM
 SG_ DET_VALID_FLAG_087 : 340|1@0+ (1,0) [0|1] "" ASDM
 SG_ DET_BI_STATIC_FLAG_087 : 485|1@0+ (1,0) [0|1] "" ASDM
 SG_ DET_SUPER_RES_TARGET_087 : 319|1@0+ (1,0) [0|1] "" ASDM
 SG_ DET_SNR_087 : 351|8@0+ (0.35156,0) [0|89.6478] "dB" ASDM
 SG_ DET_POINT_TARGET_PROB_087 : 335|4@0+ (6.67,0) [0|100] "%" ASDM
 SG_ DET_EXISTENCE_PROB_087 : 331|6@0+ (1.588,0) [0|100] "%" ASDM
 SG_ DET_OUTSIDE_SECTOR_087 : 341|1@0+ (1,0) [0|1] "" ASDM
 SG_ DET_HVC_FLAG_087 : 327|1@0+ (1,0) [0|1] "" ASDM
 SG_ DET_CONFD_AZIMUTH_087 : 337|2@0+ (1,0) [0|3] "" ASDM
 SG_ DET_CONFD_ELEVATION_087 : 339|2@0+ (1,0) [0|3] "" ASDM
 SG_ DET_AZIMUTH_AMB_ID_087 : 322|3@0+ (1,0) [0|7] "" ASDM
 SG_ DET_AMBG_AZIMUTH_PROB_087 : 326|4@0+ (6.67,0) [0|100] "%" ASDM
 SG_ DET_RANGE_088 : 367|15@0+ (0.015625,0) [0|500] "m" ASDM
 SG_ DET_RANGE_ERR_088 : 368|7@0+ (0.0075,0) [0|0.9525] "m" ASDM
 SG_ DET_RANGE_VELOCITY_088 : 377|15@0+ (0.0078125,-128) [-128|127.9921875] "m/s" ASDM
 SG_ DET_RANGE_VELOCITY_ERR_088 : 394|8@0+ (0.003,0) [0|0.765] "m/s" ASDM
 SG_ DET_AZIMUTH_088 : 420|13@0+ (0.0004,-1.5708) [-1.5708|1.5708] "rad" ASDM
 SG_ DET_AZIMUTH_ERR_088 : 438|7@0+ (0.00087267,0) [0|0.11082909] "rad" ASDM
 SG_ DET_ELEVATION_088 : 402|8@0+ (0.00275,-0.34925) [-0.34925|0.34925] "rad" ASDM
 SG_ DET_ELEVATION_ERR_088 : 410|6@0+ (0.00174533,0) [0|0.10995579] "rad" ASDM
 SG_ DET_RCS_088 : 479|8@0+ (0.5,-64) [-64|63.5] "dBsm" ASDM
 SG_ DET_VALID_FLAG_088 : 460|1@0+ (1,0) [0|1] "" ASDM
 SG_ DET_BI_STATIC_FLAG_088 : 484|1@0+ (1,0) [0|1] "" ASDM
 SG_ DET_SUPER_RES_TARGET_088 : 439|1@0+ (1,0) [0|1] "" ASDM
 SG_ DET_SNR_088 : 471|8@0+ (0.35156,0) [0|89.6478] "dB" ASDM
 SG_ DET_POINT_TARGET_PROB_088 : 455|4@0+ (6.67,0) [0|100] "%" ASDM
 SG_ DET_EXISTENCE_PROB_088 : 451|6@0+ (1.588,0) [0|100] "%" ASDM
 SG_ DET_OUTSIDE_SECTOR_088 : 461|1@0+ (1,0) [0|1] "" ASDM
 SG_ DET_HVC_FLAG_088 : 447|1@0+ (1,0) [0|1] "" ASDM
 SG_ DET_CONFD_AZIMUTH_088 : 457|2@0+ (1,0) [0|3] "" ASDM
 SG_ DET_CONFD_ELEVATION_088 : 459|2@0+ (1,0) [0|3] "" ASDM
 SG_ DET_AZIMUTH_AMB_ID_088 : 442|3@0+ (1,0) [0|7] "" ASDM
 SG_ DET_AMBG_AZIMUTH_PROB_088 : 446|4@0+ (6.67,0) [0|100] "%" ASDM
 SG_ DET_MH_SCAN_INDEX_4LSB_085_088 : 483|4@0+ (1,0) [0|15] "" ASDM
 SG_ DET_MH_CYCLE_COUNTER_085_088 : 495|8@0+ (1,0) [0|255] "" ASDM
 SG_ DET_MH_CRC16_085_088 : 503|16@0+ (1,0) [0|65535] "" ASDM

BO_ 662 RDR_DETECTION_089_092: 64 G5_RDR04
 SG_ DET_RANGE_089 : 7|15@0+ (0.015625,0) [0|500] "m" ASDM
 SG_ DET_RANGE_ERR_089 : 8|7@0+ (0.0075,0) [0|0.9525] "m" ASDM
 SG_ DET_RANGE_VELOCITY_089 : 17|15@0+ (0.0078125,-128) [-128|127.9921875] "m/s" ASDM
 SG_ DET_RANGE_VELOCITY_ERR_089 : 34|8@0+ (0.003,0) [0|0.765] "m/s" ASDM
 SG_ DET_AZIMUTH_089 : 60|13@0+ (0.0004,-1.5708) [-1.5708|1.5708] "rad" ASDM
 SG_ DET_AZIMUTH_ERR_089 : 78|7@0+ (0.00087267,0) [0|0.11082909] "rad" ASDM
 SG_ DET_ELEVATION_089 : 42|8@0+ (0.00275,-0.34925) [-0.34925|0.34925] "rad" ASDM
 SG_ DET_ELEVATION_ERR_089 : 50|6@0+ (0.00174533,0) [0|0.10995579] "rad" ASDM
 SG_ DET_RCS_089 : 119|8@0+ (0.5,-64) [-64|63.5] "dBsm" ASDM
 SG_ DET_VALID_FLAG_089 : 100|1@0+ (1,0) [0|1] "" ASDM
 SG_ DET_BI_STATIC_FLAG_089 : 487|1@0+ (1,0) [0|1] "" ASDM
 SG_ DET_SUPER_RES_TARGET_089 : 79|1@0+ (1,0) [0|1] "" ASDM
 SG_ DET_SNR_089 : 111|8@0+ (0.35156,0) [0|89.6478] "dB" ASDM
 SG_ DET_POINT_TARGET_PROB_089 : 95|4@0+ (6.67,0) [0|100] "%" ASDM
 SG_ DET_EXISTENCE_PROB_089 : 91|6@0+ (1.588,0) [0|100] "%" ASDM
 SG_ DET_OUTSIDE_SECTOR_089 : 101|1@0+ (1,0) [0|1] "" ASDM
 SG_ DET_HVC_FLAG_089 : 87|1@0+ (1,0) [0|1] "" ASDM
 SG_ DET_CONFD_AZIMUTH_089 : 97|2@0+ (1,0) [0|3] "" ASDM
 SG_ DET_CONFD_ELEVATION_089 : 99|2@0+ (1,0) [0|3] "" ASDM
 SG_ DET_AZIMUTH_AMB_ID_089 : 82|3@0+ (1,0) [0|7] "" ASDM
 SG_ DET_AMBG_AZIMUTH_PROB_089 : 86|4@0+ (6.67,0) [0|100] "%" ASDM
 SG_ DET_RANGE_090 : 127|15@0+ (0.015625,0) [0|500] "m" ASDM
 SG_ DET_RANGE_ERR_090 : 128|7@0+ (0.0075,0) [0|0.9525] "m" ASDM
 SG_ DET_RANGE_VELOCITY_090 : 137|15@0+ (0.0078125,-128) [-128|127.9921875] "m/s" ASDM
 SG_ DET_RANGE_VELOCITY_ERR_090 : 154|8@0+ (0.003,0) [0|0.765] "m/s" ASDM
 SG_ DET_AZIMUTH_090 : 180|13@0+ (0.0004,-1.5708) [-1.5708|1.5708] "rad" ASDM
 SG_ DET_AZIMUTH_ERR_090 : 198|7@0+ (0.00087267,0) [0|0.11082909] "rad" ASDM
 SG_ DET_ELEVATION_090 : 162|8@0+ (0.00275,-0.34925) [-0.34925|0.34925] "rad" ASDM
 SG_ DET_ELEVATION_ERR_090 : 170|6@0+ (0.00174533,0) [0|0.10995579] "rad" ASDM
 SG_ DET_RCS_090 : 239|8@0+ (0.5,-64) [-64|63.5] "dBsm" ASDM
 SG_ DET_VALID_FLAG_090 : 220|1@0+ (1,0) [0|1] "" ASDM
 SG_ DET_BI_STATIC_FLAG_090 : 486|1@0+ (1,0) [0|1] "" ASDM
 SG_ DET_SUPER_RES_TARGET_090 : 199|1@0+ (1,0) [0|1] "" ASDM
 SG_ DET_SNR_090 : 231|8@0+ (0.35156,0) [0|89.6478] "dB" ASDM
 SG_ DET_POINT_TARGET_PROB_090 : 215|4@0+ (6.67,0) [0|100] "%" ASDM
 SG_ DET_EXISTENCE_PROB_090 : 211|6@0+ (1.588,0) [0|100] "%" ASDM
 SG_ DET_OUTSIDE_SECTOR_090 : 221|1@0+ (1,0) [0|1] "" ASDM
 SG_ DET_HVC_FLAG_090 : 207|1@0+ (1,0) [0|1] "" ASDM
 SG_ DET_CONFD_AZIMUTH_090 : 217|2@0+ (1,0) [0|3] "" ASDM
 SG_ DET_CONFD_ELEVATION_090 : 219|2@0+ (1,0) [0|3] "" ASDM
 SG_ DET_AZIMUTH_AMB_ID_090 : 202|3@0+ (1,0) [0|7] "" ASDM
 SG_ DET_AMBG_AZIMUTH_PROB_090 : 206|4@0+ (6.67,0) [0|100] "%" ASDM
 SG_ DET_RANGE_091 : 247|15@0+ (0.015625,0) [0|500] "m" ASDM
 SG_ DET_RANGE_ERR_091 : 248|7@0+ (0.0075,0) [0|0.9525] "m" ASDM
 SG_ DET_RANGE_VELOCITY_091 : 257|15@0+ (0.0078125,-128) [-128|127.9921875] "m/s" ASDM
 SG_ DET_RANGE_VELOCITY_ERR_091 : 274|8@0+ (0.003,0) [0|0.765] "m/s" ASDM
 SG_ DET_AZIMUTH_091 : 300|13@0+ (0.0004,-1.5708) [-1.5708|1.5708] "rad" ASDM
 SG_ DET_AZIMUTH_ERR_091 : 318|7@0+ (0.00087267,0) [0|0.11082909] "rad" ASDM
 SG_ DET_ELEVATION_091 : 282|8@0+ (0.00275,-0.34925) [-0.34925|0.34925] "rad" ASDM
 SG_ DET_ELEVATION_ERR_091 : 290|6@0+ (0.00174533,0) [0|0.10995579] "rad" ASDM
 SG_ DET_RCS_091 : 359|8@0+ (0.5,-64) [-64|63.5] "dBsm" ASDM
 SG_ DET_VALID_FLAG_091 : 340|1@0+ (1,0) [0|1] "" ASDM
 SG_ DET_BI_STATIC_FLAG_091 : 485|1@0+ (1,0) [0|1] "" ASDM
 SG_ DET_SUPER_RES_TARGET_091 : 319|1@0+ (1,0) [0|1] "" ASDM
 SG_ DET_SNR_091 : 351|8@0+ (0.35156,0) [0|89.6478] "dB" ASDM
 SG_ DET_POINT_TARGET_PROB_091 : 335|4@0+ (6.67,0) [0|100] "%" ASDM
 SG_ DET_EXISTENCE_PROB_091 : 331|6@0+ (1.588,0) [0|100] "%" ASDM
 SG_ DET_OUTSIDE_SECTOR_091 : 341|1@0+ (1,0) [0|1] "" ASDM
 SG_ DET_HVC_FLAG_091 : 327|1@0+ (1,0) [0|1] "" ASDM
 SG_ DET_CONFD_AZIMUTH_091 : 337|2@0+ (1,0) [0|3] "" ASDM
 SG_ DET_CONFD_ELEVATION_091 : 339|2@0+ (1,0) [0|3] "" ASDM
 SG_ DET_AZIMUTH_AMB_ID_091 : 322|3@0+ (1,0) [0|7] "" ASDM
 SG_ DET_AMBG_AZIMUTH_PROB_091 : 326|4@0+ (6.67,0) [0|100] "%" ASDM
 SG_ DET_RANGE_092 : 367|15@0+ (0.015625,0) [0|500] "m" ASDM
 SG_ DET_RANGE_ERR_092 : 368|7@0+ (0.0075,0) [0|0.9525] "m" ASDM
 SG_ DET_RANGE_VELOCITY_092 : 377|15@0+ (0.0078125,-128) [-128|127.9921875] "m/s" ASDM
 SG_ DET_RANGE_VELOCITY_ERR_092 : 394|8@0+ (0.003,0) [0|0.765] "m/s" ASDM
 SG_ DET_AZIMUTH_092 : 420|13@0+ (0.0004,-1.5708) [-1.5708|1.5708] "rad" ASDM
 SG_ DET_AZIMUTH_ERR_092 : 438|7@0+ (0.00087267,0) [0|0.11082909] "rad" ASDM
 SG_ DET_ELEVATION_092 : 402|8@0+ (0.00275,-0.34925) [-0.34925|0.34925] "rad" ASDM
 SG_ DET_ELEVATION_ERR_092 : 410|6@0+ (0.00174533,0) [0|0.10995579] "rad" ASDM
 SG_ DET_RCS_092 : 479|8@0+ (0.5,-64) [-64|63.5] "dBsm" ASDM
 SG_ DET_VALID_FLAG_092 : 460|1@0+ (1,0) [0|1] "" ASDM
 SG_ DET_BI_STATIC_FLAG_092 : 484|1@0+ (1,0) [0|1] "" ASDM
 SG_ DET_SUPER_RES_TARGET_092 : 439|1@0+ (1,0) [0|1] "" ASDM
 SG_ DET_SNR_092 : 471|8@0+ (0.35156,0) [0|89.6478] "dB" ASDM
 SG_ DET_POINT_TARGET_PROB_092 : 455|4@0+ (6.67,0) [0|100] "%" ASDM
 SG_ DET_EXISTENCE_PROB_092 : 451|6@0+ (1.588,0) [0|100] "%" ASDM
 SG_ DET_OUTSIDE_SECTOR_092 : 461|1@0+ (1,0) [0|1] "" ASDM
 SG_ DET_HVC_FLAG_092 : 447|1@0+ (1,0) [0|1] "" ASDM
 SG_ DET_CONFD_AZIMUTH_092 : 457|2@0+ (1,0) [0|3] "" ASDM
 SG_ DET_CONFD_ELEVATION_092 : 459|2@0+ (1,0) [0|3] "" ASDM
 SG_ DET_AZIMUTH_AMB_ID_092 : 442|3@0+ (1,0) [0|7] "" ASDM
 SG_ DET_AMBG_AZIMUTH_PROB_092 : 446|4@0+ (6.67,0) [0|100] "%" ASDM
 SG_ DET_MH_SCAN_INDEX_4LSB_089_092 : 483|4@0+ (1,0) [0|15] "" ASDM
 SG_ DET_MH_CYCLE_COUNTER_089_092 : 495|8@0+ (1,0) [0|255] "" ASDM
 SG_ DET_MH_CRC16_089_092 : 503|16@0+ (1,0) [0|65535] "" ASDM

BO_ 663 RDR_DETECTION_093_096: 64 G5_RDR04
 SG_ DET_RANGE_093 : 7|15@0+ (0.015625,0) [0|500] "m" ASDM
 SG_ DET_RANGE_ERR_093 : 8|7@0+ (0.0075,0) [0|0.9525] "m" ASDM
 SG_ DET_RANGE_VELOCITY_093 : 17|15@0+ (0.0078125,-128) [-128|127.9921875] "m/s" ASDM
 SG_ DET_RANGE_VELOCITY_ERR_093 : 34|8@0+ (0.003,0) [0|0.765] "m/s" ASDM
 SG_ DET_AZIMUTH_093 : 60|13@0+ (0.0004,-1.5708) [-1.5708|1.5708] "rad" ASDM
 SG_ DET_AZIMUTH_ERR_093 : 78|7@0+ (0.00087267,0) [0|0.11082909] "rad" ASDM
 SG_ DET_ELEVATION_093 : 42|8@0+ (0.00275,-0.34925) [-0.34925|0.34925] "rad" ASDM
 SG_ DET_ELEVATION_ERR_093 : 50|6@0+ (0.00174533,0) [0|0.10995579] "rad" ASDM
 SG_ DET_RCS_093 : 119|8@0+ (0.5,-64) [-64|63.5] "dBsm" ASDM
 SG_ DET_VALID_FLAG_093 : 100|1@0+ (1,0) [0|1] "" ASDM
 SG_ DET_BI_STATIC_FLAG_093 : 487|1@0+ (1,0) [0|1] "" ASDM
 SG_ DET_SUPER_RES_TARGET_093 : 79|1@0+ (1,0) [0|1] "" ASDM
 SG_ DET_SNR_093 : 111|8@0+ (0.35156,0) [0|89.6478] "dB" ASDM
 SG_ DET_POINT_TARGET_PROB_093 : 95|4@0+ (6.67,0) [0|100] "%" ASDM
 SG_ DET_EXISTENCE_PROB_093 : 91|6@0+ (1.588,0) [0|100] "%" ASDM
 SG_ DET_OUTSIDE_SECTOR_093 : 101|1@0+ (1,0) [0|1] "" ASDM
 SG_ DET_HVC_FLAG_093 : 87|1@0+ (1,0) [0|1] "" ASDM
 SG_ DET_CONFD_AZIMUTH_093 : 97|2@0+ (1,0) [0|3] "" ASDM
 SG_ DET_CONFD_ELEVATION_093 : 99|2@0+ (1,0) [0|3] "" ASDM
 SG_ DET_AZIMUTH_AMB_ID_093 : 82|3@0+ (1,0) [0|7] "" ASDM
 SG_ DET_AMBG_AZIMUTH_PROB_093 : 86|4@0+ (6.67,0) [0|100] "%" ASDM
 SG_ DET_RANGE_094 : 127|15@0+ (0.015625,0) [0|500] "m" ASDM
 SG_ DET_RANGE_ERR_094 : 128|7@0+ (0.0075,0) [0|0.9525] "m" ASDM
 SG_ DET_RANGE_VELOCITY_094 : 137|15@0+ (0.0078125,-128) [-128|127.9921875] "m/s" ASDM
 SG_ DET_RANGE_VELOCITY_ERR_094 : 154|8@0+ (0.003,0) [0|0.765] "m/s" ASDM
 SG_ DET_AZIMUTH_094 : 180|13@0+ (0.0004,-1.5708) [-1.5708|1.5708] "rad" ASDM
 SG_ DET_AZIMUTH_ERR_094 : 198|7@0+ (0.00087267,0) [0|0.11082909] "rad" ASDM
 SG_ DET_ELEVATION_094 : 162|8@0+ (0.00275,-0.34925) [-0.34925|0.34925] "rad" ASDM
 SG_ DET_ELEVATION_ERR_094 : 170|6@0+ (0.00174533,0) [0|0.10995579] "rad" ASDM
 SG_ DET_RCS_094 : 239|8@0+ (0.5,-64) [-64|63.5] "dBsm" ASDM
 SG_ DET_VALID_FLAG_094 : 220|1@0+ (1,0) [0|1] "" ASDM
 SG_ DET_BI_STATIC_FLAG_094 : 486|1@0+ (1,0) [0|1] "" ASDM
 SG_ DET_SUPER_RES_TARGET_094 : 199|1@0+ (1,0) [0|1] "" ASDM
 SG_ DET_SNR_094 : 231|8@0+ (0.35156,0) [0|89.6478] "dB" ASDM
 SG_ DET_POINT_TARGET_PROB_094 : 215|4@0+ (6.67,0) [0|100] "%" ASDM
 SG_ DET_EXISTENCE_PROB_094 : 211|6@0+ (1.588,0) [0|100] "%" ASDM
 SG_ DET_OUTSIDE_SECTOR_094 : 221|1@0+ (1,0) [0|1] "" ASDM
 SG_ DET_HVC_FLAG_094 : 207|1@0+ (1,0) [0|1] "" ASDM
 SG_ DET_CONFD_AZIMUTH_094 : 217|2@0+ (1,0) [0|3] "" ASDM
 SG_ DET_CONFD_ELEVATION_094 : 219|2@0+ (1,0) [0|3] "" ASDM
 SG_ DET_AZIMUTH_AMB_ID_094 : 202|3@0+ (1,0) [0|7] "" ASDM
 SG_ DET_AMBG_AZIMUTH_PROB_094 : 206|4@0+ (6.67,0) [0|100] "%" ASDM
 SG_ DET_RANGE_095 : 247|15@0+ (0.015625,0) [0|500] "m" ASDM
 SG_ DET_RANGE_ERR_095 : 248|7@0+ (0.0075,0) [0|0.9525] "m" ASDM
 SG_ DET_RANGE_VELOCITY_095 : 257|15@0+ (0.0078125,-128) [-128|127.9921875] "m/s" ASDM
 SG_ DET_RANGE_VELOCITY_ERR_095 : 274|8@0+ (0.003,0) [0|0.765] "m/s" ASDM
 SG_ DET_AZIMUTH_095 : 300|13@0+ (0.0004,-1.5708) [-1.5708|1.5708] "rad" ASDM
 SG_ DET_AZIMUTH_ERR_095 : 318|7@0+ (0.00087267,0) [0|0.11082909] "rad" ASDM
 SG_ DET_ELEVATION_095 : 282|8@0+ (0.00275,-0.34925) [-0.34925|0.34925] "rad" ASDM
 SG_ DET_ELEVATION_ERR_095 : 290|6@0+ (0.00174533,0) [0|0.10995579] "rad" ASDM
 SG_ DET_RCS_095 : 359|8@0+ (0.5,-64) [-64|63.5] "dBsm" ASDM
 SG_ DET_VALID_FLAG_095 : 340|1@0+ (1,0) [0|1] "" ASDM
 SG_ DET_BI_STATIC_FLAG_095 : 485|1@0+ (1,0) [0|1] "" ASDM
 SG_ DET_SUPER_RES_TARGET_095 : 319|1@0+ (1,0) [0|1] "" ASDM
 SG_ DET_SNR_095 : 351|8@0+ (0.35156,0) [0|89.6478] "dB" ASDM
 SG_ DET_POINT_TARGET_PROB_095 : 335|4@0+ (6.67,0) [0|100] "%" ASDM
 SG_ DET_EXISTENCE_PROB_095 : 331|6@0+ (1.588,0) [0|100] "%" ASDM
 SG_ DET_OUTSIDE_SECTOR_095 : 341|1@0+ (1,0) [0|1] "" ASDM
 SG_ DET_HVC_FLAG_095 : 327|1@0+ (1,0) [0|1] "" ASDM
 SG_ DET_CONFD_AZIMUTH_095 : 337|2@0+ (1,0) [0|3] "" ASDM
 SG_ DET_CONFD_ELEVATION_095 : 339|2@0+ (1,0) [0|3] "" ASDM
 SG_ DET_AZIMUTH_AMB_ID_095 : 322|3@0+ (1,0) [0|7] "" ASDM
 SG_ DET_AMBG_AZIMUTH_PROB_095 : 326|4@0+ (6.67,0) [0|100] "%" ASDM
 SG_ DET_RANGE_096 : 367|15@0+ (0.015625,0) [0|500] "m" ASDM
 SG_ DET_RANGE_ERR_096 : 368|7@0+ (0.0075,0) [0|0.9525] "m" ASDM
 SG_ DET_RANGE_VELOCITY_096 : 377|15@0+ (0.0078125,-128) [-128|127.9921875] "m/s" ASDM
 SG_ DET_RANGE_VELOCITY_ERR_096 : 394|8@0+ (0.003,0) [0|0.765] "m/s" ASDM
 SG_ DET_AZIMUTH_096 : 420|13@0+ (0.0004,-1.5708) [-1.5708|1.5708] "rad" ASDM
 SG_ DET_AZIMUTH_ERR_096 : 438|7@0+ (0.00087267,0) [0|0.11082909] "rad" ASDM
 SG_ DET_ELEVATION_096 : 402|8@0+ (0.00275,-0.34925) [-0.34925|0.34925] "rad" ASDM
 SG_ DET_ELEVATION_ERR_096 : 410|6@0+ (0.00174533,0) [0|0.10995579] "rad" ASDM
 SG_ DET_RCS_096 : 479|8@0+ (0.5,-64) [-64|63.5] "dBsm" ASDM
 SG_ DET_VALID_FLAG_096 : 460|1@0+ (1,0) [0|1] "" ASDM
 SG_ DET_BI_STATIC_FLAG_096 : 484|1@0+ (1,0) [0|1] "" ASDM
 SG_ DET_SUPER_RES_TARGET_096 : 439|1@0+ (1,0) [0|1] "" ASDM
 SG_ DET_SNR_096 : 471|8@0+ (0.35156,0) [0|89.6478] "dB" ASDM
 SG_ DET_POINT_TARGET_PROB_096 : 455|4@0+ (6.67,0) [0|100] "%" ASDM
 SG_ DET_EXISTENCE_PROB_096 : 451|6@0+ (1.588,0) [0|100] "%" ASDM
 SG_ DET_OUTSIDE_SECTOR_096 : 461|1@0+ (1,0) [0|1] "" ASDM
 SG_ DET_HVC_FLAG_096 : 447|1@0+ (1,0) [0|1] "" ASDM
 SG_ DET_CONFD_AZIMUTH_096 : 457|2@0+ (1,0) [0|3] "" ASDM
 SG_ DET_CONFD_ELEVATION_096 : 459|2@0+ (1,0) [0|3] "" ASDM
 SG_ DET_AZIMUTH_AMB_ID_096 : 442|3@0+ (1,0) [0|7] "" ASDM
 SG_ DET_AMBG_AZIMUTH_PROB_096 : 446|4@0+ (6.67,0) [0|100] "%" ASDM
 SG_ DET_MH_SCAN_INDEX_4LSB_093_096 : 483|4@0+ (1,0) [0|15] "" ASDM
 SG_ DET_MH_CYCLE_COUNTER_093_096 : 495|8@0+ (1,0) [0|255] "" ASDM
 SG_ DET_MH_CRC16_093_096 : 503|16@0+ (1,0) [0|65535] "" ASDM

BO_ 664 RDR_DETECTION_097_100: 64 G5_RDR04
 SG_ DET_RANGE_097 : 7|15@0+ (0.015625,0) [0|500] "m" ASDM
 SG_ DET_RANGE_ERR_097 : 8|7@0+ (0.0075,0) [0|0.9525] "m" ASDM
 SG_ DET_RANGE_VELOCITY_097 : 17|15@0+ (0.0078125,-128) [-128|127.9921875] "m/s" ASDM
 SG_ DET_RANGE_VELOCITY_ERR_097 : 34|8@0+ (0.003,0) [0|0.765] "m/s" ASDM
 SG_ DET_AZIMUTH_097 : 60|13@0+ (0.0004,-1.5708) [-1.5708|1.5708] "rad" ASDM
 SG_ DET_AZIMUTH_ERR_097 : 78|7@0+ (0.00087267,0) [0|0.11082909] "rad" ASDM
 SG_ DET_ELEVATION_097 : 42|8@0+ (0.00275,-0.34925) [-0.34925|0.34925] "rad" ASDM
 SG_ DET_ELEVATION_ERR_097 : 50|6@0+ (0.00174533,0) [0|0.10995579] "rad" ASDM
 SG_ DET_RCS_097 : 119|8@0+ (0.5,-64) [-64|63.5] "dBsm" ASDM
 SG_ DET_VALID_FLAG_097 : 100|1@0+ (1,0) [0|1] "" ASDM
 SG_ DET_BI_STATIC_FLAG_097 : 487|1@0+ (1,0) [0|1] "" ASDM
 SG_ DET_SUPER_RES_TARGET_097 : 79|1@0+ (1,0) [0|1] "" ASDM
 SG_ DET_SNR_097 : 111|8@0+ (0.35156,0) [0|89.6478] "dB" ASDM
 SG_ DET_POINT_TARGET_PROB_097 : 95|4@0+ (6.67,0) [0|100] "%" ASDM
 SG_ DET_EXISTENCE_PROB_097 : 91|6@0+ (1.588,0) [0|100] "%" ASDM
 SG_ DET_OUTSIDE_SECTOR_097 : 101|1@0+ (1,0) [0|1] "" ASDM
 SG_ DET_HVC_FLAG_097 : 87|1@0+ (1,0) [0|1] "" ASDM
 SG_ DET_CONFD_AZIMUTH_097 : 97|2@0+ (1,0) [0|3] "" ASDM
 SG_ DET_CONFD_ELEVATION_097 : 99|2@0+ (1,0) [0|3] "" ASDM
 SG_ DET_AZIMUTH_AMB_ID_097 : 82|3@0+ (1,0) [0|7] "" ASDM
 SG_ DET_AMBG_AZIMUTH_PROB_097 : 86|4@0+ (6.67,0) [0|100] "%" ASDM
 SG_ DET_RANGE_098 : 127|15@0+ (0.015625,0) [0|500] "m" ASDM
 SG_ DET_RANGE_ERR_098 : 128|7@0+ (0.0075,0) [0|0.9525] "m" ASDM
 SG_ DET_RANGE_VELOCITY_098 : 137|15@0+ (0.0078125,-128) [-128|127.9921875] "m/s" ASDM
 SG_ DET_RANGE_VELOCITY_ERR_098 : 154|8@0+ (0.003,0) [0|0.765] "m/s" ASDM
 SG_ DET_AZIMUTH_098 : 180|13@0+ (0.0004,-1.5708) [-1.5708|1.5708] "rad" ASDM
 SG_ DET_AZIMUTH_ERR_098 : 198|7@0+ (0.00087267,0) [0|0.11082909] "rad" ASDM
 SG_ DET_ELEVATION_098 : 162|8@0+ (0.00275,-0.34925) [-0.34925|0.34925] "rad" ASDM
 SG_ DET_ELEVATION_ERR_098 : 170|6@0+ (0.00174533,0) [0|0.10995579] "rad" ASDM
 SG_ DET_RCS_098 : 239|8@0+ (0.5,-64) [-64|63.5] "dBsm" ASDM
 SG_ DET_VALID_FLAG_098 : 220|1@0+ (1,0) [0|1] "" ASDM
 SG_ DET_BI_STATIC_FLAG_098 : 486|1@0+ (1,0) [0|1] "" ASDM
 SG_ DET_SUPER_RES_TARGET_098 : 199|1@0+ (1,0) [0|1] "" ASDM
 SG_ DET_SNR_098 : 231|8@0+ (0.35156,0) [0|89.6478] "dB" ASDM
 SG_ DET_POINT_TARGET_PROB_098 : 215|4@0+ (6.67,0) [0|100] "%" ASDM
 SG_ DET_EXISTENCE_PROB_098 : 211|6@0+ (1.588,0) [0|100] "%" ASDM
 SG_ DET_OUTSIDE_SECTOR_098 : 221|1@0+ (1,0) [0|1] "" ASDM
 SG_ DET_HVC_FLAG_098 : 207|1@0+ (1,0) [0|1] "" ASDM
 SG_ DET_CONFD_AZIMUTH_098 : 217|2@0+ (1,0) [0|3] "" ASDM
 SG_ DET_CONFD_ELEVATION_098 : 219|2@0+ (1,0) [0|3] "" ASDM
 SG_ DET_AZIMUTH_AMB_ID_098 : 202|3@0+ (1,0) [0|7] "" ASDM
 SG_ DET_AMBG_AZIMUTH_PROB_098 : 206|4@0+ (6.67,0) [0|100] "%" ASDM
 SG_ DET_RANGE_099 : 247|15@0+ (0.015625,0) [0|500] "m" ASDM
 SG_ DET_RANGE_ERR_099 : 248|7@0+ (0.0075,0) [0|0.9525] "m" ASDM
 SG_ DET_RANGE_VELOCITY_099 : 257|15@0+ (0.0078125,-128) [-128|127.9921875] "m/s" ASDM
 SG_ DET_RANGE_VELOCITY_ERR_099 : 274|8@0+ (0.003,0) [0|0.765] "m/s" ASDM
 SG_ DET_AZIMUTH_099 : 300|13@0+ (0.0004,-1.5708) [-1.5708|1.5708] "rad" ASDM
 SG_ DET_AZIMUTH_ERR_099 : 318|7@0+ (0.00087267,0) [0|0.11082909] "rad" ASDM
 SG_ DET_ELEVATION_099 : 282|8@0+ (0.00275,-0.34925) [-0.34925|0.34925] "rad" ASDM
 SG_ DET_ELEVATION_ERR_099 : 290|6@0+ (0.00174533,0) [0|0.10995579] "rad" ASDM
 SG_ DET_RCS_099 : 359|8@0+ (0.5,-64) [-64|63.5] "dBsm" ASDM
 SG_ DET_VALID_FLAG_099 : 340|1@0+ (1,0) [0|1] "" ASDM
 SG_ DET_BI_STATIC_FLAG_099 : 485|1@0+ (1,0) [0|1] "" ASDM
 SG_ DET_SUPER_RES_TARGET_099 : 319|1@0+ (1,0) [0|1] "" ASDM
 SG_ DET_SNR_099 : 351|8@0+ (0.35156,0) [0|89.6478] "dB" ASDM
 SG_ DET_POINT_TARGET_PROB_099 : 335|4@0+ (6.67,0) [0|100] "%" ASDM
 SG_ DET_EXISTENCE_PROB_099 : 331|6@0+ (1.588,0) [0|100] "%" ASDM
 SG_ DET_OUTSIDE_SECTOR_099 : 341|1@0+ (1,0) [0|1] "" ASDM
 SG_ DET_HVC_FLAG_099 : 327|1@0+ (1,0) [0|1] "" ASDM
 SG_ DET_CONFD_AZIMUTH_099 : 337|2@0+ (1,0) [0|3] "" ASDM
 SG_ DET_CONFD_ELEVATION_099 : 339|2@0+ (1,0) [0|3] "" ASDM
 SG_ DET_AZIMUTH_AMB_ID_099 : 322|3@0+ (1,0) [0|7] "" ASDM
 SG_ DET_AMBG_AZIMUTH_PROB_099 : 326|4@0+ (6.67,0) [0|100] "%" ASDM
 SG_ DET_RANGE_100 : 367|15@0+ (0.015625,0) [0|500] "m" ASDM
 SG_ DET_RANGE_ERR_100 : 368|7@0+ (0.0075,0) [0|0.9525] "m" ASDM
 SG_ DET_RANGE_VELOCITY_100 : 377|15@0+ (0.0078125,-128) [-128|127.9921875] "m/s" ASDM
 SG_ DET_RANGE_VELOCITY_ERR_100 : 394|8@0+ (0.003,0) [0|0.765] "m/s" ASDM
 SG_ DET_AZIMUTH_100 : 420|13@0+ (0.0004,-1.5708) [-1.5708|1.5708] "rad" ASDM
 SG_ DET_AZIMUTH_ERR_100 : 438|7@0+ (0.00087267,0) [0|0.11082909] "rad" ASDM
 SG_ DET_ELEVATION_100 : 402|8@0+ (0.00275,-0.34925) [-0.34925|0.34925] "rad" ASDM
 SG_ DET_ELEVATION_ERR_100 : 410|6@0+ (0.00174533,0) [0|0.10995579] "rad" ASDM
 SG_ DET_RCS_100 : 479|8@0+ (0.5,-64) [-64|63.5] "dBsm" ASDM
 SG_ DET_VALID_FLAG_100 : 460|1@0+ (1,0) [0|1] "" ASDM
 SG_ DET_BI_STATIC_FLAG_100 : 484|1@0+ (1,0) [0|1] "" ASDM
 SG_ DET_SUPER_RES_TARGET_100 : 439|1@0+ (1,0) [0|1] "" ASDM
 SG_ DET_SNR_100 : 471|8@0+ (0.35156,0) [0|89.6478] "dB" ASDM
 SG_ DET_POINT_TARGET_PROB_100 : 455|4@0+ (6.67,0) [0|100] "%" ASDM
 SG_ DET_EXISTENCE_PROB_100 : 451|6@0+ (1.588,0) [0|100] "%" ASDM
 SG_ DET_OUTSIDE_SECTOR_100 : 461|1@0+ (1,0) [0|1] "" ASDM
 SG_ DET_HVC_FLAG_100 : 447|1@0+ (1,0) [0|1] "" ASDM
 SG_ DET_CONFD_AZIMUTH_100 : 457|2@0+ (1,0) [0|3] "" ASDM
 SG_ DET_CONFD_ELEVATION_100 : 459|2@0+ (1,0) [0|3] "" ASDM
 SG_ DET_AZIMUTH_AMB_ID_100 : 442|3@0+ (1,0) [0|7] "" ASDM
 SG_ DET_AMBG_AZIMUTH_PROB_100 : 446|4@0+ (6.67,0) [0|100] "%" ASDM
 SG_ DET_MH_SCAN_INDEX_4LSB_097_100 : 483|4@0+ (1,0) [0|15] "" ASDM
 SG_ DET_MH_CYCLE_COUNTER_097_100 : 495|8@0+ (1,0) [0|255] "" ASDM
 SG_ DET_MH_CRC16_097_100 : 503|16@0+ (1,0) [0|65535] "" ASDM

BO_ 665 RDR_DETECTION_101_104: 64 G5_RDR04
 SG_ DET_RANGE_101 : 7|15@0+ (0.015625,0) [0|500] "m" ASDM
 SG_ DET_RANGE_ERR_101 : 8|7@0+ (0.0075,0) [0|0.9525] "m" ASDM
 SG_ DET_RANGE_VELOCITY_101 : 17|15@0+ (0.0078125,-128) [-128|127.9921875] "m/s" ASDM
 SG_ DET_RANGE_VELOCITY_ERR_101 : 34|8@0+ (0.003,0) [0|0.765] "m/s" ASDM
 SG_ DET_AZIMUTH_101 : 60|13@0+ (0.0004,-1.5708) [-1.5708|1.5708] "rad" ASDM
 SG_ DET_AZIMUTH_ERR_101 : 78|7@0+ (0.00087267,0) [0|0.11082909] "rad" ASDM
 SG_ DET_ELEVATION_101 : 42|8@0+ (0.00275,-0.34925) [-0.34925|0.34925] "rad" ASDM
 SG_ DET_ELEVATION_ERR_101 : 50|6@0+ (0.00174533,0) [0|0.10995579] "rad" ASDM
 SG_ DET_RCS_101 : 119|8@0+ (0.5,-64) [-64|63.5] "dBsm" ASDM
 SG_ DET_VALID_FLAG_101 : 100|1@0+ (1,0) [0|1] "" ASDM
 SG_ DET_BI_STATIC_FLAG_101 : 487|1@0+ (1,0) [0|1] "" ASDM
 SG_ DET_SUPER_RES_TARGET_101 : 79|1@0+ (1,0) [0|1] "" ASDM
 SG_ DET_SNR_101 : 111|8@0+ (0.35156,0) [0|89.6478] "dB" ASDM
 SG_ DET_POINT_TARGET_PROB_101 : 95|4@0+ (6.67,0) [0|100] "%" ASDM
 SG_ DET_EXISTENCE_PROB_101 : 91|6@0+ (1.588,0) [0|100] "%" ASDM
 SG_ DET_OUTSIDE_SECTOR_101 : 101|1@0+ (1,0) [0|1] "" ASDM
 SG_ DET_HVC_FLAG_101 : 87|1@0+ (1,0) [0|1] "" ASDM
 SG_ DET_CONFD_AZIMUTH_101 : 97|2@0+ (1,0) [0|3] "" ASDM
 SG_ DET_CONFD_ELEVATION_101 : 99|2@0+ (1,0) [0|3] "" ASDM
 SG_ DET_AZIMUTH_AMB_ID_101 : 82|3@0+ (1,0) [0|7] "" ASDM
 SG_ DET_AMBG_AZIMUTH_PROB_101 : 86|4@0+ (6.67,0) [0|100] "%" ASDM
 SG_ DET_RANGE_102 : 127|15@0+ (0.015625,0) [0|500] "m" ASDM
 SG_ DET_RANGE_ERR_102 : 128|7@0+ (0.0075,0) [0|0.9525] "m" ASDM
 SG_ DET_RANGE_VELOCITY_102 : 137|15@0+ (0.0078125,-128) [-128|127.9921875] "m/s" ASDM
 SG_ DET_RANGE_VELOCITY_ERR_102 : 154|8@0+ (0.003,0) [0|0.765] "m/s" ASDM
 SG_ DET_AZIMUTH_102 : 180|13@0+ (0.0004,-1.5708) [-1.5708|1.5708] "rad" ASDM
 SG_ DET_AZIMUTH_ERR_102 : 198|7@0+ (0.00087267,0) [0|0.11082909] "rad" ASDM
 SG_ DET_ELEVATION_102 : 162|8@0+ (0.00275,-0.34925) [-0.34925|0.34925] "rad" ASDM
 SG_ DET_ELEVATION_ERR_102 : 170|6@0+ (0.00174533,0) [0|0.10995579] "rad" ASDM
 SG_ DET_RCS_102 : 239|8@0+ (0.5,-64) [-64|63.5] "dBsm" ASDM
 SG_ DET_VALID_FLAG_102 : 220|1@0+ (1,0) [0|1] "" ASDM
 SG_ DET_BI_STATIC_FLAG_102 : 486|1@0+ (1,0) [0|1] "" ASDM
 SG_ DET_SUPER_RES_TARGET_102 : 199|1@0+ (1,0) [0|1] "" ASDM
 SG_ DET_SNR_102 : 231|8@0+ (0.35156,0) [0|89.6478] "dB" ASDM
 SG_ DET_POINT_TARGET_PROB_102 : 215|4@0+ (6.67,0) [0|100] "%" ASDM
 SG_ DET_EXISTENCE_PROB_102 : 211|6@0+ (1.588,0) [0|100] "%" ASDM
 SG_ DET_OUTSIDE_SECTOR_102 : 221|1@0+ (1,0) [0|1] "" ASDM
 SG_ DET_HVC_FLAG_102 : 207|1@0+ (1,0) [0|1] "" ASDM
 SG_ DET_CONFD_AZIMUTH_102 : 217|2@0+ (1,0) [0|3] "" ASDM
 SG_ DET_CONFD_ELEVATION_102 : 219|2@0+ (1,0) [0|3] "" ASDM
 SG_ DET_AZIMUTH_AMB_ID_102 : 202|3@0+ (1,0) [0|7] "" ASDM
 SG_ DET_AMBG_AZIMUTH_PROB_102 : 206|4@0+ (6.67,0) [0|100] "%" ASDM
 SG_ DET_RANGE_103 : 247|15@0+ (0.015625,0) [0|500] "m" ASDM
 SG_ DET_RANGE_ERR_103 : 248|7@0+ (0.0075,0) [0|0.9525] "m" ASDM
 SG_ DET_RANGE_VELOCITY_103 : 257|15@0+ (0.0078125,-128) [-128|127.9921875] "m/s" ASDM
 SG_ DET_RANGE_VELOCITY_ERR_103 : 274|8@0+ (0.003,0) [0|0.765] "m/s" ASDM
 SG_ DET_AZIMUTH_103 : 300|13@0+ (0.0004,-1.5708) [-1.5708|1.5708] "rad" ASDM
 SG_ DET_AZIMUTH_ERR_103 : 318|7@0+ (0.00087267,0) [0|0.11082909] "rad" ASDM
 SG_ DET_ELEVATION_103 : 282|8@0+ (0.00275,-0.34925) [-0.34925|0.34925] "rad" ASDM
 SG_ DET_ELEVATION_ERR_103 : 290|6@0+ (0.00174533,0) [0|0.10995579] "rad" ASDM
 SG_ DET_RCS_103 : 359|8@0+ (0.5,-64) [-64|63.5] "dBsm" ASDM
 SG_ DET_VALID_FLAG_103 : 340|1@0+ (1,0) [0|1] "" ASDM
 SG_ DET_BI_STATIC_FLAG_103 : 485|1@0+ (1,0) [0|1] "" ASDM
 SG_ DET_SUPER_RES_TARGET_103 : 319|1@0+ (1,0) [0|1] "" ASDM
 SG_ DET_SNR_103 : 351|8@0+ (0.35156,0) [0|89.6478] "dB" ASDM
 SG_ DET_POINT_TARGET_PROB_103 : 335|4@0+ (6.67,0) [0|100] "%" ASDM
 SG_ DET_EXISTENCE_PROB_103 : 331|6@0+ (1.588,0) [0|100] "%" ASDM
 SG_ DET_OUTSIDE_SECTOR_103 : 341|1@0+ (1,0) [0|1] "" ASDM
 SG_ DET_HVC_FLAG_103 : 327|1@0+ (1,0) [0|1] "" ASDM
 SG_ DET_CONFD_AZIMUTH_103 : 337|2@0+ (1,0) [0|3] "" ASDM
 SG_ DET_CONFD_ELEVATION_103 : 339|2@0+ (1,0) [0|3] "" ASDM
 SG_ DET_AZIMUTH_AMB_ID_103 : 322|3@0+ (1,0) [0|7] "" ASDM
 SG_ DET_AMBG_AZIMUTH_PROB_103 : 326|4@0+ (6.67,0) [0|100] "%" ASDM
 SG_ DET_RANGE_104 : 367|15@0+ (0.015625,0) [0|500] "m" ASDM
 SG_ DET_RANGE_ERR_104 : 368|7@0+ (0.0075,0) [0|0.9525] "m" ASDM
 SG_ DET_RANGE_VELOCITY_104 : 377|15@0+ (0.0078125,-128) [-128|127.9921875] "m/s" ASDM
 SG_ DET_RANGE_VELOCITY_ERR_104 : 394|8@0+ (0.003,0) [0|0.765] "m/s" ASDM
 SG_ DET_AZIMUTH_104 : 420|13@0+ (0.0004,-1.5708) [-1.5708|1.5708] "rad" ASDM
 SG_ DET_AZIMUTH_ERR_104 : 438|7@0+ (0.00087267,0) [0|0.11082909] "rad" ASDM
 SG_ DET_ELEVATION_104 : 402|8@0+ (0.00275,-0.34925) [-0.34925|0.34925] "rad" ASDM
 SG_ DET_ELEVATION_ERR_104 : 410|6@0+ (0.00174533,0) [0|0.10995579] "rad" ASDM
 SG_ DET_RCS_104 : 479|8@0+ (0.5,-64) [-64|63.5] "dBsm" ASDM
 SG_ DET_VALID_FLAG_104 : 460|1@0+ (1,0) [0|1] "" ASDM
 SG_ DET_BI_STATIC_FLAG_104 : 484|1@0+ (1,0) [0|1] "" ASDM
 SG_ DET_SUPER_RES_TARGET_104 : 439|1@0+ (1,0) [0|1] "" ASDM
 SG_ DET_SNR_104 : 471|8@0+ (0.35156,0) [0|89.6478] "dB" ASDM
 SG_ DET_POINT_TARGET_PROB_104 : 455|4@0+ (6.67,0) [0|100] "%" ASDM
 SG_ DET_EXISTENCE_PROB_104 : 451|6@0+ (1.588,0) [0|100] "%" ASDM
 SG_ DET_OUTSIDE_SECTOR_104 : 461|1@0+ (1,0) [0|1] "" ASDM
 SG_ DET_HVC_FLAG_104 : 447|1@0+ (1,0) [0|1] "" ASDM
 SG_ DET_CONFD_AZIMUTH_104 : 457|2@0+ (1,0) [0|3] "" ASDM
 SG_ DET_CONFD_ELEVATION_104 : 459|2@0+ (1,0) [0|3] "" ASDM
 SG_ DET_AZIMUTH_AMB_ID_104 : 442|3@0+ (1,0) [0|7] "" ASDM
 SG_ DET_AMBG_AZIMUTH_PROB_104 : 446|4@0+ (6.67,0) [0|100] "%" ASDM
 SG_ DET_MH_SCAN_INDEX_4LSB_101_104 : 483|4@0+ (1,0) [0|15] "" ASDM
 SG_ DET_MH_CYCLE_COUNTER_101_104 : 495|8@0+ (1,0) [0|255] "" ASDM
 SG_ DET_MH_CRC16_101_104 : 503|16@0+ (1,0) [0|65535] "" ASDM

CM_ SG_ 649 DET_RANGE_037 " measured position  of the detection";
CM_ SG_ 649 DET_RANGE_ERR_037 "RMSE or standard deviation of the measured angle  of the detection";
CM_ SG_ 649 DET_RANGE_VELOCITY_037 "Radial velocity of the detection positive in direction to the sensor";
CM_ SG_ 649 DET_RANGE_VELOCITY_ERR_037 "RMSE or standard deviation of the measure radial velocity of the detection";
CM_ SG_ 649 DET_AZIMUTH_037 "Measured angle  of the detection";
CM_ SG_ 649 DET_AZIMUTH_ERR_037 "RMSE or standard deviation of the measured angle  of the detection";
CM_ SG_ 649 DET_ELEVATION_037 "measured elevation of the detection";
CM_ SG_ 649 DET_ELEVATION_ERR_037 "RMSE or standard deviation of the measured elevation  of the detection";
CM_ SG_ 649 DET_RCS_037 "Radar Cross Section or Amplitude, is a measure of how detectable an object is by radar. A larger RCS indicates that an object is more easily detected.";
CM_ SG_ 649 DET_VALID_FLAG_037 "is set if the measured detection is valid";
CM_ SG_ 649 DET_BI_STATIC_FLAG_037 "1 if detection is bi-static 0 otherwise";
CM_ SG_ 649 DET_SUPER_RES_TARGET_037 "flasg is set if the detection is super resolution target";
CM_ SG_ 649 DET_SNR_037 "The signal to noise ratio (SNR) of the radar detection";
CM_ SG_ 649 DET_POINT_TARGET_PROB_037 "Describes the possibility if more than one real-world object has led to this detection. 0[%] := 100[%] Multi target probability";
CM_ SG_ 649 DET_EXISTENCE_PROB_037 "Existence probability of the detection not based on history. Value does  not depend on any past experience with similar detections.
\note Use as confidence measure where a low value means less confidence
and a high value indicates strong confidence.";
CM_ SG_ 649 DET_OUTSIDE_SECTOR_037 "Flag to indicate detections outside the sector, set if the wrong sector calibration matrix was used";
CM_ SG_ 649 DET_HVC_FLAG_037 "Core2 Vehicle clutter flag";
CM_ SG_ 649 DET_CONFD_AZIMUTH_037 "Define the Confidence of Azimuth for Detection ";
CM_ SG_ 649 DET_CONFD_ELEVATION_037 "Define the Confidence of Elevation for the Detection ";
CM_ SG_ 649 DET_AZIMUTH_AMB_ID_037 "Each ambiguous measurement generates one Ambiguity ID. Ambiguity is indicated by an identical ambiguity ID.
note Unambiguous measurements have the ambiguity ID 0.";
CM_ SG_ 649 DET_AMBG_AZIMUTH_PROB_037 "Probability for different hypothesis, sum is 100 [%] for all detections with the same Ambiguity ID. 0 means no Ambiguity";
CM_ SG_ 649 DET_BI_STATIC_FLAG_038 "1 if detection is bi-static 0 otherwise";
CM_ SG_ 649 DET_BI_STATIC_FLAG_039 "1 if detection is bi-static 0 otherwise";
CM_ SG_ 649 DET_BI_STATIC_FLAG_040 "1 if detection is bi-static 0 otherwise";
CM_ SG_ 649 DET_MH_SCAN_INDEX_4LSB_037_040 "Scan index of the measured detection";
CM_ SG_ 649 DET_MH_CYCLE_COUNTER_037_040 "Detection Alive Counter";
CM_ SG_ 650 DET_RANGE_041 " measured position  of the detection";
CM_ SG_ 650 DET_RANGE_ERR_041 "RMSE or standard deviation of the measured angle  of the detection";
CM_ SG_ 650 DET_RANGE_VELOCITY_041 "Radial velocity of the detection positive in direction to the sensor";
CM_ SG_ 650 DET_RANGE_VELOCITY_ERR_041 "RMSE or standard deviation of the measure radial velocity of the detection";
CM_ SG_ 650 DET_AZIMUTH_041 "Measured angle  of the detection";
CM_ SG_ 650 DET_AZIMUTH_ERR_041 "RMSE or standard deviation of the measured angle  of the detection";
CM_ SG_ 650 DET_ELEVATION_041 "measured elevation of the detection";
CM_ SG_ 650 DET_ELEVATION_ERR_041 "RMSE or standard deviation of the measured elevation  of the detection";
CM_ SG_ 650 DET_RCS_041 "Radar Cross Section or Amplitude, is a measure of how detectable an object is by radar. A larger RCS indicates that an object is more easily detected.";
CM_ SG_ 650 DET_VALID_FLAG_041 "is set if the measured detection is valid";
CM_ SG_ 650 DET_BI_STATIC_FLAG_041 "1 if detection is bi-static 0 otherwise";
CM_ SG_ 650 DET_SUPER_RES_TARGET_041 "flasg is set if the detection is super resolution target";
CM_ SG_ 650 DET_SNR_041 "The signal to noise ratio (SNR) of the radar detection";
CM_ SG_ 650 DET_POINT_TARGET_PROB_041 "Describes the possibility if more than one real-world object has led to this detection. 0[%] := 100[%] Multi target probability";
CM_ SG_ 650 DET_EXISTENCE_PROB_041 "Existence probability of the detection not based on history. Value does  not depend on any past experience with similar detections.
\note Use as confidence measure where a low value means less confidence
and a high value indicates strong confidence.";
CM_ SG_ 650 DET_OUTSIDE_SECTOR_041 "Flag to indicate detections outside the sector, set if the wrong sector calibration matrix was used";
CM_ SG_ 650 DET_HVC_FLAG_041 "Core2 Vehicle clutter flag";
CM_ SG_ 650 DET_CONFD_AZIMUTH_041 "Define the Confidence of Azimuth for Detection ";
CM_ SG_ 650 DET_CONFD_ELEVATION_041 "Define the Confidence of Elevation for the Detection ";
CM_ SG_ 650 DET_AZIMUTH_AMB_ID_041 "Each ambiguous measurement generates one Ambiguity ID. Ambiguity is indicated by an identical ambiguity ID.
note Unambiguous measurements have the ambiguity ID 0.";
CM_ SG_ 650 DET_AMBG_AZIMUTH_PROB_041 "Probability for different hypothesis, sum is 100 [%] for all detections with the same Ambiguity ID. 0 means no Ambiguity";
CM_ SG_ 650 DET_BI_STATIC_FLAG_042 "1 if detection is bi-static 0 otherwise";
CM_ SG_ 650 DET_BI_STATIC_FLAG_043 "1 if detection is bi-static 0 otherwise";
CM_ SG_ 650 DET_BI_STATIC_FLAG_044 "1 if detection is bi-static 0 otherwise";
CM_ SG_ 650 DET_MH_SCAN_INDEX_4LSB_041_044 "Scan index of the measured detection";
CM_ SG_ 650 DET_MH_CYCLE_COUNTER_041_044 "Detection Alive Counter";
CM_ SG_ 651 DET_RANGE_045 " measured position  of the detection";
CM_ SG_ 651 DET_RANGE_ERR_045 "RMSE or standard deviation of the measured angle  of the detection";
CM_ SG_ 651 DET_RANGE_VELOCITY_045 "Radial velocity of the detection positive in direction to the sensor";
CM_ SG_ 651 DET_RANGE_VELOCITY_ERR_045 "RMSE or standard deviation of the measure radial velocity of the detection";
CM_ SG_ 651 DET_AZIMUTH_045 "Measured angle  of the detection";
CM_ SG_ 651 DET_AZIMUTH_ERR_045 "RMSE or standard deviation of the measured angle  of the detection";
CM_ SG_ 651 DET_ELEVATION_045 "measured elevation of the detection";
CM_ SG_ 651 DET_ELEVATION_ERR_045 "RMSE or standard deviation of the measured elevation  of the detection";
CM_ SG_ 651 DET_RCS_045 "Radar Cross Section or Amplitude, is a measure of how detectable an object is by radar. A larger RCS indicates that an object is more easily detected.";
CM_ SG_ 651 DET_VALID_FLAG_045 "is set if the measured detection is valid";
CM_ SG_ 651 DET_BI_STATIC_FLAG_045 "1 if detection is bi-static 0 otherwise";
CM_ SG_ 651 DET_SUPER_RES_TARGET_045 "flasg is set if the detection is super resolution target";
CM_ SG_ 651 DET_SNR_045 "The signal to noise ratio (SNR) of the radar detection";
CM_ SG_ 651 DET_POINT_TARGET_PROB_045 "Describes the possibility if more than one real-world object has led to this detection. 0[%] := 100[%] Multi target probability";
CM_ SG_ 651 DET_EXISTENCE_PROB_045 "Existence probability of the detection not based on history. Value does  not depend on any past experience with similar detections.
\note Use as confidence measure where a low value means less confidence
and a high value indicates strong confidence.";
CM_ SG_ 651 DET_OUTSIDE_SECTOR_045 "Flag to indicate detections outside the sector, set if the wrong sector calibration matrix was used";
CM_ SG_ 651 DET_HVC_FLAG_045 "Core2 Vehicle clutter flag";
CM_ SG_ 651 DET_CONFD_AZIMUTH_045 "Define the Confidence of Azimuth for Detection ";
CM_ SG_ 651 DET_CONFD_ELEVATION_045 "Define the Confidence of Elevation for the Detection ";
CM_ SG_ 651 DET_AZIMUTH_AMB_ID_045 "Each ambiguous measurement generates one Ambiguity ID. Ambiguity is indicated by an identical ambiguity ID.
note Unambiguous measurements have the ambiguity ID 0.";
CM_ SG_ 651 DET_AMBG_AZIMUTH_PROB_045 "Probability for different hypothesis, sum is 100 [%] for all detections with the same Ambiguity ID. 0 means no Ambiguity";
CM_ SG_ 651 DET_BI_STATIC_FLAG_046 "1 if detection is bi-static 0 otherwise";
CM_ SG_ 651 DET_BI_STATIC_FLAG_047 "1 if detection is bi-static 0 otherwise";
CM_ SG_ 651 DET_BI_STATIC_FLAG_048 "1 if detection is bi-static 0 otherwise";
CM_ SG_ 651 DET_MH_SCAN_INDEX_4LSB_045_048 "Scan index of the measured detection";
CM_ SG_ 651 DET_MH_CYCLE_COUNTER_045_048 "Detection Alive Counter";
CM_ SG_ 652 DET_RANGE_049 " measured position  of the detection";
CM_ SG_ 652 DET_RANGE_ERR_049 "RMSE or standard deviation of the measured angle  of the detection";
CM_ SG_ 652 DET_RANGE_VELOCITY_049 "Radial velocity of the detection positive in direction to the sensor";
CM_ SG_ 652 DET_RANGE_VELOCITY_ERR_049 "RMSE or standard deviation of the measure radial velocity of the detection";
CM_ SG_ 652 DET_AZIMUTH_049 "Measured angle  of the detection";
CM_ SG_ 652 DET_AZIMUTH_ERR_049 "RMSE or standard deviation of the measured angle  of the detection";
CM_ SG_ 652 DET_ELEVATION_049 "measured elevation of the detection";
CM_ SG_ 652 DET_ELEVATION_ERR_049 "RMSE or standard deviation of the measured elevation  of the detection";
CM_ SG_ 652 DET_RCS_049 "Radar Cross Section or Amplitude, is a measure of how detectable an object is by radar. A larger RCS indicates that an object is more easily detected.";
CM_ SG_ 652 DET_VALID_FLAG_049 "is set if the measured detection is valid";
CM_ SG_ 652 DET_BI_STATIC_FLAG_049 "1 if detection is bi-static 0 otherwise";
CM_ SG_ 652 DET_SUPER_RES_TARGET_049 "flasg is set if the detection is super resolution target";
CM_ SG_ 652 DET_SNR_049 "The signal to noise ratio (SNR) of the radar detection";
CM_ SG_ 652 DET_POINT_TARGET_PROB_049 "Describes the possibility if more than one real-world object has led to this detection. 0[%] := 100[%] Multi target probability";
CM_ SG_ 652 DET_EXISTENCE_PROB_049 "Existence probability of the detection not based on history. Value does  not depend on any past experience with similar detections.
\note Use as confidence measure where a low value means less confidence
and a high value indicates strong confidence.";
CM_ SG_ 652 DET_OUTSIDE_SECTOR_049 "Flag to indicate detections outside the sector, set if the wrong sector calibration matrix was used";
CM_ SG_ 652 DET_HVC_FLAG_049 "Core2 Vehicle clutter flag";
CM_ SG_ 652 DET_CONFD_AZIMUTH_049 "Define the Confidence of Azimuth for Detection ";
CM_ SG_ 652 DET_CONFD_ELEVATION_049 "Define the Confidence of Elevation for the Detection ";
CM_ SG_ 652 DET_AZIMUTH_AMB_ID_049 "Each ambiguous measurement generates one Ambiguity ID. Ambiguity is indicated by an identical ambiguity ID.
note Unambiguous measurements have the ambiguity ID 0.";
CM_ SG_ 652 DET_AMBG_AZIMUTH_PROB_049 "Probability for different hypothesis, sum is 100 [%] for all detections with the same Ambiguity ID. 0 means no Ambiguity";
CM_ SG_ 652 DET_BI_STATIC_FLAG_050 "1 if detection is bi-static 0 otherwise";
CM_ SG_ 652 DET_BI_STATIC_FLAG_051 "1 if detection is bi-static 0 otherwise";
CM_ SG_ 652 DET_BI_STATIC_FLAG_052 "1 if detection is bi-static 0 otherwise";
CM_ SG_ 652 DET_MH_SCAN_INDEX_4LSB_049_052 "Scan index of the measured detection";
CM_ SG_ 652 DET_MH_CYCLE_COUNTER_049_052 "Detection Alive Counter";
CM_ SG_ 653 DET_RANGE_053 " measured position  of the detection";
CM_ SG_ 653 DET_RANGE_ERR_053 "RMSE or standard deviation of the measured angle  of the detection";
CM_ SG_ 653 DET_RANGE_VELOCITY_053 "Radial velocity of the detection positive in direction to the sensor";
CM_ SG_ 653 DET_RANGE_VELOCITY_ERR_053 "RMSE or standard deviation of the measure radial velocity of the detection";
CM_ SG_ 653 DET_AZIMUTH_053 "Measured angle  of the detection";
CM_ SG_ 653 DET_AZIMUTH_ERR_053 "RMSE or standard deviation of the measured angle  of the detection";
CM_ SG_ 653 DET_ELEVATION_053 "measured elevation of the detection";
CM_ SG_ 653 DET_ELEVATION_ERR_053 "RMSE or standard deviation of the measured elevation  of the detection";
CM_ SG_ 653 DET_RCS_053 "Radar Cross Section or Amplitude, is a measure of how detectable an object is by radar. A larger RCS indicates that an object is more easily detected.";
CM_ SG_ 653 DET_VALID_FLAG_053 "is set if the measured detection is valid";
CM_ SG_ 653 DET_BI_STATIC_FLAG_053 "1 if detection is bi-static 0 otherwise";
CM_ SG_ 653 DET_SUPER_RES_TARGET_053 "flasg is set if the detection is super resolution target";
CM_ SG_ 653 DET_SNR_053 "The signal to noise ratio (SNR) of the radar detection";
CM_ SG_ 653 DET_POINT_TARGET_PROB_053 "Describes the possibility if more than one real-world object has led to this detection. 0[%] := 100[%] Multi target probability";
CM_ SG_ 653 DET_EXISTENCE_PROB_053 "Existence probability of the detection not based on history. Value does  not depend on any past experience with similar detections.
\note Use as confidence measure where a low value means less confidence
and a high value indicates strong confidence.";
CM_ SG_ 653 DET_OUTSIDE_SECTOR_053 "Flag to indicate detections outside the sector, set if the wrong sector calibration matrix was used";
CM_ SG_ 653 DET_HVC_FLAG_053 "Core2 Vehicle clutter flag";
CM_ SG_ 653 DET_CONFD_AZIMUTH_053 "Define the Confidence of Azimuth for Detection ";
CM_ SG_ 653 DET_CONFD_ELEVATION_053 "Define the Confidence of Elevation for the Detection ";
CM_ SG_ 653 DET_AZIMUTH_AMB_ID_053 "Each ambiguous measurement generates one Ambiguity ID. Ambiguity is indicated by an identical ambiguity ID.
note Unambiguous measurements have the ambiguity ID 0.";
CM_ SG_ 653 DET_AMBG_AZIMUTH_PROB_053 "Probability for different hypothesis, sum is 100 [%] for all detections with the same Ambiguity ID. 0 means no Ambiguity";
CM_ SG_ 653 DET_BI_STATIC_FLAG_054 "1 if detection is bi-static 0 otherwise";
CM_ SG_ 653 DET_BI_STATIC_FLAG_055 "1 if detection is bi-static 0 otherwise";
CM_ SG_ 653 DET_BI_STATIC_FLAG_056 "1 if detection is bi-static 0 otherwise";
CM_ SG_ 653 DET_MH_SCAN_INDEX_4LSB_053_056 "Scan index of the measured detection";
CM_ SG_ 653 DET_MH_CYCLE_COUNTER_053_056 "Detection Alive Counter";
CM_ SG_ 654 DET_RANGE_057 " measured position  of the detection";
CM_ SG_ 654 DET_RANGE_ERR_057 "RMSE or standard deviation of the measured angle  of the detection";
CM_ SG_ 654 DET_RANGE_VELOCITY_057 "Radial velocity of the detection positive in direction to the sensor";
CM_ SG_ 654 DET_RANGE_VELOCITY_ERR_057 "RMSE or standard deviation of the measure radial velocity of the detection";
CM_ SG_ 654 DET_AZIMUTH_057 "Measured angle  of the detection";
CM_ SG_ 654 DET_AZIMUTH_ERR_057 "RMSE or standard deviation of the measured angle  of the detection";
CM_ SG_ 654 DET_ELEVATION_057 "measured elevation of the detection";
CM_ SG_ 654 DET_ELEVATION_ERR_057 "RMSE or standard deviation of the measured elevation  of the detection";
CM_ SG_ 654 DET_RCS_057 "Radar Cross Section or Amplitude, is a measure of how detectable an object is by radar. A larger RCS indicates that an object is more easily detected.";
CM_ SG_ 654 DET_VALID_FLAG_057 "is set if the measured detection is valid";
CM_ SG_ 654 DET_BI_STATIC_FLAG_057 "1 if detection is bi-static 0 otherwise";
CM_ SG_ 654 DET_SUPER_RES_TARGET_057 "flasg is set if the detection is super resolution target";
CM_ SG_ 654 DET_SNR_057 "The signal to noise ratio (SNR) of the radar detection";
CM_ SG_ 654 DET_POINT_TARGET_PROB_057 "Describes the possibility if more than one real-world object has led to this detection. 0[%] := 100[%] Multi target probability";
CM_ SG_ 654 DET_EXISTENCE_PROB_057 "Existence probability of the detection not based on history. Value does  not depend on any past experience with similar detections.
\note Use as confidence measure where a low value means less confidence
and a high value indicates strong confidence.";
CM_ SG_ 654 DET_OUTSIDE_SECTOR_057 "Flag to indicate detections outside the sector, set if the wrong sector calibration matrix was used";
CM_ SG_ 654 DET_HVC_FLAG_057 "Core2 Vehicle clutter flag";
CM_ SG_ 654 DET_CONFD_AZIMUTH_057 "Define the Confidence of Azimuth for Detection ";
CM_ SG_ 654 DET_CONFD_ELEVATION_057 "Define the Confidence of Elevation for the Detection ";
CM_ SG_ 654 DET_AZIMUTH_AMB_ID_057 "Each ambiguous measurement generates one Ambiguity ID. Ambiguity is indicated by an identical ambiguity ID.
note Unambiguous measurements have the ambiguity ID 0.";
CM_ SG_ 654 DET_AMBG_AZIMUTH_PROB_057 "Probability for different hypothesis, sum is 100 [%] for all detections with the same Ambiguity ID. 0 means no Ambiguity";
CM_ SG_ 654 DET_BI_STATIC_FLAG_058 "1 if detection is bi-static 0 otherwise";
CM_ SG_ 654 DET_BI_STATIC_FLAG_059 "1 if detection is bi-static 0 otherwise";
CM_ SG_ 654 DET_BI_STATIC_FLAG_060 "1 if detection is bi-static 0 otherwise";
CM_ SG_ 654 DET_MH_SCAN_INDEX_4LSB_057_060 "Scan index of the measured detection";
CM_ SG_ 654 DET_MH_CYCLE_COUNTER_057_060 "Detection Alive Counter";
CM_ SG_ 655 DET_RANGE_061 " measured position  of the detection";
CM_ SG_ 655 DET_RANGE_ERR_061 "RMSE or standard deviation of the measured angle  of the detection";
CM_ SG_ 655 DET_RANGE_VELOCITY_061 "Radial velocity of the detection positive in direction to the sensor";
CM_ SG_ 655 DET_RANGE_VELOCITY_ERR_061 "RMSE or standard deviation of the measure radial velocity of the detection";
CM_ SG_ 655 DET_AZIMUTH_061 "Measured angle  of the detection";
CM_ SG_ 655 DET_AZIMUTH_ERR_061 "RMSE or standard deviation of the measured angle  of the detection";
CM_ SG_ 655 DET_ELEVATION_061 "measured elevation of the detection";
CM_ SG_ 655 DET_ELEVATION_ERR_061 "RMSE or standard deviation of the measured elevation  of the detection";
CM_ SG_ 655 DET_RCS_061 "Radar Cross Section or Amplitude, is a measure of how detectable an object is by radar. A larger RCS indicates that an object is more easily detected.";
CM_ SG_ 655 DET_VALID_FLAG_061 "is set if the measured detection is valid";
CM_ SG_ 655 DET_BI_STATIC_FLAG_061 "1 if detection is bi-static 0 otherwise";
CM_ SG_ 655 DET_SUPER_RES_TARGET_061 "flasg is set if the detection is super resolution target";
CM_ SG_ 655 DET_SNR_061 "The signal to noise ratio (SNR) of the radar detection";
CM_ SG_ 655 DET_POINT_TARGET_PROB_061 "Describes the possibility if more than one real-world object has led to this detection. 0[%] := 100[%] Multi target probability";
CM_ SG_ 655 DET_EXISTENCE_PROB_061 "Existence probability of the detection not based on history. Value does  not depend on any past experience with similar detections.
\note Use as confidence measure where a low value means less confidence
and a high value indicates strong confidence.";
CM_ SG_ 655 DET_OUTSIDE_SECTOR_061 "Flag to indicate detections outside the sector, set if the wrong sector calibration matrix was used";
CM_ SG_ 655 DET_HVC_FLAG_061 "Core2 Vehicle clutter flag";
CM_ SG_ 655 DET_CONFD_AZIMUTH_061 "Define the Confidence of Azimuth for Detection ";
CM_ SG_ 655 DET_CONFD_ELEVATION_061 "Define the Confidence of Elevation for the Detection ";
CM_ SG_ 655 DET_AZIMUTH_AMB_ID_061 "Each ambiguous measurement generates one Ambiguity ID. Ambiguity is indicated by an identical ambiguity ID.
note Unambiguous measurements have the ambiguity ID 0.";
CM_ SG_ 655 DET_AMBG_AZIMUTH_PROB_061 "Probability for different hypothesis, sum is 100 [%] for all detections with the same Ambiguity ID. 0 means no Ambiguity";
CM_ SG_ 655 DET_BI_STATIC_FLAG_062 "1 if detection is bi-static 0 otherwise";
CM_ SG_ 655 DET_BI_STATIC_FLAG_063 "1 if detection is bi-static 0 otherwise";
CM_ SG_ 655 DET_BI_STATIC_FLAG_064 "1 if detection is bi-static 0 otherwise";
CM_ SG_ 655 DET_MH_SCAN_INDEX_4LSB_061_064 "Scan index of the measured detection";
CM_ SG_ 655 DET_MH_CYCLE_COUNTER_061_064 "Detection Alive Counter";
CM_ SG_ 656 DET_RANGE_065 " measured position  of the detection";
CM_ SG_ 656 DET_RANGE_ERR_065 "RMSE or standard deviation of the measured angle  of the detection";
CM_ SG_ 656 DET_RANGE_VELOCITY_065 "Radial velocity of the detection positive in direction to the sensor";
CM_ SG_ 656 DET_RANGE_VELOCITY_ERR_065 "RMSE or standard deviation of the measure radial velocity of the detection";
CM_ SG_ 656 DET_AZIMUTH_065 "Measured angle  of the detection";
CM_ SG_ 656 DET_AZIMUTH_ERR_065 "RMSE or standard deviation of the measured angle  of the detection";
CM_ SG_ 656 DET_ELEVATION_065 "measured elevation of the detection";
CM_ SG_ 656 DET_ELEVATION_ERR_065 "RMSE or standard deviation of the measured elevation  of the detection";
CM_ SG_ 656 DET_RCS_065 "Radar Cross Section or Amplitude, is a measure of how detectable an object is by radar. A larger RCS indicates that an object is more easily detected.";
CM_ SG_ 656 DET_VALID_FLAG_065 "is set if the measured detection is valid";
CM_ SG_ 656 DET_BI_STATIC_FLAG_065 "1 if detection is bi-static 0 otherwise";
CM_ SG_ 656 DET_SUPER_RES_TARGET_065 "flasg is set if the detection is super resolution target";
CM_ SG_ 656 DET_SNR_065 "The signal to noise ratio (SNR) of the radar detection";
CM_ SG_ 656 DET_POINT_TARGET_PROB_065 "Describes the possibility if more than one real-world object has led to this detection. 0[%] := 100[%] Multi target probability";
CM_ SG_ 656 DET_EXISTENCE_PROB_065 "Existence probability of the detection not based on history. Value does  not depend on any past experience with similar detections.
\note Use as confidence measure where a low value means less confidence
and a high value indicates strong confidence.";
CM_ SG_ 656 DET_OUTSIDE_SECTOR_065 "Flag to indicate detections outside the sector, set if the wrong sector calibration matrix was used";
CM_ SG_ 656 DET_HVC_FLAG_065 "Core2 Vehicle clutter flag";
CM_ SG_ 656 DET_CONFD_AZIMUTH_065 "Define the Confidence of Azimuth for Detection ";
CM_ SG_ 656 DET_CONFD_ELEVATION_065 "Define the Confidence of Elevation for the Detection ";
CM_ SG_ 656 DET_AZIMUTH_AMB_ID_065 "Each ambiguous measurement generates one Ambiguity ID. Ambiguity is indicated by an identical ambiguity ID.
note Unambiguous measurements have the ambiguity ID 0.";
CM_ SG_ 656 DET_AMBG_AZIMUTH_PROB_065 "Probability for different hypothesis, sum is 100 [%] for all detections with the same Ambiguity ID. 0 means no Ambiguity";
CM_ SG_ 656 DET_BI_STATIC_FLAG_066 "1 if detection is bi-static 0 otherwise";
CM_ SG_ 656 DET_BI_STATIC_FLAG_067 "1 if detection is bi-static 0 otherwise";
CM_ SG_ 656 DET_BI_STATIC_FLAG_068 "1 if detection is bi-static 0 otherwise";
CM_ SG_ 656 DET_MH_SCAN_INDEX_4LSB_065_068 "Scan index of the measured detection";
CM_ SG_ 656 DET_MH_CYCLE_COUNTER_065_068 "Detection Alive Counter";
CM_ SG_ 657 DET_RANGE_069 " measured position  of the detection";
CM_ SG_ 657 DET_RANGE_ERR_069 "RMSE or standard deviation of the measured angle  of the detection";
CM_ SG_ 657 DET_RANGE_VELOCITY_069 "Radial velocity of the detection positive in direction to the sensor";
CM_ SG_ 657 DET_RANGE_VELOCITY_ERR_069 "RMSE or standard deviation of the measure radial velocity of the detection";
CM_ SG_ 657 DET_AZIMUTH_069 "Measured angle  of the detection";
CM_ SG_ 657 DET_AZIMUTH_ERR_069 "RMSE or standard deviation of the measured angle  of the detection";
CM_ SG_ 657 DET_ELEVATION_069 "measured elevation of the detection";
CM_ SG_ 657 DET_ELEVATION_ERR_069 "RMSE or standard deviation of the measured elevation  of the detection";
CM_ SG_ 657 DET_RCS_069 "Radar Cross Section or Amplitude, is a measure of how detectable an object is by radar. A larger RCS indicates that an object is more easily detected.";
CM_ SG_ 657 DET_VALID_FLAG_069 "is set if the measured detection is valid";
CM_ SG_ 657 DET_BI_STATIC_FLAG_069 "1 if detection is bi-static 0 otherwise";
CM_ SG_ 657 DET_SUPER_RES_TARGET_069 "flasg is set if the detection is super resolution target";
CM_ SG_ 657 DET_SNR_069 "The signal to noise ratio (SNR) of the radar detection";
CM_ SG_ 657 DET_POINT_TARGET_PROB_069 "Describes the possibility if more than one real-world object has led to this detection. 0[%] := 100[%] Multi target probability";
CM_ SG_ 657 DET_EXISTENCE_PROB_069 "Existence probability of the detection not based on history. Value does  not depend on any past experience with similar detections.
\note Use as confidence measure where a low value means less confidence
and a high value indicates strong confidence.";
CM_ SG_ 657 DET_OUTSIDE_SECTOR_069 "Flag to indicate detections outside the sector, set if the wrong sector calibration matrix was used";
CM_ SG_ 657 DET_HVC_FLAG_069 "Core2 Vehicle clutter flag";
CM_ SG_ 657 DET_CONFD_AZIMUTH_069 "Define the Confidence of Azimuth for Detection ";
CM_ SG_ 657 DET_CONFD_ELEVATION_069 "Define the Confidence of Elevation for the Detection ";
CM_ SG_ 657 DET_AZIMUTH_AMB_ID_069 "Each ambiguous measurement generates one Ambiguity ID. Ambiguity is indicated by an identical ambiguity ID.
note Unambiguous measurements have the ambiguity ID 0.";
CM_ SG_ 657 DET_AMBG_AZIMUTH_PROB_069 "Probability for different hypothesis, sum is 100 [%] for all detections with the same Ambiguity ID. 0 means no Ambiguity";
CM_ SG_ 657 DET_BI_STATIC_FLAG_070 "1 if detection is bi-static 0 otherwise";
CM_ SG_ 657 DET_BI_STATIC_FLAG_071 "1 if detection is bi-static 0 otherwise";
CM_ SG_ 657 DET_BI_STATIC_FLAG_072 "1 if detection is bi-static 0 otherwise";
CM_ SG_ 657 DET_MH_SCAN_INDEX_4LSB_069_072 "Scan index of the measured detection";
CM_ SG_ 657 DET_MH_CYCLE_COUNTER_069_072 "Detection Alive Counter";
CM_ SG_ 658 DET_RANGE_073 " measured position  of the detection";
CM_ SG_ 658 DET_RANGE_ERR_073 "RMSE or standard deviation of the measured angle  of the detection";
CM_ SG_ 658 DET_RANGE_VELOCITY_073 "Radial velocity of the detection positive in direction to the sensor";
CM_ SG_ 658 DET_RANGE_VELOCITY_ERR_073 "RMSE or standard deviation of the measure radial velocity of the detection";
CM_ SG_ 658 DET_AZIMUTH_073 "Measured angle  of the detection";
CM_ SG_ 658 DET_AZIMUTH_ERR_073 "RMSE or standard deviation of the measured angle  of the detection";
CM_ SG_ 658 DET_ELEVATION_073 "measured elevation of the detection";
CM_ SG_ 658 DET_ELEVATION_ERR_073 "RMSE or standard deviation of the measured elevation  of the detection";
CM_ SG_ 658 DET_RCS_073 "Radar Cross Section or Amplitude, is a measure of how detectable an object is by radar. A larger RCS indicates that an object is more easily detected.";
CM_ SG_ 658 DET_VALID_FLAG_073 "is set if the measured detection is valid";
CM_ SG_ 658 DET_BI_STATIC_FLAG_073 "1 if detection is bi-static 0 otherwise";
CM_ SG_ 658 DET_SUPER_RES_TARGET_073 "flasg is set if the detection is super resolution target";
CM_ SG_ 658 DET_SNR_073 "The signal to noise ratio (SNR) of the radar detection";
CM_ SG_ 658 DET_POINT_TARGET_PROB_073 "Describes the possibility if more than one real-world object has led to this detection. 0[%] := 100[%] Multi target probability";
CM_ SG_ 658 DET_EXISTENCE_PROB_073 "Existence probability of the detection not based on history. Value does  not depend on any past experience with similar detections.
\note Use as confidence measure where a low value means less confidence
and a high value indicates strong confidence.";
CM_ SG_ 658 DET_OUTSIDE_SECTOR_073 "Flag to indicate detections outside the sector, set if the wrong sector calibration matrix was used";
CM_ SG_ 658 DET_HVC_FLAG_073 "Core2 Vehicle clutter flag";
CM_ SG_ 658 DET_CONFD_AZIMUTH_073 "Define the Confidence of Azimuth for Detection ";
CM_ SG_ 658 DET_CONFD_ELEVATION_073 "Define the Confidence of Elevation for the Detection ";
CM_ SG_ 658 DET_AZIMUTH_AMB_ID_073 "Each ambiguous measurement generates one Ambiguity ID. Ambiguity is indicated by an identical ambiguity ID.
note Unambiguous measurements have the ambiguity ID 0.";
CM_ SG_ 658 DET_AMBG_AZIMUTH_PROB_073 "Probability for different hypothesis, sum is 100 [%] for all detections with the same Ambiguity ID. 0 means no Ambiguity";
CM_ SG_ 658 DET_BI_STATIC_FLAG_074 "1 if detection is bi-static 0 otherwise";
CM_ SG_ 658 DET_BI_STATIC_FLAG_075 "1 if detection is bi-static 0 otherwise";
CM_ SG_ 658 DET_BI_STATIC_FLAG_076 "1 if detection is bi-static 0 otherwise";
CM_ SG_ 658 DET_MH_SCAN_INDEX_4LSB_073_076 "Scan index of the measured detection";
CM_ SG_ 658 DET_MH_CYCLE_COUNTER_073_076 "Detection Alive Counter";
CM_ SG_ 659 DET_RANGE_077 " measured position  of the detection";
CM_ SG_ 659 DET_RANGE_ERR_077 "RMSE or standard deviation of the measured angle  of the detection";
CM_ SG_ 659 DET_RANGE_VELOCITY_077 "Radial velocity of the detection positive in direction to the sensor";
CM_ SG_ 659 DET_RANGE_VELOCITY_ERR_077 "RMSE or standard deviation of the measure radial velocity of the detection";
CM_ SG_ 659 DET_AZIMUTH_077 "Measured angle  of the detection";
CM_ SG_ 659 DET_AZIMUTH_ERR_077 "RMSE or standard deviation of the measured angle  of the detection";
CM_ SG_ 659 DET_ELEVATION_077 "measured elevation of the detection";
CM_ SG_ 659 DET_ELEVATION_ERR_077 "RMSE or standard deviation of the measured elevation  of the detection";
CM_ SG_ 659 DET_RCS_077 "Radar Cross Section or Amplitude, is a measure of how detectable an object is by radar. A larger RCS indicates that an object is more easily detected.";
CM_ SG_ 659 DET_VALID_FLAG_077 "is set if the measured detection is valid";
CM_ SG_ 659 DET_BI_STATIC_FLAG_077 "1 if detection is bi-static 0 otherwise";
CM_ SG_ 659 DET_SUPER_RES_TARGET_077 "flasg is set if the detection is super resolution target";
CM_ SG_ 659 DET_SNR_077 "The signal to noise ratio (SNR) of the radar detection";
CM_ SG_ 659 DET_POINT_TARGET_PROB_077 "Describes the possibility if more than one real-world object has led to this detection. 0[%] := 100[%] Multi target probability";
CM_ SG_ 659 DET_EXISTENCE_PROB_077 "Existence probability of the detection not based on history. Value does  not depend on any past experience with similar detections.
\note Use as confidence measure where a low value means less confidence
and a high value indicates strong confidence.";
CM_ SG_ 659 DET_OUTSIDE_SECTOR_077 "Flag to indicate detections outside the sector, set if the wrong sector calibration matrix was used";
CM_ SG_ 659 DET_HVC_FLAG_077 "Core2 Vehicle clutter flag";
CM_ SG_ 659 DET_CONFD_AZIMUTH_077 "Define the Confidence of Azimuth for Detection ";
CM_ SG_ 659 DET_CONFD_ELEVATION_077 "Define the Confidence of Elevation for the Detection ";
CM_ SG_ 659 DET_AZIMUTH_AMB_ID_077 "Each ambiguous measurement generates one Ambiguity ID. Ambiguity is indicated by an identical ambiguity ID.
note Unambiguous measurements have the ambiguity ID 0.";
CM_ SG_ 659 DET_AMBG_AZIMUTH_PROB_077 "Probability for different hypothesis, sum is 100 [%] for all detections with the same Ambiguity ID. 0 means no Ambiguity";
CM_ SG_ 659 DET_BI_STATIC_FLAG_078 "1 if detection is bi-static 0 otherwise";
CM_ SG_ 659 DET_BI_STATIC_FLAG_079 "1 if detection is bi-static 0 otherwise";
CM_ SG_ 659 DET_BI_STATIC_FLAG_080 "1 if detection is bi-static 0 otherwise";
CM_ SG_ 659 DET_MH_SCAN_INDEX_4LSB_077_080 "Scan index of the measured detection";
CM_ SG_ 659 DET_MH_CYCLE_COUNTER_077_080 "Detection Alive Counter";
CM_ SG_ 660 DET_RANGE_081 " measured position  of the detection";
CM_ SG_ 660 DET_RANGE_ERR_081 "RMSE or standard deviation of the measured angle  of the detection";
CM_ SG_ 660 DET_RANGE_VELOCITY_081 "Radial velocity of the detection positive in direction to the sensor";
CM_ SG_ 660 DET_RANGE_VELOCITY_ERR_081 "RMSE or standard deviation of the measure radial velocity of the detection";
CM_ SG_ 660 DET_AZIMUTH_081 "Measured angle  of the detection";
CM_ SG_ 660 DET_AZIMUTH_ERR_081 "RMSE or standard deviation of the measured angle  of the detection";
CM_ SG_ 660 DET_ELEVATION_081 "measured elevation of the detection";
CM_ SG_ 660 DET_ELEVATION_ERR_081 "RMSE or standard deviation of the measured elevation  of the detection";
CM_ SG_ 660 DET_RCS_081 "Radar Cross Section or Amplitude, is a measure of how detectable an object is by radar. A larger RCS indicates that an object is more easily detected.";
CM_ SG_ 660 DET_VALID_FLAG_081 "is set if the measured detection is valid";
CM_ SG_ 660 DET_BI_STATIC_FLAG_081 "1 if detection is bi-static 0 otherwise";
CM_ SG_ 660 DET_SUPER_RES_TARGET_081 "flasg is set if the detection is super resolution target";
CM_ SG_ 660 DET_SNR_081 "The signal to noise ratio (SNR) of the radar detection";
CM_ SG_ 660 DET_POINT_TARGET_PROB_081 "Describes the possibility if more than one real-world object has led to this detection. 0[%] := 100[%] Multi target probability";
CM_ SG_ 660 DET_EXISTENCE_PROB_081 "Existence probability of the detection not based on history. Value does  not depend on any past experience with similar detections.
\note Use as confidence measure where a low value means less confidence
and a high value indicates strong confidence.";
CM_ SG_ 660 DET_OUTSIDE_SECTOR_081 "Flag to indicate detections outside the sector, set if the wrong sector calibration matrix was used";
CM_ SG_ 660 DET_HVC_FLAG_081 "Core2 Vehicle clutter flag";
CM_ SG_ 660 DET_CONFD_AZIMUTH_081 "Define the Confidence of Azimuth for Detection ";
CM_ SG_ 660 DET_CONFD_ELEVATION_081 "Define the Confidence of Elevation for the Detection ";
CM_ SG_ 660 DET_AZIMUTH_AMB_ID_081 "Each ambiguous measurement generates one Ambiguity ID. Ambiguity is indicated by an identical ambiguity ID.
note Unambiguous measurements have the ambiguity ID 0.";
CM_ SG_ 660 DET_AMBG_AZIMUTH_PROB_081 "Probability for different hypothesis, sum is 100 [%] for all detections with the same Ambiguity ID. 0 means no Ambiguity";
CM_ SG_ 660 DET_BI_STATIC_FLAG_082 "1 if detection is bi-static 0 otherwise";
CM_ SG_ 660 DET_BI_STATIC_FLAG_083 "1 if detection is bi-static 0 otherwise";
CM_ SG_ 660 DET_BI_STATIC_FLAG_084 "1 if detection is bi-static 0 otherwise";
CM_ SG_ 660 DET_MH_SCAN_INDEX_4LSB_081_084 "Scan index of the measured detection";
CM_ SG_ 660 DET_MH_CYCLE_COUNTER_081_084 "Detection Alive Counter";
CM_ SG_ 661 DET_RANGE_085 " measured position  of the detection";
CM_ SG_ 661 DET_RANGE_ERR_085 "RMSE or standard deviation of the measured angle  of the detection";
CM_ SG_ 661 DET_RANGE_VELOCITY_085 "Radial velocity of the detection positive in direction to the sensor";
CM_ SG_ 661 DET_RANGE_VELOCITY_ERR_085 "RMSE or standard deviation of the measure radial velocity of the detection";
CM_ SG_ 661 DET_AZIMUTH_085 "Measured angle  of the detection";
CM_ SG_ 661 DET_AZIMUTH_ERR_085 "RMSE or standard deviation of the measured angle  of the detection";
CM_ SG_ 661 DET_ELEVATION_085 "measured elevation of the detection";
CM_ SG_ 661 DET_ELEVATION_ERR_085 "RMSE or standard deviation of the measured elevation  of the detection";
CM_ SG_ 661 DET_RCS_085 "Radar Cross Section or Amplitude, is a measure of how detectable an object is by radar. A larger RCS indicates that an object is more easily detected.";
CM_ SG_ 661 DET_VALID_FLAG_085 "is set if the measured detection is valid";
CM_ SG_ 661 DET_BI_STATIC_FLAG_085 "1 if detection is bi-static 0 otherwise";
CM_ SG_ 661 DET_SUPER_RES_TARGET_085 "flasg is set if the detection is super resolution target";
CM_ SG_ 661 DET_SNR_085 "The signal to noise ratio (SNR) of the radar detection";
CM_ SG_ 661 DET_POINT_TARGET_PROB_085 "Describes the possibility if more than one real-world object has led to this detection. 0[%] := 100[%] Multi target probability";
CM_ SG_ 661 DET_EXISTENCE_PROB_085 "Existence probability of the detection not based on history. Value does  not depend on any past experience with similar detections.
\note Use as confidence measure where a low value means less confidence
and a high value indicates strong confidence.";
CM_ SG_ 661 DET_OUTSIDE_SECTOR_085 "Flag to indicate detections outside the sector, set if the wrong sector calibration matrix was used";
CM_ SG_ 661 DET_HVC_FLAG_085 "Core2 Vehicle clutter flag";
CM_ SG_ 661 DET_CONFD_AZIMUTH_085 "Define the Confidence of Azimuth for Detection ";
CM_ SG_ 661 DET_CONFD_ELEVATION_085 "Define the Confidence of Elevation for the Detection ";
CM_ SG_ 661 DET_AZIMUTH_AMB_ID_085 "Each ambiguous measurement generates one Ambiguity ID. Ambiguity is indicated by an identical ambiguity ID.
note Unambiguous measurements have the ambiguity ID 0.";
CM_ SG_ 661 DET_AMBG_AZIMUTH_PROB_085 "Probability for different hypothesis, sum is 100 [%] for all detections with the same Ambiguity ID. 0 means no Ambiguity";
CM_ SG_ 661 DET_BI_STATIC_FLAG_086 "1 if detection is bi-static 0 otherwise";
CM_ SG_ 661 DET_BI_STATIC_FLAG_087 "1 if detection is bi-static 0 otherwise";
CM_ SG_ 661 DET_BI_STATIC_FLAG_088 "1 if detection is bi-static 0 otherwise";
CM_ SG_ 661 DET_MH_SCAN_INDEX_4LSB_085_088 "Scan index of the measured detection";
CM_ SG_ 661 DET_MH_CYCLE_COUNTER_085_088 "Detection Alive Counter";
CM_ SG_ 662 DET_RANGE_089 " measured position  of the detection";
CM_ SG_ 662 DET_RANGE_ERR_089 "RMSE or standard deviation of the measured angle  of the detection";
CM_ SG_ 662 DET_RANGE_VELOCITY_089 "Radial velocity of the detection positive in direction to the sensor";
CM_ SG_ 662 DET_RANGE_VELOCITY_ERR_089 "RMSE or standard deviation of the measure radial velocity of the detection";
CM_ SG_ 662 DET_AZIMUTH_089 "Measured angle  of the detection";
CM_ SG_ 662 DET_AZIMUTH_ERR_089 "RMSE or standard deviation of the measured angle  of the detection";
CM_ SG_ 662 DET_ELEVATION_089 "measured elevation of the detection";
CM_ SG_ 662 DET_ELEVATION_ERR_089 "RMSE or standard deviation of the measured elevation  of the detection";
CM_ SG_ 662 DET_RCS_089 "Radar Cross Section or Amplitude, is a measure of how detectable an object is by radar. A larger RCS indicates that an object is more easily detected.";
CM_ SG_ 662 DET_VALID_FLAG_089 "is set if the measured detection is valid";
CM_ SG_ 662 DET_BI_STATIC_FLAG_089 "1 if detection is bi-static 0 otherwise";
CM_ SG_ 662 DET_SUPER_RES_TARGET_089 "flasg is set if the detection is super resolution target";
CM_ SG_ 662 DET_SNR_089 "The signal to noise ratio (SNR) of the radar detection";
CM_ SG_ 662 DET_POINT_TARGET_PROB_089 "Describes the possibility if more than one real-world object has led to this detection. 0[%] := 100[%] Multi target probability";
CM_ SG_ 662 DET_EXISTENCE_PROB_089 "Existence probability of the detection not based on history. Value does  not depend on any past experience with similar detections.
\note Use as confidence measure where a low value means less confidence
and a high value indicates strong confidence.";
CM_ SG_ 662 DET_OUTSIDE_SECTOR_089 "Flag to indicate detections outside the sector, set if the wrong sector calibration matrix was used";
CM_ SG_ 662 DET_HVC_FLAG_089 "Core2 Vehicle clutter flag";
CM_ SG_ 662 DET_CONFD_AZIMUTH_089 "Define the Confidence of Azimuth for Detection ";
CM_ SG_ 662 DET_CONFD_ELEVATION_089 "Define the Confidence of Elevation for the Detection ";
CM_ SG_ 662 DET_AZIMUTH_AMB_ID_089 "Each ambiguous measurement generates one Ambiguity ID. Ambiguity is indicated by an identical ambiguity ID.
note Unambiguous measurements have the ambiguity ID 0.";
CM_ SG_ 662 DET_AMBG_AZIMUTH_PROB_089 "Probability for different hypothesis, sum is 100 [%] for all detections with the same Ambiguity ID. 0 means no Ambiguity";
CM_ SG_ 662 DET_BI_STATIC_FLAG_090 "1 if detection is bi-static 0 otherwise";
CM_ SG_ 662 DET_BI_STATIC_FLAG_091 "1 if detection is bi-static 0 otherwise";
CM_ SG_ 662 DET_BI_STATIC_FLAG_092 "1 if detection is bi-static 0 otherwise";
CM_ SG_ 662 DET_MH_SCAN_INDEX_4LSB_089_092 "Scan index of the measured detection";
CM_ SG_ 662 DET_MH_CYCLE_COUNTER_089_092 "Detection Alive Counter";
CM_ SG_ 663 DET_RANGE_093 " measured position  of the detection";
CM_ SG_ 663 DET_RANGE_ERR_093 "RMSE or standard deviation of the measured angle  of the detection";
CM_ SG_ 663 DET_RANGE_VELOCITY_093 "Radial velocity of the detection positive in direction to the sensor";
CM_ SG_ 663 DET_RANGE_VELOCITY_ERR_093 "RMSE or standard deviation of the measure radial velocity of the detection";
CM_ SG_ 663 DET_AZIMUTH_093 "Measured angle  of the detection";
CM_ SG_ 663 DET_AZIMUTH_ERR_093 "RMSE or standard deviation of the measured angle  of the detection";
CM_ SG_ 663 DET_ELEVATION_093 "measured elevation of the detection";
CM_ SG_ 663 DET_ELEVATION_ERR_093 "RMSE or standard deviation of the measured elevation  of the detection";
CM_ SG_ 663 DET_RCS_093 "Radar Cross Section or Amplitude, is a measure of how detectable an object is by radar. A larger RCS indicates that an object is more easily detected.";
CM_ SG_ 663 DET_VALID_FLAG_093 "is set if the measured detection is valid";
CM_ SG_ 663 DET_BI_STATIC_FLAG_093 "1 if detection is bi-static 0 otherwise";
CM_ SG_ 663 DET_SUPER_RES_TARGET_093 "flasg is set if the detection is super resolution target";
CM_ SG_ 663 DET_SNR_093 "The signal to noise ratio (SNR) of the radar detection";
CM_ SG_ 663 DET_POINT_TARGET_PROB_093 "Describes the possibility if more than one real-world object has led to this detection. 0[%] := 100[%] Multi target probability";
CM_ SG_ 663 DET_EXISTENCE_PROB_093 "Existence probability of the detection not based on history. Value does  not depend on any past experience with similar detections.
\note Use as confidence measure where a low value means less confidence
and a high value indicates strong confidence.";
CM_ SG_ 663 DET_OUTSIDE_SECTOR_093 "Flag to indicate detections outside the sector, set if the wrong sector calibration matrix was used";
CM_ SG_ 663 DET_HVC_FLAG_093 "Core2 Vehicle clutter flag";
CM_ SG_ 663 DET_CONFD_AZIMUTH_093 "Define the Confidence of Azimuth for Detection ";
CM_ SG_ 663 DET_CONFD_ELEVATION_093 "Define the Confidence of Elevation for the Detection ";
CM_ SG_ 663 DET_AZIMUTH_AMB_ID_093 "Each ambiguous measurement generates one Ambiguity ID. Ambiguity is indicated by an identical ambiguity ID.
note Unambiguous measurements have the ambiguity ID 0.";
CM_ SG_ 663 DET_AMBG_AZIMUTH_PROB_093 "Probability for different hypothesis, sum is 100 [%] for all detections with the same Ambiguity ID. 0 means no Ambiguity";
CM_ SG_ 663 DET_BI_STATIC_FLAG_094 "1 if detection is bi-static 0 otherwise";
CM_ SG_ 663 DET_BI_STATIC_FLAG_095 "1 if detection is bi-static 0 otherwise";
CM_ SG_ 663 DET_BI_STATIC_FLAG_096 "1 if detection is bi-static 0 otherwise";
CM_ SG_ 663 DET_MH_SCAN_INDEX_4LSB_093_096 "Scan index of the measured detection";
CM_ SG_ 663 DET_MH_CYCLE_COUNTER_093_096 "Detection Alive Counter";
CM_ SG_ 664 DET_RANGE_097 " measured position  of the detection";
CM_ SG_ 664 DET_RANGE_ERR_097 "RMSE or standard deviation of the measured angle  of the detection";
CM_ SG_ 664 DET_RANGE_VELOCITY_097 "Radial velocity of the detection positive in direction to the sensor";
CM_ SG_ 664 DET_RANGE_VELOCITY_ERR_097 "RMSE or standard deviation of the measure radial velocity of the detection";
CM_ SG_ 664 DET_AZIMUTH_097 "Measured angle  of the detection";
CM_ SG_ 664 DET_AZIMUTH_ERR_097 "RMSE or standard deviation of the measured angle  of the detection";
CM_ SG_ 664 DET_ELEVATION_097 "measured elevation of the detection";
CM_ SG_ 664 DET_ELEVATION_ERR_097 "RMSE or standard deviation of the measured elevation  of the detection";
CM_ SG_ 664 DET_RCS_097 "Radar Cross Section or Amplitude, is a measure of how detectable an object is by radar. A larger RCS indicates that an object is more easily detected.";
CM_ SG_ 664 DET_VALID_FLAG_097 "is set if the measured detection is valid";
CM_ SG_ 664 DET_BI_STATIC_FLAG_097 "1 if detection is bi-static 0 otherwise";
CM_ SG_ 664 DET_SUPER_RES_TARGET_097 "flasg is set if the detection is super resolution target";
CM_ SG_ 664 DET_SNR_097 "The signal to noise ratio (SNR) of the radar detection";
CM_ SG_ 664 DET_POINT_TARGET_PROB_097 "Describes the possibility if more than one real-world object has led to this detection. 0[%] := 100[%] Multi target probability";
CM_ SG_ 664 DET_EXISTENCE_PROB_097 "Existence probability of the detection not based on history. Value does  not depend on any past experience with similar detections.
\note Use as confidence measure where a low value means less confidence
and a high value indicates strong confidence.";
CM_ SG_ 664 DET_OUTSIDE_SECTOR_097 "Flag to indicate detections outside the sector, set if the wrong sector calibration matrix was used";
CM_ SG_ 664 DET_HVC_FLAG_097 "Core2 Vehicle clutter flag";
CM_ SG_ 664 DET_CONFD_AZIMUTH_097 "Define the Confidence of Azimuth for Detection ";
CM_ SG_ 664 DET_CONFD_ELEVATION_097 "Define the Confidence of Elevation for the Detection ";
CM_ SG_ 664 DET_AZIMUTH_AMB_ID_097 "Each ambiguous measurement generates one Ambiguity ID. Ambiguity is indicated by an identical ambiguity ID.
note Unambiguous measurements have the ambiguity ID 0.";
CM_ SG_ 664 DET_AMBG_AZIMUTH_PROB_097 "Probability for different hypothesis, sum is 100 [%] for all detections with the same Ambiguity ID. 0 means no Ambiguity";
CM_ SG_ 664 DET_BI_STATIC_FLAG_098 "1 if detection is bi-static 0 otherwise";
CM_ SG_ 664 DET_BI_STATIC_FLAG_099 "1 if detection is bi-static 0 otherwise";
CM_ SG_ 664 DET_BI_STATIC_FLAG_100 "1 if detection is bi-static 0 otherwise";
CM_ SG_ 664 DET_MH_SCAN_INDEX_4LSB_097_100 "Scan index of the measured detection";
CM_ SG_ 664 DET_MH_CYCLE_COUNTER_097_100 "Detection Alive Counter";
CM_ SG_ 665 DET_RANGE_101 " measured position  of the detection";
CM_ SG_ 665 DET_RANGE_ERR_101 "RMSE or standard deviation of the measured angle  of the detection";
CM_ SG_ 665 DET_RANGE_VELOCITY_101 "Radial velocity of the detection positive in direction to the sensor";
CM_ SG_ 665 DET_RANGE_VELOCITY_ERR_101 "RMSE or standard deviation of the measure radial velocity of the detection";
CM_ SG_ 665 DET_AZIMUTH_101 "Measured angle  of the detection";
CM_ SG_ 665 DET_AZIMUTH_ERR_101 "RMSE or standard deviation of the measured angle  of the detection";
CM_ SG_ 665 DET_ELEVATION_101 "measured elevation of the detection";
CM_ SG_ 665 DET_ELEVATION_ERR_101 "RMSE or standard deviation of the measured elevation  of the detection";
CM_ SG_ 665 DET_RCS_101 "Radar Cross Section or Amplitude, is a measure of how detectable an object is by radar. A larger RCS indicates that an object is more easily detected.";
CM_ SG_ 665 DET_VALID_FLAG_101 "is set if the measured detection is valid";
CM_ SG_ 665 DET_BI_STATIC_FLAG_101 "1 if detection is bi-static 0 otherwise";
CM_ SG_ 665 DET_SUPER_RES_TARGET_101 "flasg is set if the detection is super resolution target";
CM_ SG_ 665 DET_SNR_101 "The signal to noise ratio (SNR) of the radar detection";
CM_ SG_ 665 DET_POINT_TARGET_PROB_101 "Describes the possibility if more than one real-world object has led to this detection. 0[%] := 100[%] Multi target probability";
CM_ SG_ 665 DET_EXISTENCE_PROB_101 "Existence probability of the detection not based on history. Value does  not depend on any past experience with similar detections.
\note Use as confidence measure where a low value means less confidence
and a high value indicates strong confidence.";
CM_ SG_ 665 DET_OUTSIDE_SECTOR_101 "Flag to indicate detections outside the sector, set if the wrong sector calibration matrix was used";
CM_ SG_ 665 DET_HVC_FLAG_101 "Core2 Vehicle clutter flag";
CM_ SG_ 665 DET_CONFD_AZIMUTH_101 "Define the Confidence of Azimuth for Detection ";
CM_ SG_ 665 DET_CONFD_ELEVATION_101 "Define the Confidence of Elevation for the Detection ";
CM_ SG_ 665 DET_AZIMUTH_AMB_ID_101 "Each ambiguous measurement generates one Ambiguity ID. Ambiguity is indicated by an identical ambiguity ID.
note Unambiguous measurements have the ambiguity ID 0.";
CM_ SG_ 665 DET_AMBG_AZIMUTH_PROB_101 "Probability for different hypothesis, sum is 100 [%] for all detections with the same Ambiguity ID. 0 means no Ambiguity";
CM_ SG_ 665 DET_BI_STATIC_FLAG_102 "1 if detection is bi-static 0 otherwise";
CM_ SG_ 665 DET_BI_STATIC_FLAG_103 "1 if detection is bi-static 0 otherwise";
CM_ SG_ 665 DET_BI_STATIC_FLAG_104 "1 if detection is bi-static 0 otherwise";
CM_ SG_ 665 DET_MH_SCAN_INDEX_4LSB_101_104 "Scan index of the measured detection";
CM_ SG_ 665 DET_MH_CYCLE_COUNTER_101_104 "Detection Alive Counter";

BA_DEF_ BO_ "CanTpBs" INT 0 255;
BA_DEF_ BO_ "EventRateOfChange" INT 10 10000;
BA_DEF_ BO_ "GenMsgCycleTime" INT 0 100000;
BA_DEF_ BO_ "GenMsgILSupport" ENUM  "No","Yes";
BA_DEF_ BO_ "GenMsgNrOfRepetition" INT 0 100;
BA_DEF_ BO_ "GenMsgSendType" ENUM  "FixedPeriodic","Event","EnabledPeriodic","NotUsed","NotUsed","EventPeriodic","NotUsed","NotUsed","NoMsgSendType";
BA_DEF_ BO_ "NetworkInitialization" ENUM  "No","Yes";
BA_DEF_ BO_ "VFrameFormat" ENUM  "StandardCAN","ExtendedCAN","reserved","reserved","reserved","reserved","reserved","reserved","reserved","reserved","reserved","reserved","reserved","reserved","StandardCAN_FD","ExtendedCAN_FD";
BA_DEF_ SG_ "GenSigCmt" STRING;
BA_DEF_ SG_ "GenSigCycleTime" INT 0 0;
BA_DEF_ SG_ "GenSigSendType" ENUM  "Cyclic","OnWrite","vector_leerstring","OnChange","vector_leerstring","IfActive","vector_leerstring","NoSigSendType";
BA_DEF_ SG_ "GenSigStartValue" INT 0 1000000000;
BA_DEF_ SG_ "GenSigTimeoutTime" INT 0 0;
BA_DEF_ SG_ "GenSigVtEn" STRING;
BA_DEF_ SG_ "GenSigVtName" STRING;
BA_DEF_DEF_ "CanTpBs" 255;
BA_DEF_DEF_ "EventRateOfChange" 10000;
BA_DEF_DEF_ "GenMsgCycleTime" 0;
BA_DEF_DEF_ "GenMsgILSupport" "Yes";
BA_DEF_DEF_ "GenMsgNrOfRepetition" 0;
BA_DEF_DEF_ "GenMsgSendType" "NoMsgSendType";
BA_DEF_DEF_ "GenSigCmt" "";
BA_DEF_DEF_ "GenSigCycleTime" 0;
BA_DEF_DEF_ "GenSigSendType" "NoSigSendType";
BA_DEF_DEF_ "GenSigStartValue" 0;
BA_DEF_DEF_ "GenSigTimeoutTime" 0;
BA_DEF_DEF_ "GenSigVtEn" "";
BA_DEF_DEF_ "GenSigVtName" "";
BA_DEF_DEF_ "NetworkInitialization" "Yes";
BA_DEF_DEF_ "VFrameFormat" "StandardCAN_FD";
BA_ "GenMsgSendType" BO_ 649 1;
BA_ "GenMsgSendType" BO_ 650 1;
BA_ "GenMsgSendType" BO_ 651 1;
BA_ "GenMsgSendType" BO_ 652 1;
BA_ "GenMsgSendType" BO_ 653 1;
BA_ "GenMsgSendType" BO_ 654 1;
BA_ "GenMsgSendType" BO_ 655 1;
BA_ "GenMsgSendType" BO_ 656 1;
BA_ "GenMsgSendType" BO_ 657 1;
BA_ "GenMsgSendType" BO_ 658 1;
BA_ "GenMsgSendType" BO_ 659 1;
BA_ "GenMsgSendType" BO_ 660 1;
BA_ "GenMsgSendType" BO_ 661 1;
BA_ "GenMsgSendType" BO_ 662 1;
BA_ "GenMsgSendType" BO_ 663 1;
BA_ "GenMsgSendType" BO_ 664 1;
BA_ "GenMsgSendType" BO_ 665 1;
BA_ "GenSigStartValue" SG_ 649 DET_RANGE_VELOCITY_037 16384;
BA_ "GenSigStartValue" SG_ 649 DET_RCS_037 128;
BA_ "GenSigStartValue" SG_ 649 DET_RANGE_VELOCITY_038 16384;
BA_ "GenSigStartValue" SG_ 649 DET_RCS_038 128;
BA_ "GenSigStartValue" SG_ 649 DET_RANGE_VELOCITY_039 16384;
BA_ "GenSigStartValue" SG_ 649 DET_RCS_039 128;
BA_ "GenSigStartValue" SG_ 649 DET_RANGE_VELOCITY_040 16384;
BA_ "GenSigStartValue" SG_ 649 DET_RCS_040 128;
BA_ "GenSigStartValue" SG_ 650 DET_RANGE_VELOCITY_041 16384;
BA_ "GenSigStartValue" SG_ 650 DET_RCS_041 128;
BA_ "GenSigStartValue" SG_ 650 DET_RANGE_VELOCITY_042 16384;
BA_ "GenSigStartValue" SG_ 650 DET_RCS_042 128;
BA_ "GenSigStartValue" SG_ 650 DET_RANGE_VELOCITY_043 16384;
BA_ "GenSigStartValue" SG_ 650 DET_RCS_043 128;
BA_ "GenSigStartValue" SG_ 650 DET_RANGE_VELOCITY_044 16384;
BA_ "GenSigStartValue" SG_ 650 DET_RCS_044 128;
BA_ "GenSigStartValue" SG_ 651 DET_RANGE_VELOCITY_045 16384;
BA_ "GenSigStartValue" SG_ 651 DET_RCS_045 128;
BA_ "GenSigStartValue" SG_ 651 DET_RANGE_VELOCITY_046 16384;
BA_ "GenSigStartValue" SG_ 651 DET_RCS_046 128;
BA_ "GenSigStartValue" SG_ 651 DET_RANGE_VELOCITY_047 16384;
BA_ "GenSigStartValue" SG_ 651 DET_RCS_047 128;
BA_ "GenSigStartValue" SG_ 651 DET_RANGE_VELOCITY_048 16384;
BA_ "GenSigStartValue" SG_ 651 DET_RCS_048 128;
BA_ "GenSigStartValue" SG_ 652 DET_RANGE_VELOCITY_049 16384;
BA_ "GenSigStartValue" SG_ 652 DET_RCS_049 128;
BA_ "GenSigStartValue" SG_ 652 DET_RANGE_VELOCITY_050 16384;
BA_ "GenSigStartValue" SG_ 652 DET_RCS_050 128;
BA_ "GenSigStartValue" SG_ 652 DET_RANGE_VELOCITY_051 16384;
BA_ "GenSigStartValue" SG_ 652 DET_RCS_051 128;
BA_ "GenSigStartValue" SG_ 652 DET_RANGE_VELOCITY_052 16384;
BA_ "GenSigStartValue" SG_ 652 DET_RCS_052 128;
BA_ "GenSigStartValue" SG_ 653 DET_RANGE_VELOCITY_053 16384;
BA_ "GenSigStartValue" SG_ 653 DET_RCS_053 128;
BA_ "GenSigStartValue" SG_ 653 DET_RANGE_VELOCITY_054 16384;
BA_ "GenSigStartValue" SG_ 653 DET_RCS_054 128;
BA_ "GenSigStartValue" SG_ 653 DET_RANGE_VELOCITY_055 16384;
BA_ "GenSigStartValue" SG_ 653 DET_RCS_055 128;
BA_ "GenSigStartValue" SG_ 653 DET_RANGE_VELOCITY_056 16384;
BA_ "GenSigStartValue" SG_ 653 DET_RCS_056 128;
BA_ "GenSigStartValue" SG_ 654 DET_RANGE_VELOCITY_057 16384;
BA_ "GenSigStartValue" SG_ 654 DET_RCS_057 128;
BA_ "GenSigStartValue" SG_ 654 DET_RANGE_VELOCITY_058 16384;
BA_ "GenSigStartValue" SG_ 654 DET_RCS_058 128;
BA_ "GenSigStartValue" SG_ 654 DET_RANGE_VELOCITY_059 16384;
BA_ "GenSigStartValue" SG_ 654 DET_RCS_059 128;
BA_ "GenSigStartValue" SG_ 654 DET_RANGE_VELOCITY_060 16384;
BA_ "GenSigStartValue" SG_ 654 DET_RCS_060 128;
BA_ "GenSigStartValue" SG_ 655 DET_RANGE_VELOCITY_061 16384;
BA_ "GenSigStartValue" SG_ 655 DET_RCS_061 128;
BA_ "GenSigStartValue" SG_ 655 DET_RANGE_VELOCITY_062 16384;
BA_ "GenSigStartValue" SG_ 655 DET_RCS_062 128;
BA_ "GenSigStartValue" SG_ 655 DET_RANGE_VELOCITY_063 16384;
BA_ "GenSigStartValue" SG_ 655 DET_RCS_063 128;
BA_ "GenSigStartValue" SG_ 655 DET_RANGE_VELOCITY_064 16384;
BA_ "GenSigStartValue" SG_ 655 DET_RCS_064 128;
BA_ "GenSigStartValue" SG_ 656 DET_RANGE_VELOCITY_065 16384;
BA_ "GenSigStartValue" SG_ 656 DET_RCS_065 128;
BA_ "GenSigStartValue" SG_ 656 DET_RANGE_VELOCITY_066 16384;
BA_ "GenSigStartValue" SG_ 656 DET_RCS_066 128;
BA_ "GenSigStartValue" SG_ 656 DET_RANGE_VELOCITY_067 16384;
BA_ "GenSigStartValue" SG_ 656 DET_RCS_067 128;
BA_ "GenSigStartValue" SG_ 656 DET_RANGE_VELOCITY_068 16384;
BA_ "GenSigStartValue" SG_ 656 DET_RCS_068 128;
BA_ "GenSigStartValue" SG_ 657 DET_RANGE_VELOCITY_069 16384;
BA_ "GenSigStartValue" SG_ 657 DET_RCS_069 128;
BA_ "GenSigStartValue" SG_ 657 DET_RANGE_VELOCITY_070 16384;
BA_ "GenSigStartValue" SG_ 657 DET_RCS_070 128;
BA_ "GenSigStartValue" SG_ 657 DET_RANGE_VELOCITY_071 16384;
BA_ "GenSigStartValue" SG_ 657 DET_RCS_071 128;
BA_ "GenSigStartValue" SG_ 657 DET_RANGE_VELOCITY_072 16384;
BA_ "GenSigStartValue" SG_ 657 DET_RCS_072 128;
BA_ "GenSigStartValue" SG_ 658 DET_RANGE_VELOCITY_073 16384;
BA_ "GenSigStartValue" SG_ 658 DET_RCS_073 128;
BA_ "GenSigStartValue" SG_ 658 DET_RANGE_VELOCITY_074 16384;
BA_ "GenSigStartValue" SG_ 658 DET_RCS_074 128;
BA_ "GenSigStartValue" SG_ 658 DET_RANGE_VELOCITY_075 16384;
BA_ "GenSigStartValue" SG_ 658 DET_RCS_075 128;
BA_ "GenSigStartValue" SG_ 658 DET_RANGE_VELOCITY_076 16384;
BA_ "GenSigStartValue" SG_ 658 DET_RCS_076 128;
BA_ "GenSigStartValue" SG_ 659 DET_RANGE_VELOCITY_077 16384;
BA_ "GenSigStartValue" SG_ 659 DET_RCS_077 128;
BA_ "GenSigStartValue" SG_ 659 DET_RANGE_VELOCITY_078 16384;
BA_ "GenSigStartValue" SG_ 659 DET_RCS_078 128;
BA_ "GenSigStartValue" SG_ 659 DET_RANGE_VELOCITY_079 16384;
BA_ "GenSigStartValue" SG_ 659 DET_RCS_079 128;
BA_ "GenSigStartValue" SG_ 659 DET_RANGE_VELOCITY_080 16384;
BA_ "GenSigStartValue" SG_ 659 DET_RCS_080 128;
BA_ "GenSigStartValue" SG_ 660 DET_RANGE_VELOCITY_081 16384;
BA_ "GenSigStartValue" SG_ 660 DET_RCS_081 128;
BA_ "GenSigStartValue" SG_ 660 DET_RANGE_VELOCITY_082 16384;
BA_ "GenSigStartValue" SG_ 660 DET_RCS_082 128;
BA_ "GenSigStartValue" SG_ 660 DET_RANGE_VELOCITY_083 16384;
BA_ "GenSigStartValue" SG_ 660 DET_RCS_083 128;
BA_ "GenSigStartValue" SG_ 660 DET_RANGE_VELOCITY_084 16384;
BA_ "GenSigStartValue" SG_ 660 DET_RCS_084 128;
BA_ "GenSigStartValue" SG_ 661 DET_RANGE_VELOCITY_085 16384;
BA_ "GenSigStartValue" SG_ 661 DET_RCS_085 128;
BA_ "GenSigStartValue" SG_ 661 DET_RANGE_VELOCITY_086 16384;
BA_ "GenSigStartValue" SG_ 661 DET_RCS_086 128;
BA_ "GenSigStartValue" SG_ 661 DET_RANGE_VELOCITY_087 16384;
BA_ "GenSigStartValue" SG_ 661 DET_RCS_087 128;
BA_ "GenSigStartValue" SG_ 661 DET_RANGE_VELOCITY_088 16384;
BA_ "GenSigStartValue" SG_ 661 DET_RCS_088 128;
BA_ "GenSigStartValue" SG_ 662 DET_RANGE_VELOCITY_089 16384;
BA_ "GenSigStartValue" SG_ 662 DET_RCS_089 128;
BA_ "GenSigStartValue" SG_ 662 DET_RANGE_VELOCITY_090 16384;
BA_ "GenSigStartValue" SG_ 662 DET_RCS_090 128;
BA_ "GenSigStartValue" SG_ 662 DET_RANGE_VELOCITY_091 16384;
BA_ "GenSigStartValue" SG_ 662 DET_RCS_091 128;
BA_ "GenSigStartValue" SG_ 662 DET_RANGE_VELOCITY_092 16384;
BA_ "GenSigStartValue" SG_ 662 DET_RCS_092 128;
BA_ "GenSigStartValue" SG_ 663 DET_RANGE_VELOCITY_093 16384;
BA_ "GenSigStartValue" SG_ 663 DET_RCS_093 128;
BA_ "GenSigStartValue" SG_ 663 DET_RANGE_VELOCITY_094 16384;
BA_ "GenSigStartValue" SG_ 663 DET_RCS_094 128;
BA_ "GenSigStartValue" SG_ 663 DET_RANGE_VELOCITY_095 16384;
BA_ "GenSigStartValue" SG_ 663 DET_RCS_095 128;
BA_ "GenSigStartValue" SG_ 663 DET_RANGE_VELOCITY_096 16384;
BA_ "GenSigStartValue" SG_ 663 DET_RCS_096 128;
BA_ "GenSigStartValue" SG_ 664 DET_RANGE_VELOCITY_097 16384;
BA_ "GenSigStartValue" SG_ 664 DET_RCS_097 128;
BA_ "GenSigStartValue" SG_ 664 DET_RANGE_VELOCITY_098 16384;
BA_ "GenSigStartValue" SG_ 664 DET_RCS_098 128;
BA_ "GenSigStartValue" SG_ 664 DET_RANGE_VELOCITY_099 16384;
BA_ "GenSigStartValue" SG_ 664 DET_RCS_099 128;
BA_ "GenSigStartValue" SG_ 664 DET_RANGE_VELOCITY_100 16384;
BA_ "GenSigStartValue" SG_ 664 DET_RCS_100 128;
BA_ "GenSigStartValue" SG_ 665 DET_RANGE_VELOCITY_101 16384;
BA_ "GenSigStartValue" SG_ 665 DET_RCS_101 128;
BA_ "GenSigStartValue" SG_ 665 DET_RANGE_VELOCITY_102 16384;
BA_ "GenSigStartValue" SG_ 665 DET_RCS_102 128;
BA_ "GenSigStartValue" SG_ 665 DET_RANGE_VELOCITY_103 16384;
BA_ "GenSigStartValue" SG_ 665 DET_RCS_103 128;
BA_ "GenSigStartValue" SG_ 665 DET_RANGE_VELOCITY_104 16384;
BA_ "GenSigStartValue" SG_ 665 DET_RCS_104 128;
VAL_ 649 DET_CONFD_AZIMUTH_037 0 "High" 1 "MidHigh" 2 "MidLow" 3 "Low";
VAL_ 649 DET_CONFD_ELEVATION_037 0 "High" 1 "MidHigh" 2 "MidLow" 3 "Low";
VAL_ 649 DET_CONFD_AZIMUTH_038 0 "High" 1 "MidHigh" 2 "MidLow" 3 "Low";
VAL_ 649 DET_CONFD_ELEVATION_038 0 "High" 1 "MidHigh" 2 "MidLow" 3 "Low";
VAL_ 649 DET_CONFD_AZIMUTH_039 0 "High" 1 "MidHigh" 2 "MidLow" 3 "Low";
VAL_ 649 DET_CONFD_ELEVATION_039 0 "High" 1 "MidHigh" 2 "MidLow" 3 "Low";
VAL_ 650 DET_CONFD_AZIMUTH_041 0 "High" 1 "MidHigh" 2 "MidLow" 3 "Low";
VAL_ 650 DET_CONFD_ELEVATION_041 0 "High" 1 "MidHigh" 2 "MidLow" 3 "Low";
VAL_ 650 DET_CONFD_AZIMUTH_042 0 "High" 1 "MidHigh" 2 "MidLow" 3 "Low";
VAL_ 650 DET_CONFD_ELEVATION_042 0 "High" 1 "MidHigh" 2 "MidLow" 3 "Low";
VAL_ 650 DET_CONFD_AZIMUTH_043 0 "High" 1 "MidHigh" 2 "MidLow" 3 "Low";
VAL_ 650 DET_CONFD_ELEVATION_043 0 "High" 1 "MidHigh" 2 "MidLow" 3 "Low";
VAL_ 651 DET_CONFD_AZIMUTH_045 0 "High" 1 "MidHigh" 2 "MidLow" 3 "Low";
VAL_ 651 DET_CONFD_ELEVATION_045 0 "High" 1 "MidHigh" 2 "MidLow" 3 "Low";
VAL_ 651 DET_CONFD_AZIMUTH_046 0 "High" 1 "MidHigh" 2 "MidLow" 3 "Low";
VAL_ 651 DET_CONFD_ELEVATION_046 0 "High" 1 "MidHigh" 2 "MidLow" 3 "Low";
VAL_ 651 DET_CONFD_AZIMUTH_047 0 "High" 1 "MidHigh" 2 "MidLow" 3 "Low";
VAL_ 651 DET_CONFD_ELEVATION_047 0 "High" 1 "MidHigh" 2 "MidLow" 3 "Low";
VAL_ 652 DET_CONFD_AZIMUTH_049 0 "High" 1 "MidHigh" 2 "MidLow" 3 "Low";
VAL_ 652 DET_CONFD_ELEVATION_049 0 "High" 1 "MidHigh" 2 "MidLow" 3 "Low";
VAL_ 652 DET_CONFD_AZIMUTH_050 0 "High" 1 "MidHigh" 2 "MidLow" 3 "Low";
VAL_ 652 DET_CONFD_ELEVATION_050 0 "High" 1 "MidHigh" 2 "MidLow" 3 "Low";
VAL_ 652 DET_CONFD_AZIMUTH_051 0 "High" 1 "MidHigh" 2 "MidLow" 3 "Low";
VAL_ 652 DET_CONFD_ELEVATION_051 0 "High" 1 "MidHigh" 2 "MidLow" 3 "Low";
VAL_ 653 DET_CONFD_AZIMUTH_053 0 "High" 1 "MidHigh" 2 "MidLow" 3 "Low";
VAL_ 653 DET_CONFD_ELEVATION_053 0 "High" 1 "MidHigh" 2 "MidLow" 3 "Low";
VAL_ 653 DET_CONFD_AZIMUTH_054 0 "High" 1 "MidHigh" 2 "MidLow" 3 "Low";
VAL_ 653 DET_CONFD_ELEVATION_054 0 "High" 1 "MidHigh" 2 "MidLow" 3 "Low";
VAL_ 653 DET_CONFD_AZIMUTH_055 0 "High" 1 "MidHigh" 2 "MidLow" 3 "Low";
VAL_ 653 DET_CONFD_ELEVATION_055 0 "High" 1 "MidHigh" 2 "MidLow" 3 "Low";
VAL_ 654 DET_CONFD_AZIMUTH_057 0 "High" 1 "MidHigh" 2 "MidLow" 3 "Low";
VAL_ 654 DET_CONFD_ELEVATION_057 0 "High" 1 "MidHigh" 2 "MidLow" 3 "Low";
VAL_ 654 DET_CONFD_AZIMUTH_058 0 "High" 1 "MidHigh" 2 "MidLow" 3 "Low";
VAL_ 654 DET_CONFD_ELEVATION_058 0 "High" 1 "MidHigh" 2 "MidLow" 3 "Low";
VAL_ 654 DET_CONFD_AZIMUTH_059 0 "High" 1 "MidHigh" 2 "MidLow" 3 "Low";
VAL_ 654 DET_CONFD_ELEVATION_059 0 "High" 1 "MidHigh" 2 "MidLow" 3 "Low";
VAL_ 655 DET_CONFD_AZIMUTH_061 0 "High" 1 "MidHigh" 2 "MidLow" 3 "Low";
VAL_ 655 DET_CONFD_ELEVATION_061 0 "High" 1 "MidHigh" 2 "MidLow" 3 "Low";
VAL_ 655 DET_CONFD_AZIMUTH_062 0 "High" 1 "MidHigh" 2 "MidLow" 3 "Low";
VAL_ 655 DET_CONFD_ELEVATION_062 0 "High" 1 "MidHigh" 2 "MidLow" 3 "Low";
VAL_ 655 DET_CONFD_AZIMUTH_063 0 "High" 1 "MidHigh" 2 "MidLow" 3 "Low";
VAL_ 655 DET_CONFD_ELEVATION_063 0 "High" 1 "MidHigh" 2 "MidLow" 3 "Low";
VAL_ 656 DET_CONFD_AZIMUTH_065 0 "High" 1 "MidHigh" 2 "MidLow" 3 "Low";
VAL_ 656 DET_CONFD_ELEVATION_065 0 "High" 1 "MidHigh" 2 "MidLow" 3 "Low";
VAL_ 656 DET_CONFD_AZIMUTH_066 0 "High" 1 "MidHigh" 2 "MidLow" 3 "Low";
VAL_ 656 DET_CONFD_ELEVATION_066 0 "High" 1 "MidHigh" 2 "MidLow" 3 "Low";
VAL_ 656 DET_CONFD_AZIMUTH_067 0 "High" 1 "MidHigh" 2 "MidLow" 3 "Low";
VAL_ 656 DET_CONFD_ELEVATION_067 0 "High" 1 "MidHigh" 2 "MidLow" 3 "Low";
VAL_ 657 DET_CONFD_AZIMUTH_069 0 "High" 1 "MidHigh" 2 "MidLow" 3 "Low";
VAL_ 657 DET_CONFD_ELEVATION_069 0 "High" 1 "MidHigh" 2 "MidLow" 3 "Low";
VAL_ 657 DET_CONFD_AZIMUTH_070 0 "High" 1 "MidHigh" 2 "MidLow" 3 "Low";
VAL_ 657 DET_CONFD_ELEVATION_070 0 "High" 1 "MidHigh" 2 "MidLow" 3 "Low";
VAL_ 657 DET_CONFD_AZIMUTH_071 0 "High" 1 "MidHigh" 2 "MidLow" 3 "Low";
VAL_ 657 DET_CONFD_ELEVATION_071 0 "High" 1 "MidHigh" 2 "MidLow" 3 "Low";
VAL_ 658 DET_CONFD_AZIMUTH_073 0 "High" 1 "MidHigh" 2 "MidLow" 3 "Low";
VAL_ 658 DET_CONFD_ELEVATION_073 0 "High" 1 "MidHigh" 2 "MidLow" 3 "Low";
VAL_ 658 DET_CONFD_AZIMUTH_074 0 "High" 1 "MidHigh" 2 "MidLow" 3 "Low";
VAL_ 658 DET_CONFD_ELEVATION_074 0 "High" 1 "MidHigh" 2 "MidLow" 3 "Low";
VAL_ 658 DET_CONFD_AZIMUTH_075 0 "High" 1 "MidHigh" 2 "MidLow" 3 "Low";
VAL_ 658 DET_CONFD_ELEVATION_075 0 "High" 1 "MidHigh" 2 "MidLow" 3 "Low";
VAL_ 659 DET_CONFD_AZIMUTH_077 0 "High" 1 "MidHigh" 2 "MidLow" 3 "Low";
VAL_ 659 DET_CONFD_ELEVATION_077 0 "High" 1 "MidHigh" 2 "MidLow" 3 "Low";
VAL_ 659 DET_CONFD_AZIMUTH_078 0 "High" 1 "MidHigh" 2 "MidLow" 3 "Low";
VAL_ 659 DET_CONFD_ELEVATION_078 0 "High" 1 "MidHigh" 2 "MidLow" 3 "Low";
VAL_ 659 DET_CONFD_AZIMUTH_079 0 "High" 1 "MidHigh" 2 "MidLow" 3 "Low";
VAL_ 659 DET_CONFD_ELEVATION_079 0 "High" 1 "MidHigh" 2 "MidLow" 3 "Low";
VAL_ 660 DET_CONFD_AZIMUTH_081 0 "High" 1 "MidHigh" 2 "MidLow" 3 "Low";
VAL_ 660 DET_CONFD_ELEVATION_081 0 "High" 1 "MidHigh" 2 "MidLow" 3 "Low";
VAL_ 660 DET_CONFD_AZIMUTH_082 0 "High" 1 "MidHigh" 2 "MidLow" 3 "Low";
VAL_ 660 DET_CONFD_ELEVATION_082 0 "High" 1 "MidHigh" 2 "MidLow" 3 "Low";
VAL_ 660 DET_CONFD_AZIMUTH_083 0 "High" 1 "MidHigh" 2 "MidLow" 3 "Low";
VAL_ 660 DET_CONFD_ELEVATION_083 0 "High" 1 "MidHigh" 2 "MidLow" 3 "Low";
VAL_ 661 DET_CONFD_AZIMUTH_085 0 "High" 1 "MidHigh" 2 "MidLow" 3 "Low";
VAL_ 661 DET_CONFD_ELEVATION_085 0 "High" 1 "MidHigh" 2 "MidLow" 3 "Low";
VAL_ 661 DET_CONFD_AZIMUTH_086 0 "High" 1 "MidHigh" 2 "MidLow" 3 "Low";
VAL_ 661 DET_CONFD_ELEVATION_086 0 "High" 1 "MidHigh" 2 "MidLow" 3 "Low";
VAL_ 661 DET_CONFD_AZIMUTH_087 0 "High" 1 "MidHigh" 2 "MidLow" 3 "Low";
VAL_ 661 DET_CONFD_ELEVATION_087 0 "High" 1 "MidHigh" 2 "MidLow" 3 "Low";
VAL_ 662 DET_CONFD_AZIMUTH_089 0 "High" 1 "MidHigh" 2 "MidLow" 3 "Low";
VAL_ 662 DET_CONFD_ELEVATION_089 0 "High" 1 "MidHigh" 2 "MidLow" 3 "Low";
VAL_ 662 DET_CONFD_AZIMUTH_090 0 "High" 1 "MidHigh" 2 "MidLow" 3 "Low";
VAL_ 662 DET_CONFD_ELEVATION_090 0 "High" 1 "MidHigh" 2 "MidLow" 3 "Low";
VAL_ 662 DET_CONFD_AZIMUTH_091 0 "High" 1 "MidHigh" 2 "MidLow" 3 "Low";
VAL_ 662 DET_CONFD_ELEVATION_091 0 "High" 1 "MidHigh" 2 "MidLow" 3 "Low";
VAL_ 663 DET_CONFD_AZIMUTH_093 0 "High" 1 "MidHigh" 2 "MidLow" 3 "Low";
VAL_ 663 DET_CONFD_ELEVATION_093 0 "High" 1 "MidHigh" 2 "MidLow" 3 "Low";
VAL_ 663 DET_CONFD_AZIMUTH_094 0 "High" 1 "MidHigh" 2 "MidLow" 3 "Low";
VAL_ 663 DET_CONFD_ELEVATION_094 0 "High" 1 "MidHigh" 2 "MidLow" 3 "Low";
VAL_ 663 DET_CONFD_AZIMUTH_095 0 "High" 1 "MidHigh" 2 "MidLow" 3 "Low";
VAL_ 663 DET_CONFD_ELEVATION_095 0 "High" 1 "MidHigh" 2 "MidLow" 3 "Low";
VAL_ 664 DET_CONFD_AZIMUTH_097 0 "High" 1 "MidHigh" 2 "MidLow" 3 "Low";
VAL_ 664 DET_CONFD_ELEVATION_097 0 "High" 1 "MidHigh" 2 "MidLow" 3 "Low";
VAL_ 664 DET_CONFD_AZIMUTH_098 0 "High" 1 "MidHigh" 2 "MidLow" 3 "Low";
VAL_ 664 DET_CONFD_ELEVATION_098 0 "High" 1 "MidHigh" 2 "MidLow" 3 "Low";
VAL_ 664 DET_CONFD_AZIMUTH_099 0 "High" 1 "MidHigh" 2 "MidLow" 3 "Low";
VAL_ 664 DET_CONFD_ELEVATION_099 0 "High" 1 "MidHigh" 2 "MidLow" 3 "Low";
VAL_ 665 DET_CONFD_AZIMUTH_101 0 "High" 1 "MidHigh" 2 "MidLow" 3 "Low";
VAL_ 665 DET_CONFD_ELEVATION_101 0 "High" 1 "MidHigh" 2 "MidLow" 3 "Low";
VAL_ 665 DET_CONFD_AZIMUTH_102 0 "High" 1 "MidHigh" 2 "MidLow" 3 "Low";
VAL_ 665 DET_CONFD_ELEVATION_102 0 "High" 1 "MidHigh" 2 "MidLow" 3 "Low";
VAL_ 665 DET_CONFD_AZIMUTH_103 0 "High" 1 "MidHigh" 2 "MidLow" 3 "Low";
VAL_ 665 DET_CONFD_ELEVATION_103 0 "High" 1 "MidHigh" 2 "MidLow" 3 "Low";
SIG_GROUP_ 649 Detection037 1 : DET_BI_STATIC_FLAG_037 DET_AMBG_AZIMUTH_PROB_037 DET_AZIMUTH_AMB_ID_037 DET_CONFD_ELEVATION_037 DET_CONFD_AZIMUTH_037 DET_HVC_FLAG_037 DET_OUTSIDE_SECTOR_037 DET_AZIMUTH_ERR_037 DET_ELEVATION_ERR_037 DET_RANGE_ERR_037 DET_RANGE_VELOCITY_ERR_037 DET_EXISTENCE_PROB_037 DET_POINT_TARGET_PROB_037 DET_SNR_037 DET_SUPER_RES_TARGET_037 DET_VALID_FLAG_037 DET_RCS_037 DET_ELEVATION_037 DET_AZIMUTH_037 DET_RANGE_VELOCITY_037 DET_RANGE_037;
SIG_GROUP_ 649 Detection038 1 : DET_BI_STATIC_FLAG_038 DET_AMBG_AZIMUTH_PROB_038 DET_AZIMUTH_AMB_ID_038 DET_CONFD_ELEVATION_038 DET_CONFD_AZIMUTH_038 DET_HVC_FLAG_038 DET_OUTSIDE_SECTOR_038 DET_AZIMUTH_ERR_038 DET_ELEVATION_ERR_038 DET_RANGE_ERR_038 DET_RANGE_VELOCITY_ERR_038 DET_EXISTENCE_PROB_038 DET_POINT_TARGET_PROB_038 DET_SNR_038 DET_SUPER_RES_TARGET_038 DET_VALID_FLAG_038 DET_RCS_038 DET_ELEVATION_038 DET_AZIMUTH_038 DET_RANGE_VELOCITY_038 DET_RANGE_038;
SIG_GROUP_ 649 Detection039 1 : DET_BI_STATIC_FLAG_039 DET_AMBG_AZIMUTH_PROB_039 DET_AZIMUTH_AMB_ID_039 DET_CONFD_ELEVATION_039 DET_CONFD_AZIMUTH_039 DET_HVC_FLAG_039 DET_OUTSIDE_SECTOR_039 DET_AZIMUTH_ERR_039 DET_ELEVATION_ERR_039 DET_RANGE_ERR_039 DET_RANGE_VELOCITY_ERR_039 DET_EXISTENCE_PROB_039 DET_POINT_TARGET_PROB_039 DET_SNR_039 DET_SUPER_RES_TARGET_039 DET_VALID_FLAG_039 DET_RCS_039 DET_ELEVATION_039 DET_AZIMUTH_039 DET_RANGE_VELOCITY_039 DET_RANGE_039;
SIG_GROUP_ 649 Detection040 1 : DET_BI_STATIC_FLAG_040 DET_AMBG_AZIMUTH_PROB_040 DET_AZIMUTH_AMB_ID_040 DET_CONFD_ELEVATION_040 DET_CONFD_AZIMUTH_040 DET_HVC_FLAG_040 DET_OUTSIDE_SECTOR_040 DET_EXISTENCE_PROB_040 DET_POINT_TARGET_PROB_040 DET_SNR_040 DET_SUPER_RES_TARGET_040 DET_VALID_FLAG_040 DET_RCS_040 DET_ELEVATION_ERR_040 DET_ELEVATION_040 DET_AZIMUTH_ERR_040 DET_AZIMUTH_040 DET_RANGE_VELOCITY_ERR_040 DET_RANGE_VELOCITY_040 DET_RANGE_ERR_040 DET_RANGE_040;
SIG_GROUP_ 650 Detection041 1 : DET_BI_STATIC_FLAG_041 DET_AMBG_AZIMUTH_PROB_041 DET_AZIMUTH_AMB_ID_041 DET_CONFD_ELEVATION_041 DET_CONFD_AZIMUTH_041 DET_HVC_FLAG_041 DET_OUTSIDE_SECTOR_041 DET_AZIMUTH_ERR_041 DET_ELEVATION_ERR_041 DET_RANGE_ERR_041 DET_RANGE_VELOCITY_ERR_041 DET_EXISTENCE_PROB_041 DET_POINT_TARGET_PROB_041 DET_SNR_041 DET_SUPER_RES_TARGET_041 DET_VALID_FLAG_041 DET_RCS_041 DET_ELEVATION_041 DET_AZIMUTH_041 DET_RANGE_VELOCITY_041 DET_RANGE_041;
SIG_GROUP_ 650 Detection042 1 : DET_BI_STATIC_FLAG_042 DET_AMBG_AZIMUTH_PROB_042 DET_AZIMUTH_AMB_ID_042 DET_CONFD_ELEVATION_042 DET_CONFD_AZIMUTH_042 DET_HVC_FLAG_042 DET_OUTSIDE_SECTOR_042 DET_AZIMUTH_ERR_042 DET_ELEVATION_ERR_042 DET_RANGE_ERR_042 DET_RANGE_VELOCITY_ERR_042 DET_EXISTENCE_PROB_042 DET_POINT_TARGET_PROB_042 DET_SNR_042 DET_SUPER_RES_TARGET_042 DET_VALID_FLAG_042 DET_RCS_042 DET_ELEVATION_042 DET_AZIMUTH_042 DET_RANGE_VELOCITY_042 DET_RANGE_042;
SIG_GROUP_ 650 Detection043 1 : DET_BI_STATIC_FLAG_043 DET_AMBG_AZIMUTH_PROB_043 DET_AZIMUTH_AMB_ID_043 DET_CONFD_ELEVATION_043 DET_CONFD_AZIMUTH_043 DET_HVC_FLAG_043 DET_OUTSIDE_SECTOR_043 DET_AZIMUTH_ERR_043 DET_ELEVATION_ERR_043 DET_RANGE_ERR_043 DET_RANGE_VELOCITY_ERR_043 DET_EXISTENCE_PROB_043 DET_POINT_TARGET_PROB_043 DET_SNR_043 DET_SUPER_RES_TARGET_043 DET_VALID_FLAG_043 DET_RCS_043 DET_ELEVATION_043 DET_AZIMUTH_043 DET_RANGE_VELOCITY_043 DET_RANGE_043;
SIG_GROUP_ 650 Detection044 1 : DET_BI_STATIC_FLAG_044 DET_AMBG_AZIMUTH_PROB_044 DET_AZIMUTH_AMB_ID_044 DET_CONFD_ELEVATION_044 DET_CONFD_AZIMUTH_044 DET_HVC_FLAG_044 DET_OUTSIDE_SECTOR_044 DET_EXISTENCE_PROB_044 DET_POINT_TARGET_PROB_044 DET_SNR_044 DET_SUPER_RES_TARGET_044 DET_VALID_FLAG_044 DET_RCS_044 DET_ELEVATION_ERR_044 DET_ELEVATION_044 DET_AZIMUTH_ERR_044 DET_AZIMUTH_044 DET_RANGE_VELOCITY_ERR_044 DET_RANGE_VELOCITY_044 DET_RANGE_ERR_044 DET_RANGE_044;
SIG_GROUP_ 651 Detection045 1 : DET_BI_STATIC_FLAG_045 DET_AMBG_AZIMUTH_PROB_045 DET_AZIMUTH_AMB_ID_045 DET_CONFD_ELEVATION_045 DET_CONFD_AZIMUTH_045 DET_HVC_FLAG_045 DET_OUTSIDE_SECTOR_045 DET_AZIMUTH_ERR_045 DET_ELEVATION_ERR_045 DET_RANGE_ERR_045 DET_RANGE_VELOCITY_ERR_045 DET_EXISTENCE_PROB_045 DET_POINT_TARGET_PROB_045 DET_SNR_045 DET_SUPER_RES_TARGET_045 DET_VALID_FLAG_045 DET_RCS_045 DET_ELEVATION_045 DET_AZIMUTH_045 DET_RANGE_VELOCITY_045 DET_RANGE_045;
SIG_GROUP_ 651 Detection046 1 : DET_BI_STATIC_FLAG_046 DET_AMBG_AZIMUTH_PROB_046 DET_AZIMUTH_AMB_ID_046 DET_CONFD_ELEVATION_046 DET_CONFD_AZIMUTH_046 DET_HVC_FLAG_046 DET_OUTSIDE_SECTOR_046 DET_AZIMUTH_ERR_046 DET_ELEVATION_ERR_046 DET_RANGE_ERR_046 DET_RANGE_VELOCITY_ERR_046 DET_EXISTENCE_PROB_046 DET_POINT_TARGET_PROB_046 DET_SNR_046 DET_SUPER_RES_TARGET_046 DET_VALID_FLAG_046 DET_RCS_046 DET_ELEVATION_046 DET_AZIMUTH_046 DET_RANGE_VELOCITY_046 DET_RANGE_046;
SIG_GROUP_ 651 Detection047 1 : DET_BI_STATIC_FLAG_047 DET_AMBG_AZIMUTH_PROB_047 DET_AZIMUTH_AMB_ID_047 DET_CONFD_ELEVATION_047 DET_CONFD_AZIMUTH_047 DET_HVC_FLAG_047 DET_OUTSIDE_SECTOR_047 DET_AZIMUTH_ERR_047 DET_ELEVATION_ERR_047 DET_RANGE_ERR_047 DET_RANGE_VELOCITY_ERR_047 DET_EXISTENCE_PROB_047 DET_POINT_TARGET_PROB_047 DET_SNR_047 DET_SUPER_RES_TARGET_047 DET_VALID_FLAG_047 DET_RCS_047 DET_ELEVATION_047 DET_AZIMUTH_047 DET_RANGE_VELOCITY_047 DET_RANGE_047;
SIG_GROUP_ 651 Detection048 1 : DET_BI_STATIC_FLAG_048 DET_AMBG_AZIMUTH_PROB_048 DET_AZIMUTH_AMB_ID_048 DET_CONFD_ELEVATION_048 DET_CONFD_AZIMUTH_048 DET_HVC_FLAG_048 DET_OUTSIDE_SECTOR_048 DET_EXISTENCE_PROB_048 DET_POINT_TARGET_PROB_048 DET_SNR_048 DET_SUPER_RES_TARGET_048 DET_VALID_FLAG_048 DET_RCS_048 DET_ELEVATION_ERR_048 DET_ELEVATION_048 DET_AZIMUTH_ERR_048 DET_AZIMUTH_048 DET_RANGE_VELOCITY_ERR_048 DET_RANGE_VELOCITY_048 DET_RANGE_ERR_048 DET_RANGE_048;
SIG_GROUP_ 652 Detection049 1 : DET_BI_STATIC_FLAG_049 DET_AMBG_AZIMUTH_PROB_049 DET_AZIMUTH_AMB_ID_049 DET_CONFD_ELEVATION_049 DET_CONFD_AZIMUTH_049 DET_HVC_FLAG_049 DET_OUTSIDE_SECTOR_049 DET_AZIMUTH_ERR_049 DET_ELEVATION_ERR_049 DET_RANGE_ERR_049 DET_RANGE_VELOCITY_ERR_049 DET_EXISTENCE_PROB_049 DET_POINT_TARGET_PROB_049 DET_SNR_049 DET_SUPER_RES_TARGET_049 DET_VALID_FLAG_049 DET_RCS_049 DET_ELEVATION_049 DET_AZIMUTH_049 DET_RANGE_VELOCITY_049 DET_RANGE_049;
SIG_GROUP_ 652 Detection050 1 : DET_BI_STATIC_FLAG_050 DET_AMBG_AZIMUTH_PROB_050 DET_AZIMUTH_AMB_ID_050 DET_CONFD_ELEVATION_050 DET_CONFD_AZIMUTH_050 DET_HVC_FLAG_050 DET_OUTSIDE_SECTOR_050 DET_AZIMUTH_ERR_050 DET_ELEVATION_ERR_050 DET_RANGE_ERR_050 DET_RANGE_VELOCITY_ERR_050 DET_EXISTENCE_PROB_050 DET_POINT_TARGET_PROB_050 DET_SNR_050 DET_SUPER_RES_TARGET_050 DET_VALID_FLAG_050 DET_RCS_050 DET_ELEVATION_050 DET_AZIMUTH_050 DET_RANGE_VELOCITY_050 DET_RANGE_050;
SIG_GROUP_ 652 Detection051 1 : DET_BI_STATIC_FLAG_051 DET_AMBG_AZIMUTH_PROB_051 DET_AZIMUTH_AMB_ID_051 DET_CONFD_ELEVATION_051 DET_CONFD_AZIMUTH_051 DET_HVC_FLAG_051 DET_OUTSIDE_SECTOR_051 DET_AZIMUTH_ERR_051 DET_ELEVATION_ERR_051 DET_RANGE_ERR_051 DET_RANGE_VELOCITY_ERR_051 DET_EXISTENCE_PROB_051 DET_POINT_TARGET_PROB_051 DET_SNR_051 DET_SUPER_RES_TARGET_051 DET_VALID_FLAG_051 DET_RCS_051 DET_ELEVATION_051 DET_AZIMUTH_051 DET_RANGE_VELOCITY_051 DET_RANGE_051;
SIG_GROUP_ 652 Detection052 1 : DET_BI_STATIC_FLAG_052 DET_AMBG_AZIMUTH_PROB_052 DET_AZIMUTH_AMB_ID_052 DET_CONFD_ELEVATION_052 DET_CONFD_AZIMUTH_052 DET_HVC_FLAG_052 DET_OUTSIDE_SECTOR_052 DET_EXISTENCE_PROB_052 DET_POINT_TARGET_PROB_052 DET_SNR_052 DET_SUPER_RES_TARGET_052 DET_VALID_FLAG_052 DET_RCS_052 DET_ELEVATION_ERR_052 DET_ELEVATION_052 DET_AZIMUTH_ERR_052 DET_AZIMUTH_052 DET_RANGE_VELOCITY_ERR_052 DET_RANGE_VELOCITY_052 DET_RANGE_ERR_052 DET_RANGE_052;
SIG_GROUP_ 653 Detection053 1 : DET_BI_STATIC_FLAG_053 DET_AMBG_AZIMUTH_PROB_053 DET_AZIMUTH_AMB_ID_053 DET_CONFD_ELEVATION_053 DET_CONFD_AZIMUTH_053 DET_HVC_FLAG_053 DET_OUTSIDE_SECTOR_053 DET_AZIMUTH_ERR_053 DET_ELEVATION_ERR_053 DET_RANGE_ERR_053 DET_RANGE_VELOCITY_ERR_053 DET_EXISTENCE_PROB_053 DET_POINT_TARGET_PROB_053 DET_SNR_053 DET_SUPER_RES_TARGET_053 DET_VALID_FLAG_053 DET_RCS_053 DET_ELEVATION_053 DET_AZIMUTH_053 DET_RANGE_VELOCITY_053 DET_RANGE_053;
SIG_GROUP_ 653 Detection054 1 : DET_BI_STATIC_FLAG_054 DET_AMBG_AZIMUTH_PROB_054 DET_AZIMUTH_AMB_ID_054 DET_CONFD_ELEVATION_054 DET_CONFD_AZIMUTH_054 DET_HVC_FLAG_054 DET_OUTSIDE_SECTOR_054 DET_AZIMUTH_ERR_054 DET_ELEVATION_ERR_054 DET_RANGE_ERR_054 DET_RANGE_VELOCITY_ERR_054 DET_EXISTENCE_PROB_054 DET_POINT_TARGET_PROB_054 DET_SNR_054 DET_SUPER_RES_TARGET_054 DET_VALID_FLAG_054 DET_RCS_054 DET_ELEVATION_054 DET_AZIMUTH_054 DET_RANGE_VELOCITY_054 DET_RANGE_054;
SIG_GROUP_ 653 Detection055 1 : DET_BI_STATIC_FLAG_055 DET_AMBG_AZIMUTH_PROB_055 DET_AZIMUTH_AMB_ID_055 DET_CONFD_ELEVATION_055 DET_CONFD_AZIMUTH_055 DET_HVC_FLAG_055 DET_OUTSIDE_SECTOR_055 DET_AZIMUTH_ERR_055 DET_ELEVATION_ERR_055 DET_RANGE_ERR_055 DET_RANGE_VELOCITY_ERR_055 DET_EXISTENCE_PROB_055 DET_POINT_TARGET_PROB_055 DET_SNR_055 DET_SUPER_RES_TARGET_055 DET_VALID_FLAG_055 DET_RCS_055 DET_ELEVATION_055 DET_AZIMUTH_055 DET_RANGE_VELOCITY_055 DET_RANGE_055;
SIG_GROUP_ 653 Detection056 1 : DET_BI_STATIC_FLAG_056 DET_AMBG_AZIMUTH_PROB_056 DET_AZIMUTH_AMB_ID_056 DET_CONFD_ELEVATION_056 DET_CONFD_AZIMUTH_056 DET_HVC_FLAG_056 DET_OUTSIDE_SECTOR_056 DET_EXISTENCE_PROB_056 DET_POINT_TARGET_PROB_056 DET_SNR_056 DET_SUPER_RES_TARGET_056 DET_VALID_FLAG_056 DET_RCS_056 DET_ELEVATION_ERR_056 DET_ELEVATION_056 DET_AZIMUTH_ERR_056 DET_AZIMUTH_056 DET_RANGE_VELOCITY_ERR_056 DET_RANGE_VELOCITY_056 DET_RANGE_ERR_056 DET_RANGE_056;
SIG_GROUP_ 654 Detection057 1 : DET_BI_STATIC_FLAG_057 DET_AMBG_AZIMUTH_PROB_057 DET_AZIMUTH_AMB_ID_057 DET_CONFD_ELEVATION_057 DET_CONFD_AZIMUTH_057 DET_HVC_FLAG_057 DET_OUTSIDE_SECTOR_057 DET_AZIMUTH_ERR_057 DET_ELEVATION_ERR_057 DET_RANGE_ERR_057 DET_RANGE_VELOCITY_ERR_057 DET_EXISTENCE_PROB_057 DET_POINT_TARGET_PROB_057 DET_SNR_057 DET_SUPER_RES_TARGET_057 DET_VALID_FLAG_057 DET_RCS_057 DET_ELEVATION_057 DET_AZIMUTH_057 DET_RANGE_VELOCITY_057 DET_RANGE_057;
SIG_GROUP_ 654 Detection058 1 : DET_BI_STATIC_FLAG_058 DET_AMBG_AZIMUTH_PROB_058 DET_AZIMUTH_AMB_ID_058 DET_CONFD_ELEVATION_058 DET_CONFD_AZIMUTH_058 DET_HVC_FLAG_058 DET_OUTSIDE_SECTOR_058 DET_AZIMUTH_ERR_058 DET_ELEVATION_ERR_058 DET_RANGE_ERR_058 DET_RANGE_VELOCITY_ERR_058 DET_EXISTENCE_PROB_058 DET_POINT_TARGET_PROB_058 DET_SNR_058 DET_SUPER_RES_TARGET_058 DET_VALID_FLAG_058 DET_RCS_058 DET_ELEVATION_058 DET_AZIMUTH_058 DET_RANGE_VELOCITY_058 DET_RANGE_058;
SIG_GROUP_ 654 Detection059 1 : DET_BI_STATIC_FLAG_059 DET_AMBG_AZIMUTH_PROB_059 DET_AZIMUTH_AMB_ID_059 DET_CONFD_ELEVATION_059 DET_CONFD_AZIMUTH_059 DET_HVC_FLAG_059 DET_OUTSIDE_SECTOR_059 DET_AZIMUTH_ERR_059 DET_ELEVATION_ERR_059 DET_RANGE_ERR_059 DET_RANGE_VELOCITY_ERR_059 DET_EXISTENCE_PROB_059 DET_POINT_TARGET_PROB_059 DET_SNR_059 DET_SUPER_RES_TARGET_059 DET_VALID_FLAG_059 DET_RCS_059 DET_ELEVATION_059 DET_AZIMUTH_059 DET_RANGE_VELOCITY_059 DET_RANGE_059;
SIG_GROUP_ 654 Detection060 1 : DET_BI_STATIC_FLAG_060 DET_AMBG_AZIMUTH_PROB_060 DET_AZIMUTH_AMB_ID_060 DET_CONFD_ELEVATION_060 DET_CONFD_AZIMUTH_060 DET_HVC_FLAG_060 DET_OUTSIDE_SECTOR_060 DET_EXISTENCE_PROB_060 DET_POINT_TARGET_PROB_060 DET_SNR_060 DET_SUPER_RES_TARGET_060 DET_VALID_FLAG_060 DET_RCS_060 DET_ELEVATION_ERR_060 DET_ELEVATION_060 DET_AZIMUTH_ERR_060 DET_AZIMUTH_060 DET_RANGE_VELOCITY_ERR_060 DET_RANGE_VELOCITY_060 DET_RANGE_ERR_060 DET_RANGE_060;
SIG_GROUP_ 655 Detection061 1 : DET_BI_STATIC_FLAG_061 DET_AMBG_AZIMUTH_PROB_061 DET_AZIMUTH_AMB_ID_061 DET_CONFD_ELEVATION_061 DET_CONFD_AZIMUTH_061 DET_HVC_FLAG_061 DET_OUTSIDE_SECTOR_061 DET_AZIMUTH_ERR_061 DET_ELEVATION_ERR_061 DET_RANGE_ERR_061 DET_RANGE_VELOCITY_ERR_061 DET_EXISTENCE_PROB_061 DET_POINT_TARGET_PROB_061 DET_SNR_061 DET_SUPER_RES_TARGET_061 DET_VALID_FLAG_061 DET_RCS_061 DET_ELEVATION_061 DET_AZIMUTH_061 DET_RANGE_VELOCITY_061 DET_RANGE_061;
SIG_GROUP_ 655 Detection062 1 : DET_BI_STATIC_FLAG_062 DET_AMBG_AZIMUTH_PROB_062 DET_AZIMUTH_AMB_ID_062 DET_CONFD_ELEVATION_062 DET_CONFD_AZIMUTH_062 DET_HVC_FLAG_062 DET_OUTSIDE_SECTOR_062 DET_AZIMUTH_ERR_062 DET_ELEVATION_ERR_062 DET_RANGE_ERR_062 DET_RANGE_VELOCITY_ERR_062 DET_EXISTENCE_PROB_062 DET_POINT_TARGET_PROB_062 DET_SNR_062 DET_SUPER_RES_TARGET_062 DET_VALID_FLAG_062 DET_RCS_062 DET_ELEVATION_062 DET_AZIMUTH_062 DET_RANGE_VELOCITY_062 DET_RANGE_062;
SIG_GROUP_ 655 Detection063 1 : DET_BI_STATIC_FLAG_063 DET_AMBG_AZIMUTH_PROB_063 DET_AZIMUTH_AMB_ID_063 DET_CONFD_ELEVATION_063 DET_CONFD_AZIMUTH_063 DET_HVC_FLAG_063 DET_OUTSIDE_SECTOR_063 DET_AZIMUTH_ERR_063 DET_ELEVATION_ERR_063 DET_RANGE_ERR_063 DET_RANGE_VELOCITY_ERR_063 DET_EXISTENCE_PROB_063 DET_POINT_TARGET_PROB_063 DET_SNR_063 DET_SUPER_RES_TARGET_063 DET_VALID_FLAG_063 DET_RCS_063 DET_ELEVATION_063 DET_AZIMUTH_063 DET_RANGE_VELOCITY_063 DET_RANGE_063;
SIG_GROUP_ 655 Detection064 1 : DET_BI_STATIC_FLAG_064 DET_AMBG_AZIMUTH_PROB_064 DET_AZIMUTH_AMB_ID_064 DET_CONFD_ELEVATION_064 DET_CONFD_AZIMUTH_064 DET_HVC_FLAG_064 DET_OUTSIDE_SECTOR_064 DET_EXISTENCE_PROB_064 DET_POINT_TARGET_PROB_064 DET_SNR_064 DET_SUPER_RES_TARGET_064 DET_VALID_FLAG_064 DET_RCS_064 DET_ELEVATION_ERR_064 DET_ELEVATION_064 DET_AZIMUTH_ERR_064 DET_AZIMUTH_064 DET_RANGE_VELOCITY_ERR_064 DET_RANGE_VELOCITY_064 DET_RANGE_ERR_064 DET_RANGE_064;
SIG_GROUP_ 656 Detection065 1 : DET_BI_STATIC_FLAG_065 DET_AMBG_AZIMUTH_PROB_065 DET_AZIMUTH_AMB_ID_065 DET_CONFD_ELEVATION_065 DET_CONFD_AZIMUTH_065 DET_HVC_FLAG_065 DET_OUTSIDE_SECTOR_065 DET_AZIMUTH_ERR_065 DET_ELEVATION_ERR_065 DET_RANGE_ERR_065 DET_RANGE_VELOCITY_ERR_065 DET_EXISTENCE_PROB_065 DET_POINT_TARGET_PROB_065 DET_SNR_065 DET_SUPER_RES_TARGET_065 DET_VALID_FLAG_065 DET_RCS_065 DET_ELEVATION_065 DET_AZIMUTH_065 DET_RANGE_VELOCITY_065 DET_RANGE_065;
SIG_GROUP_ 656 Detection066 1 : DET_BI_STATIC_FLAG_066 DET_AMBG_AZIMUTH_PROB_066 DET_AZIMUTH_AMB_ID_066 DET_CONFD_ELEVATION_066 DET_CONFD_AZIMUTH_066 DET_HVC_FLAG_066 DET_OUTSIDE_SECTOR_066 DET_AZIMUTH_ERR_066 DET_ELEVATION_ERR_066 DET_RANGE_ERR_066 DET_RANGE_VELOCITY_ERR_066 DET_EXISTENCE_PROB_066 DET_POINT_TARGET_PROB_066 DET_SNR_066 DET_SUPER_RES_TARGET_066 DET_VALID_FLAG_066 DET_RCS_066 DET_ELEVATION_066 DET_AZIMUTH_066 DET_RANGE_VELOCITY_066 DET_RANGE_066;
SIG_GROUP_ 656 Detection067 1 : DET_BI_STATIC_FLAG_067 DET_AMBG_AZIMUTH_PROB_067 DET_AZIMUTH_AMB_ID_067 DET_CONFD_ELEVATION_067 DET_CONFD_AZIMUTH_067 DET_HVC_FLAG_067 DET_OUTSIDE_SECTOR_067 DET_AZIMUTH_ERR_067 DET_ELEVATION_ERR_067 DET_RANGE_ERR_067 DET_RANGE_VELOCITY_ERR_067 DET_EXISTENCE_PROB_067 DET_POINT_TARGET_PROB_067 DET_SNR_067 DET_SUPER_RES_TARGET_067 DET_VALID_FLAG_067 DET_RCS_067 DET_ELEVATION_067 DET_AZIMUTH_067 DET_RANGE_VELOCITY_067 DET_RANGE_067;
SIG_GROUP_ 656 Detection068 1 : DET_BI_STATIC_FLAG_068 DET_AMBG_AZIMUTH_PROB_068 DET_AZIMUTH_AMB_ID_068 DET_CONFD_ELEVATION_068 DET_CONFD_AZIMUTH_068 DET_HVC_FLAG_068 DET_OUTSIDE_SECTOR_068 DET_EXISTENCE_PROB_068 DET_POINT_TARGET_PROB_068 DET_SNR_068 DET_SUPER_RES_TARGET_068 DET_VALID_FLAG_068 DET_RCS_068 DET_ELEVATION_ERR_068 DET_ELEVATION_068 DET_AZIMUTH_ERR_068 DET_AZIMUTH_068 DET_RANGE_VELOCITY_ERR_068 DET_RANGE_VELOCITY_068 DET_RANGE_ERR_068 DET_RANGE_068;
SIG_GROUP_ 657 Detection069 1 : DET_BI_STATIC_FLAG_069 DET_AMBG_AZIMUTH_PROB_069 DET_AZIMUTH_AMB_ID_069 DET_CONFD_ELEVATION_069 DET_CONFD_AZIMUTH_069 DET_HVC_FLAG_069 DET_OUTSIDE_SECTOR_069 DET_AZIMUTH_ERR_069 DET_ELEVATION_ERR_069 DET_RANGE_ERR_069 DET_RANGE_VELOCITY_ERR_069 DET_EXISTENCE_PROB_069 DET_POINT_TARGET_PROB_069 DET_SNR_069 DET_SUPER_RES_TARGET_069 DET_VALID_FLAG_069 DET_RCS_069 DET_ELEVATION_069 DET_AZIMUTH_069 DET_RANGE_VELOCITY_069 DET_RANGE_069;
SIG_GROUP_ 657 Detection070 1 : DET_BI_STATIC_FLAG_070 DET_AMBG_AZIMUTH_PROB_070 DET_AZIMUTH_AMB_ID_070 DET_CONFD_ELEVATION_070 DET_CONFD_AZIMUTH_070 DET_HVC_FLAG_070 DET_OUTSIDE_SECTOR_070 DET_AZIMUTH_ERR_070 DET_ELEVATION_ERR_070 DET_RANGE_ERR_070 DET_RANGE_VELOCITY_ERR_070 DET_EXISTENCE_PROB_070 DET_POINT_TARGET_PROB_070 DET_SNR_070 DET_SUPER_RES_TARGET_070 DET_VALID_FLAG_070 DET_RCS_070 DET_ELEVATION_070 DET_AZIMUTH_070 DET_RANGE_VELOCITY_070 DET_RANGE_070;
SIG_GROUP_ 657 Detection071 1 : DET_BI_STATIC_FLAG_071 DET_AMBG_AZIMUTH_PROB_071 DET_AZIMUTH_AMB_ID_071 DET_CONFD_ELEVATION_071 DET_CONFD_AZIMUTH_071 DET_HVC_FLAG_071 DET_OUTSIDE_SECTOR_071 DET_AZIMUTH_ERR_071 DET_ELEVATION_ERR_071 DET_RANGE_ERR_071 DET_RANGE_VELOCITY_ERR_071 DET_EXISTENCE_PROB_071 DET_POINT_TARGET_PROB_071 DET_SNR_071 DET_SUPER_RES_TARGET_071 DET_VALID_FLAG_071 DET_RCS_071 DET_ELEVATION_071 DET_AZIMUTH_071 DET_RANGE_VELOCITY_071 DET_RANGE_071;
SIG_GROUP_ 657 Detection072 1 : DET_BI_STATIC_FLAG_072 DET_AMBG_AZIMUTH_PROB_072 DET_AZIMUTH_AMB_ID_072 DET_CONFD_ELEVATION_072 DET_CONFD_AZIMUTH_072 DET_HVC_FLAG_072 DET_OUTSIDE_SECTOR_072 DET_EXISTENCE_PROB_072 DET_POINT_TARGET_PROB_072 DET_SNR_072 DET_SUPER_RES_TARGET_072 DET_VALID_FLAG_072 DET_RCS_072 DET_ELEVATION_ERR_072 DET_ELEVATION_072 DET_AZIMUTH_ERR_072 DET_AZIMUTH_072 DET_RANGE_VELOCITY_ERR_072 DET_RANGE_VELOCITY_072 DET_RANGE_ERR_072 DET_RANGE_072;
SIG_GROUP_ 658 Detection073 1 : DET_BI_STATIC_FLAG_073 DET_AMBG_AZIMUTH_PROB_073 DET_AZIMUTH_AMB_ID_073 DET_CONFD_ELEVATION_073 DET_CONFD_AZIMUTH_073 DET_HVC_FLAG_073 DET_OUTSIDE_SECTOR_073 DET_AZIMUTH_ERR_073 DET_ELEVATION_ERR_073 DET_RANGE_ERR_073 DET_RANGE_VELOCITY_ERR_073 DET_EXISTENCE_PROB_073 DET_POINT_TARGET_PROB_073 DET_SNR_073 DET_SUPER_RES_TARGET_073 DET_VALID_FLAG_073 DET_RCS_073 DET_ELEVATION_073 DET_AZIMUTH_073 DET_RANGE_VELOCITY_073 DET_RANGE_073;
SIG_GROUP_ 658 Detection074 1 : DET_BI_STATIC_FLAG_074 DET_AMBG_AZIMUTH_PROB_074 DET_AZIMUTH_AMB_ID_074 DET_CONFD_ELEVATION_074 DET_CONFD_AZIMUTH_074 DET_HVC_FLAG_074 DET_OUTSIDE_SECTOR_074 DET_AZIMUTH_ERR_074 DET_ELEVATION_ERR_074 DET_RANGE_ERR_074 DET_RANGE_VELOCITY_ERR_074 DET_EXISTENCE_PROB_074 DET_POINT_TARGET_PROB_074 DET_SNR_074 DET_SUPER_RES_TARGET_074 DET_VALID_FLAG_074 DET_RCS_074 DET_ELEVATION_074 DET_AZIMUTH_074 DET_RANGE_VELOCITY_074 DET_RANGE_074;
SIG_GROUP_ 658 Detection075 1 : DET_BI_STATIC_FLAG_075 DET_AMBG_AZIMUTH_PROB_075 DET_AZIMUTH_AMB_ID_075 DET_CONFD_ELEVATION_075 DET_CONFD_AZIMUTH_075 DET_HVC_FLAG_075 DET_OUTSIDE_SECTOR_075 DET_AZIMUTH_ERR_075 DET_ELEVATION_ERR_075 DET_RANGE_ERR_075 DET_RANGE_VELOCITY_ERR_075 DET_EXISTENCE_PROB_075 DET_POINT_TARGET_PROB_075 DET_SNR_075 DET_SUPER_RES_TARGET_075 DET_VALID_FLAG_075 DET_RCS_075 DET_ELEVATION_075 DET_AZIMUTH_075 DET_RANGE_VELOCITY_075 DET_RANGE_075;
SIG_GROUP_ 658 Detection076 1 : DET_BI_STATIC_FLAG_076 DET_AMBG_AZIMUTH_PROB_076 DET_AZIMUTH_AMB_ID_076 DET_CONFD_ELEVATION_076 DET_CONFD_AZIMUTH_076 DET_HVC_FLAG_076 DET_OUTSIDE_SECTOR_076 DET_EXISTENCE_PROB_076 DET_POINT_TARGET_PROB_076 DET_SNR_076 DET_SUPER_RES_TARGET_076 DET_VALID_FLAG_076 DET_RCS_076 DET_ELEVATION_ERR_076 DET_ELEVATION_076 DET_AZIMUTH_ERR_076 DET_AZIMUTH_076 DET_RANGE_VELOCITY_ERR_076 DET_RANGE_VELOCITY_076 DET_RANGE_ERR_076 DET_RANGE_076;
SIG_GROUP_ 659 Detection077 1 : DET_BI_STATIC_FLAG_077 DET_AMBG_AZIMUTH_PROB_077 DET_AZIMUTH_AMB_ID_077 DET_CONFD_ELEVATION_077 DET_CONFD_AZIMUTH_077 DET_HVC_FLAG_077 DET_OUTSIDE_SECTOR_077 DET_AZIMUTH_ERR_077 DET_ELEVATION_ERR_077 DET_RANGE_ERR_077 DET_RANGE_VELOCITY_ERR_077 DET_EXISTENCE_PROB_077 DET_POINT_TARGET_PROB_077 DET_SNR_077 DET_SUPER_RES_TARGET_077 DET_VALID_FLAG_077 DET_RCS_077 DET_ELEVATION_077 DET_AZIMUTH_077 DET_RANGE_VELOCITY_077 DET_RANGE_077;
SIG_GROUP_ 659 Detection078 1 : DET_BI_STATIC_FLAG_078 DET_AMBG_AZIMUTH_PROB_078 DET_AZIMUTH_AMB_ID_078 DET_CONFD_ELEVATION_078 DET_CONFD_AZIMUTH_078 DET_HVC_FLAG_078 DET_OUTSIDE_SECTOR_078 DET_AZIMUTH_ERR_078 DET_ELEVATION_ERR_078 DET_RANGE_ERR_078 DET_RANGE_VELOCITY_ERR_078 DET_EXISTENCE_PROB_078 DET_POINT_TARGET_PROB_078 DET_SNR_078 DET_SUPER_RES_TARGET_078 DET_VALID_FLAG_078 DET_RCS_078 DET_ELEVATION_078 DET_AZIMUTH_078 DET_RANGE_VELOCITY_078 DET_RANGE_078;
SIG_GROUP_ 659 Detection079 1 : DET_BI_STATIC_FLAG_079 DET_AMBG_AZIMUTH_PROB_079 DET_AZIMUTH_AMB_ID_079 DET_CONFD_ELEVATION_079 DET_CONFD_AZIMUTH_079 DET_HVC_FLAG_079 DET_OUTSIDE_SECTOR_079 DET_AZIMUTH_ERR_079 DET_ELEVATION_ERR_079 DET_RANGE_ERR_079 DET_RANGE_VELOCITY_ERR_079 DET_EXISTENCE_PROB_079 DET_POINT_TARGET_PROB_079 DET_SNR_079 DET_SUPER_RES_TARGET_079 DET_VALID_FLAG_079 DET_RCS_079 DET_ELEVATION_079 DET_AZIMUTH_079 DET_RANGE_VELOCITY_079 DET_RANGE_079;
SIG_GROUP_ 659 Detection080 1 : DET_BI_STATIC_FLAG_080 DET_AMBG_AZIMUTH_PROB_080 DET_AZIMUTH_AMB_ID_080 DET_CONFD_ELEVATION_080 DET_CONFD_AZIMUTH_080 DET_HVC_FLAG_080 DET_OUTSIDE_SECTOR_080 DET_EXISTENCE_PROB_080 DET_POINT_TARGET_PROB_080 DET_SNR_080 DET_SUPER_RES_TARGET_080 DET_VALID_FLAG_080 DET_RCS_080 DET_ELEVATION_ERR_080 DET_ELEVATION_080 DET_AZIMUTH_ERR_080 DET_AZIMUTH_080 DET_RANGE_VELOCITY_ERR_080 DET_RANGE_VELOCITY_080 DET_RANGE_ERR_080 DET_RANGE_080;
SIG_GROUP_ 660 Detection081 1 : DET_BI_STATIC_FLAG_081 DET_AMBG_AZIMUTH_PROB_081 DET_AZIMUTH_AMB_ID_081 DET_CONFD_ELEVATION_081 DET_CONFD_AZIMUTH_081 DET_HVC_FLAG_081 DET_OUTSIDE_SECTOR_081 DET_AZIMUTH_ERR_081 DET_ELEVATION_ERR_081 DET_RANGE_ERR_081 DET_RANGE_VELOCITY_ERR_081 DET_EXISTENCE_PROB_081 DET_POINT_TARGET_PROB_081 DET_SNR_081 DET_SUPER_RES_TARGET_081 DET_VALID_FLAG_081 DET_RCS_081 DET_ELEVATION_081 DET_AZIMUTH_081 DET_RANGE_VELOCITY_081 DET_RANGE_081;
SIG_GROUP_ 660 Detection082 1 : DET_BI_STATIC_FLAG_082 DET_AMBG_AZIMUTH_PROB_082 DET_AZIMUTH_AMB_ID_082 DET_CONFD_ELEVATION_082 DET_CONFD_AZIMUTH_082 DET_HVC_FLAG_082 DET_OUTSIDE_SECTOR_082 DET_AZIMUTH_ERR_082 DET_ELEVATION_ERR_082 DET_RANGE_ERR_082 DET_RANGE_VELOCITY_ERR_082 DET_EXISTENCE_PROB_082 DET_POINT_TARGET_PROB_082 DET_SNR_082 DET_SUPER_RES_TARGET_082 DET_VALID_FLAG_082 DET_RCS_082 DET_ELEVATION_082 DET_AZIMUTH_082 DET_RANGE_VELOCITY_082 DET_RANGE_082;
SIG_GROUP_ 660 Detection083 1 : DET_BI_STATIC_FLAG_083 DET_AMBG_AZIMUTH_PROB_083 DET_AZIMUTH_AMB_ID_083 DET_CONFD_ELEVATION_083 DET_CONFD_AZIMUTH_083 DET_HVC_FLAG_083 DET_OUTSIDE_SECTOR_083 DET_AZIMUTH_ERR_083 DET_ELEVATION_ERR_083 DET_RANGE_ERR_083 DET_RANGE_VELOCITY_ERR_083 DET_EXISTENCE_PROB_083 DET_POINT_TARGET_PROB_083 DET_SNR_083 DET_SUPER_RES_TARGET_083 DET_VALID_FLAG_083 DET_RCS_083 DET_ELEVATION_083 DET_AZIMUTH_083 DET_RANGE_VELOCITY_083 DET_RANGE_083;
SIG_GROUP_ 660 Detection084 1 : DET_BI_STATIC_FLAG_084 DET_AMBG_AZIMUTH_PROB_084 DET_AZIMUTH_AMB_ID_084 DET_CONFD_ELEVATION_084 DET_CONFD_AZIMUTH_084 DET_HVC_FLAG_084 DET_OUTSIDE_SECTOR_084 DET_EXISTENCE_PROB_084 DET_POINT_TARGET_PROB_084 DET_SNR_084 DET_SUPER_RES_TARGET_084 DET_VALID_FLAG_084 DET_RCS_084 DET_ELEVATION_ERR_084 DET_ELEVATION_084 DET_AZIMUTH_ERR_084 DET_AZIMUTH_084 DET_RANGE_VELOCITY_ERR_084 DET_RANGE_VELOCITY_084 DET_RANGE_ERR_084 DET_RANGE_084;
SIG_GROUP_ 661 Detection085 1 : DET_BI_STATIC_FLAG_085 DET_AMBG_AZIMUTH_PROB_085 DET_AZIMUTH_AMB_ID_085 DET_CONFD_ELEVATION_085 DET_CONFD_AZIMUTH_085 DET_HVC_FLAG_085 DET_OUTSIDE_SECTOR_085 DET_AZIMUTH_ERR_085 DET_ELEVATION_ERR_085 DET_RANGE_ERR_085 DET_RANGE_VELOCITY_ERR_085 DET_EXISTENCE_PROB_085 DET_POINT_TARGET_PROB_085 DET_SNR_085 DET_SUPER_RES_TARGET_085 DET_VALID_FLAG_085 DET_RCS_085 DET_ELEVATION_085 DET_AZIMUTH_085 DET_RANGE_VELOCITY_085 DET_RANGE_085;
SIG_GROUP_ 661 Detection086 1 : DET_BI_STATIC_FLAG_086 DET_AMBG_AZIMUTH_PROB_086 DET_AZIMUTH_AMB_ID_086 DET_CONFD_ELEVATION_086 DET_CONFD_AZIMUTH_086 DET_HVC_FLAG_086 DET_OUTSIDE_SECTOR_086 DET_AZIMUTH_ERR_086 DET_ELEVATION_ERR_086 DET_RANGE_ERR_086 DET_RANGE_VELOCITY_ERR_086 DET_EXISTENCE_PROB_086 DET_POINT_TARGET_PROB_086 DET_SNR_086 DET_SUPER_RES_TARGET_086 DET_VALID_FLAG_086 DET_RCS_086 DET_ELEVATION_086 DET_AZIMUTH_086 DET_RANGE_VELOCITY_086 DET_RANGE_086;
SIG_GROUP_ 661 Detection087 1 : DET_BI_STATIC_FLAG_087 DET_AMBG_AZIMUTH_PROB_087 DET_AZIMUTH_AMB_ID_087 DET_CONFD_ELEVATION_087 DET_CONFD_AZIMUTH_087 DET_HVC_FLAG_087 DET_OUTSIDE_SECTOR_087 DET_AZIMUTH_ERR_087 DET_ELEVATION_ERR_087 DET_RANGE_ERR_087 DET_RANGE_VELOCITY_ERR_087 DET_EXISTENCE_PROB_087 DET_POINT_TARGET_PROB_087 DET_SNR_087 DET_SUPER_RES_TARGET_087 DET_VALID_FLAG_087 DET_RCS_087 DET_ELEVATION_087 DET_AZIMUTH_087 DET_RANGE_VELOCITY_087 DET_RANGE_087;
SIG_GROUP_ 661 Detection088 1 : DET_BI_STATIC_FLAG_088 DET_AMBG_AZIMUTH_PROB_088 DET_AZIMUTH_AMB_ID_088 DET_CONFD_ELEVATION_088 DET_CONFD_AZIMUTH_088 DET_HVC_FLAG_088 DET_OUTSIDE_SECTOR_088 DET_EXISTENCE_PROB_088 DET_POINT_TARGET_PROB_088 DET_SNR_088 DET_SUPER_RES_TARGET_088 DET_VALID_FLAG_088 DET_RCS_088 DET_ELEVATION_ERR_088 DET_ELEVATION_088 DET_AZIMUTH_ERR_088 DET_AZIMUTH_088 DET_RANGE_VELOCITY_ERR_088 DET_RANGE_VELOCITY_088 DET_RANGE_ERR_088 DET_RANGE_088;
SIG_GROUP_ 662 Detection089 1 : DET_BI_STATIC_FLAG_089 DET_AMBG_AZIMUTH_PROB_089 DET_AZIMUTH_AMB_ID_089 DET_CONFD_ELEVATION_089 DET_CONFD_AZIMUTH_089 DET_HVC_FLAG_089 DET_OUTSIDE_SECTOR_089 DET_AZIMUTH_ERR_089 DET_ELEVATION_ERR_089 DET_RANGE_ERR_089 DET_RANGE_VELOCITY_ERR_089 DET_EXISTENCE_PROB_089 DET_POINT_TARGET_PROB_089 DET_SNR_089 DET_SUPER_RES_TARGET_089 DET_VALID_FLAG_089 DET_RCS_089 DET_ELEVATION_089 DET_AZIMUTH_089 DET_RANGE_VELOCITY_089 DET_RANGE_089;
SIG_GROUP_ 662 Detection090 1 : DET_BI_STATIC_FLAG_090 DET_AMBG_AZIMUTH_PROB_090 DET_AZIMUTH_AMB_ID_090 DET_CONFD_ELEVATION_090 DET_CONFD_AZIMUTH_090 DET_HVC_FLAG_090 DET_OUTSIDE_SECTOR_090 DET_AZIMUTH_ERR_090 DET_ELEVATION_ERR_090 DET_RANGE_ERR_090 DET_RANGE_VELOCITY_ERR_090 DET_EXISTENCE_PROB_090 DET_POINT_TARGET_PROB_090 DET_SNR_090 DET_SUPER_RES_TARGET_090 DET_VALID_FLAG_090 DET_RCS_090 DET_ELEVATION_090 DET_AZIMUTH_090 DET_RANGE_VELOCITY_090 DET_RANGE_090;
SIG_GROUP_ 662 Detection091 1 : DET_BI_STATIC_FLAG_091 DET_AMBG_AZIMUTH_PROB_091 DET_AZIMUTH_AMB_ID_091 DET_CONFD_ELEVATION_091 DET_CONFD_AZIMUTH_091 DET_HVC_FLAG_091 DET_OUTSIDE_SECTOR_091 DET_AZIMUTH_ERR_091 DET_ELEVATION_ERR_091 DET_RANGE_ERR_091 DET_RANGE_VELOCITY_ERR_091 DET_EXISTENCE_PROB_091 DET_POINT_TARGET_PROB_091 DET_SNR_091 DET_SUPER_RES_TARGET_091 DET_VALID_FLAG_091 DET_RCS_091 DET_ELEVATION_091 DET_AZIMUTH_091 DET_RANGE_VELOCITY_091 DET_RANGE_091;
SIG_GROUP_ 662 Detection092 1 : DET_BI_STATIC_FLAG_092 DET_AMBG_AZIMUTH_PROB_092 DET_AZIMUTH_AMB_ID_092 DET_CONFD_ELEVATION_092 DET_CONFD_AZIMUTH_092 DET_HVC_FLAG_092 DET_OUTSIDE_SECTOR_092 DET_EXISTENCE_PROB_092 DET_POINT_TARGET_PROB_092 DET_SNR_092 DET_SUPER_RES_TARGET_092 DET_VALID_FLAG_092 DET_RCS_092 DET_ELEVATION_ERR_092 DET_ELEVATION_092 DET_AZIMUTH_ERR_092 DET_AZIMUTH_092 DET_RANGE_VELOCITY_ERR_092 DET_RANGE_VELOCITY_092 DET_RANGE_ERR_092 DET_RANGE_092;
SIG_GROUP_ 663 Detection093 1 : DET_BI_STATIC_FLAG_093 DET_AMBG_AZIMUTH_PROB_093 DET_AZIMUTH_AMB_ID_093 DET_CONFD_ELEVATION_093 DET_CONFD_AZIMUTH_093 DET_HVC_FLAG_093 DET_OUTSIDE_SECTOR_093 DET_AZIMUTH_ERR_093 DET_ELEVATION_ERR_093 DET_RANGE_ERR_093 DET_RANGE_VELOCITY_ERR_093 DET_EXISTENCE_PROB_093 DET_POINT_TARGET_PROB_093 DET_SNR_093 DET_SUPER_RES_TARGET_093 DET_VALID_FLAG_093 DET_RCS_093 DET_ELEVATION_093 DET_AZIMUTH_093 DET_RANGE_VELOCITY_093 DET_RANGE_093;
SIG_GROUP_ 663 Detection094 1 : DET_BI_STATIC_FLAG_094 DET_AMBG_AZIMUTH_PROB_094 DET_AZIMUTH_AMB_ID_094 DET_CONFD_ELEVATION_094 DET_CONFD_AZIMUTH_094 DET_HVC_FLAG_094 DET_OUTSIDE_SECTOR_094 DET_AZIMUTH_ERR_094 DET_ELEVATION_ERR_094 DET_RANGE_ERR_094 DET_RANGE_VELOCITY_ERR_094 DET_EXISTENCE_PROB_094 DET_POINT_TARGET_PROB_094 DET_SNR_094 DET_SUPER_RES_TARGET_094 DET_VALID_FLAG_094 DET_RCS_094 DET_ELEVATION_094 DET_AZIMUTH_094 DET_RANGE_VELOCITY_094 DET_RANGE_094;
SIG_GROUP_ 663 Detection095 1 : DET_BI_STATIC_FLAG_095 DET_AMBG_AZIMUTH_PROB_095 DET_AZIMUTH_AMB_ID_095 DET_CONFD_ELEVATION_095 DET_CONFD_AZIMUTH_095 DET_HVC_FLAG_095 DET_OUTSIDE_SECTOR_095 DET_AZIMUTH_ERR_095 DET_ELEVATION_ERR_095 DET_RANGE_ERR_095 DET_RANGE_VELOCITY_ERR_095 DET_EXISTENCE_PROB_095 DET_POINT_TARGET_PROB_095 DET_SNR_095 DET_SUPER_RES_TARGET_095 DET_VALID_FLAG_095 DET_RCS_095 DET_ELEVATION_095 DET_AZIMUTH_095 DET_RANGE_VELOCITY_095 DET_RANGE_095;
SIG_GROUP_ 663 Detection096 1 : DET_BI_STATIC_FLAG_096 DET_AMBG_AZIMUTH_PROB_096 DET_AZIMUTH_AMB_ID_096 DET_CONFD_ELEVATION_096 DET_CONFD_AZIMUTH_096 DET_HVC_FLAG_096 DET_OUTSIDE_SECTOR_096 DET_EXISTENCE_PROB_096 DET_POINT_TARGET_PROB_096 DET_SNR_096 DET_SUPER_RES_TARGET_096 DET_VALID_FLAG_096 DET_RCS_096 DET_ELEVATION_ERR_096 DET_ELEVATION_096 DET_AZIMUTH_ERR_096 DET_AZIMUTH_096 DET_RANGE_VELOCITY_ERR_096 DET_RANGE_VELOCITY_096 DET_RANGE_ERR_096 DET_RANGE_096;
SIG_GROUP_ 664 Detection097 1 : DET_BI_STATIC_FLAG_097 DET_AMBG_AZIMUTH_PROB_097 DET_AZIMUTH_AMB_ID_097 DET_CONFD_ELEVATION_097 DET_CONFD_AZIMUTH_097 DET_HVC_FLAG_097 DET_OUTSIDE_SECTOR_097 DET_AZIMUTH_ERR_097 DET_ELEVATION_ERR_097 DET_RANGE_ERR_097 DET_RANGE_VELOCITY_ERR_097 DET_EXISTENCE_PROB_097 DET_POINT_TARGET_PROB_097 DET_SNR_097 DET_SUPER_RES_TARGET_097 DET_VALID_FLAG_097 DET_RCS_097 DET_ELEVATION_097 DET_AZIMUTH_097 DET_RANGE_VELOCITY_097 DET_RANGE_097;
SIG_GROUP_ 664 Detection098 1 : DET_BI_STATIC_FLAG_098 DET_AMBG_AZIMUTH_PROB_098 DET_AZIMUTH_AMB_ID_098 DET_CONFD_ELEVATION_098 DET_CONFD_AZIMUTH_098 DET_HVC_FLAG_098 DET_OUTSIDE_SECTOR_098 DET_AZIMUTH_ERR_098 DET_ELEVATION_ERR_098 DET_RANGE_ERR_098 DET_RANGE_VELOCITY_ERR_098 DET_EXISTENCE_PROB_098 DET_POINT_TARGET_PROB_098 DET_SNR_098 DET_SUPER_RES_TARGET_098 DET_VALID_FLAG_098 DET_RCS_098 DET_ELEVATION_098 DET_AZIMUTH_098 DET_RANGE_VELOCITY_098 DET_RANGE_098;
SIG_GROUP_ 664 Detection099 1 : DET_BI_STATIC_FLAG_099 DET_AMBG_AZIMUTH_PROB_099 DET_AZIMUTH_AMB_ID_099 DET_CONFD_ELEVATION_099 DET_CONFD_AZIMUTH_099 DET_HVC_FLAG_099 DET_OUTSIDE_SECTOR_099 DET_AZIMUTH_ERR_099 DET_ELEVATION_ERR_099 DET_RANGE_ERR_099 DET_RANGE_VELOCITY_ERR_099 DET_EXISTENCE_PROB_099 DET_POINT_TARGET_PROB_099 DET_SNR_099 DET_SUPER_RES_TARGET_099 DET_VALID_FLAG_099 DET_RCS_099 DET_ELEVATION_099 DET_AZIMUTH_099 DET_RANGE_VELOCITY_099 DET_RANGE_099;
SIG_GROUP_ 664 Detection100 1 : DET_BI_STATIC_FLAG_100 DET_AMBG_AZIMUTH_PROB_100 DET_AZIMUTH_AMB_ID_100 DET_CONFD_ELEVATION_100 DET_CONFD_AZIMUTH_100 DET_HVC_FLAG_100 DET_OUTSIDE_SECTOR_100 DET_EXISTENCE_PROB_100 DET_POINT_TARGET_PROB_100 DET_SNR_100 DET_SUPER_RES_TARGET_100 DET_VALID_FLAG_100 DET_RCS_100 DET_ELEVATION_ERR_100 DET_ELEVATION_100 DET_AZIMUTH_ERR_100 DET_AZIMUTH_100 DET_RANGE_VELOCITY_ERR_100 DET_RANGE_VELOCITY_100 DET_RANGE_ERR_100 DET_RANGE_100;
SIG_GROUP_ 665 Detection101 1 : DET_BI_STATIC_FLAG_101 DET_AMBG_AZIMUTH_PROB_101 DET_AZIMUTH_AMB_ID_101 DET_CONFD_ELEVATION_101 DET_CONFD_AZIMUTH_101 DET_HVC_FLAG_101 DET_OUTSIDE_SECTOR_101 DET_AZIMUTH_ERR_101 DET_ELEVATION_ERR_101 DET_RANGE_ERR_101 DET_RANGE_VELOCITY_ERR_101 DET_EXISTENCE_PROB_101 DET_POINT_TARGET_PROB_101 DET_SNR_101 DET_SUPER_RES_TARGET_101 DET_VALID_FLAG_101 DET_RCS_101 DET_ELEVATION_101 DET_AZIMUTH_101 DET_RANGE_VELOCITY_101 DET_RANGE_101;
SIG_GROUP_ 665 Detection102 1 : DET_BI_STATIC_FLAG_102 DET_AMBG_AZIMUTH_PROB_102 DET_AZIMUTH_AMB_ID_102 DET_CONFD_ELEVATION_102 DET_CONFD_AZIMUTH_102 DET_HVC_FLAG_102 DET_OUTSIDE_SECTOR_102 DET_AZIMUTH_ERR_102 DET_ELEVATION_ERR_102 DET_RANGE_ERR_102 DET_RANGE_VELOCITY_ERR_102 DET_EXISTENCE_PROB_102 DET_POINT_TARGET_PROB_102 DET_SNR_102 DET_SUPER_RES_TARGET_102 DET_VALID_FLAG_102 DET_RCS_102 DET_ELEVATION_102 DET_AZIMUTH_102 DET_RANGE_VELOCITY_102 DET_RANGE_102;
SIG_GROUP_ 665 Detection103 1 : DET_BI_STATIC_FLAG_103 DET_AMBG_AZIMUTH_PROB_103 DET_AZIMUTH_AMB_ID_103 DET_CONFD_ELEVATION_103 DET_CONFD_AZIMUTH_103 DET_HVC_FLAG_103 DET_OUTSIDE_SECTOR_103 DET_AZIMUTH_ERR_103 DET_ELEVATION_ERR_103 DET_RANGE_ERR_103 DET_RANGE_VELOCITY_ERR_103 DET_EXISTENCE_PROB_103 DET_POINT_TARGET_PROB_103 DET_SNR_103 DET_SUPER_RES_TARGET_103 DET_VALID_FLAG_103 DET_RCS_103 DET_ELEVATION_103 DET_AZIMUTH_103 DET_RANGE_VELOCITY_103 DET_RANGE_103;
SIG_GROUP_ 665 Detection104 1 : DET_BI_STATIC_FLAG_104 DET_AMBG_AZIMUTH_PROB_104 DET_AZIMUTH_AMB_ID_104 DET_CONFD_ELEVATION_104 DET_CONFD_AZIMUTH_104 DET_HVC_FLAG_104 DET_OUTSIDE_SECTOR_104 DET_EXISTENCE_PROB_104 DET_POINT_TARGET_PROB_104 DET_SNR_104 DET_SUPER_RES_TARGET_104 DET_VALID_FLAG_104 DET_RCS_104 DET_ELEVATION_ERR_104 DET_ELEVATION_104 DET_AZIMUTH_ERR_104 DET_AZIMUTH_104 DET_RANGE_VELOCITY_ERR_104 DET_RANGE_VELOCITY_104 DET_RANGE_ERR_104 DET_RANGE_104;

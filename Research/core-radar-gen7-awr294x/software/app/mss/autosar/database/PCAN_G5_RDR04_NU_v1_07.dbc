VERSION "created by canmatrix"

NS_ :

BS_:

BU_: External_Tool ASDM G5_RDR04

BO_ 700 RDR_DETECTION_241_244: 64 G5_RDR04
 SG_ DET_RANGE_241 : 7|15@0+ (0.015625,0) [0|500] "m" ASDM
 SG_ DET_RANGE_ERR_241 : 8|7@0+ (0.0075,0) [0|0.9525] "m" ASDM
 SG_ DET_RANGE_VELOCITY_241 : 17|15@0+ (0.0078125,-128) [-128|127.9921875] "m/s" ASDM
 SG_ DET_RANGE_VELOCITY_ERR_241 : 34|8@0+ (0.003,0) [0|0.765] "m/s" ASDM
 SG_ DET_AZIMUTH_241 : 60|13@0+ (0.0004,-1.5708) [-1.5708|1.5708] "rad" ASDM
 SG_ DET_AZIMUTH_ERR_241 : 78|7@0+ (0.00087267,0) [0|0.11082909] "rad" ASDM
 SG_ DET_ELEVATION_241 : 42|8@0+ (0.00275,-0.34925) [-0.34925|0.34925] "rad" ASDM
 SG_ DET_ELEVATION_ERR_241 : 50|6@0+ (0.00174533,0) [0|0.10995579] "rad" ASDM
 SG_ DET_RCS_241 : 119|8@0+ (0.5,-64) [-64|63.5] "dBsm" ASDM
 SG_ DET_VALID_FLAG_241 : 100|1@0+ (1,0) [0|1] "" ASDM
 SG_ DET_BI_STATIC_FLAG_241 : 487|1@0+ (1,0) [0|1] "" ASDM
 SG_ DET_SUPER_RES_TARGET_241 : 79|1@0+ (1,0) [0|1] "" ASDM
 SG_ DET_SNR_241 : 111|8@0+ (0.35156,0) [0|89.6478] "dB" ASDM
 SG_ DET_POINT_TARGET_PROB_241 : 95|4@0+ (6.67,0) [0|100] "%" ASDM
 SG_ DET_EXISTENCE_PROB_241 : 91|6@0+ (1.588,0) [0|100] "%" ASDM
 SG_ DET_OUTSIDE_SECTOR_241 : 101|1@0+ (1,0) [0|1] "" ASDM
 SG_ DET_HVC_FLAG_241 : 87|1@0+ (1,0) [0|1] "" ASDM
 SG_ DET_CONFD_AZIMUTH_241 : 97|2@0+ (1,0) [0|3] "" ASDM
 SG_ DET_CONFD_ELEVATION_241 : 99|2@0+ (1,0) [0|3] "" ASDM
 SG_ DET_AZIMUTH_AMB_ID_241 : 82|3@0+ (1,0) [0|7] "" ASDM
 SG_ DET_AMBG_AZIMUTH_PROB_241 : 86|4@0+ (6.67,0) [0|100] "%" ASDM
 SG_ DET_RANGE_242 : 127|15@0+ (0.015625,0) [0|500] "m" ASDM
 SG_ DET_RANGE_ERR_242 : 128|7@0+ (0.0075,0) [0|0.9525] "m" ASDM
 SG_ DET_RANGE_VELOCITY_242 : 137|15@0+ (0.0078125,-128) [-128|127.9921875] "m/s" ASDM
 SG_ DET_RANGE_VELOCITY_ERR_242 : 154|8@0+ (0.003,0) [0|0.765] "m/s" ASDM
 SG_ DET_AZIMUTH_242 : 180|13@0+ (0.0004,-1.5708) [-1.5708|1.5708] "rad" ASDM
 SG_ DET_AZIMUTH_ERR_242 : 198|7@0+ (0.00087267,0) [0|0.11082909] "rad" ASDM
 SG_ DET_ELEVATION_242 : 162|8@0+ (0.00275,-0.34925) [-0.34925|0.34925] "rad" ASDM
 SG_ DET_ELEVATION_ERR_242 : 170|6@0+ (0.00174533,0) [0|0.10995579] "rad" ASDM
 SG_ DET_RCS_242 : 239|8@0+ (0.5,-64) [-64|63.5] "dBsm" ASDM
 SG_ DET_VALID_FLAG_242 : 220|1@0+ (1,0) [0|1] "" ASDM
 SG_ DET_BI_STATIC_FLAG_242 : 486|1@0+ (1,0) [0|1] "" ASDM
 SG_ DET_SUPER_RES_TARGET_242 : 199|1@0+ (1,0) [0|1] "" ASDM
 SG_ DET_SNR_242 : 231|8@0+ (0.35156,0) [0|89.6478] "dB" ASDM
 SG_ DET_POINT_TARGET_PROB_242 : 215|4@0+ (6.67,0) [0|100] "%" ASDM
 SG_ DET_EXISTENCE_PROB_242 : 211|6@0+ (1.588,0) [0|100] "%" ASDM
 SG_ DET_OUTSIDE_SECTOR_242 : 221|1@0+ (1,0) [0|1] "" ASDM
 SG_ DET_HVC_FLAG_242 : 207|1@0+ (1,0) [0|1] "" ASDM
 SG_ DET_CONFD_AZIMUTH_242 : 217|2@0+ (1,0) [0|3] "" ASDM
 SG_ DET_CONFD_ELEVATION_242 : 219|2@0+ (1,0) [0|3] "" ASDM
 SG_ DET_AZIMUTH_AMB_ID_242 : 202|3@0+ (1,0) [0|7] "" ASDM
 SG_ DET_AMBG_AZIMUTH_PROB_242 : 206|4@0+ (6.67,0) [0|100] "%" ASDM
 SG_ DET_RANGE_243 : 247|15@0+ (0.015625,0) [0|500] "m" ASDM
 SG_ DET_RANGE_ERR_243 : 248|7@0+ (0.0075,0) [0|0.9525] "m" ASDM
 SG_ DET_RANGE_VELOCITY_243 : 257|15@0+ (0.0078125,-128) [-128|127.9921875] "m/s" ASDM
 SG_ DET_RANGE_VELOCITY_ERR_243 : 274|8@0+ (0.003,0) [0|0.765] "m/s" ASDM
 SG_ DET_AZIMUTH_243 : 300|13@0+ (0.0004,-1.5708) [-1.5708|1.5708] "rad" ASDM
 SG_ DET_AZIMUTH_ERR_243 : 318|7@0+ (0.00087267,0) [0|0.11082909] "rad" ASDM
 SG_ DET_ELEVATION_243 : 282|8@0+ (0.00275,-0.34925) [-0.34925|0.34925] "rad" ASDM
 SG_ DET_ELEVATION_ERR_243 : 290|6@0+ (0.00174533,0) [0|0.10995579] "rad" ASDM
 SG_ DET_RCS_243 : 359|8@0+ (0.5,-64) [-64|63.5] "dBsm" ASDM
 SG_ DET_VALID_FLAG_243 : 340|1@0+ (1,0) [0|1] "" ASDM
 SG_ DET_BI_STATIC_FLAG_243 : 485|1@0+ (1,0) [0|1] "" ASDM
 SG_ DET_SUPER_RES_TARGET_243 : 319|1@0+ (1,0) [0|1] "" ASDM
 SG_ DET_SNR_243 : 351|8@0+ (0.35156,0) [0|89.6478] "dB" ASDM
 SG_ DET_POINT_TARGET_PROB_243 : 335|4@0+ (6.67,0) [0|100] "%" ASDM
 SG_ DET_EXISTENCE_PROB_243 : 331|6@0+ (1.588,0) [0|100] "%" ASDM
 SG_ DET_OUTSIDE_SECTOR_243 : 341|1@0+ (1,0) [0|1] "" ASDM
 SG_ DET_HVC_FLAG_243 : 327|1@0+ (1,0) [0|1] "" ASDM
 SG_ DET_CONFD_AZIMUTH_243 : 337|2@0+ (1,0) [0|3] "" ASDM
 SG_ DET_CONFD_ELEVATION_243 : 339|2@0+ (1,0) [0|3] "" ASDM
 SG_ DET_AZIMUTH_AMB_ID_243 : 322|3@0+ (1,0) [0|7] "" ASDM
 SG_ DET_AMBG_AZIMUTH_PROB_243 : 326|4@0+ (6.67,0) [0|100] "%" ASDM
 SG_ DET_RANGE_244 : 367|15@0+ (0.015625,0) [0|500] "m" ASDM
 SG_ DET_RANGE_ERR_244 : 368|7@0+ (0.0075,0) [0|0.9525] "m" ASDM
 SG_ DET_RANGE_VELOCITY_244 : 377|15@0+ (0.0078125,-128) [-128|127.9921875] "m/s" ASDM
 SG_ DET_RANGE_VELOCITY_ERR_244 : 394|8@0+ (0.003,0) [0|0.765] "m/s" ASDM
 SG_ DET_AZIMUTH_244 : 420|13@0+ (0.0004,-1.5708) [-1.5708|1.5708] "rad" ASDM
 SG_ DET_AZIMUTH_ERR_244 : 438|7@0+ (0.00087267,0) [0|0.11082909] "rad" ASDM
 SG_ DET_ELEVATION_244 : 402|8@0+ (0.00275,-0.34925) [-0.34925|0.34925] "rad" ASDM
 SG_ DET_ELEVATION_ERR_244 : 410|6@0+ (0.00174533,0) [0|0.10995579] "rad" ASDM
 SG_ DET_RCS_244 : 479|8@0+ (0.5,-64) [-64|63.5] "dBsm" ASDM
 SG_ DET_VALID_FLAG_244 : 460|1@0+ (1,0) [0|1] "" ASDM
 SG_ DET_BI_STATIC_FLAG_244 : 484|1@0+ (1,0) [0|1] "" ASDM
 SG_ DET_SUPER_RES_TARGET_244 : 439|1@0+ (1,0) [0|1] "" ASDM
 SG_ DET_SNR_244 : 471|8@0+ (0.35156,0) [0|89.6478] "dB" ASDM
 SG_ DET_POINT_TARGET_PROB_244 : 455|4@0+ (6.67,0) [0|100] "%" ASDM
 SG_ DET_EXISTENCE_PROB_244 : 451|6@0+ (1.588,0) [0|100] "%" ASDM
 SG_ DET_OUTSIDE_SECTOR_244 : 461|1@0+ (1,0) [0|1] "" ASDM
 SG_ DET_HVC_FLAG_244 : 447|1@0+ (1,0) [0|1] "" ASDM
 SG_ DET_CONFD_AZIMUTH_244 : 457|2@0+ (1,0) [0|3] "" ASDM
 SG_ DET_CONFD_ELEVATION_244 : 459|2@0+ (1,0) [0|3] "" ASDM
 SG_ DET_AZIMUTH_AMB_ID_244 : 442|3@0+ (1,0) [0|7] "" ASDM
 SG_ DET_AMBG_AZIMUTH_PROB_244 : 446|4@0+ (6.67,0) [0|100] "%" ASDM
 SG_ DET_MH_SCAN_INDEX_4LSB_241_244 : 483|4@0+ (1,0) [0|15] "" ASDM
 SG_ DET_MH_CYCLE_COUNTER_241_244 : 495|8@0+ (1,0) [0|255] "" ASDM
 SG_ DET_MH_CRC16_241_244 : 503|16@0+ (1,0) [0|65535] "" ASDM

BO_ 701 RDR_DETECTION_245_248: 64 G5_RDR04
 SG_ DET_RANGE_245 : 7|15@0+ (0.015625,0) [0|500] "m" ASDM
 SG_ DET_RANGE_ERR_245 : 8|7@0+ (0.0075,0) [0|0.9525] "m" ASDM
 SG_ DET_RANGE_VELOCITY_245 : 17|15@0+ (0.0078125,-128) [-128|127.9921875] "m/s" ASDM
 SG_ DET_RANGE_VELOCITY_ERR_245 : 34|8@0+ (0.003,0) [0|0.765] "m/s" ASDM
 SG_ DET_AZIMUTH_245 : 60|13@0+ (0.0004,-1.5708) [-1.5708|1.5708] "rad" ASDM
 SG_ DET_AZIMUTH_ERR_245 : 78|7@0+ (0.00087267,0) [0|0.11082909] "rad" ASDM
 SG_ DET_ELEVATION_245 : 42|8@0+ (0.00275,-0.34925) [-0.34925|0.34925] "rad" ASDM
 SG_ DET_ELEVATION_ERR_245 : 50|6@0+ (0.00174533,0) [0|0.10995579] "rad" ASDM
 SG_ DET_RCS_245 : 119|8@0+ (0.5,-64) [-64|63.5] "dBsm" ASDM
 SG_ DET_VALID_FLAG_245 : 100|1@0+ (1,0) [0|1] "" ASDM
 SG_ DET_BI_STATIC_FLAG_245 : 487|1@0+ (1,0) [0|1] "" ASDM
 SG_ DET_SUPER_RES_TARGET_245 : 79|1@0+ (1,0) [0|1] "" ASDM
 SG_ DET_SNR_245 : 111|8@0+ (0.35156,0) [0|89.6478] "dB" ASDM
 SG_ DET_POINT_TARGET_PROB_245 : 95|4@0+ (6.67,0) [0|100] "%" ASDM
 SG_ DET_EXISTENCE_PROB_245 : 91|6@0+ (1.588,0) [0|100] "%" ASDM
 SG_ DET_OUTSIDE_SECTOR_245 : 101|1@0+ (1,0) [0|1] "" ASDM
 SG_ DET_HVC_FLAG_245 : 87|1@0+ (1,0) [0|1] "" ASDM
 SG_ DET_CONFD_AZIMUTH_245 : 97|2@0+ (1,0) [0|3] "" ASDM
 SG_ DET_CONFD_ELEVATION_245 : 99|2@0+ (1,0) [0|3] "" ASDM
 SG_ DET_AZIMUTH_AMB_ID_245 : 82|3@0+ (1,0) [0|7] "" ASDM
 SG_ DET_AMBG_AZIMUTH_PROB_245 : 86|4@0+ (6.67,0) [0|100] "%" ASDM
 SG_ DET_RANGE_246 : 127|15@0+ (0.015625,0) [0|500] "m" ASDM
 SG_ DET_RANGE_ERR_246 : 128|7@0+ (0.0075,0) [0|0.9525] "m" ASDM
 SG_ DET_RANGE_VELOCITY_246 : 137|15@0+ (0.0078125,-128) [-128|127.9921875] "m/s" ASDM
 SG_ DET_RANGE_VELOCITY_ERR_246 : 154|8@0+ (0.003,0) [0|0.765] "m/s" ASDM
 SG_ DET_AZIMUTH_246 : 180|13@0+ (0.0004,-1.5708) [-1.5708|1.5708] "rad" ASDM
 SG_ DET_AZIMUTH_ERR_246 : 198|7@0+ (0.00087267,0) [0|0.11082909] "rad" ASDM
 SG_ DET_ELEVATION_246 : 162|8@0+ (0.00275,-0.34925) [-0.34925|0.34925] "rad" ASDM
 SG_ DET_ELEVATION_ERR_246 : 170|6@0+ (0.00174533,0) [0|0.10995579] "rad" ASDM
 SG_ DET_RCS_246 : 239|8@0+ (0.5,-64) [-64|63.5] "dBsm" ASDM
 SG_ DET_VALID_FLAG_246 : 220|1@0+ (1,0) [0|1] "" ASDM
 SG_ DET_BI_STATIC_FLAG_246 : 486|1@0+ (1,0) [0|1] "" ASDM
 SG_ DET_SUPER_RES_TARGET_246 : 199|1@0+ (1,0) [0|1] "" ASDM
 SG_ DET_SNR_246 : 231|8@0+ (0.35156,0) [0|89.6478] "dB" ASDM
 SG_ DET_POINT_TARGET_PROB_246 : 215|4@0+ (6.67,0) [0|100] "%" ASDM
 SG_ DET_EXISTENCE_PROB_246 : 211|6@0+ (1.588,0) [0|100] "%" ASDM
 SG_ DET_OUTSIDE_SECTOR_246 : 221|1@0+ (1,0) [0|1] "" ASDM
 SG_ DET_HVC_FLAG_246 : 207|1@0+ (1,0) [0|1] "" ASDM
 SG_ DET_CONFD_AZIMUTH_246 : 217|2@0+ (1,0) [0|3] "" ASDM
 SG_ DET_CONFD_ELEVATION_246 : 219|2@0+ (1,0) [0|3] "" ASDM
 SG_ DET_AZIMUTH_AMB_ID_246 : 202|3@0+ (1,0) [0|7] "" ASDM
 SG_ DET_AMBG_AZIMUTH_PROB_246 : 206|4@0+ (6.67,0) [0|100] "%" ASDM
 SG_ DET_RANGE_247 : 247|15@0+ (0.015625,0) [0|500] "m" ASDM
 SG_ DET_RANGE_ERR_247 : 248|7@0+ (0.0075,0) [0|0.9525] "m" ASDM
 SG_ DET_RANGE_VELOCITY_247 : 257|15@0+ (0.0078125,-128) [-128|127.9921875] "m/s" ASDM
 SG_ DET_RANGE_VELOCITY_ERR_247 : 274|8@0+ (0.003,0) [0|0.765] "m/s" ASDM
 SG_ DET_AZIMUTH_247 : 300|13@0+ (0.0004,-1.5708) [-1.5708|1.5708] "rad" ASDM
 SG_ DET_AZIMUTH_ERR_247 : 318|7@0+ (0.00087267,0) [0|0.11082909] "rad" ASDM
 SG_ DET_ELEVATION_247 : 282|8@0+ (0.00275,-0.34925) [-0.34925|0.34925] "rad" ASDM
 SG_ DET_ELEVATION_ERR_247 : 290|6@0+ (0.00174533,0) [0|0.10995579] "rad" ASDM
 SG_ DET_RCS_247 : 359|8@0+ (0.5,-64) [-64|63.5] "dBsm" ASDM
 SG_ DET_VALID_FLAG_247 : 340|1@0+ (1,0) [0|1] "" ASDM
 SG_ DET_BI_STATIC_FLAG_247 : 485|1@0+ (1,0) [0|1] "" ASDM
 SG_ DET_SUPER_RES_TARGET_247 : 319|1@0+ (1,0) [0|1] "" ASDM
 SG_ DET_SNR_247 : 351|8@0+ (0.35156,0) [0|89.6478] "dB" ASDM
 SG_ DET_POINT_TARGET_PROB_247 : 335|4@0+ (6.67,0) [0|100] "%" ASDM
 SG_ DET_EXISTENCE_PROB_247 : 331|6@0+ (1.588,0) [0|100] "%" ASDM
 SG_ DET_OUTSIDE_SECTOR_247 : 341|1@0+ (1,0) [0|1] "" ASDM
 SG_ DET_HVC_FLAG_247 : 327|1@0+ (1,0) [0|1] "" ASDM
 SG_ DET_CONFD_AZIMUTH_247 : 337|2@0+ (1,0) [0|3] "" ASDM
 SG_ DET_CONFD_ELEVATION_247 : 339|2@0+ (1,0) [0|3] "" ASDM
 SG_ DET_AZIMUTH_AMB_ID_247 : 322|3@0+ (1,0) [0|7] "" ASDM
 SG_ DET_AMBG_AZIMUTH_PROB_247 : 326|4@0+ (6.67,0) [0|100] "%" ASDM
 SG_ DET_RANGE_248 : 367|15@0+ (0.015625,0) [0|500] "m" ASDM
 SG_ DET_RANGE_ERR_248 : 368|7@0+ (0.0075,0) [0|0.9525] "m" ASDM
 SG_ DET_RANGE_VELOCITY_248 : 377|15@0+ (0.0078125,-128) [-128|127.9921875] "m/s" ASDM
 SG_ DET_RANGE_VELOCITY_ERR_248 : 394|8@0+ (0.003,0) [0|0.765] "m/s" ASDM
 SG_ DET_AZIMUTH_248 : 420|13@0+ (0.0004,-1.5708) [-1.5708|1.5708] "rad" ASDM
 SG_ DET_AZIMUTH_ERR_248 : 438|7@0+ (0.00087267,0) [0|0.11082909] "rad" ASDM
 SG_ DET_ELEVATION_248 : 402|8@0+ (0.00275,-0.34925) [-0.34925|0.34925] "rad" ASDM
 SG_ DET_ELEVATION_ERR_248 : 410|6@0+ (0.00174533,0) [0|0.10995579] "rad" ASDM
 SG_ DET_RCS_248 : 479|8@0+ (0.5,-64) [-64|63.5] "dBsm" ASDM
 SG_ DET_VALID_FLAG_248 : 460|1@0+ (1,0) [0|1] "" ASDM
 SG_ DET_BI_STATIC_FLAG_248 : 484|1@0+ (1,0) [0|1] "" ASDM
 SG_ DET_SUPER_RES_TARGET_248 : 439|1@0+ (1,0) [0|1] "" ASDM
 SG_ DET_SNR_248 : 471|8@0+ (0.35156,0) [0|89.6478] "dB" ASDM
 SG_ DET_POINT_TARGET_PROB_248 : 455|4@0+ (6.67,0) [0|100] "%" ASDM
 SG_ DET_EXISTENCE_PROB_248 : 451|6@0+ (1.588,0) [0|100] "%" ASDM
 SG_ DET_OUTSIDE_SECTOR_248 : 461|1@0+ (1,0) [0|1] "" ASDM
 SG_ DET_HVC_FLAG_248 : 447|1@0+ (1,0) [0|1] "" ASDM
 SG_ DET_CONFD_AZIMUTH_248 : 457|2@0+ (1,0) [0|3] "" ASDM
 SG_ DET_CONFD_ELEVATION_248 : 459|2@0+ (1,0) [0|3] "" ASDM
 SG_ DET_AZIMUTH_AMB_ID_248 : 442|3@0+ (1,0) [0|7] "" ASDM
 SG_ DET_AMBG_AZIMUTH_PROB_248 : 446|4@0+ (6.67,0) [0|100] "%" ASDM
 SG_ DET_MH_SCAN_INDEX_4LSB_245_248 : 483|4@0+ (1,0) [0|15] "" ASDM
 SG_ DET_MH_CYCLE_COUNTER_245_248 : 495|8@0+ (1,0) [0|255] "" ASDM
 SG_ DET_MH_CRC16_245_248 : 503|16@0+ (1,0) [0|65535] "" ASDM

BO_ 702 RDR_DETECTION_249_252: 64 G5_RDR04
 SG_ DET_RANGE_249 : 7|15@0+ (0.015625,0) [0|500] "m" ASDM
 SG_ DET_RANGE_ERR_249 : 8|7@0+ (0.0075,0) [0|0.9525] "m" ASDM
 SG_ DET_RANGE_VELOCITY_249 : 17|15@0+ (0.0078125,-128) [-128|127.9921875] "m/s" ASDM
 SG_ DET_RANGE_VELOCITY_ERR_249 : 34|8@0+ (0.003,0) [0|0.765] "m/s" ASDM
 SG_ DET_AZIMUTH_249 : 60|13@0+ (0.0004,-1.5708) [-1.5708|1.5708] "rad" ASDM
 SG_ DET_AZIMUTH_ERR_249 : 78|7@0+ (0.00087267,0) [0|0.11082909] "rad" ASDM
 SG_ DET_ELEVATION_249 : 42|8@0+ (0.00275,-0.34925) [-0.34925|0.34925] "rad" ASDM
 SG_ DET_ELEVATION_ERR_249 : 50|6@0+ (0.00174533,0) [0|0.10995579] "rad" ASDM
 SG_ DET_RCS_249 : 119|8@0+ (0.5,-64) [-64|63.5] "dBsm" ASDM
 SG_ DET_VALID_FLAG_249 : 100|1@0+ (1,0) [0|1] "" ASDM
 SG_ DET_BI_STATIC_FLAG_249 : 487|1@0+ (1,0) [0|1] "" ASDM
 SG_ DET_SUPER_RES_TARGET_249 : 79|1@0+ (1,0) [0|1] "" ASDM
 SG_ DET_SNR_249 : 111|8@0+ (0.35156,0) [0|89.6478] "dB" ASDM
 SG_ DET_POINT_TARGET_PROB_249 : 95|4@0+ (6.67,0) [0|100] "%" ASDM
 SG_ DET_EXISTENCE_PROB_249 : 91|6@0+ (1.588,0) [0|100] "%" ASDM
 SG_ DET_OUTSIDE_SECTOR_249 : 101|1@0+ (1,0) [0|1] "" ASDM
 SG_ DET_HVC_FLAG_249 : 87|1@0+ (1,0) [0|1] "" ASDM
 SG_ DET_CONFD_AZIMUTH_249 : 97|2@0+ (1,0) [0|3] "" ASDM
 SG_ DET_CONFD_ELEVATION_249 : 99|2@0+ (1,0) [0|3] "" ASDM
 SG_ DET_AZIMUTH_AMB_ID_249 : 82|3@0+ (1,0) [0|7] "" ASDM
 SG_ DET_AMBG_AZIMUTH_PROB_249 : 86|4@0+ (6.67,0) [0|100] "%" ASDM
 SG_ DET_RANGE_250 : 127|15@0+ (0.015625,0) [0|500] "m" ASDM
 SG_ DET_RANGE_ERR_250 : 128|7@0+ (0.0075,0) [0|0.9525] "m" ASDM
 SG_ DET_RANGE_VELOCITY_250 : 137|15@0+ (0.0078125,-128) [-128|127.9921875] "m/s" ASDM
 SG_ DET_RANGE_VELOCITY_ERR_250 : 154|8@0+ (0.003,0) [0|0.765] "m/s" ASDM
 SG_ DET_AZIMUTH_250 : 180|13@0+ (0.0004,-1.5708) [-1.5708|1.5708] "rad" ASDM
 SG_ DET_AZIMUTH_ERR_250 : 198|7@0+ (0.00087267,0) [0|0.11082909] "rad" ASDM
 SG_ DET_ELEVATION_250 : 162|8@0+ (0.00275,-0.34925) [-0.34925|0.34925] "rad" ASDM
 SG_ DET_ELEVATION_ERR_250 : 170|6@0+ (0.00174533,0) [0|0.10995579] "rad" ASDM
 SG_ DET_RCS_250 : 239|8@0+ (0.5,-64) [-64|63.5] "dBsm" ASDM
 SG_ DET_VALID_FLAG_250 : 220|1@0+ (1,0) [0|1] "" ASDM
 SG_ DET_BI_STATIC_FLAG_250 : 486|1@0+ (1,0) [0|1] "" ASDM
 SG_ DET_SUPER_RES_TARGET_250 : 199|1@0+ (1,0) [0|1] "" ASDM
 SG_ DET_SNR_250 : 231|8@0+ (0.35156,0) [0|89.6478] "dB" ASDM
 SG_ DET_POINT_TARGET_PROB_250 : 215|4@0+ (6.67,0) [0|100] "%" ASDM
 SG_ DET_EXISTENCE_PROB_250 : 211|6@0+ (1.588,0) [0|100] "%" ASDM
 SG_ DET_OUTSIDE_SECTOR_250 : 221|1@0+ (1,0) [0|1] "" ASDM
 SG_ DET_HVC_FLAG_250 : 207|1@0+ (1,0) [0|1] "" ASDM
 SG_ DET_CONFD_AZIMUTH_250 : 217|2@0+ (1,0) [0|3] "" ASDM
 SG_ DET_CONFD_ELEVATION_250 : 219|2@0+ (1,0) [0|3] "" ASDM
 SG_ DET_AZIMUTH_AMB_ID_250 : 202|3@0+ (1,0) [0|7] "" ASDM
 SG_ DET_AMBG_AZIMUTH_PROB_250 : 206|4@0+ (6.67,0) [0|100] "%" ASDM
 SG_ DET_RANGE_251 : 247|15@0+ (0.015625,0) [0|500] "m" ASDM
 SG_ DET_RANGE_ERR_251 : 248|7@0+ (0.0075,0) [0|0.9525] "m" ASDM
 SG_ DET_RANGE_VELOCITY_251 : 257|15@0+ (0.0078125,-128) [-128|127.9921875] "m/s" ASDM
 SG_ DET_RANGE_VELOCITY_ERR_251 : 274|8@0+ (0.003,0) [0|0.765] "m/s" ASDM
 SG_ DET_AZIMUTH_251 : 300|13@0+ (0.0004,-1.5708) [-1.5708|1.5708] "rad" ASDM
 SG_ DET_AZIMUTH_ERR_251 : 318|7@0+ (0.00087267,0) [0|0.11082909] "rad" ASDM
 SG_ DET_ELEVATION_251 : 282|8@0+ (0.00275,-0.34925) [-0.34925|0.34925] "rad" ASDM
 SG_ DET_ELEVATION_ERR_251 : 290|6@0+ (0.00174533,0) [0|0.10995579] "rad" ASDM
 SG_ DET_RCS_251 : 359|8@0+ (0.5,-64) [-64|63.5] "dBsm" ASDM
 SG_ DET_VALID_FLAG_251 : 340|1@0+ (1,0) [0|1] "" ASDM
 SG_ DET_BI_STATIC_FLAG_251 : 485|1@0+ (1,0) [0|1] "" ASDM
 SG_ DET_SUPER_RES_TARGET_251 : 319|1@0+ (1,0) [0|1] "" ASDM
 SG_ DET_SNR_251 : 351|8@0+ (0.35156,0) [0|89.6478] "dB" ASDM
 SG_ DET_POINT_TARGET_PROB_251 : 335|4@0+ (6.67,0) [0|100] "%" ASDM
 SG_ DET_EXISTENCE_PROB_251 : 331|6@0+ (1.588,0) [0|100] "%" ASDM
 SG_ DET_OUTSIDE_SECTOR_251 : 341|1@0+ (1,0) [0|1] "" ASDM
 SG_ DET_HVC_FLAG_251 : 327|1@0+ (1,0) [0|1] "" ASDM
 SG_ DET_CONFD_AZIMUTH_251 : 337|2@0+ (1,0) [0|3] "" ASDM
 SG_ DET_CONFD_ELEVATION_251 : 339|2@0+ (1,0) [0|3] "" ASDM
 SG_ DET_AZIMUTH_AMB_ID_251 : 322|3@0+ (1,0) [0|7] "" ASDM
 SG_ DET_AMBG_AZIMUTH_PROB_251 : 326|4@0+ (6.67,0) [0|100] "%" ASDM
 SG_ DET_RANGE_252 : 367|15@0+ (0.015625,0) [0|500] "m" ASDM
 SG_ DET_RANGE_ERR_252 : 368|7@0+ (0.0075,0) [0|0.9525] "m" ASDM
 SG_ DET_RANGE_VELOCITY_252 : 377|15@0+ (0.0078125,-128) [-128|127.9921875] "m/s" ASDM
 SG_ DET_RANGE_VELOCITY_ERR_252 : 394|8@0+ (0.003,0) [0|0.765] "m/s" ASDM
 SG_ DET_AZIMUTH_252 : 420|13@0+ (0.0004,-1.5708) [-1.5708|1.5708] "rad" ASDM
 SG_ DET_AZIMUTH_ERR_252 : 438|7@0+ (0.00087267,0) [0|0.11082909] "rad" ASDM
 SG_ DET_ELEVATION_252 : 402|8@0+ (0.00275,-0.34925) [-0.34925|0.34925] "rad" ASDM
 SG_ DET_ELEVATION_ERR_252 : 410|6@0+ (0.00174533,0) [0|0.10995579] "rad" ASDM
 SG_ DET_RCS_252 : 479|8@0+ (0.5,-64) [-64|63.5] "dBsm" ASDM
 SG_ DET_VALID_FLAG_252 : 460|1@0+ (1,0) [0|1] "" ASDM
 SG_ DET_BI_STATIC_FLAG_252 : 484|1@0+ (1,0) [0|1] "" ASDM
 SG_ DET_SUPER_RES_TARGET_252 : 439|1@0+ (1,0) [0|1] "" ASDM
 SG_ DET_SNR_252 : 471|8@0+ (0.35156,0) [0|89.6478] "dB" ASDM
 SG_ DET_POINT_TARGET_PROB_252 : 455|4@0+ (6.67,0) [0|100] "%" ASDM
 SG_ DET_EXISTENCE_PROB_252 : 451|6@0+ (1.588,0) [0|100] "%" ASDM
 SG_ DET_OUTSIDE_SECTOR_252 : 461|1@0+ (1,0) [0|1] "" ASDM
 SG_ DET_HVC_FLAG_252 : 447|1@0+ (1,0) [0|1] "" ASDM
 SG_ DET_CONFD_AZIMUTH_252 : 457|2@0+ (1,0) [0|3] "" ASDM
 SG_ DET_CONFD_ELEVATION_252 : 459|2@0+ (1,0) [0|3] "" ASDM
 SG_ DET_AZIMUTH_AMB_ID_252 : 442|3@0+ (1,0) [0|7] "" ASDM
 SG_ DET_AMBG_AZIMUTH_PROB_252 : 446|4@0+ (6.67,0) [0|100] "%" ASDM
 SG_ DET_MH_SCAN_INDEX_4LSB_249_252 : 483|4@0+ (1,0) [0|15] "" ASDM
 SG_ DET_MH_CYCLE_COUNTER_249_252 : 495|8@0+ (1,0) [0|255] "" ASDM
 SG_ DET_MH_CRC16_249_252 : 503|16@0+ (1,0) [0|65535] "" ASDM

BO_ 703 RDR_DETECTION_253_256: 64 G5_RDR04
 SG_ DET_RANGE_253 : 7|15@0+ (0.015625,0) [0|500] "m" ASDM
 SG_ DET_RANGE_ERR_253 : 8|7@0+ (0.0075,0) [0|0.9525] "m" ASDM
 SG_ DET_RANGE_VELOCITY_253 : 17|15@0+ (0.0078125,-128) [-128|127.9921875] "m/s" ASDM
 SG_ DET_RANGE_VELOCITY_ERR_253 : 34|8@0+ (0.003,0) [0|0.765] "m/s" ASDM
 SG_ DET_AZIMUTH_253 : 60|13@0+ (0.0004,-1.5708) [-1.5708|1.5708] "rad" ASDM
 SG_ DET_AZIMUTH_ERR_253 : 78|7@0+ (0.00087267,0) [0|0.11082909] "rad" ASDM
 SG_ DET_ELEVATION_253 : 42|8@0+ (0.00275,-0.34925) [-0.34925|0.34925] "rad" ASDM
 SG_ DET_ELEVATION_ERR_253 : 50|6@0+ (0.00174533,0) [0|0.10995579] "rad" ASDM
 SG_ DET_RCS_253 : 119|8@0+ (0.5,-64) [-64|63.5] "dBsm" ASDM
 SG_ DET_VALID_FLAG_253 : 100|1@0+ (1,0) [0|1] "" ASDM
 SG_ DET_BI_STATIC_FLAG_253 : 487|1@0+ (1,0) [0|1] "" ASDM
 SG_ DET_SUPER_RES_TARGET_253 : 79|1@0+ (1,0) [0|1] "" ASDM
 SG_ DET_SNR_253 : 111|8@0+ (0.35156,0) [0|89.6478] "dB" ASDM
 SG_ DET_POINT_TARGET_PROB_253 : 95|4@0+ (6.67,0) [0|100] "%" ASDM
 SG_ DET_EXISTENCE_PROB_253 : 91|6@0+ (1.588,0) [0|100] "%" ASDM
 SG_ DET_OUTSIDE_SECTOR_253 : 101|1@0+ (1,0) [0|1] "" ASDM
 SG_ DET_HVC_FLAG_253 : 87|1@0+ (1,0) [0|1] "" ASDM
 SG_ DET_CONFD_AZIMUTH_253 : 97|2@0+ (1,0) [0|3] "" ASDM
 SG_ DET_CONFD_ELEVATION_253 : 99|2@0+ (1,0) [0|3] "" ASDM
 SG_ DET_AZIMUTH_AMB_ID_253 : 82|3@0+ (1,0) [0|7] "" ASDM
 SG_ DET_AMBG_AZIMUTH_PROB_253 : 86|4@0+ (6.67,0) [0|100] "%" ASDM
 SG_ DET_RANGE_254 : 127|15@0+ (0.015625,0) [0|500] "m" ASDM
 SG_ DET_RANGE_ERR_254 : 128|7@0+ (0.0075,0) [0|0.9525] "m" ASDM
 SG_ DET_RANGE_VELOCITY_254 : 137|15@0+ (0.0078125,-128) [-128|127.9921875] "m/s" ASDM
 SG_ DET_RANGE_VELOCITY_ERR_254 : 154|8@0+ (0.003,0) [0|0.765] "m/s" ASDM
 SG_ DET_AZIMUTH_254 : 180|13@0+ (0.0004,-1.5708) [-1.5708|1.5708] "rad" ASDM
 SG_ DET_AZIMUTH_ERR_254 : 198|7@0+ (0.00087267,0) [0|0.11082909] "rad" ASDM
 SG_ DET_ELEVATION_254 : 162|8@0+ (0.00275,-0.34925) [-0.34925|0.34925] "rad" ASDM
 SG_ DET_ELEVATION_ERR_254 : 170|6@0+ (0.00174533,0) [0|0.10995579] "rad" ASDM
 SG_ DET_RCS_254 : 239|8@0+ (0.5,-64) [-64|63.5] "dBsm" ASDM
 SG_ DET_VALID_FLAG_254 : 220|1@0+ (1,0) [0|1] "" ASDM
 SG_ DET_BI_STATIC_FLAG_254 : 486|1@0+ (1,0) [0|1] "" ASDM
 SG_ DET_SUPER_RES_TARGET_254 : 199|1@0+ (1,0) [0|1] "" ASDM
 SG_ DET_SNR_254 : 231|8@0+ (0.35156,0) [0|89.6478] "dB" ASDM
 SG_ DET_POINT_TARGET_PROB_254 : 215|4@0+ (6.67,0) [0|100] "%" ASDM
 SG_ DET_EXISTENCE_PROB_254 : 211|6@0+ (1.588,0) [0|100] "%" ASDM
 SG_ DET_OUTSIDE_SECTOR_254 : 221|1@0+ (1,0) [0|1] "" ASDM
 SG_ DET_HVC_FLAG_254 : 207|1@0+ (1,0) [0|1] "" ASDM
 SG_ DET_CONFD_AZIMUTH_254 : 217|2@0+ (1,0) [0|3] "" ASDM
 SG_ DET_CONFD_ELEVATION_254 : 219|2@0+ (1,0) [0|3] "" ASDM
 SG_ DET_AZIMUTH_AMB_ID_254 : 202|3@0+ (1,0) [0|7] "" ASDM
 SG_ DET_AMBG_AZIMUTH_PROB_254 : 206|4@0+ (6.67,0) [0|100] "%" ASDM
 SG_ DET_RANGE_255 : 247|15@0+ (0.015625,0) [0|500] "m" ASDM
 SG_ DET_RANGE_ERR_255 : 248|7@0+ (0.0075,0) [0|0.9525] "m" ASDM
 SG_ DET_RANGE_VELOCITY_255 : 257|15@0+ (0.0078125,-128) [-128|127.9921875] "m/s" ASDM
 SG_ DET_RANGE_VELOCITY_ERR_255 : 274|8@0+ (0.003,0) [0|0.765] "m/s" ASDM
 SG_ DET_AZIMUTH_255 : 300|13@0+ (0.0004,-1.5708) [-1.5708|1.5708] "rad" ASDM
 SG_ DET_AZIMUTH_ERR_255 : 318|7@0+ (0.00087267,0) [0|0.11082909] "rad" ASDM
 SG_ DET_ELEVATION_255 : 282|8@0+ (0.00275,-0.34925) [-0.34925|0.34925] "rad" ASDM
 SG_ DET_ELEVATION_ERR_255 : 290|6@0+ (0.00174533,0) [0|0.10995579] "rad" ASDM
 SG_ DET_RCS_255 : 359|8@0+ (0.5,-64) [-64|63.5] "dBsm" ASDM
 SG_ DET_VALID_FLAG_255 : 340|1@0+ (1,0) [0|1] "" ASDM
 SG_ DET_BI_STATIC_FLAG_255 : 485|1@0+ (1,0) [0|1] "" ASDM
 SG_ DET_SUPER_RES_TARGET_255 : 319|1@0+ (1,0) [0|1] "" ASDM
 SG_ DET_SNR_255 : 351|8@0+ (0.35156,0) [0|89.6478] "dB" ASDM
 SG_ DET_POINT_TARGET_PROB_255 : 335|4@0+ (6.67,0) [0|100] "%" ASDM
 SG_ DET_EXISTENCE_PROB_255 : 331|6@0+ (1.588,0) [0|100] "%" ASDM
 SG_ DET_OUTSIDE_SECTOR_255 : 341|1@0+ (1,0) [0|1] "" ASDM
 SG_ DET_HVC_FLAG_255 : 327|1@0+ (1,0) [0|1] "" ASDM
 SG_ DET_CONFD_AZIMUTH_255 : 337|2@0+ (1,0) [0|3] "" ASDM
 SG_ DET_CONFD_ELEVATION_255 : 339|2@0+ (1,0) [0|3] "" ASDM
 SG_ DET_AZIMUTH_AMB_ID_255 : 322|3@0+ (1,0) [0|7] "" ASDM
 SG_ DET_AMBG_AZIMUTH_PROB_255 : 326|4@0+ (6.67,0) [0|100] "%" ASDM
 SG_ DET_RANGE_256 : 367|15@0+ (0.015625,0) [0|500] "m" ASDM
 SG_ DET_RANGE_ERR_256 : 368|7@0+ (0.0075,0) [0|0.9525] "m" ASDM
 SG_ DET_RANGE_VELOCITY_256 : 377|15@0+ (0.0078125,-128) [-128|127.9921875] "m/s" ASDM
 SG_ DET_RANGE_VELOCITY_ERR_256 : 394|8@0+ (0.003,0) [0|0.765] "m/s" ASDM
 SG_ DET_AZIMUTH_256 : 420|13@0+ (0.0004,-1.5708) [-1.5708|1.5708] "rad" ASDM
 SG_ DET_AZIMUTH_ERR_256 : 438|7@0+ (0.00087267,0) [0|0.11082909] "rad" ASDM
 SG_ DET_ELEVATION_256 : 402|8@0+ (0.00275,-0.34925) [-0.34925|0.34925] "rad" ASDM
 SG_ DET_ELEVATION_ERR_256 : 410|6@0+ (0.00174533,0) [0|0.10995579] "rad" ASDM
 SG_ DET_RCS_256 : 479|8@0+ (0.5,-64) [-64|63.5] "dBsm" ASDM
 SG_ DET_VALID_FLAG_256 : 460|1@0+ (1,0) [0|1] "" ASDM
 SG_ DET_BI_STATIC_FLAG_256 : 484|1@0+ (1,0) [0|1] "" ASDM
 SG_ DET_SUPER_RES_TARGET_256 : 439|1@0+ (1,0) [0|1] "" ASDM
 SG_ DET_SNR_256 : 471|8@0+ (0.35156,0) [0|89.6478] "dB" ASDM
 SG_ DET_POINT_TARGET_PROB_256 : 455|4@0+ (6.67,0) [0|100] "%" ASDM
 SG_ DET_EXISTENCE_PROB_256 : 451|6@0+ (1.588,0) [0|100] "%" ASDM
 SG_ DET_OUTSIDE_SECTOR_256 : 461|1@0+ (1,0) [0|1] "" ASDM
 SG_ DET_HVC_FLAG_256 : 447|1@0+ (1,0) [0|1] "" ASDM
 SG_ DET_CONFD_AZIMUTH_256 : 457|2@0+ (1,0) [0|3] "" ASDM
 SG_ DET_CONFD_ELEVATION_256 : 459|2@0+ (1,0) [0|3] "" ASDM
 SG_ DET_AZIMUTH_AMB_ID_256 : 442|3@0+ (1,0) [0|7] "" ASDM
 SG_ DET_AMBG_AZIMUTH_PROB_256 : 446|4@0+ (6.67,0) [0|100] "%" ASDM
 SG_ DET_MH_SCAN_INDEX_4LSB_253_256 : 483|4@0+ (1,0) [0|15] "" ASDM
 SG_ DET_MH_CYCLE_COUNTER_253_256 : 495|8@0+ (1,0) [0|255] "" ASDM
 SG_ DET_MH_CRC16_253_256 : 503|16@0+ (1,0) [0|65535] "" ASDM

BO_ 705 RDR_TRACKER_OBJ_002: 64 G5_RDR04
 SG_ OBJ_ALIVE_TIME_002 : 255|16@0+ (1,0) [0|65535] "ms" ASDM
 SG_ OBJ_ACCELERATION_LONG_ERR_002 : 215|8@0+ (0.025,0) [0|6.375] "m/s^2" ASDM
 SG_ OBJ_ACCELERATION_LAT_ERR_002 : 223|8@0+ (0.025,0) [0|6.375] "m/s^2" ASDM
 SG_ OBJ_VELOCITY_LONG_ERR_002 : 143|8@0+ (0.05,0) [0|12.75] "m/s" ASDM
 SG_ OBJ_VELOCITY_LAT_ERR_002 : 151|8@0+ (0.05,0) [0|12.75] "m/s" ASDM
 SG_ OBJ_POS_LONG_ERR_002 : 95|8@0+ (0.025,0) [0|6.375] "m" ASDM
 SG_ OBJ_POS_LAT_ERR_002 : 103|8@0+ (0.025,0) [0|6.375] "m" ASDM
 SG_ OBJ_TRACK_MOTION_MODEL_002 : 9|2@0+ (1,0) [1|3] "NA" ASDM
 SG_ OBJ_DIMENSION_WIDTH_002 : 17|10@0+ (0.01,0) [0|10.23] "m" ASDM
 SG_ OBJ_DIMENSION_LENGTH_002 : 37|12@0+ (0.01,0) [0|40.95] "m" ASDM
 SG_ OBJ_EXISTENCE_PROB_002 : 229|14@0+ (0.0001,0) [0|1] "NA" ASDM
 SG_ OBJ_YAW_ANGLE_002 : 155|12@0+ (0.005,-10) [-10|10.475] "rad" ASDM
 SG_ OBJ_YAW_ANGLE_ERR_002 : 175|7@0+ (0.01,0) [0|1.27] "rad" ASDM
 SG_ OBJ_ID_002 : 7|8@0+ (1,0) [0|255] "NA" ASDM
 SG_ OBJ_MOVEMENT_STATUS_002 : 196|3@0+ (1,0) [0|3] "NA" ASDM
 SG_ OBJ_MEASUREMENT_STATUS_002 : 14|3@0+ (1,0) [0|7] "NA" ASDM
 SG_ OBJ_POS_LONG_002 : 63|16@0+ (0.01,-327) [-327|327] "m" ASDM
 SG_ OBJ_POS_LAT_002 : 79|16@0+ (0.01,-327) [-327|327] "m" ASDM
 SG_ OBJ_VELOCITY_LONG_002 : 110|15@0+ (0.01,-163) [-163|163] "m/s" ASDM
 SG_ OBJ_VELOCITY_LAT_002 : 126|15@0+ (0.01,-163) [-163|163] "m/s" ASDM
 SG_ OBJ_ACCELERATION_LONG_002 : 193|10@0+ (0.05,-20) [-20|20] "m/s^2" ASDM
 SG_ OBJ_ACCELERATION_LAT_002 : 177|10@0+ (0.05,-20) [-20|20] "m/s^2" ASDM
 SG_ OBJ_VEH_TRACK_FLAG_002 : 10|1@0+ (1,0) [0|1] "NA" ASDM
 SG_ OBJ_MH_CYCLE_COUNTER_002 : 487|8@0+ (1,0) [0|255] "NA" ASDM
 SG_ OBJ_MH_CRC16_002 : 495|16@0+ (1,0) [0|65535] "NA" ASDM
 SG_ OBJ_TIMESTAMP_OFFSET_002 : 247|8@0+ (1,-127) [-127|128] "ms" ASDM
 SG_ OBJ_DIMENSION_WIDTH_ERR_002 : 23|6@0+ (0.01,0) [0|0.63] "m" ASDM
 SG_ OBJ_DIMENSION_LENGTH_ERR_002 : 41|10@0+ (0.01,0) [0|10.23] "m" ASDM
 SG_ OBJ_CLS_TYPE1_002 : 271|4@0+ (1,0) [0|15] "NA" ASDM
 SG_ OBJ_CLS_TYPE1_PROB_002 : 303|8@0+ (0.004,0) [0|1] "NA" ASDM
 SG_ OBJ_CLS_TYPE2_002 : 267|4@0+ (1,0) [0|15] "NA" ASDM
 SG_ OBJ_CLS_TYPE2_PROB_002 : 311|8@0+ (0.004,0) [0|1] "NA" ASDM
 SG_ OBJ_CLS_TYPE3_002 : 279|4@0+ (1,0) [0|15] "NA" ASDM
 SG_ OBJ_CLS_TYPE3_PROB_002 : 319|8@0+ (0.004,0) [0|1] "NA" ASDM
 SG_ OBJ_CLS_TYPE4_002 : 275|4@0+ (1,0) [0|15] "NA" ASDM
 SG_ OBJ_CLS_TYPE4_PROB_002 : 327|8@0+ (0.004,0) [0|1] "NA" ASDM
 SG_ OBJ_CLS_TYPE5_002 : 287|4@0+ (1,0) [0|15] "NA" ASDM
 SG_ OBJ_CLS_TYPE5_PROB_002 : 335|8@0+ (0.004,0) [0|1] "NA" ASDM
 SG_ OBJ_CLS_TYPE6_002 : 282|4@0+ (1,0) [0|15] "NA" ASDM
 SG_ OBJ_CLS_TYPE6_PROB_002 : 343|8@0+ (0.004,0) [0|1] "NA" ASDM
 SG_ OBJ_RCS_002 : 351|7@0+ (1,-64) [-64|63] "dBsm" ASDM
 SG_ OBJ_REF_PT_LONG_OFFSET_002 : 357|14@0+ (0.0001,0) [0|1] "NA" ASDM
 SG_ OBJ_REF_PT_LAT_OFFSET_002 : 370|14@0+ (0.0001,0) [0|1] "NA" ASDM
 SG_ OBJ_YAW_RATE_002 : 399|10@0+ (0.005,-2.24) [-2.24|2.24] "rad/s" ASDM
 SG_ OBJ_YAW_RATE_ERR_002 : 388|5@0+ (0.025,0) [0|0.775] "rad/s" ASDM
 SG_ OBJ_GROUP_ID_002 : 405|6@0+ (1,0) [0|63] "NA" ASDM
 SG_ OBJ_POS_ERR_CRR_COEF_002 : 415|8@0+ (0.01,-1.2) [-1.2|1] "NA" ASDM
 SG_ OBJ_VELOCITY_ERR_CRR_COEF_002 : 423|8@0+ (0.01,-1.2) [-1.2|1] "NA" ASDM
 SG_ OBJ_ACCEL_ERR_CRR_COEF_002 : 431|8@0+ (0.01,-1.2) [-1.2|1] "NA" ASDM

BO_ 706 RDR_TRACKER_OBJ_003: 64 G5_RDR04
 SG_ OBJ_ALIVE_TIME_003 : 255|16@0+ (1,0) [0|65535] "ms" ASDM
 SG_ OBJ_ACCELERATION_LONG_ERR_003 : 215|8@0+ (0.025,0) [0|6.375] "m/s^2" ASDM
 SG_ OBJ_ACCELERATION_LAT_ERR_003 : 223|8@0+ (0.025,0) [0|6.375] "m/s^2" ASDM
 SG_ OBJ_VELOCITY_LONG_ERR_003 : 143|8@0+ (0.05,0) [0|12.75] "m/s" ASDM
 SG_ OBJ_VELOCITY_LAT_ERR_003 : 151|8@0+ (0.05,0) [0|12.75] "m/s" ASDM
 SG_ OBJ_POS_LONG_ERR_003 : 95|8@0+ (0.025,0) [0|6.375] "m" ASDM
 SG_ OBJ_POS_LAT_ERR_003 : 103|8@0+ (0.025,0) [0|6.375] "m" ASDM
 SG_ OBJ_TRACK_MOTION_MODEL_003 : 9|2@0+ (1,0) [1|3] "NA" ASDM
 SG_ OBJ_DIMENSION_WIDTH_003 : 17|10@0+ (0.01,0) [0|10.23] "m" ASDM
 SG_ OBJ_DIMENSION_LENGTH_003 : 37|12@0+ (0.01,0) [0|40.95] "m" ASDM
 SG_ OBJ_EXISTENCE_PROB_003 : 229|14@0+ (0.0001,0) [0|1] "NA" ASDM
 SG_ OBJ_YAW_ANGLE_003 : 155|12@0+ (0.005,-10) [-10|10.475] "rad" ASDM
 SG_ OBJ_YAW_ANGLE_ERR_003 : 175|7@0+ (0.01,0) [0|1.27] "rad" ASDM
 SG_ OBJ_ID_003 : 7|8@0+ (1,0) [0|255] "NA" ASDM
 SG_ OBJ_MOVEMENT_STATUS_003 : 196|3@0+ (1,0) [0|3] "NA" ASDM
 SG_ OBJ_MEASUREMENT_STATUS_003 : 14|3@0+ (1,0) [0|7] "NA" ASDM
 SG_ OBJ_POS_LONG_003 : 63|16@0+ (0.01,-327) [-327|327] "m" ASDM
 SG_ OBJ_POS_LAT_003 : 79|16@0+ (0.01,-327) [-327|327] "m" ASDM
 SG_ OBJ_VELOCITY_LONG_003 : 110|15@0+ (0.01,-163) [-163|163] "m/s" ASDM
 SG_ OBJ_VELOCITY_LAT_003 : 126|15@0+ (0.01,-163) [-163|163] "m/s" ASDM
 SG_ OBJ_ACCELERATION_LONG_003 : 193|10@0+ (0.05,-20) [-20|20] "m/s^2" ASDM
 SG_ OBJ_ACCELERATION_LAT_003 : 177|10@0+ (0.05,-20) [-20|20] "m/s^2" ASDM
 SG_ OBJ_VEH_TRACK_FLAG_003 : 10|1@0+ (1,0) [0|1] "NA" ASDM
 SG_ OBJ_MH_CYCLE_COUNTER_003 : 487|8@0+ (1,0) [0|255] "NA" ASDM
 SG_ OBJ_MH_CRC16_003 : 495|16@0+ (1,0) [0|65535] "NA" ASDM
 SG_ OBJ_TIMESTAMP_OFFSET_003 : 247|8@0+ (1,-127) [-127|128] "ms" ASDM
 SG_ OBJ_DIMENSION_WIDTH_ERR_003 : 23|6@0+ (0.01,0) [0|0.63] "m" ASDM
 SG_ OBJ_DIMENSION_LENGTH_ERR_003 : 41|10@0+ (0.01,0) [0|10.23] "m" ASDM
 SG_ OBJ_CLS_TYPE1_003 : 271|4@0+ (1,0) [0|15] "NA" ASDM
 SG_ OBJ_CLS_TYPE1_PROB_003 : 303|8@0+ (0.004,0) [0|1] "NA" ASDM
 SG_ OBJ_CLS_TYPE2_003 : 267|4@0+ (1,0) [0|15] "NA" ASDM
 SG_ OBJ_CLS_TYPE2_PROB_003 : 311|8@0+ (0.004,0) [0|1] "NA" ASDM
 SG_ OBJ_CLS_TYPE3_003 : 279|4@0+ (1,0) [0|15] "NA" ASDM
 SG_ OBJ_CLS_TYPE3_PROB_003 : 319|8@0+ (0.004,0) [0|1] "NA" ASDM
 SG_ OBJ_CLS_TYPE4_003 : 275|4@0+ (1,0) [0|15] "NA" ASDM
 SG_ OBJ_CLS_TYPE4_PROB_003 : 327|8@0+ (0.004,0) [0|1] "NA" ASDM
 SG_ OBJ_CLS_TYPE5_003 : 287|4@0+ (1,0) [0|15] "NA" ASDM
 SG_ OBJ_CLS_TYPE5_PROB_003 : 335|8@0+ (0.004,0) [0|1] "NA" ASDM
 SG_ OBJ_CLS_TYPE6_003 : 282|4@0+ (1,0) [0|15] "NA" ASDM
 SG_ OBJ_CLS_TYPE6_PROB_003 : 343|8@0+ (0.004,0) [0|1] "NA" ASDM
 SG_ OBJ_RCS_003 : 351|7@0+ (1,-64) [-64|63] "dBsm" ASDM
 SG_ OBJ_REF_PT_LONG_OFFSET_003 : 357|14@0+ (0.0001,0) [0|1] "NA" ASDM
 SG_ OBJ_REF_PT_LAT_OFFSET_003 : 370|14@0+ (0.0001,0) [0|1] "NA" ASDM
 SG_ OBJ_YAW_RATE_003 : 399|10@0+ (0.005,-2.24) [-2.24|2.24] "rad/s" ASDM
 SG_ OBJ_YAW_RATE_ERR_003 : 388|5@0+ (0.025,0) [0|0.775] "rad/s" ASDM
 SG_ OBJ_GROUP_ID_003 : 405|6@0+ (1,0) [0|63] "NA" ASDM
 SG_ OBJ_POS_ERR_CRR_COEF_003 : 415|8@0+ (0.01,-1.2) [-1.2|1] "NA" ASDM
 SG_ OBJ_VELOCITY_ERR_CRR_COEF_003 : 423|8@0+ (0.01,-1.2) [-1.2|1] "NA" ASDM
 SG_ OBJ_ACCEL_ERR_CRR_COEF_003 : 431|8@0+ (0.01,-1.2) [-1.2|1] "NA" ASDM

BO_ 707 RDR_TRACKER_OBJ_004: 64 G5_RDR04
 SG_ OBJ_ALIVE_TIME_004 : 255|16@0+ (1,0) [0|65535] "ms" ASDM
 SG_ OBJ_ACCELERATION_LONG_ERR_004 : 215|8@0+ (0.025,0) [0|6.375] "m/s^2" ASDM
 SG_ OBJ_ACCELERATION_LAT_ERR_004 : 223|8@0+ (0.025,0) [0|6.375] "m/s^2" ASDM
 SG_ OBJ_VELOCITY_LONG_ERR_004 : 143|8@0+ (0.05,0) [0|12.75] "m/s" ASDM
 SG_ OBJ_VELOCITY_LAT_ERR_004 : 151|8@0+ (0.05,0) [0|12.75] "m/s" ASDM
 SG_ OBJ_POS_LONG_ERR_004 : 95|8@0+ (0.025,0) [0|6.375] "m" ASDM
 SG_ OBJ_POS_LAT_ERR_004 : 103|8@0+ (0.025,0) [0|6.375] "m" ASDM
 SG_ OBJ_TRACK_MOTION_MODEL_004 : 9|2@0+ (1,0) [1|3] "NA" ASDM
 SG_ OBJ_DIMENSION_WIDTH_004 : 17|10@0+ (0.01,0) [0|10.23] "m" ASDM
 SG_ OBJ_DIMENSION_LENGTH_004 : 37|12@0+ (0.01,0) [0|40.95] "m" ASDM
 SG_ OBJ_EXISTENCE_PROB_004 : 229|14@0+ (0.0001,0) [0|1] "NA" ASDM
 SG_ OBJ_YAW_ANGLE_004 : 155|12@0+ (0.005,-10) [-10|10.475] "rad" ASDM
 SG_ OBJ_YAW_ANGLE_ERR_004 : 175|7@0+ (0.01,0) [0|1.27] "rad" ASDM
 SG_ OBJ_ID_004 : 7|8@0+ (1,0) [0|255] "NA" ASDM
 SG_ OBJ_MOVEMENT_STATUS_004 : 196|3@0+ (1,0) [0|3] "NA" ASDM
 SG_ OBJ_MEASUREMENT_STATUS_004 : 14|3@0+ (1,0) [0|7] "NA" ASDM
 SG_ OBJ_POS_LONG_004 : 63|16@0+ (0.01,-327) [-327|327] "m" ASDM
 SG_ OBJ_POS_LAT_004 : 79|16@0+ (0.01,-327) [-327|327] "m" ASDM
 SG_ OBJ_VELOCITY_LONG_004 : 110|15@0+ (0.01,-163) [-163|163] "m/s" ASDM
 SG_ OBJ_VELOCITY_LAT_004 : 126|15@0+ (0.01,-163) [-163|163] "m/s" ASDM
 SG_ OBJ_ACCELERATION_LONG_004 : 193|10@0+ (0.05,-20) [-20|20] "m/s^2" ASDM
 SG_ OBJ_ACCELERATION_LAT_004 : 177|10@0+ (0.05,-20) [-20|20] "m/s^2" ASDM
 SG_ OBJ_VEH_TRACK_FLAG_004 : 10|1@0+ (1,0) [0|1] "NA" ASDM
 SG_ OBJ_MH_CYCLE_COUNTER_004 : 487|8@0+ (1,0) [0|255] "NA" ASDM
 SG_ OBJ_MH_CRC16_004 : 495|16@0+ (1,0) [0|65535] "NA" ASDM
 SG_ OBJ_TIMESTAMP_OFFSET_004 : 247|8@0+ (1,-127) [-127|128] "ms" ASDM
 SG_ OBJ_DIMENSION_WIDTH_ERR_004 : 23|6@0+ (0.01,0) [0|0.63] "m" ASDM
 SG_ OBJ_DIMENSION_LENGTH_ERR_004 : 41|10@0+ (0.01,0) [0|10.23] "m" ASDM
 SG_ OBJ_CLS_TYPE1_004 : 271|4@0+ (1,0) [0|15] "NA" ASDM
 SG_ OBJ_CLS_TYPE1_PROB_004 : 303|8@0+ (0.004,0) [0|1] "NA" ASDM
 SG_ OBJ_CLS_TYPE2_004 : 267|4@0+ (1,0) [0|15] "NA" ASDM
 SG_ OBJ_CLS_TYPE2_PROB_004 : 311|8@0+ (0.004,0) [0|1] "NA" ASDM
 SG_ OBJ_CLS_TYPE3_004 : 279|4@0+ (1,0) [0|15] "NA" ASDM
 SG_ OBJ_CLS_TYPE3_PROB_004 : 319|8@0+ (0.004,0) [0|1] "NA" ASDM
 SG_ OBJ_CLS_TYPE4_004 : 275|4@0+ (1,0) [0|15] "NA" ASDM
 SG_ OBJ_CLS_TYPE4_PROB_004 : 327|8@0+ (0.004,0) [0|1] "NA" ASDM
 SG_ OBJ_CLS_TYPE5_004 : 287|4@0+ (1,0) [0|15] "NA" ASDM
 SG_ OBJ_CLS_TYPE5_PROB_004 : 335|8@0+ (0.004,0) [0|1] "NA" ASDM
 SG_ OBJ_CLS_TYPE6_004 : 282|4@0+ (1,0) [0|15] "NA" ASDM
 SG_ OBJ_CLS_TYPE6_PROB_004 : 343|8@0+ (0.004,0) [0|1] "NA" ASDM
 SG_ OBJ_RCS_004 : 351|7@0+ (1,-64) [-64|63] "dBsm" ASDM
 SG_ OBJ_REF_PT_LONG_OFFSET_004 : 357|14@0+ (0.0001,0) [0|1] "NA" ASDM
 SG_ OBJ_REF_PT_LAT_OFFSET_004 : 370|14@0+ (0.0001,0) [0|1] "NA" ASDM
 SG_ OBJ_YAW_RATE_004 : 399|10@0+ (0.005,-2.24) [-2.24|2.24] "rad/s" ASDM
 SG_ OBJ_YAW_RATE_ERR_004 : 388|5@0+ (0.025,0) [0|0.775] "rad/s" ASDM
 SG_ OBJ_GROUP_ID_004 : 405|6@0+ (1,0) [0|63] "NA" ASDM
 SG_ OBJ_POS_ERR_CRR_COEF_004 : 415|8@0+ (0.01,-1.2) [-1.2|1] "NA" ASDM
 SG_ OBJ_VELOCITY_ERR_CRR_COEF_004 : 423|8@0+ (0.01,-1.2) [-1.2|1] "NA" ASDM
 SG_ OBJ_ACCEL_ERR_CRR_COEF_004 : 431|8@0+ (0.01,-1.2) [-1.2|1] "NA" ASDM

BO_ 708 RDR_TRACKER_OBJ_005: 64 G5_RDR04
 SG_ OBJ_ALIVE_TIME_005 : 255|16@0+ (1,0) [0|65535] "ms" ASDM
 SG_ OBJ_ACCELERATION_LONG_ERR_005 : 215|8@0+ (0.025,0) [0|6.375] "m/s^2" ASDM
 SG_ OBJ_ACCELERATION_LAT_ERR_005 : 223|8@0+ (0.025,0) [0|6.375] "m/s^2" ASDM
 SG_ OBJ_VELOCITY_LONG_ERR_005 : 143|8@0+ (0.05,0) [0|12.75] "m/s" ASDM
 SG_ OBJ_VELOCITY_LAT_ERR_005 : 151|8@0+ (0.05,0) [0|12.75] "m/s" ASDM
 SG_ OBJ_POS_LONG_ERR_005 : 95|8@0+ (0.025,0) [0|6.375] "m" ASDM
 SG_ OBJ_POS_LAT_ERR_005 : 103|8@0+ (0.025,0) [0|6.375] "m" ASDM
 SG_ OBJ_TRACK_MOTION_MODEL_005 : 9|2@0+ (1,0) [1|3] "NA" ASDM
 SG_ OBJ_DIMENSION_WIDTH_005 : 17|10@0+ (0.01,0) [0|10.23] "m" ASDM
 SG_ OBJ_DIMENSION_LENGTH_005 : 37|12@0+ (0.01,0) [0|40.95] "m" ASDM
 SG_ OBJ_EXISTENCE_PROB_005 : 229|14@0+ (0.0001,0) [0|1] "NA" ASDM
 SG_ OBJ_YAW_ANGLE_005 : 155|12@0+ (0.005,-10) [-10|10.475] "rad" ASDM
 SG_ OBJ_YAW_ANGLE_ERR_005 : 175|7@0+ (0.01,0) [0|1.27] "rad" ASDM
 SG_ OBJ_ID_005 : 7|8@0+ (1,0) [0|255] "NA" ASDM
 SG_ OBJ_MOVEMENT_STATUS_005 : 196|3@0+ (1,0) [0|3] "NA" ASDM
 SG_ OBJ_MEASUREMENT_STATUS_005 : 14|3@0+ (1,0) [0|7] "NA" ASDM
 SG_ OBJ_POS_LONG_005 : 63|16@0+ (0.01,-327) [-327|327] "m" ASDM
 SG_ OBJ_POS_LAT_005 : 79|16@0+ (0.01,-327) [-327|327] "m" ASDM
 SG_ OBJ_VELOCITY_LONG_005 : 110|15@0+ (0.01,-163) [-163|163] "m/s" ASDM
 SG_ OBJ_VELOCITY_LAT_005 : 126|15@0+ (0.01,-163) [-163|163] "m/s" ASDM
 SG_ OBJ_ACCELERATION_LONG_005 : 193|10@0+ (0.05,-20) [-20|20] "m/s^2" ASDM
 SG_ OBJ_ACCELERATION_LAT_005 : 177|10@0+ (0.05,-20) [-20|20] "m/s^2" ASDM
 SG_ OBJ_VEH_TRACK_FLAG_005 : 10|1@0+ (1,0) [0|1] "NA" ASDM
 SG_ OBJ_MH_CYCLE_COUNTER_005 : 487|8@0+ (1,0) [0|255] "NA" ASDM
 SG_ OBJ_MH_CRC16_005 : 495|16@0+ (1,0) [0|65535] "NA" ASDM
 SG_ OBJ_TIMESTAMP_OFFSET_005 : 247|8@0+ (1,-127) [-127|128] "ms" ASDM
 SG_ OBJ_DIMENSION_WIDTH_ERR_005 : 23|6@0+ (0.01,0) [0|0.63] "m" ASDM
 SG_ OBJ_DIMENSION_LENGTH_ERR_005 : 41|10@0+ (0.01,0) [0|10.23] "m" ASDM
 SG_ OBJ_CLS_TYPE1_005 : 271|4@0+ (1,0) [0|15] "NA" ASDM
 SG_ OBJ_CLS_TYPE1_PROB_005 : 303|8@0+ (0.004,0) [0|1] "NA" ASDM
 SG_ OBJ_CLS_TYPE2_005 : 267|4@0+ (1,0) [0|15] "NA" ASDM
 SG_ OBJ_CLS_TYPE2_PROB_005 : 311|8@0+ (0.004,0) [0|1] "NA" ASDM
 SG_ OBJ_CLS_TYPE3_005 : 279|4@0+ (1,0) [0|15] "NA" ASDM
 SG_ OBJ_CLS_TYPE3_PROB_005 : 319|8@0+ (0.004,0) [0|1] "NA" ASDM
 SG_ OBJ_CLS_TYPE4_005 : 275|4@0+ (1,0) [0|15] "NA" ASDM
 SG_ OBJ_CLS_TYPE4_PROB_005 : 327|8@0+ (0.004,0) [0|1] "NA" ASDM
 SG_ OBJ_CLS_TYPE5_005 : 287|4@0+ (1,0) [0|15] "NA" ASDM
 SG_ OBJ_CLS_TYPE5_PROB_005 : 335|8@0+ (0.004,0) [0|1] "NA" ASDM
 SG_ OBJ_CLS_TYPE6_005 : 282|4@0+ (1,0) [0|15] "NA" ASDM
 SG_ OBJ_CLS_TYPE6_PROB_005 : 343|8@0+ (0.004,0) [0|1] "NA" ASDM
 SG_ OBJ_RCS_005 : 351|7@0+ (1,-64) [-64|63] "dBsm" ASDM
 SG_ OBJ_REF_PT_LONG_OFFSET_005 : 357|14@0+ (0.0001,0) [0|1] "NA" ASDM
 SG_ OBJ_REF_PT_LAT_OFFSET_005 : 370|14@0+ (0.0001,0) [0|1] "NA" ASDM
 SG_ OBJ_YAW_RATE_005 : 399|10@0+ (0.005,-2.24) [-2.24|2.24] "rad/s" ASDM
 SG_ OBJ_YAW_RATE_ERR_005 : 388|5@0+ (0.025,0) [0|0.775] "rad/s" ASDM
 SG_ OBJ_GROUP_ID_005 : 405|6@0+ (1,0) [0|63] "NA" ASDM
 SG_ OBJ_POS_ERR_CRR_COEF_005 : 415|8@0+ (0.01,-1.2) [-1.2|1] "NA" ASDM
 SG_ OBJ_VELOCITY_ERR_CRR_COEF_005 : 423|8@0+ (0.01,-1.2) [-1.2|1] "NA" ASDM
 SG_ OBJ_ACCEL_ERR_CRR_COEF_005 : 431|8@0+ (0.01,-1.2) [-1.2|1] "NA" ASDM

BO_ 709 RDR_TRACKER_OBJ_006: 64 G5_RDR04
 SG_ OBJ_ALIVE_TIME_006 : 255|16@0+ (1,0) [0|65535] "ms" ASDM
 SG_ OBJ_ACCELERATION_LONG_ERR_006 : 215|8@0+ (0.025,0) [0|6.375] "m/s^2" ASDM
 SG_ OBJ_ACCELERATION_LAT_ERR_006 : 223|8@0+ (0.025,0) [0|6.375] "m/s^2" ASDM
 SG_ OBJ_VELOCITY_LONG_ERR_006 : 143|8@0+ (0.05,0) [0|12.75] "m/s" ASDM
 SG_ OBJ_VELOCITY_LAT_ERR_006 : 151|8@0+ (0.05,0) [0|12.75] "m/s" ASDM
 SG_ OBJ_POS_LONG_ERR_006 : 95|8@0+ (0.025,0) [0|6.375] "m" ASDM
 SG_ OBJ_POS_LAT_ERR_006 : 103|8@0+ (0.025,0) [0|6.375] "m" ASDM
 SG_ OBJ_TRACK_MOTION_MODEL_006 : 9|2@0+ (1,0) [1|3] "NA" ASDM
 SG_ OBJ_DIMENSION_WIDTH_006 : 17|10@0+ (0.01,0) [0|10.23] "m" ASDM
 SG_ OBJ_DIMENSION_LENGTH_006 : 37|12@0+ (0.01,0) [0|40.95] "m" ASDM
 SG_ OBJ_EXISTENCE_PROB_006 : 229|14@0+ (0.0001,0) [0|1] "NA" ASDM
 SG_ OBJ_YAW_ANGLE_006 : 155|12@0+ (0.005,-10) [-10|10.475] "rad" ASDM
 SG_ OBJ_YAW_ANGLE_ERR_006 : 175|7@0+ (0.01,0) [0|1.27] "rad" ASDM
 SG_ OBJ_ID_006 : 7|8@0+ (1,0) [0|255] "NA" ASDM
 SG_ OBJ_MOVEMENT_STATUS_006 : 196|3@0+ (1,0) [0|3] "NA" ASDM
 SG_ OBJ_MEASUREMENT_STATUS_006 : 14|3@0+ (1,0) [0|7] "NA" ASDM
 SG_ OBJ_POS_LONG_006 : 63|16@0+ (0.01,-327) [-327|327] "m" ASDM
 SG_ OBJ_POS_LAT_006 : 79|16@0+ (0.01,-327) [-327|327] "m" ASDM
 SG_ OBJ_VELOCITY_LONG_006 : 110|15@0+ (0.01,-163) [-163|163] "m/s" ASDM
 SG_ OBJ_VELOCITY_LAT_006 : 126|15@0+ (0.01,-163) [-163|163] "m/s" ASDM
 SG_ OBJ_ACCELERATION_LONG_006 : 193|10@0+ (0.05,-20) [-20|20] "m/s^2" ASDM
 SG_ OBJ_ACCELERATION_LAT_006 : 177|10@0+ (0.05,-20) [-20|20] "m/s^2" ASDM
 SG_ OBJ_VEH_TRACK_FLAG_006 : 10|1@0+ (1,0) [0|1] "NA" ASDM
 SG_ OBJ_MH_CYCLE_COUNTER_006 : 487|8@0+ (1,0) [0|255] "NA" ASDM
 SG_ OBJ_MH_CRC16_006 : 495|16@0+ (1,0) [0|65535] "NA" ASDM
 SG_ OBJ_TIMESTAMP_OFFSET_006 : 247|8@0+ (1,-127) [-127|128] "ms" ASDM
 SG_ OBJ_DIMENSION_WIDTH_ERR_006 : 23|6@0+ (0.01,0) [0|0.63] "m" ASDM
 SG_ OBJ_DIMENSION_LENGTH_ERR_006 : 41|10@0+ (0.01,0) [0|10.23] "m" ASDM
 SG_ OBJ_CLS_TYPE1_006 : 271|4@0+ (1,0) [0|15] "NA" ASDM
 SG_ OBJ_CLS_TYPE1_PROB_006 : 303|8@0+ (0.004,0) [0|1] "NA" ASDM
 SG_ OBJ_CLS_TYPE2_006 : 267|4@0+ (1,0) [0|15] "NA" ASDM
 SG_ OBJ_CLS_TYPE2_PROB_006 : 311|8@0+ (0.004,0) [0|1] "NA" ASDM
 SG_ OBJ_CLS_TYPE3_006 : 279|4@0+ (1,0) [0|15] "NA" ASDM
 SG_ OBJ_CLS_TYPE3_PROB_006 : 319|8@0+ (0.004,0) [0|1] "NA" ASDM
 SG_ OBJ_CLS_TYPE4_006 : 275|4@0+ (1,0) [0|15] "NA" ASDM
 SG_ OBJ_CLS_TYPE4_PROB_006 : 327|8@0+ (0.004,0) [0|1] "NA" ASDM
 SG_ OBJ_CLS_TYPE5_006 : 287|4@0+ (1,0) [0|15] "NA" ASDM
 SG_ OBJ_CLS_TYPE5_PROB_006 : 335|8@0+ (0.004,0) [0|1] "NA" ASDM
 SG_ OBJ_CLS_TYPE6_006 : 282|4@0+ (1,0) [0|15] "NA" ASDM
 SG_ OBJ_CLS_TYPE6_PROB_006 : 343|8@0+ (0.004,0) [0|1] "NA" ASDM
 SG_ OBJ_RCS_006 : 351|7@0+ (1,-64) [-64|63] "dBsm" ASDM
 SG_ OBJ_REF_PT_LONG_OFFSET_006 : 357|14@0+ (0.0001,0) [0|1] "NA" ASDM
 SG_ OBJ_REF_PT_LAT_OFFSET_006 : 370|14@0+ (0.0001,0) [0|1] "NA" ASDM
 SG_ OBJ_YAW_RATE_006 : 399|10@0+ (0.005,-2.24) [-2.24|2.24] "rad/s" ASDM
 SG_ OBJ_YAW_RATE_ERR_006 : 388|5@0+ (0.025,0) [0|0.775] "rad/s" ASDM
 SG_ OBJ_GROUP_ID_006 : 405|6@0+ (1,0) [0|63] "NA" ASDM
 SG_ OBJ_POS_ERR_CRR_COEF_006 : 415|8@0+ (0.01,-1.2) [-1.2|1] "NA" ASDM
 SG_ OBJ_VELOCITY_ERR_CRR_COEF_006 : 423|8@0+ (0.01,-1.2) [-1.2|1] "NA" ASDM
 SG_ OBJ_ACCEL_ERR_CRR_COEF_006 : 431|8@0+ (0.01,-1.2) [-1.2|1] "NA" ASDM

BO_ 710 RDR_TRACKER_OBJ_007: 64 G5_RDR04
 SG_ OBJ_ALIVE_TIME_007 : 255|16@0+ (1,0) [0|65535] "ms" ASDM
 SG_ OBJ_ACCELERATION_LONG_ERR_007 : 215|8@0+ (0.025,0) [0|6.375] "m/s^2" ASDM
 SG_ OBJ_ACCELERATION_LAT_ERR_007 : 223|8@0+ (0.025,0) [0|6.375] "m/s^2" ASDM
 SG_ OBJ_VELOCITY_LONG_ERR_007 : 143|8@0+ (0.05,0) [0|12.75] "m/s" ASDM
 SG_ OBJ_VELOCITY_LAT_ERR_007 : 151|8@0+ (0.05,0) [0|12.75] "m/s" ASDM
 SG_ OBJ_POS_LONG_ERR_007 : 95|8@0+ (0.025,0) [0|6.375] "m" ASDM
 SG_ OBJ_POS_LAT_ERR_007 : 103|8@0+ (0.025,0) [0|6.375] "m" ASDM
 SG_ OBJ_TRACK_MOTION_MODEL_007 : 9|2@0+ (1,0) [1|3] "NA" ASDM
 SG_ OBJ_DIMENSION_WIDTH_007 : 17|10@0+ (0.01,0) [0|10.23] "m" ASDM
 SG_ OBJ_DIMENSION_LENGTH_007 : 37|12@0+ (0.01,0) [0|40.95] "m" ASDM
 SG_ OBJ_EXISTENCE_PROB_007 : 229|14@0+ (0.0001,0) [0|1] "NA" ASDM
 SG_ OBJ_YAW_ANGLE_007 : 155|12@0+ (0.005,-10) [-10|10.475] "rad" ASDM
 SG_ OBJ_YAW_ANGLE_ERR_007 : 175|7@0+ (0.01,0) [0|1.27] "rad" ASDM
 SG_ OBJ_ID_007 : 7|8@0+ (1,0) [0|255] "NA" ASDM
 SG_ OBJ_MOVEMENT_STATUS_007 : 196|3@0+ (1,0) [0|3] "NA" ASDM
 SG_ OBJ_MEASUREMENT_STATUS_007 : 14|3@0+ (1,0) [0|7] "NA" ASDM
 SG_ OBJ_POS_LONG_007 : 63|16@0+ (0.01,-327) [-327|327] "m" ASDM
 SG_ OBJ_POS_LAT_007 : 79|16@0+ (0.01,-327) [-327|327] "m" ASDM
 SG_ OBJ_VELOCITY_LONG_007 : 110|15@0+ (0.01,-163) [-163|163] "m/s" ASDM
 SG_ OBJ_VELOCITY_LAT_007 : 126|15@0+ (0.01,-163) [-163|163] "m/s" ASDM
 SG_ OBJ_ACCELERATION_LONG_007 : 193|10@0+ (0.05,-20) [-20|20] "m/s^2" ASDM
 SG_ OBJ_ACCELERATION_LAT_007 : 177|10@0+ (0.05,-20) [-20|20] "m/s^2" ASDM
 SG_ OBJ_VEH_TRACK_FLAG_007 : 10|1@0+ (1,0) [0|1] "NA" ASDM
 SG_ OBJ_MH_CYCLE_COUNTER_007 : 487|8@0+ (1,0) [0|255] "NA" ASDM
 SG_ OBJ_MH_CRC16_007 : 495|16@0+ (1,0) [0|65535] "NA" ASDM
 SG_ OBJ_TIMESTAMP_OFFSET_007 : 247|8@0+ (1,-127) [-127|128] "ms" ASDM
 SG_ OBJ_DIMENSION_WIDTH_ERR_007 : 23|6@0+ (0.01,0) [0|0.63] "m" ASDM
 SG_ OBJ_DIMENSION_LENGTH_ERR_007 : 41|10@0+ (0.01,0) [0|10.23] "m" ASDM
 SG_ OBJ_CLS_TYPE1_007 : 271|4@0+ (1,0) [0|15] "NA" ASDM
 SG_ OBJ_CLS_TYPE1_PROB_007 : 303|8@0+ (0.004,0) [0|1] "NA" ASDM
 SG_ OBJ_CLS_TYPE2_007 : 267|4@0+ (1,0) [0|15] "NA" ASDM
 SG_ OBJ_CLS_TYPE2_PROB_007 : 311|8@0+ (0.004,0) [0|1] "NA" ASDM
 SG_ OBJ_CLS_TYPE3_007 : 279|4@0+ (1,0) [0|15] "NA" ASDM
 SG_ OBJ_CLS_TYPE3_PROB_007 : 319|8@0+ (0.004,0) [0|1] "NA" ASDM
 SG_ OBJ_CLS_TYPE4_007 : 275|4@0+ (1,0) [0|15] "NA" ASDM
 SG_ OBJ_CLS_TYPE4_PROB_007 : 327|8@0+ (0.004,0) [0|1] "NA" ASDM
 SG_ OBJ_CLS_TYPE5_007 : 287|4@0+ (1,0) [0|15] "NA" ASDM
 SG_ OBJ_CLS_TYPE5_PROB_007 : 335|8@0+ (0.004,0) [0|1] "NA" ASDM
 SG_ OBJ_CLS_TYPE6_007 : 282|4@0+ (1,0) [0|15] "NA" ASDM
 SG_ OBJ_CLS_TYPE6_PROB_007 : 343|8@0+ (0.004,0) [0|1] "NA" ASDM
 SG_ OBJ_RCS_007 : 351|7@0+ (1,-64) [-64|63] "dBsm" ASDM
 SG_ OBJ_REF_PT_LONG_OFFSET_007 : 357|14@0+ (0.0001,0) [0|1] "NA" ASDM
 SG_ OBJ_REF_PT_LAT_OFFSET_007 : 370|14@0+ (0.0001,0) [0|1] "NA" ASDM
 SG_ OBJ_YAW_RATE_007 : 399|10@0+ (0.005,-2.24) [-2.24|2.24] "rad/s" ASDM
 SG_ OBJ_YAW_RATE_ERR_007 : 388|5@0+ (0.025,0) [0|0.775] "rad/s" ASDM
 SG_ OBJ_GROUP_ID_007 : 405|6@0+ (1,0) [0|63] "NA" ASDM
 SG_ OBJ_POS_ERR_CRR_COEF_007 : 415|8@0+ (0.01,-1.2) [-1.2|1] "NA" ASDM
 SG_ OBJ_VELOCITY_ERR_CRR_COEF_007 : 423|8@0+ (0.01,-1.2) [-1.2|1] "NA" ASDM
 SG_ OBJ_ACCEL_ERR_CRR_COEF_007 : 431|8@0+ (0.01,-1.2) [-1.2|1] "NA" ASDM

BO_ 711 RDR_TRACKER_OBJ_008: 64 G5_RDR04
 SG_ OBJ_ALIVE_TIME_008 : 255|16@0+ (1,0) [0|65535] "ms" ASDM
 SG_ OBJ_ACCELERATION_LONG_ERR_008 : 215|8@0+ (0.025,0) [0|6.375] "m/s^2" ASDM
 SG_ OBJ_ACCELERATION_LAT_ERR_008 : 223|8@0+ (0.025,0) [0|6.375] "m/s^2" ASDM
 SG_ OBJ_VELOCITY_LONG_ERR_008 : 143|8@0+ (0.05,0) [0|12.75] "m/s" ASDM
 SG_ OBJ_VELOCITY_LAT_ERR_008 : 151|8@0+ (0.05,0) [0|12.75] "m/s" ASDM
 SG_ OBJ_POS_LONG_ERR_008 : 95|8@0+ (0.025,0) [0|6.375] "m" ASDM
 SG_ OBJ_POS_LAT_ERR_008 : 103|8@0+ (0.025,0) [0|6.375] "m" ASDM
 SG_ OBJ_TRACK_MOTION_MODEL_008 : 9|2@0+ (1,0) [1|3] "NA" ASDM
 SG_ OBJ_DIMENSION_WIDTH_008 : 17|10@0+ (0.01,0) [0|10.23] "m" ASDM
 SG_ OBJ_DIMENSION_LENGTH_008 : 37|12@0+ (0.01,0) [0|40.95] "m" ASDM
 SG_ OBJ_EXISTENCE_PROB_008 : 229|14@0+ (0.0001,0) [0|1] "NA" ASDM
 SG_ OBJ_YAW_ANGLE_008 : 155|12@0+ (0.005,-10) [-10|10.475] "rad" ASDM
 SG_ OBJ_YAW_ANGLE_ERR_008 : 175|7@0+ (0.01,0) [0|1.27] "rad" ASDM
 SG_ OBJ_ID_008 : 7|8@0+ (1,0) [0|255] "NA" ASDM
 SG_ OBJ_MOVEMENT_STATUS_008 : 196|3@0+ (1,0) [0|3] "NA" ASDM
 SG_ OBJ_MEASUREMENT_STATUS_008 : 14|3@0+ (1,0) [0|7] "NA" ASDM
 SG_ OBJ_POS_LONG_008 : 63|16@0+ (0.01,-327) [-327|327] "m" ASDM
 SG_ OBJ_POS_LAT_008 : 79|16@0+ (0.01,-327) [-327|327] "m" ASDM
 SG_ OBJ_VELOCITY_LONG_008 : 110|15@0+ (0.01,-163) [-163|163] "m/s" ASDM
 SG_ OBJ_VELOCITY_LAT_008 : 126|15@0+ (0.01,-163) [-163|163] "m/s" ASDM
 SG_ OBJ_ACCELERATION_LONG_008 : 193|10@0+ (0.05,-20) [-20|20] "m/s^2" ASDM
 SG_ OBJ_ACCELERATION_LAT_008 : 177|10@0+ (0.05,-20) [-20|20] "m/s^2" ASDM
 SG_ OBJ_VEH_TRACK_FLAG_008 : 10|1@0+ (1,0) [0|1] "NA" ASDM
 SG_ OBJ_MH_CYCLE_COUNTER_008 : 487|8@0+ (1,0) [0|255] "NA" ASDM
 SG_ OBJ_MH_CRC16_008 : 495|16@0+ (1,0) [0|65535] "NA" ASDM
 SG_ OBJ_TIMESTAMP_OFFSET_008 : 247|8@0+ (1,-127) [-127|128] "ms" ASDM
 SG_ OBJ_DIMENSION_WIDTH_ERR_008 : 23|6@0+ (0.01,0) [0|0.63] "m" ASDM
 SG_ OBJ_DIMENSION_LENGTH_ERR_008 : 41|10@0+ (0.01,0) [0|10.23] "m" ASDM
 SG_ OBJ_CLS_TYPE1_008 : 271|4@0+ (1,0) [0|15] "NA" ASDM
 SG_ OBJ_CLS_TYPE1_PROB_008 : 303|8@0+ (0.004,0) [0|1] "NA" ASDM
 SG_ OBJ_CLS_TYPE2_008 : 267|4@0+ (1,0) [0|15] "NA" ASDM
 SG_ OBJ_CLS_TYPE2_PROB_008 : 311|8@0+ (0.004,0) [0|1] "NA" ASDM
 SG_ OBJ_CLS_TYPE3_008 : 279|4@0+ (1,0) [0|15] "NA" ASDM
 SG_ OBJ_CLS_TYPE3_PROB_008 : 319|8@0+ (0.004,0) [0|1] "NA" ASDM
 SG_ OBJ_CLS_TYPE4_008 : 275|4@0+ (1,0) [0|15] "NA" ASDM
 SG_ OBJ_CLS_TYPE4_PROB_008 : 327|8@0+ (0.004,0) [0|1] "NA" ASDM
 SG_ OBJ_CLS_TYPE5_008 : 287|4@0+ (1,0) [0|15] "NA" ASDM
 SG_ OBJ_CLS_TYPE5_PROB_008 : 335|8@0+ (0.004,0) [0|1] "NA" ASDM
 SG_ OBJ_CLS_TYPE6_008 : 282|4@0+ (1,0) [0|15] "NA" ASDM
 SG_ OBJ_CLS_TYPE6_PROB_008 : 343|8@0+ (0.004,0) [0|1] "NA" ASDM
 SG_ OBJ_RCS_008 : 351|7@0+ (1,-64) [-64|63] "dBsm" ASDM
 SG_ OBJ_REF_PT_LONG_OFFSET_008 : 357|14@0+ (0.0001,0) [0|1] "NA" ASDM
 SG_ OBJ_REF_PT_LAT_OFFSET_008 : 370|14@0+ (0.0001,0) [0|1] "NA" ASDM
 SG_ OBJ_YAW_RATE_008 : 399|10@0+ (0.005,-2.24) [-2.24|2.24] "rad/s" ASDM
 SG_ OBJ_YAW_RATE_ERR_008 : 388|5@0+ (0.025,0) [0|0.775] "rad/s" ASDM
 SG_ OBJ_GROUP_ID_008 : 405|6@0+ (1,0) [0|63] "NA" ASDM
 SG_ OBJ_POS_ERR_CRR_COEF_008 : 415|8@0+ (0.01,-1.2) [-1.2|1] "NA" ASDM
 SG_ OBJ_VELOCITY_ERR_CRR_COEF_008 : 423|8@0+ (0.01,-1.2) [-1.2|1] "NA" ASDM
 SG_ OBJ_ACCEL_ERR_CRR_COEF_008 : 431|8@0+ (0.01,-1.2) [-1.2|1] "NA" ASDM

BO_ 712 RDR_TRACKER_OBJ_009: 64 G5_RDR04
 SG_ OBJ_ALIVE_TIME_009 : 255|16@0+ (1,0) [0|65535] "ms" ASDM
 SG_ OBJ_ACCELERATION_LONG_ERR_009 : 215|8@0+ (0.025,0) [0|6.375] "m/s^2" ASDM
 SG_ OBJ_ACCELERATION_LAT_ERR_009 : 223|8@0+ (0.025,0) [0|6.375] "m/s^2" ASDM
 SG_ OBJ_VELOCITY_LONG_ERR_009 : 143|8@0+ (0.05,0) [0|12.75] "m/s" ASDM
 SG_ OBJ_VELOCITY_LAT_ERR_009 : 151|8@0+ (0.05,0) [0|12.75] "m/s" ASDM
 SG_ OBJ_POS_LONG_ERR_009 : 95|8@0+ (0.025,0) [0|6.375] "m" ASDM
 SG_ OBJ_POS_LAT_ERR_009 : 103|8@0+ (0.025,0) [0|6.375] "m" ASDM
 SG_ OBJ_TRACK_MOTION_MODEL_009 : 9|2@0+ (1,0) [1|3] "NA" ASDM
 SG_ OBJ_DIMENSION_WIDTH_009 : 17|10@0+ (0.01,0) [0|10.23] "m" ASDM
 SG_ OBJ_DIMENSION_LENGTH_009 : 37|12@0+ (0.01,0) [0|40.95] "m" ASDM
 SG_ OBJ_EXISTENCE_PROB_009 : 229|14@0+ (0.0001,0) [0|1] "NA" ASDM
 SG_ OBJ_YAW_ANGLE_009 : 155|12@0+ (0.005,-10) [-10|10.475] "rad" ASDM
 SG_ OBJ_YAW_ANGLE_ERR_009 : 175|7@0+ (0.01,0) [0|1.27] "rad" ASDM
 SG_ OBJ_ID_009 : 7|8@0+ (1,0) [0|255] "NA" ASDM
 SG_ OBJ_MOVEMENT_STATUS_009 : 196|3@0+ (1,0) [0|3] "NA" ASDM
 SG_ OBJ_MEASUREMENT_STATUS_009 : 14|3@0+ (1,0) [0|7] "NA" ASDM
 SG_ OBJ_POS_LONG_009 : 63|16@0+ (0.01,-327) [-327|327] "m" ASDM
 SG_ OBJ_POS_LAT_009 : 79|16@0+ (0.01,-327) [-327|327] "m" ASDM
 SG_ OBJ_VELOCITY_LONG_009 : 110|15@0+ (0.01,-163) [-163|163] "m/s" ASDM
 SG_ OBJ_VELOCITY_LAT_009 : 126|15@0+ (0.01,-163) [-163|163] "m/s" ASDM
 SG_ OBJ_ACCELERATION_LONG_009 : 193|10@0+ (0.05,-20) [-20|20] "m/s^2" ASDM
 SG_ OBJ_ACCELERATION_LAT_009 : 177|10@0+ (0.05,-20) [-20|20] "m/s^2" ASDM
 SG_ OBJ_VEH_TRACK_FLAG_009 : 10|1@0+ (1,0) [0|1] "NA" ASDM
 SG_ OBJ_MH_CYCLE_COUNTER_009 : 487|8@0+ (1,0) [0|255] "NA" ASDM
 SG_ OBJ_MH_CRC16_009 : 495|16@0+ (1,0) [0|65535] "NA" ASDM
 SG_ OBJ_TIMESTAMP_OFFSET_009 : 247|8@0+ (1,-127) [-127|128] "ms" ASDM
 SG_ OBJ_DIMENSION_WIDTH_ERR_009 : 23|6@0+ (0.01,0) [0|0.63] "m" ASDM
 SG_ OBJ_DIMENSION_LENGTH_ERR_009 : 41|10@0+ (0.01,0) [0|10.23] "m" ASDM
 SG_ OBJ_CLS_TYPE1_009 : 271|4@0+ (1,0) [0|15] "NA" ASDM
 SG_ OBJ_CLS_TYPE1_PROB_009 : 303|8@0+ (0.004,0) [0|1] "NA" ASDM
 SG_ OBJ_CLS_TYPE2_009 : 267|4@0+ (1,0) [0|15] "NA" ASDM
 SG_ OBJ_CLS_TYPE2_PROB_009 : 311|8@0+ (0.004,0) [0|1] "NA" ASDM
 SG_ OBJ_CLS_TYPE3_009 : 279|4@0+ (1,0) [0|15] "NA" ASDM
 SG_ OBJ_CLS_TYPE3_PROB_009 : 319|8@0+ (0.004,0) [0|1] "NA" ASDM
 SG_ OBJ_CLS_TYPE4_009 : 275|4@0+ (1,0) [0|15] "NA" ASDM
 SG_ OBJ_CLS_TYPE4_PROB_009 : 327|8@0+ (0.004,0) [0|1] "NA" ASDM
 SG_ OBJ_CLS_TYPE5_009 : 287|4@0+ (1,0) [0|15] "NA" ASDM
 SG_ OBJ_CLS_TYPE5_PROB_009 : 335|8@0+ (0.004,0) [0|1] "NA" ASDM
 SG_ OBJ_CLS_TYPE6_009 : 282|4@0+ (1,0) [0|15] "NA" ASDM
 SG_ OBJ_CLS_TYPE6_PROB_009 : 343|8@0+ (0.004,0) [0|1] "NA" ASDM
 SG_ OBJ_RCS_009 : 351|7@0+ (1,-64) [-64|63] "dBsm" ASDM
 SG_ OBJ_REF_PT_LONG_OFFSET_009 : 357|14@0+ (0.0001,0) [0|1] "NA" ASDM
 SG_ OBJ_REF_PT_LAT_OFFSET_009 : 370|14@0+ (0.0001,0) [0|1] "NA" ASDM
 SG_ OBJ_YAW_RATE_009 : 399|10@0+ (0.005,-2.24) [-2.24|2.24] "rad/s" ASDM
 SG_ OBJ_YAW_RATE_ERR_009 : 388|5@0+ (0.025,0) [0|0.775] "rad/s" ASDM
 SG_ OBJ_GROUP_ID_009 : 405|6@0+ (1,0) [0|63] "NA" ASDM
 SG_ OBJ_POS_ERR_CRR_COEF_009 : 415|8@0+ (0.01,-1.2) [-1.2|1] "NA" ASDM
 SG_ OBJ_VELOCITY_ERR_CRR_COEF_009 : 423|8@0+ (0.01,-1.2) [-1.2|1] "NA" ASDM
 SG_ OBJ_ACCEL_ERR_CRR_COEF_009 : 431|8@0+ (0.01,-1.2) [-1.2|1] "NA" ASDM

BO_ 713 RDR_TRACKER_OBJ_010: 64 G5_RDR04
 SG_ OBJ_ALIVE_TIME_010 : 255|16@0+ (1,0) [0|65535] "ms" ASDM
 SG_ OBJ_ACCELERATION_LONG_ERR_010 : 215|8@0+ (0.025,0) [0|6.375] "m/s^2" ASDM
 SG_ OBJ_ACCELERATION_LAT_ERR_010 : 223|8@0+ (0.025,0) [0|6.375] "m/s^2" ASDM
 SG_ OBJ_VELOCITY_LONG_ERR_010 : 143|8@0+ (0.05,0) [0|12.75] "m/s" ASDM
 SG_ OBJ_VELOCITY_LAT_ERR_010 : 151|8@0+ (0.05,0) [0|12.75] "m/s" ASDM
 SG_ OBJ_POS_LONG_ERR_010 : 95|8@0+ (0.025,0) [0|6.375] "m" ASDM
 SG_ OBJ_POS_LAT_ERR_010 : 103|8@0+ (0.025,0) [0|6.375] "m" ASDM
 SG_ OBJ_TRACK_MOTION_MODEL_010 : 9|2@0+ (1,0) [1|3] "NA" ASDM
 SG_ OBJ_DIMENSION_WIDTH_010 : 17|10@0+ (0.01,0) [0|10.23] "m" ASDM
 SG_ OBJ_DIMENSION_LENGTH_010 : 37|12@0+ (0.01,0) [0|40.95] "m" ASDM
 SG_ OBJ_EXISTENCE_PROB_010 : 229|14@0+ (0.0001,0) [0|1] "NA" ASDM
 SG_ OBJ_YAW_ANGLE_010 : 155|12@0+ (0.005,-10) [-10|10.475] "rad" ASDM
 SG_ OBJ_YAW_ANGLE_ERR_010 : 175|7@0+ (0.01,0) [0|1.27] "rad" ASDM
 SG_ OBJ_ID_010 : 7|8@0+ (1,0) [0|255] "NA" ASDM
 SG_ OBJ_MOVEMENT_STATUS_010 : 196|3@0+ (1,0) [0|3] "NA" ASDM
 SG_ OBJ_MEASUREMENT_STATUS_010 : 14|3@0+ (1,0) [0|7] "NA" ASDM
 SG_ OBJ_POS_LONG_010 : 63|16@0+ (0.01,-327) [-327|327] "m" ASDM
 SG_ OBJ_POS_LAT_010 : 79|16@0+ (0.01,-327) [-327|327] "m" ASDM
 SG_ OBJ_VELOCITY_LONG_010 : 110|15@0+ (0.01,-163) [-163|163] "m/s" ASDM
 SG_ OBJ_VELOCITY_LAT_010 : 126|15@0+ (0.01,-163) [-163|163] "m/s" ASDM
 SG_ OBJ_ACCELERATION_LONG_010 : 193|10@0+ (0.05,-20) [-20|20] "m/s^2" ASDM
 SG_ OBJ_ACCELERATION_LAT_010 : 177|10@0+ (0.05,-20) [-20|20] "m/s^2" ASDM
 SG_ OBJ_VEH_TRACK_FLAG_010 : 10|1@0+ (1,0) [0|1] "NA" ASDM
 SG_ OBJ_MH_CYCLE_COUNTER_010 : 487|8@0+ (1,0) [0|255] "NA" ASDM
 SG_ OBJ_MH_CRC16_010 : 495|16@0+ (1,0) [0|65535] "NA" ASDM
 SG_ OBJ_TIMESTAMP_OFFSET_010 : 247|8@0+ (1,-127) [-127|128] "ms" ASDM
 SG_ OBJ_DIMENSION_WIDTH_ERR_010 : 23|6@0+ (0.01,0) [0|0.63] "m" ASDM
 SG_ OBJ_DIMENSION_LENGTH_ERR_010 : 41|10@0+ (0.01,0) [0|10.23] "m" ASDM
 SG_ OBJ_CLS_TYPE1_010 : 271|4@0+ (1,0) [0|15] "NA" ASDM
 SG_ OBJ_CLS_TYPE1_PROB_010 : 303|8@0+ (0.004,0) [0|1] "NA" ASDM
 SG_ OBJ_CLS_TYPE2_010 : 267|4@0+ (1,0) [0|15] "NA" ASDM
 SG_ OBJ_CLS_TYPE2_PROB_010 : 311|8@0+ (0.004,0) [0|1] "NA" ASDM
 SG_ OBJ_CLS_TYPE3_010 : 279|4@0+ (1,0) [0|15] "NA" ASDM
 SG_ OBJ_CLS_TYPE3_PROB_010 : 319|8@0+ (0.004,0) [0|1] "NA" ASDM
 SG_ OBJ_CLS_TYPE4_010 : 275|4@0+ (1,0) [0|15] "NA" ASDM
 SG_ OBJ_CLS_TYPE4_PROB_010 : 327|8@0+ (0.004,0) [0|1] "NA" ASDM
 SG_ OBJ_CLS_TYPE5_010 : 287|4@0+ (1,0) [0|15] "NA" ASDM
 SG_ OBJ_CLS_TYPE5_PROB_010 : 335|8@0+ (0.004,0) [0|1] "NA" ASDM
 SG_ OBJ_CLS_TYPE6_010 : 282|4@0+ (1,0) [0|15] "NA" ASDM
 SG_ OBJ_CLS_TYPE6_PROB_010 : 343|8@0+ (0.004,0) [0|1] "NA" ASDM
 SG_ OBJ_RCS_010 : 351|7@0+ (1,-64) [-64|63] "dBsm" ASDM
 SG_ OBJ_REF_PT_LONG_OFFSET_010 : 357|14@0+ (0.0001,0) [0|1] "NA" ASDM
 SG_ OBJ_REF_PT_LAT_OFFSET_010 : 370|14@0+ (0.0001,0) [0|1] "NA" ASDM
 SG_ OBJ_YAW_RATE_010 : 399|10@0+ (0.005,-2.24) [-2.24|2.24] "rad/s" ASDM
 SG_ OBJ_YAW_RATE_ERR_010 : 388|5@0+ (0.025,0) [0|0.775] "rad/s" ASDM
 SG_ OBJ_GROUP_ID_010 : 405|6@0+ (1,0) [0|63] "NA" ASDM
 SG_ OBJ_POS_ERR_CRR_COEF_010 : 415|8@0+ (0.01,-1.2) [-1.2|1] "NA" ASDM
 SG_ OBJ_VELOCITY_ERR_CRR_COEF_010 : 423|8@0+ (0.01,-1.2) [-1.2|1] "NA" ASDM
 SG_ OBJ_ACCEL_ERR_CRR_COEF_010 : 431|8@0+ (0.01,-1.2) [-1.2|1] "NA" ASDM

BO_ 714 RDR_TRACKER_OBJ_011: 64 G5_RDR04
 SG_ OBJ_ALIVE_TIME_011 : 255|16@0+ (1,0) [0|65535] "ms" ASDM
 SG_ OBJ_ACCELERATION_LONG_ERR_011 : 215|8@0+ (0.025,0) [0|6.375] "m/s^2" ASDM
 SG_ OBJ_ACCELERATION_LAT_ERR_011 : 223|8@0+ (0.025,0) [0|6.375] "m/s^2" ASDM
 SG_ OBJ_VELOCITY_LONG_ERR_011 : 143|8@0+ (0.05,0) [0|12.75] "m/s" ASDM
 SG_ OBJ_VELOCITY_LAT_ERR_011 : 151|8@0+ (0.05,0) [0|12.75] "m/s" ASDM
 SG_ OBJ_POS_LONG_ERR_011 : 95|8@0+ (0.025,0) [0|6.375] "m" ASDM
 SG_ OBJ_POS_LAT_ERR_011 : 103|8@0+ (0.025,0) [0|6.375] "m" ASDM
 SG_ OBJ_TRACK_MOTION_MODEL_011 : 9|2@0+ (1,0) [1|3] "NA" ASDM
 SG_ OBJ_DIMENSION_WIDTH_011 : 17|10@0+ (0.01,0) [0|10.23] "m" ASDM
 SG_ OBJ_DIMENSION_LENGTH_011 : 37|12@0+ (0.01,0) [0|40.95] "m" ASDM
 SG_ OBJ_EXISTENCE_PROB_011 : 229|14@0+ (0.0001,0) [0|1] "NA" ASDM
 SG_ OBJ_YAW_ANGLE_011 : 155|12@0+ (0.005,-10) [-10|10.475] "rad" ASDM
 SG_ OBJ_YAW_ANGLE_ERR_011 : 175|7@0+ (0.01,0) [0|1.27] "rad" ASDM
 SG_ OBJ_ID_011 : 7|8@0+ (1,0) [0|255] "NA" ASDM
 SG_ OBJ_MOVEMENT_STATUS_011 : 196|3@0+ (1,0) [0|3] "NA" ASDM
 SG_ OBJ_MEASUREMENT_STATUS_011 : 14|3@0+ (1,0) [0|7] "NA" ASDM
 SG_ OBJ_POS_LONG_011 : 63|16@0+ (0.01,-327) [-327|327] "m" ASDM
 SG_ OBJ_POS_LAT_011 : 79|16@0+ (0.01,-327) [-327|327] "m" ASDM
 SG_ OBJ_VELOCITY_LONG_011 : 110|15@0+ (0.01,-163) [-163|163] "m/s" ASDM
 SG_ OBJ_VELOCITY_LAT_011 : 126|15@0+ (0.01,-163) [-163|163] "m/s" ASDM
 SG_ OBJ_ACCELERATION_LONG_011 : 193|10@0+ (0.05,-20) [-20|20] "m/s^2" ASDM
 SG_ OBJ_ACCELERATION_LAT_011 : 177|10@0+ (0.05,-20) [-20|20] "m/s^2" ASDM
 SG_ OBJ_VEH_TRACK_FLAG_011 : 10|1@0+ (1,0) [0|1] "NA" ASDM
 SG_ OBJ_MH_CYCLE_COUNTER_011 : 487|8@0+ (1,0) [0|255] "NA" ASDM
 SG_ OBJ_MH_CRC16_011 : 495|16@0+ (1,0) [0|65535] "NA" ASDM
 SG_ OBJ_TIMESTAMP_OFFSET_011 : 247|8@0+ (1,-127) [-127|128] "ms" ASDM
 SG_ OBJ_DIMENSION_WIDTH_ERR_011 : 23|6@0+ (0.01,0) [0|0.63] "m" ASDM
 SG_ OBJ_DIMENSION_LENGTH_ERR_011 : 41|10@0+ (0.01,0) [0|10.23] "m" ASDM
 SG_ OBJ_CLS_TYPE1_011 : 271|4@0+ (1,0) [0|15] "NA" ASDM
 SG_ OBJ_CLS_TYPE1_PROB_011 : 303|8@0+ (0.004,0) [0|1] "NA" ASDM
 SG_ OBJ_CLS_TYPE2_011 : 267|4@0+ (1,0) [0|15] "NA" ASDM
 SG_ OBJ_CLS_TYPE2_PROB_011 : 311|8@0+ (0.004,0) [0|1] "NA" ASDM
 SG_ OBJ_CLS_TYPE3_011 : 279|4@0+ (1,0) [0|15] "NA" ASDM
 SG_ OBJ_CLS_TYPE3_PROB_011 : 319|8@0+ (0.004,0) [0|1] "NA" ASDM
 SG_ OBJ_CLS_TYPE4_011 : 275|4@0+ (1,0) [0|15] "NA" ASDM
 SG_ OBJ_CLS_TYPE4_PROB_011 : 327|8@0+ (0.004,0) [0|1] "NA" ASDM
 SG_ OBJ_CLS_TYPE5_011 : 287|4@0+ (1,0) [0|15] "NA" ASDM
 SG_ OBJ_CLS_TYPE5_PROB_011 : 335|8@0+ (0.004,0) [0|1] "NA" ASDM
 SG_ OBJ_CLS_TYPE6_011 : 282|4@0+ (1,0) [0|15] "NA" ASDM
 SG_ OBJ_CLS_TYPE6_PROB_011 : 343|8@0+ (0.004,0) [0|1] "NA" ASDM
 SG_ OBJ_RCS_011 : 351|7@0+ (1,-64) [-64|63] "dBsm" ASDM
 SG_ OBJ_REF_PT_LONG_OFFSET_011 : 357|14@0+ (0.0001,0) [0|1] "NA" ASDM
 SG_ OBJ_REF_PT_LAT_OFFSET_011 : 370|14@0+ (0.0001,0) [0|1] "NA" ASDM
 SG_ OBJ_YAW_RATE_011 : 399|10@0+ (0.005,-2.24) [-2.24|2.24] "rad/s" ASDM
 SG_ OBJ_YAW_RATE_ERR_011 : 388|5@0+ (0.025,0) [0|0.775] "rad/s" ASDM
 SG_ OBJ_GROUP_ID_011 : 405|6@0+ (1,0) [0|63] "NA" ASDM
 SG_ OBJ_POS_ERR_CRR_COEF_011 : 415|8@0+ (0.01,-1.2) [-1.2|1] "NA" ASDM
 SG_ OBJ_VELOCITY_ERR_CRR_COEF_011 : 423|8@0+ (0.01,-1.2) [-1.2|1] "NA" ASDM
 SG_ OBJ_ACCEL_ERR_CRR_COEF_011 : 431|8@0+ (0.01,-1.2) [-1.2|1] "NA" ASDM

BO_ 715 RDR_TRACKER_OBJ_012: 64 G5_RDR04
 SG_ OBJ_ALIVE_TIME_012 : 255|16@0+ (1,0) [0|65535] "ms" ASDM
 SG_ OBJ_ACCELERATION_LONG_ERR_012 : 215|8@0+ (0.025,0) [0|6.375] "m/s^2" ASDM
 SG_ OBJ_ACCELERATION_LAT_ERR_012 : 223|8@0+ (0.025,0) [0|6.375] "m/s^2" ASDM
 SG_ OBJ_VELOCITY_LONG_ERR_012 : 143|8@0+ (0.05,0) [0|12.75] "m/s" ASDM
 SG_ OBJ_VELOCITY_LAT_ERR_012 : 151|8@0+ (0.05,0) [0|12.75] "m/s" ASDM
 SG_ OBJ_POS_LONG_ERR_012 : 95|8@0+ (0.025,0) [0|6.375] "m" ASDM
 SG_ OBJ_POS_LAT_ERR_012 : 103|8@0+ (0.025,0) [0|6.375] "m" ASDM
 SG_ OBJ_TRACK_MOTION_MODEL_012 : 9|2@0+ (1,0) [1|3] "NA" ASDM
 SG_ OBJ_DIMENSION_WIDTH_012 : 17|10@0+ (0.01,0) [0|10.23] "m" ASDM
 SG_ OBJ_DIMENSION_LENGTH_012 : 37|12@0+ (0.01,0) [0|40.95] "m" ASDM
 SG_ OBJ_EXISTENCE_PROB_012 : 229|14@0+ (0.0001,0) [0|1] "NA" ASDM
 SG_ OBJ_YAW_ANGLE_012 : 155|12@0+ (0.005,-10) [-10|10.475] "rad" ASDM
 SG_ OBJ_YAW_ANGLE_ERR_012 : 175|7@0+ (0.01,0) [0|1.27] "rad" ASDM
 SG_ OBJ_ID_012 : 7|8@0+ (1,0) [0|255] "NA" ASDM
 SG_ OBJ_MOVEMENT_STATUS_012 : 196|3@0+ (1,0) [0|3] "NA" ASDM
 SG_ OBJ_MEASUREMENT_STATUS_012 : 14|3@0+ (1,0) [0|7] "NA" ASDM
 SG_ OBJ_POS_LONG_012 : 63|16@0+ (0.01,-327) [-327|327] "m" ASDM
 SG_ OBJ_POS_LAT_012 : 79|16@0+ (0.01,-327) [-327|327] "m" ASDM
 SG_ OBJ_VELOCITY_LONG_012 : 110|15@0+ (0.01,-163) [-163|163] "m/s" ASDM
 SG_ OBJ_VELOCITY_LAT_012 : 126|15@0+ (0.01,-163) [-163|163] "m/s" ASDM
 SG_ OBJ_ACCELERATION_LONG_012 : 193|10@0+ (0.05,-20) [-20|20] "m/s^2" ASDM
 SG_ OBJ_ACCELERATION_LAT_012 : 177|10@0+ (0.05,-20) [-20|20] "m/s^2" ASDM
 SG_ OBJ_VEH_TRACK_FLAG_012 : 10|1@0+ (1,0) [0|1] "NA" ASDM
 SG_ OBJ_MH_CYCLE_COUNTER_012 : 487|8@0+ (1,0) [0|255] "NA" ASDM
 SG_ OBJ_MH_CRC16_012 : 495|16@0+ (1,0) [0|65535] "NA" ASDM
 SG_ OBJ_TIMESTAMP_OFFSET_012 : 247|8@0+ (1,-127) [-127|128] "ms" ASDM
 SG_ OBJ_DIMENSION_WIDTH_ERR_012 : 23|6@0+ (0.01,0) [0|0.63] "m" ASDM
 SG_ OBJ_DIMENSION_LENGTH_ERR_012 : 41|10@0+ (0.01,0) [0|10.23] "m" ASDM
 SG_ OBJ_CLS_TYPE1_012 : 271|4@0+ (1,0) [0|15] "NA" ASDM
 SG_ OBJ_CLS_TYPE1_PROB_012 : 303|8@0+ (0.004,0) [0|1] "NA" ASDM
 SG_ OBJ_CLS_TYPE2_012 : 267|4@0+ (1,0) [0|15] "NA" ASDM
 SG_ OBJ_CLS_TYPE2_PROB_012 : 311|8@0+ (0.004,0) [0|1] "NA" ASDM
 SG_ OBJ_CLS_TYPE3_012 : 279|4@0+ (1,0) [0|15] "NA" ASDM
 SG_ OBJ_CLS_TYPE3_PROB_012 : 319|8@0+ (0.004,0) [0|1] "NA" ASDM
 SG_ OBJ_CLS_TYPE4_012 : 275|4@0+ (1,0) [0|15] "NA" ASDM
 SG_ OBJ_CLS_TYPE4_PROB_012 : 327|8@0+ (0.004,0) [0|1] "NA" ASDM
 SG_ OBJ_CLS_TYPE5_012 : 287|4@0+ (1,0) [0|15] "NA" ASDM
 SG_ OBJ_CLS_TYPE5_PROB_012 : 335|8@0+ (0.004,0) [0|1] "NA" ASDM
 SG_ OBJ_CLS_TYPE6_012 : 282|4@0+ (1,0) [0|15] "NA" ASDM
 SG_ OBJ_CLS_TYPE6_PROB_012 : 343|8@0+ (0.004,0) [0|1] "NA" ASDM
 SG_ OBJ_RCS_012 : 351|7@0+ (1,-64) [-64|63] "dBsm" ASDM
 SG_ OBJ_REF_PT_LONG_OFFSET_012 : 357|14@0+ (0.0001,0) [0|1] "NA" ASDM
 SG_ OBJ_REF_PT_LAT_OFFSET_012 : 370|14@0+ (0.0001,0) [0|1] "NA" ASDM
 SG_ OBJ_YAW_RATE_012 : 399|10@0+ (0.005,-2.24) [-2.24|2.24] "rad/s" ASDM
 SG_ OBJ_YAW_RATE_ERR_012 : 388|5@0+ (0.025,0) [0|0.775] "rad/s" ASDM
 SG_ OBJ_GROUP_ID_012 : 405|6@0+ (1,0) [0|63] "NA" ASDM
 SG_ OBJ_POS_ERR_CRR_COEF_012 : 415|8@0+ (0.01,-1.2) [-1.2|1] "NA" ASDM
 SG_ OBJ_VELOCITY_ERR_CRR_COEF_012 : 423|8@0+ (0.01,-1.2) [-1.2|1] "NA" ASDM
 SG_ OBJ_ACCEL_ERR_CRR_COEF_012 : 431|8@0+ (0.01,-1.2) [-1.2|1] "NA" ASDM

BO_ 716 RDR_TRACKER_OBJ_013: 64 G5_RDR04
 SG_ OBJ_ALIVE_TIME_013 : 255|16@0+ (1,0) [0|65535] "ms" ASDM
 SG_ OBJ_ACCELERATION_LONG_ERR_013 : 215|8@0+ (0.025,0) [0|6.375] "m/s^2" ASDM
 SG_ OBJ_ACCELERATION_LAT_ERR_013 : 223|8@0+ (0.025,0) [0|6.375] "m/s^2" ASDM
 SG_ OBJ_VELOCITY_LONG_ERR_013 : 143|8@0+ (0.05,0) [0|12.75] "m/s" ASDM
 SG_ OBJ_VELOCITY_LAT_ERR_013 : 151|8@0+ (0.05,0) [0|12.75] "m/s" ASDM
 SG_ OBJ_POS_LONG_ERR_013 : 95|8@0+ (0.025,0) [0|6.375] "m" ASDM
 SG_ OBJ_POS_LAT_ERR_013 : 103|8@0+ (0.025,0) [0|6.375] "m" ASDM
 SG_ OBJ_TRACK_MOTION_MODEL_013 : 9|2@0+ (1,0) [1|3] "NA" ASDM
 SG_ OBJ_DIMENSION_WIDTH_013 : 17|10@0+ (0.01,0) [0|10.23] "m" ASDM
 SG_ OBJ_DIMENSION_LENGTH_013 : 37|12@0+ (0.01,0) [0|40.95] "m" ASDM
 SG_ OBJ_EXISTENCE_PROB_013 : 229|14@0+ (0.0001,0) [0|1] "NA" ASDM
 SG_ OBJ_YAW_ANGLE_013 : 155|12@0+ (0.005,-10) [-10|10.475] "rad" ASDM
 SG_ OBJ_YAW_ANGLE_ERR_013 : 175|7@0+ (0.01,0) [0|1.27] "rad" ASDM
 SG_ OBJ_ID_013 : 7|8@0+ (1,0) [0|255] "NA" ASDM
 SG_ OBJ_MOVEMENT_STATUS_013 : 196|3@0+ (1,0) [0|3] "NA" ASDM
 SG_ OBJ_MEASUREMENT_STATUS_013 : 14|3@0+ (1,0) [0|7] "NA" ASDM
 SG_ OBJ_POS_LONG_013 : 63|16@0+ (0.01,-327) [-327|327] "m" ASDM
 SG_ OBJ_POS_LAT_013 : 79|16@0+ (0.01,-327) [-327|327] "m" ASDM
 SG_ OBJ_VELOCITY_LONG_013 : 110|15@0+ (0.01,-163) [-163|163] "m/s" ASDM
 SG_ OBJ_VELOCITY_LAT_013 : 126|15@0+ (0.01,-163) [-163|163] "m/s" ASDM
 SG_ OBJ_ACCELERATION_LONG_013 : 193|10@0+ (0.05,-20) [-20|20] "m/s^2" ASDM
 SG_ OBJ_ACCELERATION_LAT_013 : 177|10@0+ (0.05,-20) [-20|20] "m/s^2" ASDM
 SG_ OBJ_VEH_TRACK_FLAG_013 : 10|1@0+ (1,0) [0|1] "NA" ASDM
 SG_ OBJ_MH_CYCLE_COUNTER_013 : 487|8@0+ (1,0) [0|255] "NA" ASDM
 SG_ OBJ_MH_CRC16_013 : 495|16@0+ (1,0) [0|65535] "NA" ASDM
 SG_ OBJ_TIMESTAMP_OFFSET_013 : 247|8@0+ (1,-127) [-127|128] "ms" ASDM
 SG_ OBJ_DIMENSION_WIDTH_ERR_013 : 23|6@0+ (0.01,0) [0|0.63] "m" ASDM
 SG_ OBJ_DIMENSION_LENGTH_ERR_013 : 41|10@0+ (0.01,0) [0|10.23] "m" ASDM
 SG_ OBJ_CLS_TYPE1_013 : 271|4@0+ (1,0) [0|15] "NA" ASDM
 SG_ OBJ_CLS_TYPE1_PROB_013 : 303|8@0+ (0.004,0) [0|1] "NA" ASDM
 SG_ OBJ_CLS_TYPE2_013 : 267|4@0+ (1,0) [0|15] "NA" ASDM
 SG_ OBJ_CLS_TYPE2_PROB_013 : 311|8@0+ (0.004,0) [0|1] "NA" ASDM
 SG_ OBJ_CLS_TYPE3_013 : 279|4@0+ (1,0) [0|15] "NA" ASDM
 SG_ OBJ_CLS_TYPE3_PROB_013 : 319|8@0+ (0.004,0) [0|1] "NA" ASDM
 SG_ OBJ_CLS_TYPE4_013 : 275|4@0+ (1,0) [0|15] "NA" ASDM
 SG_ OBJ_CLS_TYPE4_PROB_013 : 327|8@0+ (0.004,0) [0|1] "NA" ASDM
 SG_ OBJ_CLS_TYPE5_013 : 287|4@0+ (1,0) [0|15] "NA" ASDM
 SG_ OBJ_CLS_TYPE5_PROB_013 : 335|8@0+ (0.004,0) [0|1] "NA" ASDM
 SG_ OBJ_CLS_TYPE6_013 : 282|4@0+ (1,0) [0|15] "NA" ASDM
 SG_ OBJ_CLS_TYPE6_PROB_013 : 343|8@0+ (0.004,0) [0|1] "NA" ASDM
 SG_ OBJ_RCS_013 : 351|7@0+ (1,-64) [-64|63] "dBsm" ASDM
 SG_ OBJ_REF_PT_LONG_OFFSET_013 : 357|14@0+ (0.0001,0) [0|1] "NA" ASDM
 SG_ OBJ_REF_PT_LAT_OFFSET_013 : 370|14@0+ (0.0001,0) [0|1] "NA" ASDM
 SG_ OBJ_YAW_RATE_013 : 399|10@0+ (0.005,-2.24) [-2.24|2.24] "rad/s" ASDM
 SG_ OBJ_YAW_RATE_ERR_013 : 388|5@0+ (0.025,0) [0|0.775] "rad/s" ASDM
 SG_ OBJ_GROUP_ID_013 : 405|6@0+ (1,0) [0|63] "NA" ASDM
 SG_ OBJ_POS_ERR_CRR_COEF_013 : 415|8@0+ (0.01,-1.2) [-1.2|1] "NA" ASDM
 SG_ OBJ_VELOCITY_ERR_CRR_COEF_013 : 423|8@0+ (0.01,-1.2) [-1.2|1] "NA" ASDM
 SG_ OBJ_ACCEL_ERR_CRR_COEF_013 : 431|8@0+ (0.01,-1.2) [-1.2|1] "NA" ASDM

BO_ 717 RDR_TRACKER_OBJ_014: 64 G5_RDR04
 SG_ OBJ_ALIVE_TIME_014 : 255|16@0+ (1,0) [0|65535] "ms" ASDM
 SG_ OBJ_ACCELERATION_LONG_ERR_014 : 215|8@0+ (0.025,0) [0|6.375] "m/s^2" ASDM
 SG_ OBJ_ACCELERATION_LAT_ERR_014 : 223|8@0+ (0.025,0) [0|6.375] "m/s^2" ASDM
 SG_ OBJ_VELOCITY_LONG_ERR_014 : 143|8@0+ (0.05,0) [0|12.75] "m/s" ASDM
 SG_ OBJ_VELOCITY_LAT_ERR_014 : 151|8@0+ (0.05,0) [0|12.75] "m/s" ASDM
 SG_ OBJ_POS_LONG_ERR_014 : 95|8@0+ (0.025,0) [0|6.375] "m" ASDM
 SG_ OBJ_POS_LAT_ERR_014 : 103|8@0+ (0.025,0) [0|6.375] "m" ASDM
 SG_ OBJ_TRACK_MOTION_MODEL_014 : 9|2@0+ (1,0) [1|3] "NA" ASDM
 SG_ OBJ_DIMENSION_WIDTH_014 : 17|10@0+ (0.01,0) [0|10.23] "m" ASDM
 SG_ OBJ_DIMENSION_LENGTH_014 : 37|12@0+ (0.01,0) [0|40.95] "m" ASDM
 SG_ OBJ_EXISTENCE_PROB_014 : 229|14@0+ (0.0001,0) [0|1] "NA" ASDM
 SG_ OBJ_YAW_ANGLE_014 : 155|12@0+ (0.005,-10) [-10|10.475] "rad" ASDM
 SG_ OBJ_YAW_ANGLE_ERR_014 : 175|7@0+ (0.01,0) [0|1.27] "rad" ASDM
 SG_ OBJ_ID_014 : 7|8@0+ (1,0) [0|255] "NA" ASDM
 SG_ OBJ_MOVEMENT_STATUS_014 : 196|3@0+ (1,0) [0|3] "NA" ASDM
 SG_ OBJ_MEASUREMENT_STATUS_014 : 14|3@0+ (1,0) [0|7] "NA" ASDM
 SG_ OBJ_POS_LONG_014 : 63|16@0+ (0.01,-327) [-327|327] "m" ASDM
 SG_ OBJ_POS_LAT_014 : 79|16@0+ (0.01,-327) [-327|327] "m" ASDM
 SG_ OBJ_VELOCITY_LONG_014 : 110|15@0+ (0.01,-163) [-163|163] "m/s" ASDM
 SG_ OBJ_VELOCITY_LAT_014 : 126|15@0+ (0.01,-163) [-163|163] "m/s" ASDM
 SG_ OBJ_ACCELERATION_LONG_014 : 193|10@0+ (0.05,-20) [-20|20] "m/s^2" ASDM
 SG_ OBJ_ACCELERATION_LAT_014 : 177|10@0+ (0.05,-20) [-20|20] "m/s^2" ASDM
 SG_ OBJ_VEH_TRACK_FLAG_014 : 10|1@0+ (1,0) [0|1] "NA" ASDM
 SG_ OBJ_MH_CYCLE_COUNTER_014 : 487|8@0+ (1,0) [0|255] "NA" ASDM
 SG_ OBJ_MH_CRC16_014 : 495|16@0+ (1,0) [0|65535] "NA" ASDM
 SG_ OBJ_TIMESTAMP_OFFSET_014 : 247|8@0+ (1,-127) [-127|128] "ms" ASDM
 SG_ OBJ_DIMENSION_WIDTH_ERR_014 : 23|6@0+ (0.01,0) [0|0.63] "m" ASDM
 SG_ OBJ_DIMENSION_LENGTH_ERR_014 : 41|10@0+ (0.01,0) [0|10.23] "m" ASDM
 SG_ OBJ_CLS_TYPE1_014 : 271|4@0+ (1,0) [0|15] "NA" ASDM
 SG_ OBJ_CLS_TYPE1_PROB_014 : 303|8@0+ (0.004,0) [0|1] "NA" ASDM
 SG_ OBJ_CLS_TYPE2_014 : 267|4@0+ (1,0) [0|15] "NA" ASDM
 SG_ OBJ_CLS_TYPE2_PROB_014 : 311|8@0+ (0.004,0) [0|1] "NA" ASDM
 SG_ OBJ_CLS_TYPE3_014 : 279|4@0+ (1,0) [0|15] "NA" ASDM
 SG_ OBJ_CLS_TYPE3_PROB_014 : 319|8@0+ (0.004,0) [0|1] "NA" ASDM
 SG_ OBJ_CLS_TYPE4_014 : 275|4@0+ (1,0) [0|15] "NA" ASDM
 SG_ OBJ_CLS_TYPE4_PROB_014 : 327|8@0+ (0.004,0) [0|1] "NA" ASDM
 SG_ OBJ_CLS_TYPE5_014 : 287|4@0+ (1,0) [0|15] "NA" ASDM
 SG_ OBJ_CLS_TYPE5_PROB_014 : 335|8@0+ (0.004,0) [0|1] "NA" ASDM
 SG_ OBJ_CLS_TYPE6_014 : 282|4@0+ (1,0) [0|15] "NA" ASDM
 SG_ OBJ_CLS_TYPE6_PROB_014 : 343|8@0+ (0.004,0) [0|1] "NA" ASDM
 SG_ OBJ_RCS_014 : 351|7@0+ (1,-64) [-64|63] "dBsm" ASDM
 SG_ OBJ_REF_PT_LONG_OFFSET_014 : 357|14@0+ (0.0001,0) [0|1] "NA" ASDM
 SG_ OBJ_REF_PT_LAT_OFFSET_014 : 370|14@0+ (0.0001,0) [0|1] "NA" ASDM
 SG_ OBJ_YAW_RATE_014 : 399|10@0+ (0.005,-2.24) [-2.24|2.24] "rad/s" ASDM
 SG_ OBJ_YAW_RATE_ERR_014 : 388|5@0+ (0.025,0) [0|0.775] "rad/s" ASDM
 SG_ OBJ_GROUP_ID_014 : 405|6@0+ (1,0) [0|63] "NA" ASDM
 SG_ OBJ_POS_ERR_CRR_COEF_014 : 415|8@0+ (0.01,-1.2) [-1.2|1] "NA" ASDM
 SG_ OBJ_VELOCITY_ERR_CRR_COEF_014 : 423|8@0+ (0.01,-1.2) [-1.2|1] "NA" ASDM
 SG_ OBJ_ACCEL_ERR_CRR_COEF_014 : 431|8@0+ (0.01,-1.2) [-1.2|1] "NA" ASDM

CM_ SG_ 700 DET_RANGE_241 " measured position  of the detection";
CM_ SG_ 700 DET_RANGE_ERR_241 "RMSE or standard deviation of the measured angle  of the detection";
CM_ SG_ 700 DET_RANGE_VELOCITY_241 "Radial velocity of the detection positive in direction to the sensor";
CM_ SG_ 700 DET_RANGE_VELOCITY_ERR_241 "RMSE or standard deviation of the measure radial velocity of the detection";
CM_ SG_ 700 DET_AZIMUTH_241 "Measured angle  of the detection";
CM_ SG_ 700 DET_AZIMUTH_ERR_241 "RMSE or standard deviation of the measured angle  of the detection";
CM_ SG_ 700 DET_ELEVATION_241 "measured elevation of the detection";
CM_ SG_ 700 DET_ELEVATION_ERR_241 "RMSE or standard deviation of the measured elevation  of the detection";
CM_ SG_ 700 DET_RCS_241 "Radar Cross Section or Amplitude, is a measure of how detectable an object is by radar. A larger RCS indicates that an object is more easily detected.";
CM_ SG_ 700 DET_VALID_FLAG_241 "is set if the measured detection is valid";
CM_ SG_ 700 DET_BI_STATIC_FLAG_241 "1 if detection is bi-static 0 otherwise";
CM_ SG_ 700 DET_SUPER_RES_TARGET_241 "flasg is set if the detection is super resolution target";
CM_ SG_ 700 DET_SNR_241 "The signal to noise ratio (SNR) of the radar detection";
CM_ SG_ 700 DET_POINT_TARGET_PROB_241 "Describes the possibility if more than one real-world object has led to this detection. 0[%] := 100[%] Multi target probability";
CM_ SG_ 700 DET_EXISTENCE_PROB_241 "Existence probability of the detection not based on history. Value does  not depend on any past experience with similar detections.
\note Use as confidence measure where a low value means less confidence
and a high value indicates strong confidence.";
CM_ SG_ 700 DET_OUTSIDE_SECTOR_241 "Flag to indicate detections outside the sector, set if the wrong sector calibration matrix was used";
CM_ SG_ 700 DET_HVC_FLAG_241 "Core2 Vehicle clutter flag";
CM_ SG_ 700 DET_CONFD_AZIMUTH_241 "Define the Confidence of Azimuth for Detection ";
CM_ SG_ 700 DET_CONFD_ELEVATION_241 "Define the Confidence of Elevation for the Detection ";
CM_ SG_ 700 DET_AZIMUTH_AMB_ID_241 "Each ambiguous measurement generates one Ambiguity ID. Ambiguity is indicated by an identical ambiguity ID.
note Unambiguous measurements have the ambiguity ID 0.";
CM_ SG_ 700 DET_AMBG_AZIMUTH_PROB_241 "Probability for different hypothesis, sum is 100 [%] for all detections with the same Ambiguity ID. 0 means no Ambiguity";
CM_ SG_ 700 DET_BI_STATIC_FLAG_242 "1 if detection is bi-static 0 otherwise";
CM_ SG_ 700 DET_BI_STATIC_FLAG_243 "1 if detection is bi-static 0 otherwise";
CM_ SG_ 700 DET_BI_STATIC_FLAG_244 "1 if detection is bi-static 0 otherwise";
CM_ SG_ 700 DET_MH_SCAN_INDEX_4LSB_241_244 "Scan index of the measured detection";
CM_ SG_ 700 DET_MH_CYCLE_COUNTER_241_244 "Detection Alive Counter";
CM_ SG_ 701 DET_RANGE_245 " measured position  of the detection";
CM_ SG_ 701 DET_RANGE_ERR_245 "RMSE or standard deviation of the measured angle  of the detection";
CM_ SG_ 701 DET_RANGE_VELOCITY_245 "Radial velocity of the detection positive in direction to the sensor";
CM_ SG_ 701 DET_RANGE_VELOCITY_ERR_245 "RMSE or standard deviation of the measure radial velocity of the detection";
CM_ SG_ 701 DET_AZIMUTH_245 "Measured angle  of the detection";
CM_ SG_ 701 DET_AZIMUTH_ERR_245 "RMSE or standard deviation of the measured angle  of the detection";
CM_ SG_ 701 DET_ELEVATION_245 "measured elevation of the detection";
CM_ SG_ 701 DET_ELEVATION_ERR_245 "RMSE or standard deviation of the measured elevation  of the detection";
CM_ SG_ 701 DET_RCS_245 "Radar Cross Section or Amplitude, is a measure of how detectable an object is by radar. A larger RCS indicates that an object is more easily detected.";
CM_ SG_ 701 DET_VALID_FLAG_245 "is set if the measured detection is valid";
CM_ SG_ 701 DET_BI_STATIC_FLAG_245 "1 if detection is bi-static 0 otherwise";
CM_ SG_ 701 DET_SUPER_RES_TARGET_245 "flasg is set if the detection is super resolution target";
CM_ SG_ 701 DET_SNR_245 "The signal to noise ratio (SNR) of the radar detection";
CM_ SG_ 701 DET_POINT_TARGET_PROB_245 "Describes the possibility if more than one real-world object has led to this detection. 0[%] := 100[%] Multi target probability";
CM_ SG_ 701 DET_EXISTENCE_PROB_245 "Existence probability of the detection not based on history. Value does  not depend on any past experience with similar detections.
\note Use as confidence measure where a low value means less confidence
and a high value indicates strong confidence.";
CM_ SG_ 701 DET_OUTSIDE_SECTOR_245 "Flag to indicate detections outside the sector, set if the wrong sector calibration matrix was used";
CM_ SG_ 701 DET_HVC_FLAG_245 "Core2 Vehicle clutter flag";
CM_ SG_ 701 DET_CONFD_AZIMUTH_245 "Define the Confidence of Azimuth for Detection ";
CM_ SG_ 701 DET_CONFD_ELEVATION_245 "Define the Confidence of Elevation for the Detection ";
CM_ SG_ 701 DET_AZIMUTH_AMB_ID_245 "Each ambiguous measurement generates one Ambiguity ID. Ambiguity is indicated by an identical ambiguity ID.
note Unambiguous measurements have the ambiguity ID 0.";
CM_ SG_ 701 DET_AMBG_AZIMUTH_PROB_245 "Probability for different hypothesis, sum is 100 [%] for all detections with the same Ambiguity ID. 0 means no Ambiguity";
CM_ SG_ 701 DET_BI_STATIC_FLAG_246 "1 if detection is bi-static 0 otherwise";
CM_ SG_ 701 DET_BI_STATIC_FLAG_247 "1 if detection is bi-static 0 otherwise";
CM_ SG_ 701 DET_BI_STATIC_FLAG_248 "1 if detection is bi-static 0 otherwise";
CM_ SG_ 701 DET_MH_SCAN_INDEX_4LSB_245_248 "Scan index of the measured detection";
CM_ SG_ 701 DET_MH_CYCLE_COUNTER_245_248 "Detection Alive Counter";
CM_ SG_ 702 DET_RANGE_249 " measured position  of the detection";
CM_ SG_ 702 DET_RANGE_ERR_249 "RMSE or standard deviation of the measured angle  of the detection";
CM_ SG_ 702 DET_RANGE_VELOCITY_249 "Radial velocity of the detection positive in direction to the sensor";
CM_ SG_ 702 DET_RANGE_VELOCITY_ERR_249 "RMSE or standard deviation of the measure radial velocity of the detection";
CM_ SG_ 702 DET_AZIMUTH_249 "Measured angle  of the detection";
CM_ SG_ 702 DET_AZIMUTH_ERR_249 "RMSE or standard deviation of the measured angle  of the detection";
CM_ SG_ 702 DET_ELEVATION_249 "measured elevation of the detection";
CM_ SG_ 702 DET_ELEVATION_ERR_249 "RMSE or standard deviation of the measured elevation  of the detection";
CM_ SG_ 702 DET_RCS_249 "Radar Cross Section or Amplitude, is a measure of how detectable an object is by radar. A larger RCS indicates that an object is more easily detected.";
CM_ SG_ 702 DET_VALID_FLAG_249 "is set if the measured detection is valid";
CM_ SG_ 702 DET_BI_STATIC_FLAG_249 "1 if detection is bi-static 0 otherwise";
CM_ SG_ 702 DET_SUPER_RES_TARGET_249 "flasg is set if the detection is super resolution target";
CM_ SG_ 702 DET_SNR_249 "The signal to noise ratio (SNR) of the radar detection";
CM_ SG_ 702 DET_POINT_TARGET_PROB_249 "Describes the possibility if more than one real-world object has led to this detection. 0[%] := 100[%] Multi target probability";
CM_ SG_ 702 DET_EXISTENCE_PROB_249 "Existence probability of the detection not based on history. Value does  not depend on any past experience with similar detections.
\note Use as confidence measure where a low value means less confidence
and a high value indicates strong confidence.";
CM_ SG_ 702 DET_OUTSIDE_SECTOR_249 "Flag to indicate detections outside the sector, set if the wrong sector calibration matrix was used";
CM_ SG_ 702 DET_HVC_FLAG_249 "Core2 Vehicle clutter flag";
CM_ SG_ 702 DET_CONFD_AZIMUTH_249 "Define the Confidence of Azimuth for Detection ";
CM_ SG_ 702 DET_CONFD_ELEVATION_249 "Define the Confidence of Elevation for the Detection ";
CM_ SG_ 702 DET_AZIMUTH_AMB_ID_249 "Each ambiguous measurement generates one Ambiguity ID. Ambiguity is indicated by an identical ambiguity ID.
note Unambiguous measurements have the ambiguity ID 0.";
CM_ SG_ 702 DET_AMBG_AZIMUTH_PROB_249 "Probability for different hypothesis, sum is 100 [%] for all detections with the same Ambiguity ID. 0 means no Ambiguity";
CM_ SG_ 702 DET_BI_STATIC_FLAG_250 "1 if detection is bi-static 0 otherwise";
CM_ SG_ 702 DET_BI_STATIC_FLAG_251 "1 if detection is bi-static 0 otherwise";
CM_ SG_ 702 DET_BI_STATIC_FLAG_252 "1 if detection is bi-static 0 otherwise";
CM_ SG_ 702 DET_MH_SCAN_INDEX_4LSB_249_252 "Scan index of the measured detection";
CM_ SG_ 702 DET_MH_CYCLE_COUNTER_249_252 "Detection Alive Counter";
CM_ SG_ 703 DET_RANGE_253 " measured position  of the detection";
CM_ SG_ 703 DET_RANGE_ERR_253 "RMSE or standard deviation of the measured angle  of the detection";
CM_ SG_ 703 DET_RANGE_VELOCITY_253 "Radial velocity of the detection positive in direction to the sensor";
CM_ SG_ 703 DET_RANGE_VELOCITY_ERR_253 "RMSE or standard deviation of the measure radial velocity of the detection";
CM_ SG_ 703 DET_AZIMUTH_253 "Measured angle  of the detection";
CM_ SG_ 703 DET_AZIMUTH_ERR_253 "RMSE or standard deviation of the measured angle  of the detection";
CM_ SG_ 703 DET_ELEVATION_253 "measured elevation of the detection";
CM_ SG_ 703 DET_ELEVATION_ERR_253 "RMSE or standard deviation of the measured elevation  of the detection";
CM_ SG_ 703 DET_RCS_253 "Radar Cross Section or Amplitude, is a measure of how detectable an object is by radar. A larger RCS indicates that an object is more easily detected.";
CM_ SG_ 703 DET_VALID_FLAG_253 "is set if the measured detection is valid";
CM_ SG_ 703 DET_BI_STATIC_FLAG_253 "1 if detection is bi-static 0 otherwise";
CM_ SG_ 703 DET_SUPER_RES_TARGET_253 "flasg is set if the detection is super resolution target";
CM_ SG_ 703 DET_SNR_253 "The signal to noise ratio (SNR) of the radar detection";
CM_ SG_ 703 DET_POINT_TARGET_PROB_253 "Describes the possibility if more than one real-world object has led to this detection. 0[%] := 100[%] Multi target probability";
CM_ SG_ 703 DET_EXISTENCE_PROB_253 "Existence probability of the detection not based on history. Value does  not depend on any past experience with similar detections.
\note Use as confidence measure where a low value means less confidence
and a high value indicates strong confidence.";
CM_ SG_ 703 DET_OUTSIDE_SECTOR_253 "Flag to indicate detections outside the sector, set if the wrong sector calibration matrix was used";
CM_ SG_ 703 DET_HVC_FLAG_253 "Core2 Vehicle clutter flag";
CM_ SG_ 703 DET_CONFD_AZIMUTH_253 "Define the Confidence of Azimuth for Detection ";
CM_ SG_ 703 DET_CONFD_ELEVATION_253 "Define the Confidence of Elevation for the Detection ";
CM_ SG_ 703 DET_AZIMUTH_AMB_ID_253 "Each ambiguous measurement generates one Ambiguity ID. Ambiguity is indicated by an identical ambiguity ID.
note Unambiguous measurements have the ambiguity ID 0.";
CM_ SG_ 703 DET_AMBG_AZIMUTH_PROB_253 "Probability for different hypothesis, sum is 100 [%] for all detections with the same Ambiguity ID. 0 means no Ambiguity";
CM_ SG_ 703 DET_BI_STATIC_FLAG_254 "1 if detection is bi-static 0 otherwise";
CM_ SG_ 703 DET_BI_STATIC_FLAG_255 "1 if detection is bi-static 0 otherwise";
CM_ SG_ 703 DET_BI_STATIC_FLAG_256 "1 if detection is bi-static 0 otherwise";
CM_ SG_ 703 DET_MH_SCAN_INDEX_4LSB_253_256 "Scan index of the measured detection";
CM_ SG_ 703 DET_MH_CYCLE_COUNTER_253_256 "Detection Alive Counter";
CM_ SG_ 705 OBJ_ALIVE_TIME_002 "Time since object initialization in msec. Tracker internal may have bigger values. On the output interface, we should saturate the signal in that case.";
CM_ SG_ 705 OBJ_ACCELERATION_LONG_ERR_002 "acceleration along Longi  direction";
CM_ SG_ 705 OBJ_ACCELERATION_LAT_ERR_002 "acceleration along Lat direction error";
CM_ SG_ 705 OBJ_POS_LONG_ERR_002 "Lat-position error of object track's centroid in VCS coordinate";
CM_ SG_ 705 OBJ_POS_LAT_ERR_002 "Lat-position error of object track's centroid in VCS coordinate";
CM_ SG_ 705 OBJ_TRACK_MOTION_MODEL_002 "Object tracking uses a motion model for tracking moving items";
CM_ SG_ 705 OBJ_DIMENSION_WIDTH_002 "Lat distance from centroid to edge of bounding box.";
CM_ SG_ 705 OBJ_DIMENSION_LENGTH_002 "Longi distance from centroid to edge of bounding box.";
CM_ SG_ 705 OBJ_EXISTENCE_PROB_002 "Probability that the target is an actual target";
CM_ SG_ 705 OBJ_YAW_ANGLE_002 "Orientation of track's bounding box in VCS coordinate";
CM_ SG_ 705 OBJ_ID_002 "ID of object tracks, zero-ID represents an inactive track";
CM_ SG_ 705 OBJ_MOVEMENT_STATUS_002 "Information about a possible movement of the object during tracking";
CM_ SG_ 705 OBJ_MEASUREMENT_STATUS_002 "Objects should be sent out as fast as possible, even if not all statuses are observed and the object’s
signals might not be fully filled.";
CM_ SG_ 705 OBJ_POS_LONG_002 "Long-position of object track's centroid in VCS coordinate";
CM_ SG_ 705 OBJ_POS_LAT_002 "Lat-position of object track's centroid in VCS coordinate";
CM_ SG_ 705 OBJ_VELOCITY_LONG_002 "Over-the-ground velocity of object track's centroid along Long direction (in VCS coordinate)";
CM_ SG_ 705 OBJ_VELOCITY_LAT_002 "Over-the-ground velocity of object track's centroid along Lat direction (in VCS coordinate)";
CM_ SG_ 705 OBJ_ACCELERATION_LONG_002 "Over-the-ground track acceleration along Longi direction (in VCS coordinate)";
CM_ SG_ 705 OBJ_ACCELERATION_LAT_002 "Over-the-ground track acceleration along Lat direction (in VCS coordinate)";
CM_ SG_ 705 OBJ_VEH_TRACK_FLAG_002 "Indicates if current track is a vehicle";
CM_ SG_ 705 OBJ_TIMESTAMP_OFFSET_002 "A timestamp offset from the object list header timestamp for each object as we have different timestamps from different sensors leading to different timestamps on each object";
CM_ SG_ 705 OBJ_DIMENSION_WIDTH_ERR_002 "Lat distance or length error";
CM_ SG_ 705 OBJ_DIMENSION_LENGTH_ERR_002 "Longi distance or length error";
CM_ SG_ 705 OBJ_CLS_TYPE1_002 "Classification Type 1(Highest Prob), selected from ENUM list";
CM_ SG_ 705 OBJ_CLS_TYPE1_PROB_002 "Classification Type 1 probablity";
CM_ SG_ 705 OBJ_CLS_TYPE6_002 "Classification Type 6(Lowest Prob), selected from ENUM list";
CM_ SG_ 705 OBJ_CLS_TYPE6_PROB_002 "Classification Type 1 probablity";
CM_ SG_ 705 OBJ_RCS_002 "Representative RCS of the complete recognized object, Not implemented";
CM_ SG_ 705 OBJ_REF_PT_LONG_OFFSET_002 "Outer edges of the recognized object’s bounding box in Y axis";
CM_ SG_ 705 OBJ_REF_PT_LAT_OFFSET_002 "Outer edges of the recognized object’s bounding box in X axis";
CM_ SG_ 705 OBJ_YAW_RATE_002 "Orientation rate of track's bounding box in VCS coordinate";
CM_ SG_ 705 OBJ_GROUP_ID_002 "Objects which are linked together shall have same group ID";
CM_ SG_ 705 OBJ_POS_ERR_CRR_COEF_002 "vx-vy correlation due to small error in radial direction and big in cross radial - position Correlation Coefficient Error";
CM_ SG_ 705 OBJ_VELOCITY_ERR_CRR_COEF_002 "vx-vy correlation due to small error in radial direction and big in cross radial - velocity Correlation Coefficient Error";
CM_ SG_ 705 OBJ_ACCEL_ERR_CRR_COEF_002 "vx-vy correlation due to small error in radial direction and big in cross radial - Acceleration Correlation Coefficient Error";
CM_ SG_ 706 OBJ_ALIVE_TIME_003 "Time since object initialization in msec. Tracker internal may have bigger values. On the output interface, we should saturate the signal in that case.";
CM_ SG_ 706 OBJ_ACCELERATION_LONG_ERR_003 "acceleration along Longi  direction";
CM_ SG_ 706 OBJ_ACCELERATION_LAT_ERR_003 "acceleration along Lat direction error";
CM_ SG_ 706 OBJ_POS_LONG_ERR_003 "Lat-position error of object track's centroid in VCS coordinate";
CM_ SG_ 706 OBJ_POS_LAT_ERR_003 "Lat-position error of object track's centroid in VCS coordinate";
CM_ SG_ 706 OBJ_TRACK_MOTION_MODEL_003 "Object tracking uses a motion model for tracking moving items";
CM_ SG_ 706 OBJ_DIMENSION_WIDTH_003 "Lat distance from centroid to edge of bounding box.";
CM_ SG_ 706 OBJ_DIMENSION_LENGTH_003 "Longi distance from centroid to edge of bounding box.";
CM_ SG_ 706 OBJ_EXISTENCE_PROB_003 "Probability that the target is an actual target";
CM_ SG_ 706 OBJ_YAW_ANGLE_003 "Orientation of track's bounding box in VCS coordinate";
CM_ SG_ 706 OBJ_ID_003 "ID of object tracks, zero-ID represents an inactive track";
CM_ SG_ 706 OBJ_MOVEMENT_STATUS_003 "Information about a possible movement of the object during tracking";
CM_ SG_ 706 OBJ_MEASUREMENT_STATUS_003 "Objects should be sent out as fast as possible, even if not all statuses are observed and the object’s
signals might not be fully filled.";
CM_ SG_ 706 OBJ_POS_LONG_003 "Long-position of object track's centroid in VCS coordinate";
CM_ SG_ 706 OBJ_POS_LAT_003 "Lat-position of object track's centroid in VCS coordinate";
CM_ SG_ 706 OBJ_VELOCITY_LONG_003 "Over-the-ground velocity of object track's centroid along Long direction (in VCS coordinate)";
CM_ SG_ 706 OBJ_VELOCITY_LAT_003 "Over-the-ground velocity of object track's centroid along Lat direction (in VCS coordinate)";
CM_ SG_ 706 OBJ_ACCELERATION_LONG_003 "Over-the-ground track acceleration along Longi direction (in VCS coordinate)";
CM_ SG_ 706 OBJ_ACCELERATION_LAT_003 "Over-the-ground track acceleration along Lat direction (in VCS coordinate)";
CM_ SG_ 706 OBJ_VEH_TRACK_FLAG_003 "Indicates if current track is a vehicle";
CM_ SG_ 706 OBJ_TIMESTAMP_OFFSET_003 "A timestamp offset from the object list header timestamp for each object as we have different timestamps from different sensors leading to different timestamps on each object";
CM_ SG_ 706 OBJ_DIMENSION_WIDTH_ERR_003 "Lat distance or length error";
CM_ SG_ 706 OBJ_DIMENSION_LENGTH_ERR_003 "Longi distance or length error";
CM_ SG_ 706 OBJ_CLS_TYPE1_003 "Classification Type 1(Highest Prob), selected from ENUM list";
CM_ SG_ 706 OBJ_CLS_TYPE1_PROB_003 "Classification Type 1 probablity";
CM_ SG_ 706 OBJ_CLS_TYPE6_003 "Classification Type 6(Lowest Prob), selected from ENUM list";
CM_ SG_ 706 OBJ_CLS_TYPE6_PROB_003 "Classification Type 1 probablity";
CM_ SG_ 706 OBJ_RCS_003 "Representative RCS of the complete recognized object, Not implemented";
CM_ SG_ 706 OBJ_REF_PT_LONG_OFFSET_003 "Outer edges of the recognized object’s bounding box in Y axis";
CM_ SG_ 706 OBJ_REF_PT_LAT_OFFSET_003 "Outer edges of the recognized object’s bounding box in X axis";
CM_ SG_ 706 OBJ_YAW_RATE_003 "Orientation rate of track's bounding box in VCS coordinate";
CM_ SG_ 706 OBJ_GROUP_ID_003 "Objects which are linked together shall have same group ID";
CM_ SG_ 706 OBJ_POS_ERR_CRR_COEF_003 "vx-vy correlation due to small error in radial direction and big in cross radial - position Correlation Coefficient Error";
CM_ SG_ 706 OBJ_VELOCITY_ERR_CRR_COEF_003 "vx-vy correlation due to small error in radial direction and big in cross radial - velocity Correlation Coefficient Error";
CM_ SG_ 706 OBJ_ACCEL_ERR_CRR_COEF_003 "vx-vy correlation due to small error in radial direction and big in cross radial - Acceleration Correlation Coefficient Error";
CM_ SG_ 707 OBJ_ALIVE_TIME_004 "Time since object initialization in msec. Tracker internal may have bigger values. On the output interface, we should saturate the signal in that case.";
CM_ SG_ 707 OBJ_ACCELERATION_LONG_ERR_004 "acceleration along Longi  direction";
CM_ SG_ 707 OBJ_ACCELERATION_LAT_ERR_004 "acceleration along Lat direction error";
CM_ SG_ 707 OBJ_POS_LONG_ERR_004 "Lat-position error of object track's centroid in VCS coordinate";
CM_ SG_ 707 OBJ_POS_LAT_ERR_004 "Lat-position error of object track's centroid in VCS coordinate";
CM_ SG_ 707 OBJ_TRACK_MOTION_MODEL_004 "Object tracking uses a motion model for tracking moving items";
CM_ SG_ 707 OBJ_DIMENSION_WIDTH_004 "Lat distance from centroid to edge of bounding box.";
CM_ SG_ 707 OBJ_DIMENSION_LENGTH_004 "Longi distance from centroid to edge of bounding box.";
CM_ SG_ 707 OBJ_EXISTENCE_PROB_004 "Probability that the target is an actual target";
CM_ SG_ 707 OBJ_YAW_ANGLE_004 "Orientation of track's bounding box in VCS coordinate";
CM_ SG_ 707 OBJ_ID_004 "ID of object tracks, zero-ID represents an inactive track";
CM_ SG_ 707 OBJ_MOVEMENT_STATUS_004 "Information about a possible movement of the object during tracking";
CM_ SG_ 707 OBJ_MEASUREMENT_STATUS_004 "Objects should be sent out as fast as possible, even if not all statuses are observed and the object’s
signals might not be fully filled.";
CM_ SG_ 707 OBJ_POS_LONG_004 "Long-position of object track's centroid in VCS coordinate";
CM_ SG_ 707 OBJ_POS_LAT_004 "Lat-position of object track's centroid in VCS coordinate";
CM_ SG_ 707 OBJ_VELOCITY_LONG_004 "Over-the-ground velocity of object track's centroid along Long direction (in VCS coordinate)";
CM_ SG_ 707 OBJ_VELOCITY_LAT_004 "Over-the-ground velocity of object track's centroid along Lat direction (in VCS coordinate)";
CM_ SG_ 707 OBJ_ACCELERATION_LONG_004 "Over-the-ground track acceleration along Longi direction (in VCS coordinate)";
CM_ SG_ 707 OBJ_ACCELERATION_LAT_004 "Over-the-ground track acceleration along Lat direction (in VCS coordinate)";
CM_ SG_ 707 OBJ_VEH_TRACK_FLAG_004 "Indicates if current track is a vehicle";
CM_ SG_ 707 OBJ_TIMESTAMP_OFFSET_004 "A timestamp offset from the object list header timestamp for each object as we have different timestamps from different sensors leading to different timestamps on each object";
CM_ SG_ 707 OBJ_DIMENSION_WIDTH_ERR_004 "Lat distance or length error";
CM_ SG_ 707 OBJ_DIMENSION_LENGTH_ERR_004 "Longi distance or length error";
CM_ SG_ 707 OBJ_CLS_TYPE1_004 "Classification Type 1(Highest Prob), selected from ENUM list";
CM_ SG_ 707 OBJ_CLS_TYPE1_PROB_004 "Classification Type 1 probablity";
CM_ SG_ 707 OBJ_CLS_TYPE6_004 "Classification Type 6(Lowest Prob), selected from ENUM list";
CM_ SG_ 707 OBJ_CLS_TYPE6_PROB_004 "Classification Type 1 probablity";
CM_ SG_ 707 OBJ_RCS_004 "Representative RCS of the complete recognized object, Not implemented";
CM_ SG_ 707 OBJ_REF_PT_LONG_OFFSET_004 "Outer edges of the recognized object’s bounding box in Y axis";
CM_ SG_ 707 OBJ_REF_PT_LAT_OFFSET_004 "Outer edges of the recognized object’s bounding box in X axis";
CM_ SG_ 707 OBJ_YAW_RATE_004 "Orientation rate of track's bounding box in VCS coordinate";
CM_ SG_ 707 OBJ_GROUP_ID_004 "Objects which are linked together shall have same group ID";
CM_ SG_ 707 OBJ_POS_ERR_CRR_COEF_004 "vx-vy correlation due to small error in radial direction and big in cross radial - position Correlation Coefficient Error";
CM_ SG_ 707 OBJ_VELOCITY_ERR_CRR_COEF_004 "vx-vy correlation due to small error in radial direction and big in cross radial - velocity Correlation Coefficient Error";
CM_ SG_ 707 OBJ_ACCEL_ERR_CRR_COEF_004 "vx-vy correlation due to small error in radial direction and big in cross radial - Acceleration Correlation Coefficient Error";
CM_ SG_ 708 OBJ_ALIVE_TIME_005 "Time since object initialization in msec. Tracker internal may have bigger values. On the output interface, we should saturate the signal in that case.";
CM_ SG_ 708 OBJ_ACCELERATION_LONG_ERR_005 "acceleration along Longi  direction";
CM_ SG_ 708 OBJ_ACCELERATION_LAT_ERR_005 "acceleration along Lat direction error";
CM_ SG_ 708 OBJ_POS_LONG_ERR_005 "Lat-position error of object track's centroid in VCS coordinate";
CM_ SG_ 708 OBJ_POS_LAT_ERR_005 "Lat-position error of object track's centroid in VCS coordinate";
CM_ SG_ 708 OBJ_TRACK_MOTION_MODEL_005 "Object tracking uses a motion model for tracking moving items";
CM_ SG_ 708 OBJ_DIMENSION_WIDTH_005 "Lat distance from centroid to edge of bounding box.";
CM_ SG_ 708 OBJ_DIMENSION_LENGTH_005 "Longi distance from centroid to edge of bounding box.";
CM_ SG_ 708 OBJ_EXISTENCE_PROB_005 "Probability that the target is an actual target";
CM_ SG_ 708 OBJ_YAW_ANGLE_005 "Orientation of track's bounding box in VCS coordinate";
CM_ SG_ 708 OBJ_ID_005 "ID of object tracks, zero-ID represents an inactive track";
CM_ SG_ 708 OBJ_MOVEMENT_STATUS_005 "Information about a possible movement of the object during tracking";
CM_ SG_ 708 OBJ_MEASUREMENT_STATUS_005 "Objects should be sent out as fast as possible, even if not all statuses are observed and the object’s
signals might not be fully filled.";
CM_ SG_ 708 OBJ_POS_LONG_005 "Long-position of object track's centroid in VCS coordinate";
CM_ SG_ 708 OBJ_POS_LAT_005 "Lat-position of object track's centroid in VCS coordinate";
CM_ SG_ 708 OBJ_VELOCITY_LONG_005 "Over-the-ground velocity of object track's centroid along Long direction (in VCS coordinate)";
CM_ SG_ 708 OBJ_VELOCITY_LAT_005 "Over-the-ground velocity of object track's centroid along Lat direction (in VCS coordinate)";
CM_ SG_ 708 OBJ_ACCELERATION_LONG_005 "Over-the-ground track acceleration along Longi direction (in VCS coordinate)";
CM_ SG_ 708 OBJ_ACCELERATION_LAT_005 "Over-the-ground track acceleration along Lat direction (in VCS coordinate)";
CM_ SG_ 708 OBJ_VEH_TRACK_FLAG_005 "Indicates if current track is a vehicle";
CM_ SG_ 708 OBJ_TIMESTAMP_OFFSET_005 "A timestamp offset from the object list header timestamp for each object as we have different timestamps from different sensors leading to different timestamps on each object";
CM_ SG_ 708 OBJ_DIMENSION_WIDTH_ERR_005 "Lat distance or length error";
CM_ SG_ 708 OBJ_DIMENSION_LENGTH_ERR_005 "Longi distance or length error";
CM_ SG_ 708 OBJ_CLS_TYPE1_005 "Classification Type 1(Highest Prob), selected from ENUM list";
CM_ SG_ 708 OBJ_CLS_TYPE1_PROB_005 "Classification Type 1 probablity";
CM_ SG_ 708 OBJ_CLS_TYPE6_005 "Classification Type 6(Lowest Prob), selected from ENUM list";
CM_ SG_ 708 OBJ_CLS_TYPE6_PROB_005 "Classification Type 1 probablity";
CM_ SG_ 708 OBJ_RCS_005 "Representative RCS of the complete recognized object, Not implemented";
CM_ SG_ 708 OBJ_REF_PT_LONG_OFFSET_005 "Outer edges of the recognized object’s bounding box in Y axis";
CM_ SG_ 708 OBJ_REF_PT_LAT_OFFSET_005 "Outer edges of the recognized object’s bounding box in X axis";
CM_ SG_ 708 OBJ_YAW_RATE_005 "Orientation rate of track's bounding box in VCS coordinate";
CM_ SG_ 708 OBJ_GROUP_ID_005 "Objects which are linked together shall have same group ID";
CM_ SG_ 708 OBJ_POS_ERR_CRR_COEF_005 "vx-vy correlation due to small error in radial direction and big in cross radial - position Correlation Coefficient Error";
CM_ SG_ 708 OBJ_VELOCITY_ERR_CRR_COEF_005 "vx-vy correlation due to small error in radial direction and big in cross radial - velocity Correlation Coefficient Error";
CM_ SG_ 708 OBJ_ACCEL_ERR_CRR_COEF_005 "vx-vy correlation due to small error in radial direction and big in cross radial - Acceleration Correlation Coefficient Error";
CM_ SG_ 709 OBJ_ALIVE_TIME_006 "Time since object initialization in msec. Tracker internal may have bigger values. On the output interface, we should saturate the signal in that case.";
CM_ SG_ 709 OBJ_ACCELERATION_LONG_ERR_006 "acceleration along Longi  direction";
CM_ SG_ 709 OBJ_ACCELERATION_LAT_ERR_006 "acceleration along Lat direction error";
CM_ SG_ 709 OBJ_POS_LONG_ERR_006 "Lat-position error of object track's centroid in VCS coordinate";
CM_ SG_ 709 OBJ_POS_LAT_ERR_006 "Lat-position error of object track's centroid in VCS coordinate";
CM_ SG_ 709 OBJ_TRACK_MOTION_MODEL_006 "Object tracking uses a motion model for tracking moving items";
CM_ SG_ 709 OBJ_DIMENSION_WIDTH_006 "Lat distance from centroid to edge of bounding box.";
CM_ SG_ 709 OBJ_DIMENSION_LENGTH_006 "Longi distance from centroid to edge of bounding box.";
CM_ SG_ 709 OBJ_EXISTENCE_PROB_006 "Probability that the target is an actual target";
CM_ SG_ 709 OBJ_YAW_ANGLE_006 "Orientation of track's bounding box in VCS coordinate";
CM_ SG_ 709 OBJ_ID_006 "ID of object tracks, zero-ID represents an inactive track";
CM_ SG_ 709 OBJ_MOVEMENT_STATUS_006 "Information about a possible movement of the object during tracking";
CM_ SG_ 709 OBJ_MEASUREMENT_STATUS_006 "Objects should be sent out as fast as possible, even if not all statuses are observed and the object’s
signals might not be fully filled.";
CM_ SG_ 709 OBJ_POS_LONG_006 "Long-position of object track's centroid in VCS coordinate";
CM_ SG_ 709 OBJ_POS_LAT_006 "Lat-position of object track's centroid in VCS coordinate";
CM_ SG_ 709 OBJ_VELOCITY_LONG_006 "Over-the-ground velocity of object track's centroid along Long direction (in VCS coordinate)";
CM_ SG_ 709 OBJ_VELOCITY_LAT_006 "Over-the-ground velocity of object track's centroid along Lat direction (in VCS coordinate)";
CM_ SG_ 709 OBJ_ACCELERATION_LONG_006 "Over-the-ground track acceleration along Longi direction (in VCS coordinate)";
CM_ SG_ 709 OBJ_ACCELERATION_LAT_006 "Over-the-ground track acceleration along Lat direction (in VCS coordinate)";
CM_ SG_ 709 OBJ_VEH_TRACK_FLAG_006 "Indicates if current track is a vehicle";
CM_ SG_ 709 OBJ_TIMESTAMP_OFFSET_006 "A timestamp offset from the object list header timestamp for each object as we have different timestamps from different sensors leading to different timestamps on each object";
CM_ SG_ 709 OBJ_DIMENSION_WIDTH_ERR_006 "Lat distance or length error";
CM_ SG_ 709 OBJ_DIMENSION_LENGTH_ERR_006 "Longi distance or length error";
CM_ SG_ 709 OBJ_CLS_TYPE1_006 "Classification Type 1(Highest Prob), selected from ENUM list";
CM_ SG_ 709 OBJ_CLS_TYPE1_PROB_006 "Classification Type 1 probablity";
CM_ SG_ 709 OBJ_CLS_TYPE6_006 "Classification Type 6(Lowest Prob), selected from ENUM list";
CM_ SG_ 709 OBJ_CLS_TYPE6_PROB_006 "Classification Type 1 probablity";
CM_ SG_ 709 OBJ_RCS_006 "Representative RCS of the complete recognized object, Not implemented";
CM_ SG_ 709 OBJ_REF_PT_LONG_OFFSET_006 "Outer edges of the recognized object’s bounding box in Y axis";
CM_ SG_ 709 OBJ_REF_PT_LAT_OFFSET_006 "Outer edges of the recognized object’s bounding box in X axis";
CM_ SG_ 709 OBJ_YAW_RATE_006 "Orientation rate of track's bounding box in VCS coordinate";
CM_ SG_ 709 OBJ_GROUP_ID_006 "Objects which are linked together shall have same group ID";
CM_ SG_ 709 OBJ_POS_ERR_CRR_COEF_006 "vx-vy correlation due to small error in radial direction and big in cross radial - position Correlation Coefficient Error";
CM_ SG_ 709 OBJ_VELOCITY_ERR_CRR_COEF_006 "vx-vy correlation due to small error in radial direction and big in cross radial - velocity Correlation Coefficient Error";
CM_ SG_ 709 OBJ_ACCEL_ERR_CRR_COEF_006 "vx-vy correlation due to small error in radial direction and big in cross radial - Acceleration Correlation Coefficient Error";
CM_ SG_ 710 OBJ_ALIVE_TIME_007 "Time since object initialization in msec. Tracker internal may have bigger values. On the output interface, we should saturate the signal in that case.";
CM_ SG_ 710 OBJ_ACCELERATION_LONG_ERR_007 "acceleration along Longi  direction";
CM_ SG_ 710 OBJ_ACCELERATION_LAT_ERR_007 "acceleration along Lat direction error";
CM_ SG_ 710 OBJ_POS_LONG_ERR_007 "Lat-position error of object track's centroid in VCS coordinate";
CM_ SG_ 710 OBJ_POS_LAT_ERR_007 "Lat-position error of object track's centroid in VCS coordinate";
CM_ SG_ 710 OBJ_TRACK_MOTION_MODEL_007 "Object tracking uses a motion model for tracking moving items";
CM_ SG_ 710 OBJ_DIMENSION_WIDTH_007 "Lat distance from centroid to edge of bounding box.";
CM_ SG_ 710 OBJ_DIMENSION_LENGTH_007 "Longi distance from centroid to edge of bounding box.";
CM_ SG_ 710 OBJ_EXISTENCE_PROB_007 "Probability that the target is an actual target";
CM_ SG_ 710 OBJ_YAW_ANGLE_007 "Orientation of track's bounding box in VCS coordinate";
CM_ SG_ 710 OBJ_ID_007 "ID of object tracks, zero-ID represents an inactive track";
CM_ SG_ 710 OBJ_MOVEMENT_STATUS_007 "Information about a possible movement of the object during tracking";
CM_ SG_ 710 OBJ_MEASUREMENT_STATUS_007 "Objects should be sent out as fast as possible, even if not all statuses are observed and the object’s
signals might not be fully filled.";
CM_ SG_ 710 OBJ_POS_LONG_007 "Long-position of object track's centroid in VCS coordinate";
CM_ SG_ 710 OBJ_POS_LAT_007 "Lat-position of object track's centroid in VCS coordinate";
CM_ SG_ 710 OBJ_VELOCITY_LONG_007 "Over-the-ground velocity of object track's centroid along Long direction (in VCS coordinate)";
CM_ SG_ 710 OBJ_VELOCITY_LAT_007 "Over-the-ground velocity of object track's centroid along Lat direction (in VCS coordinate)";
CM_ SG_ 710 OBJ_ACCELERATION_LONG_007 "Over-the-ground track acceleration along Longi direction (in VCS coordinate)";
CM_ SG_ 710 OBJ_ACCELERATION_LAT_007 "Over-the-ground track acceleration along Lat direction (in VCS coordinate)";
CM_ SG_ 710 OBJ_VEH_TRACK_FLAG_007 "Indicates if current track is a vehicle";
CM_ SG_ 710 OBJ_TIMESTAMP_OFFSET_007 "A timestamp offset from the object list header timestamp for each object as we have different timestamps from different sensors leading to different timestamps on each object";
CM_ SG_ 710 OBJ_DIMENSION_WIDTH_ERR_007 "Lat distance or length error";
CM_ SG_ 710 OBJ_DIMENSION_LENGTH_ERR_007 "Longi distance or length error";
CM_ SG_ 710 OBJ_CLS_TYPE1_007 "Classification Type 1(Highest Prob), selected from ENUM list";
CM_ SG_ 710 OBJ_CLS_TYPE1_PROB_007 "Classification Type 1 probablity";
CM_ SG_ 710 OBJ_CLS_TYPE6_007 "Classification Type 6(Lowest Prob), selected from ENUM list";
CM_ SG_ 710 OBJ_CLS_TYPE6_PROB_007 "Classification Type 1 probablity";
CM_ SG_ 710 OBJ_RCS_007 "Representative RCS of the complete recognized object, Not implemented";
CM_ SG_ 710 OBJ_REF_PT_LONG_OFFSET_007 "Outer edges of the recognized object’s bounding box in Y axis";
CM_ SG_ 710 OBJ_REF_PT_LAT_OFFSET_007 "Outer edges of the recognized object’s bounding box in X axis";
CM_ SG_ 710 OBJ_YAW_RATE_007 "Orientation rate of track's bounding box in VCS coordinate";
CM_ SG_ 710 OBJ_GROUP_ID_007 "Objects which are linked together shall have same group ID";
CM_ SG_ 710 OBJ_POS_ERR_CRR_COEF_007 "vx-vy correlation due to small error in radial direction and big in cross radial - position Correlation Coefficient Error";
CM_ SG_ 710 OBJ_VELOCITY_ERR_CRR_COEF_007 "vx-vy correlation due to small error in radial direction and big in cross radial - velocity Correlation Coefficient Error";
CM_ SG_ 710 OBJ_ACCEL_ERR_CRR_COEF_007 "vx-vy correlation due to small error in radial direction and big in cross radial - Acceleration Correlation Coefficient Error";
CM_ SG_ 711 OBJ_ALIVE_TIME_008 "Time since object initialization in msec. Tracker internal may have bigger values. On the output interface, we should saturate the signal in that case.";
CM_ SG_ 711 OBJ_ACCELERATION_LONG_ERR_008 "acceleration along Longi  direction";
CM_ SG_ 711 OBJ_ACCELERATION_LAT_ERR_008 "acceleration along Lat direction error";
CM_ SG_ 711 OBJ_POS_LONG_ERR_008 "Lat-position error of object track's centroid in VCS coordinate";
CM_ SG_ 711 OBJ_POS_LAT_ERR_008 "Lat-position error of object track's centroid in VCS coordinate";
CM_ SG_ 711 OBJ_TRACK_MOTION_MODEL_008 "Object tracking uses a motion model for tracking moving items";
CM_ SG_ 711 OBJ_DIMENSION_WIDTH_008 "Lat distance from centroid to edge of bounding box.";
CM_ SG_ 711 OBJ_DIMENSION_LENGTH_008 "Longi distance from centroid to edge of bounding box.";
CM_ SG_ 711 OBJ_EXISTENCE_PROB_008 "Probability that the target is an actual target";
CM_ SG_ 711 OBJ_YAW_ANGLE_008 "Orientation of track's bounding box in VCS coordinate";
CM_ SG_ 711 OBJ_ID_008 "ID of object tracks, zero-ID represents an inactive track";
CM_ SG_ 711 OBJ_MOVEMENT_STATUS_008 "Information about a possible movement of the object during tracking";
CM_ SG_ 711 OBJ_MEASUREMENT_STATUS_008 "Objects should be sent out as fast as possible, even if not all statuses are observed and the object’s
signals might not be fully filled.";
CM_ SG_ 711 OBJ_POS_LONG_008 "Long-position of object track's centroid in VCS coordinate";
CM_ SG_ 711 OBJ_POS_LAT_008 "Lat-position of object track's centroid in VCS coordinate";
CM_ SG_ 711 OBJ_VELOCITY_LONG_008 "Over-the-ground velocity of object track's centroid along Long direction (in VCS coordinate)";
CM_ SG_ 711 OBJ_VELOCITY_LAT_008 "Over-the-ground velocity of object track's centroid along Lat direction (in VCS coordinate)";
CM_ SG_ 711 OBJ_ACCELERATION_LONG_008 "Over-the-ground track acceleration along Longi direction (in VCS coordinate)";
CM_ SG_ 711 OBJ_ACCELERATION_LAT_008 "Over-the-ground track acceleration along Lat direction (in VCS coordinate)";
CM_ SG_ 711 OBJ_VEH_TRACK_FLAG_008 "Indicates if current track is a vehicle";
CM_ SG_ 711 OBJ_TIMESTAMP_OFFSET_008 "A timestamp offset from the object list header timestamp for each object as we have different timestamps from different sensors leading to different timestamps on each object";
CM_ SG_ 711 OBJ_DIMENSION_WIDTH_ERR_008 "Lat distance or length error";
CM_ SG_ 711 OBJ_DIMENSION_LENGTH_ERR_008 "Longi distance or length error";
CM_ SG_ 711 OBJ_CLS_TYPE1_008 "Classification Type 1(Highest Prob), selected from ENUM list";
CM_ SG_ 711 OBJ_CLS_TYPE1_PROB_008 "Classification Type 1 probablity";
CM_ SG_ 711 OBJ_CLS_TYPE6_008 "Classification Type 6(Lowest Prob), selected from ENUM list";
CM_ SG_ 711 OBJ_CLS_TYPE6_PROB_008 "Classification Type 1 probablity";
CM_ SG_ 711 OBJ_RCS_008 "Representative RCS of the complete recognized object, Not implemented";
CM_ SG_ 711 OBJ_REF_PT_LONG_OFFSET_008 "Outer edges of the recognized object’s bounding box in Y axis";
CM_ SG_ 711 OBJ_REF_PT_LAT_OFFSET_008 "Outer edges of the recognized object’s bounding box in X axis";
CM_ SG_ 711 OBJ_YAW_RATE_008 "Orientation rate of track's bounding box in VCS coordinate";
CM_ SG_ 711 OBJ_GROUP_ID_008 "Objects which are linked together shall have same group ID";
CM_ SG_ 711 OBJ_POS_ERR_CRR_COEF_008 "vx-vy correlation due to small error in radial direction and big in cross radial - position Correlation Coefficient Error";
CM_ SG_ 711 OBJ_VELOCITY_ERR_CRR_COEF_008 "vx-vy correlation due to small error in radial direction and big in cross radial - velocity Correlation Coefficient Error";
CM_ SG_ 711 OBJ_ACCEL_ERR_CRR_COEF_008 "vx-vy correlation due to small error in radial direction and big in cross radial - Acceleration Correlation Coefficient Error";
CM_ SG_ 712 OBJ_ALIVE_TIME_009 "Time since object initialization in msec. Tracker internal may have bigger values. On the output interface, we should saturate the signal in that case.";
CM_ SG_ 712 OBJ_ACCELERATION_LONG_ERR_009 "acceleration along Longi  direction";
CM_ SG_ 712 OBJ_ACCELERATION_LAT_ERR_009 "acceleration along Lat direction error";
CM_ SG_ 712 OBJ_POS_LONG_ERR_009 "Lat-position error of object track's centroid in VCS coordinate";
CM_ SG_ 712 OBJ_POS_LAT_ERR_009 "Lat-position error of object track's centroid in VCS coordinate";
CM_ SG_ 712 OBJ_TRACK_MOTION_MODEL_009 "Object tracking uses a motion model for tracking moving items";
CM_ SG_ 712 OBJ_DIMENSION_WIDTH_009 "Lat distance from centroid to edge of bounding box.";
CM_ SG_ 712 OBJ_DIMENSION_LENGTH_009 "Longi distance from centroid to edge of bounding box.";
CM_ SG_ 712 OBJ_EXISTENCE_PROB_009 "Probability that the target is an actual target";
CM_ SG_ 712 OBJ_YAW_ANGLE_009 "Orientation of track's bounding box in VCS coordinate";
CM_ SG_ 712 OBJ_ID_009 "ID of object tracks, zero-ID represents an inactive track";
CM_ SG_ 712 OBJ_MOVEMENT_STATUS_009 "Information about a possible movement of the object during tracking";
CM_ SG_ 712 OBJ_MEASUREMENT_STATUS_009 "Objects should be sent out as fast as possible, even if not all statuses are observed and the object’s
signals might not be fully filled.";
CM_ SG_ 712 OBJ_POS_LONG_009 "Long-position of object track's centroid in VCS coordinate";
CM_ SG_ 712 OBJ_POS_LAT_009 "Lat-position of object track's centroid in VCS coordinate";
CM_ SG_ 712 OBJ_VELOCITY_LONG_009 "Over-the-ground velocity of object track's centroid along Long direction (in VCS coordinate)";
CM_ SG_ 712 OBJ_VELOCITY_LAT_009 "Over-the-ground velocity of object track's centroid along Lat direction (in VCS coordinate)";
CM_ SG_ 712 OBJ_ACCELERATION_LONG_009 "Over-the-ground track acceleration along Longi direction (in VCS coordinate)";
CM_ SG_ 712 OBJ_ACCELERATION_LAT_009 "Over-the-ground track acceleration along Lat direction (in VCS coordinate)";
CM_ SG_ 712 OBJ_VEH_TRACK_FLAG_009 "Indicates if current track is a vehicle";
CM_ SG_ 712 OBJ_TIMESTAMP_OFFSET_009 "A timestamp offset from the object list header timestamp for each object as we have different timestamps from different sensors leading to different timestamps on each object";
CM_ SG_ 712 OBJ_DIMENSION_WIDTH_ERR_009 "Lat distance or length error";
CM_ SG_ 712 OBJ_DIMENSION_LENGTH_ERR_009 "Longi distance or length error";
CM_ SG_ 712 OBJ_CLS_TYPE1_009 "Classification Type 1(Highest Prob), selected from ENUM list";
CM_ SG_ 712 OBJ_CLS_TYPE1_PROB_009 "Classification Type 1 probablity";
CM_ SG_ 712 OBJ_CLS_TYPE6_009 "Classification Type 6(Lowest Prob), selected from ENUM list";
CM_ SG_ 712 OBJ_CLS_TYPE6_PROB_009 "Classification Type 1 probablity";
CM_ SG_ 712 OBJ_RCS_009 "Representative RCS of the complete recognized object, Not implemented";
CM_ SG_ 712 OBJ_REF_PT_LONG_OFFSET_009 "Outer edges of the recognized object’s bounding box in Y axis";
CM_ SG_ 712 OBJ_REF_PT_LAT_OFFSET_009 "Outer edges of the recognized object’s bounding box in X axis";
CM_ SG_ 712 OBJ_YAW_RATE_009 "Orientation rate of track's bounding box in VCS coordinate";
CM_ SG_ 712 OBJ_GROUP_ID_009 "Objects which are linked together shall have same group ID";
CM_ SG_ 712 OBJ_POS_ERR_CRR_COEF_009 "vx-vy correlation due to small error in radial direction and big in cross radial - position Correlation Coefficient Error";
CM_ SG_ 712 OBJ_VELOCITY_ERR_CRR_COEF_009 "vx-vy correlation due to small error in radial direction and big in cross radial - velocity Correlation Coefficient Error";
CM_ SG_ 712 OBJ_ACCEL_ERR_CRR_COEF_009 "vx-vy correlation due to small error in radial direction and big in cross radial - Acceleration Correlation Coefficient Error";
CM_ SG_ 713 OBJ_ALIVE_TIME_010 "Time since object initialization in msec. Tracker internal may have bigger values. On the output interface, we should saturate the signal in that case.";
CM_ SG_ 713 OBJ_ACCELERATION_LONG_ERR_010 "acceleration along Longi  direction";
CM_ SG_ 713 OBJ_ACCELERATION_LAT_ERR_010 "acceleration along Lat direction error";
CM_ SG_ 713 OBJ_POS_LONG_ERR_010 "Lat-position error of object track's centroid in VCS coordinate";
CM_ SG_ 713 OBJ_POS_LAT_ERR_010 "Lat-position error of object track's centroid in VCS coordinate";
CM_ SG_ 713 OBJ_TRACK_MOTION_MODEL_010 "Object tracking uses a motion model for tracking moving items";
CM_ SG_ 713 OBJ_DIMENSION_WIDTH_010 "Lat distance from centroid to edge of bounding box.";
CM_ SG_ 713 OBJ_DIMENSION_LENGTH_010 "Longi distance from centroid to edge of bounding box.";
CM_ SG_ 713 OBJ_EXISTENCE_PROB_010 "Probability that the target is an actual target";
CM_ SG_ 713 OBJ_YAW_ANGLE_010 "Orientation of track's bounding box in VCS coordinate";
CM_ SG_ 713 OBJ_ID_010 "ID of object tracks, zero-ID represents an inactive track";
CM_ SG_ 713 OBJ_MOVEMENT_STATUS_010 "Information about a possible movement of the object during tracking";
CM_ SG_ 713 OBJ_MEASUREMENT_STATUS_010 "Objects should be sent out as fast as possible, even if not all statuses are observed and the object’s
signals might not be fully filled.";
CM_ SG_ 713 OBJ_POS_LONG_010 "Long-position of object track's centroid in VCS coordinate";
CM_ SG_ 713 OBJ_POS_LAT_010 "Lat-position of object track's centroid in VCS coordinate";
CM_ SG_ 713 OBJ_VELOCITY_LONG_010 "Over-the-ground velocity of object track's centroid along Long direction (in VCS coordinate)";
CM_ SG_ 713 OBJ_VELOCITY_LAT_010 "Over-the-ground velocity of object track's centroid along Lat direction (in VCS coordinate)";
CM_ SG_ 713 OBJ_ACCELERATION_LONG_010 "Over-the-ground track acceleration along Longi direction (in VCS coordinate)";
CM_ SG_ 713 OBJ_ACCELERATION_LAT_010 "Over-the-ground track acceleration along Lat direction (in VCS coordinate)";
CM_ SG_ 713 OBJ_VEH_TRACK_FLAG_010 "Indicates if current track is a vehicle";
CM_ SG_ 713 OBJ_TIMESTAMP_OFFSET_010 "A timestamp offset from the object list header timestamp for each object as we have different timestamps from different sensors leading to different timestamps on each object";
CM_ SG_ 713 OBJ_DIMENSION_WIDTH_ERR_010 "Lat distance or length error";
CM_ SG_ 713 OBJ_DIMENSION_LENGTH_ERR_010 "Longi distance or length error";
CM_ SG_ 713 OBJ_CLS_TYPE1_010 "Classification Type 1(Highest Prob), selected from ENUM list";
CM_ SG_ 713 OBJ_CLS_TYPE1_PROB_010 "Classification Type 1 probablity";
CM_ SG_ 713 OBJ_CLS_TYPE6_010 "Classification Type 6(Lowest Prob), selected from ENUM list";
CM_ SG_ 713 OBJ_CLS_TYPE6_PROB_010 "Classification Type 1 probablity";
CM_ SG_ 713 OBJ_RCS_010 "Representative RCS of the complete recognized object, Not implemented";
CM_ SG_ 713 OBJ_REF_PT_LONG_OFFSET_010 "Outer edges of the recognized object’s bounding box in Y axis";
CM_ SG_ 713 OBJ_REF_PT_LAT_OFFSET_010 "Outer edges of the recognized object’s bounding box in X axis";
CM_ SG_ 713 OBJ_YAW_RATE_010 "Orientation rate of track's bounding box in VCS coordinate";
CM_ SG_ 713 OBJ_GROUP_ID_010 "Objects which are linked together shall have same group ID";
CM_ SG_ 713 OBJ_POS_ERR_CRR_COEF_010 "vx-vy correlation due to small error in radial direction and big in cross radial - position Correlation Coefficient Error";
CM_ SG_ 713 OBJ_VELOCITY_ERR_CRR_COEF_010 "vx-vy correlation due to small error in radial direction and big in cross radial - velocity Correlation Coefficient Error";
CM_ SG_ 713 OBJ_ACCEL_ERR_CRR_COEF_010 "vx-vy correlation due to small error in radial direction and big in cross radial - Acceleration Correlation Coefficient Error";
CM_ SG_ 714 OBJ_ALIVE_TIME_011 "Time since object initialization in msec. Tracker internal may have bigger values. On the output interface, we should saturate the signal in that case.";
CM_ SG_ 714 OBJ_ACCELERATION_LONG_ERR_011 "acceleration along Longi  direction";
CM_ SG_ 714 OBJ_ACCELERATION_LAT_ERR_011 "acceleration along Lat direction error";
CM_ SG_ 714 OBJ_POS_LONG_ERR_011 "Lat-position error of object track's centroid in VCS coordinate";
CM_ SG_ 714 OBJ_POS_LAT_ERR_011 "Lat-position error of object track's centroid in VCS coordinate";
CM_ SG_ 714 OBJ_TRACK_MOTION_MODEL_011 "Object tracking uses a motion model for tracking moving items";
CM_ SG_ 714 OBJ_DIMENSION_WIDTH_011 "Lat distance from centroid to edge of bounding box.";
CM_ SG_ 714 OBJ_DIMENSION_LENGTH_011 "Longi distance from centroid to edge of bounding box.";
CM_ SG_ 714 OBJ_EXISTENCE_PROB_011 "Probability that the target is an actual target";
CM_ SG_ 714 OBJ_YAW_ANGLE_011 "Orientation of track's bounding box in VCS coordinate";
CM_ SG_ 714 OBJ_ID_011 "ID of object tracks, zero-ID represents an inactive track";
CM_ SG_ 714 OBJ_MOVEMENT_STATUS_011 "Information about a possible movement of the object during tracking";
CM_ SG_ 714 OBJ_MEASUREMENT_STATUS_011 "Objects should be sent out as fast as possible, even if not all statuses are observed and the object’s
signals might not be fully filled.";
CM_ SG_ 714 OBJ_POS_LONG_011 "Long-position of object track's centroid in VCS coordinate";
CM_ SG_ 714 OBJ_POS_LAT_011 "Lat-position of object track's centroid in VCS coordinate";
CM_ SG_ 714 OBJ_VELOCITY_LONG_011 "Over-the-ground velocity of object track's centroid along Long direction (in VCS coordinate)";
CM_ SG_ 714 OBJ_VELOCITY_LAT_011 "Over-the-ground velocity of object track's centroid along Lat direction (in VCS coordinate)";
CM_ SG_ 714 OBJ_ACCELERATION_LONG_011 "Over-the-ground track acceleration along Longi direction (in VCS coordinate)";
CM_ SG_ 714 OBJ_ACCELERATION_LAT_011 "Over-the-ground track acceleration along Lat direction (in VCS coordinate)";
CM_ SG_ 714 OBJ_VEH_TRACK_FLAG_011 "Indicates if current track is a vehicle";
CM_ SG_ 714 OBJ_TIMESTAMP_OFFSET_011 "A timestamp offset from the object list header timestamp for each object as we have different timestamps from different sensors leading to different timestamps on each object";
CM_ SG_ 714 OBJ_DIMENSION_WIDTH_ERR_011 "Lat distance or length error";
CM_ SG_ 714 OBJ_DIMENSION_LENGTH_ERR_011 "Longi distance or length error";
CM_ SG_ 714 OBJ_CLS_TYPE1_011 "Classification Type 1(Highest Prob), selected from ENUM list";
CM_ SG_ 714 OBJ_CLS_TYPE1_PROB_011 "Classification Type 1 probablity";
CM_ SG_ 714 OBJ_CLS_TYPE6_011 "Classification Type 6(Lowest Prob), selected from ENUM list";
CM_ SG_ 714 OBJ_CLS_TYPE6_PROB_011 "Classification Type 1 probablity";
CM_ SG_ 714 OBJ_RCS_011 "Representative RCS of the complete recognized object, Not implemented";
CM_ SG_ 714 OBJ_REF_PT_LONG_OFFSET_011 "Outer edges of the recognized object’s bounding box in Y axis";
CM_ SG_ 714 OBJ_REF_PT_LAT_OFFSET_011 "Outer edges of the recognized object’s bounding box in X axis";
CM_ SG_ 714 OBJ_YAW_RATE_011 "Orientation rate of track's bounding box in VCS coordinate";
CM_ SG_ 714 OBJ_GROUP_ID_011 "Objects which are linked together shall have same group ID";
CM_ SG_ 714 OBJ_POS_ERR_CRR_COEF_011 "vx-vy correlation due to small error in radial direction and big in cross radial - position Correlation Coefficient Error";
CM_ SG_ 714 OBJ_VELOCITY_ERR_CRR_COEF_011 "vx-vy correlation due to small error in radial direction and big in cross radial - velocity Correlation Coefficient Error";
CM_ SG_ 714 OBJ_ACCEL_ERR_CRR_COEF_011 "vx-vy correlation due to small error in radial direction and big in cross radial - Acceleration Correlation Coefficient Error";
CM_ SG_ 715 OBJ_ALIVE_TIME_012 "Time since object initialization in msec. Tracker internal may have bigger values. On the output interface, we should saturate the signal in that case.";
CM_ SG_ 715 OBJ_ACCELERATION_LONG_ERR_012 "acceleration along Longi  direction";
CM_ SG_ 715 OBJ_ACCELERATION_LAT_ERR_012 "acceleration along Lat direction error";
CM_ SG_ 715 OBJ_POS_LONG_ERR_012 "Lat-position error of object track's centroid in VCS coordinate";
CM_ SG_ 715 OBJ_POS_LAT_ERR_012 "Lat-position error of object track's centroid in VCS coordinate";
CM_ SG_ 715 OBJ_TRACK_MOTION_MODEL_012 "Object tracking uses a motion model for tracking moving items";
CM_ SG_ 715 OBJ_DIMENSION_WIDTH_012 "Lat distance from centroid to edge of bounding box.";
CM_ SG_ 715 OBJ_DIMENSION_LENGTH_012 "Longi distance from centroid to edge of bounding box.";
CM_ SG_ 715 OBJ_EXISTENCE_PROB_012 "Probability that the target is an actual target";
CM_ SG_ 715 OBJ_YAW_ANGLE_012 "Orientation of track's bounding box in VCS coordinate";
CM_ SG_ 715 OBJ_ID_012 "ID of object tracks, zero-ID represents an inactive track";
CM_ SG_ 715 OBJ_MOVEMENT_STATUS_012 "Information about a possible movement of the object during tracking";
CM_ SG_ 715 OBJ_MEASUREMENT_STATUS_012 "Objects should be sent out as fast as possible, even if not all statuses are observed and the object’s
signals might not be fully filled.";
CM_ SG_ 715 OBJ_POS_LONG_012 "Long-position of object track's centroid in VCS coordinate";
CM_ SG_ 715 OBJ_POS_LAT_012 "Lat-position of object track's centroid in VCS coordinate";
CM_ SG_ 715 OBJ_VELOCITY_LONG_012 "Over-the-ground velocity of object track's centroid along Long direction (in VCS coordinate)";
CM_ SG_ 715 OBJ_VELOCITY_LAT_012 "Over-the-ground velocity of object track's centroid along Lat direction (in VCS coordinate)";
CM_ SG_ 715 OBJ_ACCELERATION_LONG_012 "Over-the-ground track acceleration along Longi direction (in VCS coordinate)";
CM_ SG_ 715 OBJ_ACCELERATION_LAT_012 "Over-the-ground track acceleration along Lat direction (in VCS coordinate)";
CM_ SG_ 715 OBJ_VEH_TRACK_FLAG_012 "Indicates if current track is a vehicle";
CM_ SG_ 715 OBJ_TIMESTAMP_OFFSET_012 "A timestamp offset from the object list header timestamp for each object as we have different timestamps from different sensors leading to different timestamps on each object";
CM_ SG_ 715 OBJ_DIMENSION_WIDTH_ERR_012 "Lat distance or length error";
CM_ SG_ 715 OBJ_DIMENSION_LENGTH_ERR_012 "Longi distance or length error";
CM_ SG_ 715 OBJ_CLS_TYPE1_012 "Classification Type 1(Highest Prob), selected from ENUM list";
CM_ SG_ 715 OBJ_CLS_TYPE1_PROB_012 "Classification Type 1 probablity";
CM_ SG_ 715 OBJ_CLS_TYPE6_012 "Classification Type 6(Lowest Prob), selected from ENUM list";
CM_ SG_ 715 OBJ_CLS_TYPE6_PROB_012 "Classification Type 1 probablity";
CM_ SG_ 715 OBJ_RCS_012 "Representative RCS of the complete recognized object, Not implemented";
CM_ SG_ 715 OBJ_REF_PT_LONG_OFFSET_012 "Outer edges of the recognized object’s bounding box in Y axis";
CM_ SG_ 715 OBJ_REF_PT_LAT_OFFSET_012 "Outer edges of the recognized object’s bounding box in X axis";
CM_ SG_ 715 OBJ_YAW_RATE_012 "Orientation rate of track's bounding box in VCS coordinate";
CM_ SG_ 715 OBJ_GROUP_ID_012 "Objects which are linked together shall have same group ID";
CM_ SG_ 715 OBJ_POS_ERR_CRR_COEF_012 "vx-vy correlation due to small error in radial direction and big in cross radial - position Correlation Coefficient Error";
CM_ SG_ 715 OBJ_VELOCITY_ERR_CRR_COEF_012 "vx-vy correlation due to small error in radial direction and big in cross radial - velocity Correlation Coefficient Error";
CM_ SG_ 715 OBJ_ACCEL_ERR_CRR_COEF_012 "vx-vy correlation due to small error in radial direction and big in cross radial - Acceleration Correlation Coefficient Error";
CM_ SG_ 716 OBJ_ALIVE_TIME_013 "Time since object initialization in msec. Tracker internal may have bigger values. On the output interface, we should saturate the signal in that case.";
CM_ SG_ 716 OBJ_ACCELERATION_LONG_ERR_013 "acceleration along Longi  direction";
CM_ SG_ 716 OBJ_ACCELERATION_LAT_ERR_013 "acceleration along Lat direction error";
CM_ SG_ 716 OBJ_POS_LONG_ERR_013 "Lat-position error of object track's centroid in VCS coordinate";
CM_ SG_ 716 OBJ_POS_LAT_ERR_013 "Lat-position error of object track's centroid in VCS coordinate";
CM_ SG_ 716 OBJ_TRACK_MOTION_MODEL_013 "Object tracking uses a motion model for tracking moving items";
CM_ SG_ 716 OBJ_DIMENSION_WIDTH_013 "Lat distance from centroid to edge of bounding box.";
CM_ SG_ 716 OBJ_DIMENSION_LENGTH_013 "Longi distance from centroid to edge of bounding box.";
CM_ SG_ 716 OBJ_EXISTENCE_PROB_013 "Probability that the target is an actual target";
CM_ SG_ 716 OBJ_YAW_ANGLE_013 "Orientation of track's bounding box in VCS coordinate";
CM_ SG_ 716 OBJ_ID_013 "ID of object tracks, zero-ID represents an inactive track";
CM_ SG_ 716 OBJ_MOVEMENT_STATUS_013 "Information about a possible movement of the object during tracking";
CM_ SG_ 716 OBJ_MEASUREMENT_STATUS_013 "Objects should be sent out as fast as possible, even if not all statuses are observed and the object’s
signals might not be fully filled.";
CM_ SG_ 716 OBJ_POS_LONG_013 "Long-position of object track's centroid in VCS coordinate";
CM_ SG_ 716 OBJ_POS_LAT_013 "Lat-position of object track's centroid in VCS coordinate";
CM_ SG_ 716 OBJ_VELOCITY_LONG_013 "Over-the-ground velocity of object track's centroid along Long direction (in VCS coordinate)";
CM_ SG_ 716 OBJ_VELOCITY_LAT_013 "Over-the-ground velocity of object track's centroid along Lat direction (in VCS coordinate)";
CM_ SG_ 716 OBJ_ACCELERATION_LONG_013 "Over-the-ground track acceleration along Longi direction (in VCS coordinate)";
CM_ SG_ 716 OBJ_ACCELERATION_LAT_013 "Over-the-ground track acceleration along Lat direction (in VCS coordinate)";
CM_ SG_ 716 OBJ_VEH_TRACK_FLAG_013 "Indicates if current track is a vehicle";
CM_ SG_ 716 OBJ_TIMESTAMP_OFFSET_013 "A timestamp offset from the object list header timestamp for each object as we have different timestamps from different sensors leading to different timestamps on each object";
CM_ SG_ 716 OBJ_DIMENSION_WIDTH_ERR_013 "Lat distance or length error";
CM_ SG_ 716 OBJ_DIMENSION_LENGTH_ERR_013 "Longi distance or length error";
CM_ SG_ 716 OBJ_CLS_TYPE1_013 "Classification Type 1(Highest Prob), selected from ENUM list";
CM_ SG_ 716 OBJ_CLS_TYPE1_PROB_013 "Classification Type 1 probablity";
CM_ SG_ 716 OBJ_CLS_TYPE6_013 "Classification Type 6(Lowest Prob), selected from ENUM list";
CM_ SG_ 716 OBJ_CLS_TYPE6_PROB_013 "Classification Type 1 probablity";
CM_ SG_ 716 OBJ_RCS_013 "Representative RCS of the complete recognized object, Not implemented";
CM_ SG_ 716 OBJ_REF_PT_LONG_OFFSET_013 "Outer edges of the recognized object’s bounding box in Y axis";
CM_ SG_ 716 OBJ_REF_PT_LAT_OFFSET_013 "Outer edges of the recognized object’s bounding box in X axis";
CM_ SG_ 716 OBJ_YAW_RATE_013 "Orientation rate of track's bounding box in VCS coordinate";
CM_ SG_ 716 OBJ_GROUP_ID_013 "Objects which are linked together shall have same group ID";
CM_ SG_ 716 OBJ_POS_ERR_CRR_COEF_013 "vx-vy correlation due to small error in radial direction and big in cross radial - position Correlation Coefficient Error";
CM_ SG_ 716 OBJ_VELOCITY_ERR_CRR_COEF_013 "vx-vy correlation due to small error in radial direction and big in cross radial - velocity Correlation Coefficient Error";
CM_ SG_ 716 OBJ_ACCEL_ERR_CRR_COEF_013 "vx-vy correlation due to small error in radial direction and big in cross radial - Acceleration Correlation Coefficient Error";
CM_ SG_ 717 OBJ_ALIVE_TIME_014 "Time since object initialization in msec. Tracker internal may have bigger values. On the output interface, we should saturate the signal in that case.";
CM_ SG_ 717 OBJ_ACCELERATION_LONG_ERR_014 "acceleration along Longi  direction";
CM_ SG_ 717 OBJ_ACCELERATION_LAT_ERR_014 "acceleration along Lat direction error";
CM_ SG_ 717 OBJ_POS_LONG_ERR_014 "Lat-position error of object track's centroid in VCS coordinate";
CM_ SG_ 717 OBJ_POS_LAT_ERR_014 "Lat-position error of object track's centroid in VCS coordinate";
CM_ SG_ 717 OBJ_TRACK_MOTION_MODEL_014 "Object tracking uses a motion model for tracking moving items";
CM_ SG_ 717 OBJ_DIMENSION_WIDTH_014 "Lat distance from centroid to edge of bounding box.";
CM_ SG_ 717 OBJ_DIMENSION_LENGTH_014 "Longi distance from centroid to edge of bounding box.";
CM_ SG_ 717 OBJ_EXISTENCE_PROB_014 "Probability that the target is an actual target";
CM_ SG_ 717 OBJ_YAW_ANGLE_014 "Orientation of track's bounding box in VCS coordinate";
CM_ SG_ 717 OBJ_ID_014 "ID of object tracks, zero-ID represents an inactive track";
CM_ SG_ 717 OBJ_MOVEMENT_STATUS_014 "Information about a possible movement of the object during tracking";
CM_ SG_ 717 OBJ_MEASUREMENT_STATUS_014 "Objects should be sent out as fast as possible, even if not all statuses are observed and the object’s
signals might not be fully filled.";
CM_ SG_ 717 OBJ_POS_LONG_014 "Long-position of object track's centroid in VCS coordinate";
CM_ SG_ 717 OBJ_POS_LAT_014 "Lat-position of object track's centroid in VCS coordinate";
CM_ SG_ 717 OBJ_VELOCITY_LONG_014 "Over-the-ground velocity of object track's centroid along Long direction (in VCS coordinate)";
CM_ SG_ 717 OBJ_VELOCITY_LAT_014 "Over-the-ground velocity of object track's centroid along Lat direction (in VCS coordinate)";
CM_ SG_ 717 OBJ_ACCELERATION_LONG_014 "Over-the-ground track acceleration along Longi direction (in VCS coordinate)";
CM_ SG_ 717 OBJ_ACCELERATION_LAT_014 "Over-the-ground track acceleration along Lat direction (in VCS coordinate)";
CM_ SG_ 717 OBJ_VEH_TRACK_FLAG_014 "Indicates if current track is a vehicle";
CM_ SG_ 717 OBJ_TIMESTAMP_OFFSET_014 "A timestamp offset from the object list header timestamp for each object as we have different timestamps from different sensors leading to different timestamps on each object";
CM_ SG_ 717 OBJ_DIMENSION_WIDTH_ERR_014 "Lat distance or length error";
CM_ SG_ 717 OBJ_DIMENSION_LENGTH_ERR_014 "Longi distance or length error";
CM_ SG_ 717 OBJ_CLS_TYPE1_014 "Classification Type 1(Highest Prob), selected from ENUM list";
CM_ SG_ 717 OBJ_CLS_TYPE1_PROB_014 "Classification Type 1 probablity";
CM_ SG_ 717 OBJ_CLS_TYPE6_014 "Classification Type 6(Lowest Prob), selected from ENUM list";
CM_ SG_ 717 OBJ_CLS_TYPE6_PROB_014 "Classification Type 1 probablity";
CM_ SG_ 717 OBJ_RCS_014 "Representative RCS of the complete recognized object, Not implemented";
CM_ SG_ 717 OBJ_REF_PT_LONG_OFFSET_014 "Outer edges of the recognized object’s bounding box in Y axis";
CM_ SG_ 717 OBJ_REF_PT_LAT_OFFSET_014 "Outer edges of the recognized object’s bounding box in X axis";
CM_ SG_ 717 OBJ_YAW_RATE_014 "Orientation rate of track's bounding box in VCS coordinate";
CM_ SG_ 717 OBJ_GROUP_ID_014 "Objects which are linked together shall have same group ID";
CM_ SG_ 717 OBJ_POS_ERR_CRR_COEF_014 "vx-vy correlation due to small error in radial direction and big in cross radial - position Correlation Coefficient Error";
CM_ SG_ 717 OBJ_VELOCITY_ERR_CRR_COEF_014 "vx-vy correlation due to small error in radial direction and big in cross radial - velocity Correlation Coefficient Error";
CM_ SG_ 717 OBJ_ACCEL_ERR_CRR_COEF_014 "vx-vy correlation due to small error in radial direction and big in cross radial - Acceleration Correlation Coefficient Error";

BA_DEF_ BO_ "CanTpBs" INT 0 255;
BA_DEF_ BO_ "EventRateOfChange" INT 10 10000;
BA_DEF_ BO_ "GenMsgCycleTime" INT 0 100000;
BA_DEF_ BO_ "GenMsgILSupport" ENUM  "No","Yes";
BA_DEF_ BO_ "GenMsgNrOfRepetition" INT 0 100;
BA_DEF_ BO_ "GenMsgSendType" ENUM  "FixedPeriodic","Event","EnabledPeriodic","NotUsed","NotUsed","EventPeriodic","NotUsed","NotUsed","NoMsgSendType";
BA_DEF_ BO_ "NetworkInitialization" ENUM  "No","Yes";
BA_DEF_ BO_ "VFrameFormat" ENUM  "StandardCAN","ExtendedCAN","reserved","reserved","reserved","reserved","reserved","reserved","reserved","reserved","reserved","reserved","reserved","reserved","StandardCAN_FD","ExtendedCAN_FD";
BA_DEF_ SG_ "GenSigCmt" STRING;
BA_DEF_ SG_ "GenSigCycleTime" INT 0 0;
BA_DEF_ SG_ "GenSigSendType" ENUM  "Cyclic","OnWrite","vector_leerstring","OnChange","vector_leerstring","IfActive","vector_leerstring","NoSigSendType";
BA_DEF_ SG_ "GenSigStartValue" INT 0 1000000000;
BA_DEF_ SG_ "GenSigTimeoutTime" INT 0 0;
BA_DEF_ SG_ "GenSigVtEn" STRING;
BA_DEF_ SG_ "GenSigVtName" STRING;
BA_DEF_DEF_ "CanTpBs" 255;
BA_DEF_DEF_ "EventRateOfChange" 10000;
BA_DEF_DEF_ "GenMsgCycleTime" 0;
BA_DEF_DEF_ "GenMsgILSupport" "Yes";
BA_DEF_DEF_ "GenMsgNrOfRepetition" 0;
BA_DEF_DEF_ "GenMsgSendType" "NoMsgSendType";
BA_DEF_DEF_ "GenSigCmt" "";
BA_DEF_DEF_ "GenSigCycleTime" 0;
BA_DEF_DEF_ "GenSigSendType" "NoSigSendType";
BA_DEF_DEF_ "GenSigStartValue" 0;
BA_DEF_DEF_ "GenSigTimeoutTime" 0;
BA_DEF_DEF_ "GenSigVtEn" "";
BA_DEF_DEF_ "GenSigVtName" "";
BA_DEF_DEF_ "NetworkInitialization" "Yes";
BA_DEF_DEF_ "VFrameFormat" "StandardCAN_FD";
BA_ "GenMsgSendType" BO_ 700 1;
BA_ "GenMsgSendType" BO_ 701 1;
BA_ "GenMsgSendType" BO_ 702 1;
BA_ "GenMsgSendType" BO_ 703 1;
BA_ "GenMsgSendType" BO_ 705 1;
BA_ "GenMsgSendType" BO_ 706 1;
BA_ "GenMsgSendType" BO_ 707 1;
BA_ "GenMsgSendType" BO_ 708 1;
BA_ "GenMsgSendType" BO_ 709 1;
BA_ "GenMsgSendType" BO_ 710 1;
BA_ "GenMsgSendType" BO_ 711 1;
BA_ "GenMsgSendType" BO_ 712 1;
BA_ "GenMsgSendType" BO_ 713 1;
BA_ "GenMsgSendType" BO_ 714 1;
BA_ "GenMsgSendType" BO_ 715 1;
BA_ "GenMsgSendType" BO_ 716 1;
BA_ "GenMsgSendType" BO_ 717 1;
BA_ "GenSigStartValue" SG_ 700 DET_RANGE_VELOCITY_241 16384;
BA_ "GenSigStartValue" SG_ 700 DET_RCS_241 128;
BA_ "GenSigStartValue" SG_ 700 DET_RANGE_VELOCITY_242 16384;
BA_ "GenSigStartValue" SG_ 700 DET_RCS_242 128;
BA_ "GenSigStartValue" SG_ 700 DET_RANGE_VELOCITY_243 16384;
BA_ "GenSigStartValue" SG_ 700 DET_RCS_243 128;
BA_ "GenSigStartValue" SG_ 700 DET_RANGE_VELOCITY_244 16384;
BA_ "GenSigStartValue" SG_ 700 DET_RCS_244 128;
BA_ "GenSigStartValue" SG_ 701 DET_RANGE_VELOCITY_245 16384;
BA_ "GenSigStartValue" SG_ 701 DET_RCS_245 128;
BA_ "GenSigStartValue" SG_ 701 DET_RANGE_VELOCITY_246 16384;
BA_ "GenSigStartValue" SG_ 701 DET_RCS_246 128;
BA_ "GenSigStartValue" SG_ 701 DET_RANGE_VELOCITY_247 16384;
BA_ "GenSigStartValue" SG_ 701 DET_RCS_247 128;
BA_ "GenSigStartValue" SG_ 701 DET_RANGE_VELOCITY_248 16384;
BA_ "GenSigStartValue" SG_ 701 DET_RCS_248 128;
BA_ "GenSigStartValue" SG_ 702 DET_RANGE_VELOCITY_249 16384;
BA_ "GenSigStartValue" SG_ 702 DET_RCS_249 128;
BA_ "GenSigStartValue" SG_ 702 DET_RANGE_VELOCITY_250 16384;
BA_ "GenSigStartValue" SG_ 702 DET_RCS_250 128;
BA_ "GenSigStartValue" SG_ 702 DET_RANGE_VELOCITY_251 16384;
BA_ "GenSigStartValue" SG_ 702 DET_RCS_251 128;
BA_ "GenSigStartValue" SG_ 702 DET_RANGE_VELOCITY_252 16384;
BA_ "GenSigStartValue" SG_ 702 DET_RCS_252 128;
BA_ "GenSigStartValue" SG_ 703 DET_RANGE_VELOCITY_253 16384;
BA_ "GenSigStartValue" SG_ 703 DET_RCS_253 128;
BA_ "GenSigStartValue" SG_ 703 DET_RANGE_VELOCITY_254 16384;
BA_ "GenSigStartValue" SG_ 703 DET_RCS_254 128;
BA_ "GenSigStartValue" SG_ 703 DET_RANGE_VELOCITY_255 16384;
BA_ "GenSigStartValue" SG_ 703 DET_RCS_255 128;
BA_ "GenSigStartValue" SG_ 703 DET_RANGE_VELOCITY_256 16384;
BA_ "GenSigStartValue" SG_ 703 DET_RCS_256 128;
BA_ "GenSigStartValue" SG_ 705 OBJ_YAW_ANGLE_002 2000;
BA_ "GenSigStartValue" SG_ 705 OBJ_POS_LONG_002 32700;
BA_ "GenSigStartValue" SG_ 705 OBJ_POS_LAT_002 32700;
BA_ "GenSigStartValue" SG_ 705 OBJ_VELOCITY_LONG_002 16300;
BA_ "GenSigStartValue" SG_ 705 OBJ_VELOCITY_LAT_002 16300;
BA_ "GenSigStartValue" SG_ 705 OBJ_ACCELERATION_LONG_002 400;
BA_ "GenSigStartValue" SG_ 705 OBJ_ACCELERATION_LAT_002 400;
BA_ "GenSigStartValue" SG_ 705 OBJ_TIMESTAMP_OFFSET_002 127;
BA_ "GenSigStartValue" SG_ 705 OBJ_RCS_002 64;
BA_ "GenSigStartValue" SG_ 705 OBJ_YAW_RATE_002 448;
BA_ "GenSigStartValue" SG_ 705 OBJ_POS_ERR_CRR_COEF_002 120;
BA_ "GenSigStartValue" SG_ 705 OBJ_VELOCITY_ERR_CRR_COEF_002 120;
BA_ "GenSigStartValue" SG_ 705 OBJ_ACCEL_ERR_CRR_COEF_002 120;
BA_ "GenSigStartValue" SG_ 706 OBJ_YAW_ANGLE_003 2000;
BA_ "GenSigStartValue" SG_ 706 OBJ_POS_LONG_003 32700;
BA_ "GenSigStartValue" SG_ 706 OBJ_POS_LAT_003 32700;
BA_ "GenSigStartValue" SG_ 706 OBJ_VELOCITY_LONG_003 16300;
BA_ "GenSigStartValue" SG_ 706 OBJ_VELOCITY_LAT_003 16300;
BA_ "GenSigStartValue" SG_ 706 OBJ_ACCELERATION_LONG_003 400;
BA_ "GenSigStartValue" SG_ 706 OBJ_ACCELERATION_LAT_003 400;
BA_ "GenSigStartValue" SG_ 706 OBJ_TIMESTAMP_OFFSET_003 127;
BA_ "GenSigStartValue" SG_ 706 OBJ_RCS_003 64;
BA_ "GenSigStartValue" SG_ 706 OBJ_YAW_RATE_003 448;
BA_ "GenSigStartValue" SG_ 706 OBJ_POS_ERR_CRR_COEF_003 120;
BA_ "GenSigStartValue" SG_ 706 OBJ_VELOCITY_ERR_CRR_COEF_003 120;
BA_ "GenSigStartValue" SG_ 706 OBJ_ACCEL_ERR_CRR_COEF_003 120;
BA_ "GenSigStartValue" SG_ 707 OBJ_YAW_ANGLE_004 2000;
BA_ "GenSigStartValue" SG_ 707 OBJ_POS_LONG_004 32700;
BA_ "GenSigStartValue" SG_ 707 OBJ_POS_LAT_004 32700;
BA_ "GenSigStartValue" SG_ 707 OBJ_VELOCITY_LONG_004 16300;
BA_ "GenSigStartValue" SG_ 707 OBJ_VELOCITY_LAT_004 16300;
BA_ "GenSigStartValue" SG_ 707 OBJ_ACCELERATION_LONG_004 400;
BA_ "GenSigStartValue" SG_ 707 OBJ_ACCELERATION_LAT_004 400;
BA_ "GenSigStartValue" SG_ 707 OBJ_TIMESTAMP_OFFSET_004 127;
BA_ "GenSigStartValue" SG_ 707 OBJ_RCS_004 64;
BA_ "GenSigStartValue" SG_ 707 OBJ_YAW_RATE_004 448;
BA_ "GenSigStartValue" SG_ 707 OBJ_POS_ERR_CRR_COEF_004 120;
BA_ "GenSigStartValue" SG_ 707 OBJ_VELOCITY_ERR_CRR_COEF_004 120;
BA_ "GenSigStartValue" SG_ 707 OBJ_ACCEL_ERR_CRR_COEF_004 120;
BA_ "GenSigStartValue" SG_ 708 OBJ_YAW_ANGLE_005 2000;
BA_ "GenSigStartValue" SG_ 708 OBJ_POS_LONG_005 32700;
BA_ "GenSigStartValue" SG_ 708 OBJ_POS_LAT_005 32700;
BA_ "GenSigStartValue" SG_ 708 OBJ_VELOCITY_LONG_005 16300;
BA_ "GenSigStartValue" SG_ 708 OBJ_VELOCITY_LAT_005 16300;
BA_ "GenSigStartValue" SG_ 708 OBJ_ACCELERATION_LONG_005 400;
BA_ "GenSigStartValue" SG_ 708 OBJ_ACCELERATION_LAT_005 400;
BA_ "GenSigStartValue" SG_ 708 OBJ_TIMESTAMP_OFFSET_005 127;
BA_ "GenSigStartValue" SG_ 708 OBJ_RCS_005 64;
BA_ "GenSigStartValue" SG_ 708 OBJ_YAW_RATE_005 448;
BA_ "GenSigStartValue" SG_ 708 OBJ_POS_ERR_CRR_COEF_005 120;
BA_ "GenSigStartValue" SG_ 708 OBJ_VELOCITY_ERR_CRR_COEF_005 120;
BA_ "GenSigStartValue" SG_ 708 OBJ_ACCEL_ERR_CRR_COEF_005 120;
BA_ "GenSigStartValue" SG_ 709 OBJ_YAW_ANGLE_006 2000;
BA_ "GenSigStartValue" SG_ 709 OBJ_POS_LONG_006 32700;
BA_ "GenSigStartValue" SG_ 709 OBJ_POS_LAT_006 32700;
BA_ "GenSigStartValue" SG_ 709 OBJ_VELOCITY_LONG_006 16300;
BA_ "GenSigStartValue" SG_ 709 OBJ_VELOCITY_LAT_006 16300;
BA_ "GenSigStartValue" SG_ 709 OBJ_ACCELERATION_LONG_006 400;
BA_ "GenSigStartValue" SG_ 709 OBJ_ACCELERATION_LAT_006 400;
BA_ "GenSigStartValue" SG_ 709 OBJ_TIMESTAMP_OFFSET_006 127;
BA_ "GenSigStartValue" SG_ 709 OBJ_RCS_006 64;
BA_ "GenSigStartValue" SG_ 709 OBJ_YAW_RATE_006 448;
BA_ "GenSigStartValue" SG_ 709 OBJ_POS_ERR_CRR_COEF_006 120;
BA_ "GenSigStartValue" SG_ 709 OBJ_VELOCITY_ERR_CRR_COEF_006 120;
BA_ "GenSigStartValue" SG_ 709 OBJ_ACCEL_ERR_CRR_COEF_006 120;
BA_ "GenSigStartValue" SG_ 710 OBJ_YAW_ANGLE_007 2000;
BA_ "GenSigStartValue" SG_ 710 OBJ_POS_LONG_007 32700;
BA_ "GenSigStartValue" SG_ 710 OBJ_POS_LAT_007 32700;
BA_ "GenSigStartValue" SG_ 710 OBJ_VELOCITY_LONG_007 16300;
BA_ "GenSigStartValue" SG_ 710 OBJ_VELOCITY_LAT_007 16300;
BA_ "GenSigStartValue" SG_ 710 OBJ_ACCELERATION_LONG_007 400;
BA_ "GenSigStartValue" SG_ 710 OBJ_ACCELERATION_LAT_007 400;
BA_ "GenSigStartValue" SG_ 710 OBJ_TIMESTAMP_OFFSET_007 127;
BA_ "GenSigStartValue" SG_ 710 OBJ_RCS_007 64;
BA_ "GenSigStartValue" SG_ 710 OBJ_YAW_RATE_007 448;
BA_ "GenSigStartValue" SG_ 710 OBJ_POS_ERR_CRR_COEF_007 120;
BA_ "GenSigStartValue" SG_ 710 OBJ_VELOCITY_ERR_CRR_COEF_007 120;
BA_ "GenSigStartValue" SG_ 710 OBJ_ACCEL_ERR_CRR_COEF_007 120;
BA_ "GenSigStartValue" SG_ 711 OBJ_YAW_ANGLE_008 2000;
BA_ "GenSigStartValue" SG_ 711 OBJ_POS_LONG_008 32700;
BA_ "GenSigStartValue" SG_ 711 OBJ_POS_LAT_008 32700;
BA_ "GenSigStartValue" SG_ 711 OBJ_VELOCITY_LONG_008 16300;
BA_ "GenSigStartValue" SG_ 711 OBJ_VELOCITY_LAT_008 16300;
BA_ "GenSigStartValue" SG_ 711 OBJ_ACCELERATION_LONG_008 400;
BA_ "GenSigStartValue" SG_ 711 OBJ_ACCELERATION_LAT_008 400;
BA_ "GenSigStartValue" SG_ 711 OBJ_TIMESTAMP_OFFSET_008 127;
BA_ "GenSigStartValue" SG_ 711 OBJ_RCS_008 64;
BA_ "GenSigStartValue" SG_ 711 OBJ_YAW_RATE_008 448;
BA_ "GenSigStartValue" SG_ 711 OBJ_POS_ERR_CRR_COEF_008 120;
BA_ "GenSigStartValue" SG_ 711 OBJ_VELOCITY_ERR_CRR_COEF_008 120;
BA_ "GenSigStartValue" SG_ 711 OBJ_ACCEL_ERR_CRR_COEF_008 120;
BA_ "GenSigStartValue" SG_ 712 OBJ_YAW_ANGLE_009 2000;
BA_ "GenSigStartValue" SG_ 712 OBJ_POS_LONG_009 32700;
BA_ "GenSigStartValue" SG_ 712 OBJ_POS_LAT_009 32700;
BA_ "GenSigStartValue" SG_ 712 OBJ_VELOCITY_LONG_009 16300;
BA_ "GenSigStartValue" SG_ 712 OBJ_VELOCITY_LAT_009 16300;
BA_ "GenSigStartValue" SG_ 712 OBJ_ACCELERATION_LONG_009 400;
BA_ "GenSigStartValue" SG_ 712 OBJ_ACCELERATION_LAT_009 400;
BA_ "GenSigStartValue" SG_ 712 OBJ_TIMESTAMP_OFFSET_009 127;
BA_ "GenSigStartValue" SG_ 712 OBJ_RCS_009 64;
BA_ "GenSigStartValue" SG_ 712 OBJ_YAW_RATE_009 448;
BA_ "GenSigStartValue" SG_ 712 OBJ_POS_ERR_CRR_COEF_009 120;
BA_ "GenSigStartValue" SG_ 712 OBJ_VELOCITY_ERR_CRR_COEF_009 120;
BA_ "GenSigStartValue" SG_ 712 OBJ_ACCEL_ERR_CRR_COEF_009 120;
BA_ "GenSigStartValue" SG_ 713 OBJ_YAW_ANGLE_010 2000;
BA_ "GenSigStartValue" SG_ 713 OBJ_POS_LONG_010 32700;
BA_ "GenSigStartValue" SG_ 713 OBJ_POS_LAT_010 32700;
BA_ "GenSigStartValue" SG_ 713 OBJ_VELOCITY_LONG_010 16300;
BA_ "GenSigStartValue" SG_ 713 OBJ_VELOCITY_LAT_010 16300;
BA_ "GenSigStartValue" SG_ 713 OBJ_ACCELERATION_LONG_010 400;
BA_ "GenSigStartValue" SG_ 713 OBJ_ACCELERATION_LAT_010 400;
BA_ "GenSigStartValue" SG_ 713 OBJ_TIMESTAMP_OFFSET_010 127;
BA_ "GenSigStartValue" SG_ 713 OBJ_RCS_010 64;
BA_ "GenSigStartValue" SG_ 713 OBJ_YAW_RATE_010 448;
BA_ "GenSigStartValue" SG_ 713 OBJ_POS_ERR_CRR_COEF_010 120;
BA_ "GenSigStartValue" SG_ 713 OBJ_VELOCITY_ERR_CRR_COEF_010 120;
BA_ "GenSigStartValue" SG_ 713 OBJ_ACCEL_ERR_CRR_COEF_010 120;
BA_ "GenSigStartValue" SG_ 714 OBJ_YAW_ANGLE_011 2000;
BA_ "GenSigStartValue" SG_ 714 OBJ_POS_LONG_011 32700;
BA_ "GenSigStartValue" SG_ 714 OBJ_POS_LAT_011 32700;
BA_ "GenSigStartValue" SG_ 714 OBJ_VELOCITY_LONG_011 16300;
BA_ "GenSigStartValue" SG_ 714 OBJ_VELOCITY_LAT_011 16300;
BA_ "GenSigStartValue" SG_ 714 OBJ_ACCELERATION_LONG_011 400;
BA_ "GenSigStartValue" SG_ 714 OBJ_ACCELERATION_LAT_011 400;
BA_ "GenSigStartValue" SG_ 714 OBJ_TIMESTAMP_OFFSET_011 127;
BA_ "GenSigStartValue" SG_ 714 OBJ_RCS_011 64;
BA_ "GenSigStartValue" SG_ 714 OBJ_YAW_RATE_011 448;
BA_ "GenSigStartValue" SG_ 714 OBJ_POS_ERR_CRR_COEF_011 120;
BA_ "GenSigStartValue" SG_ 714 OBJ_VELOCITY_ERR_CRR_COEF_011 120;
BA_ "GenSigStartValue" SG_ 714 OBJ_ACCEL_ERR_CRR_COEF_011 120;
BA_ "GenSigStartValue" SG_ 715 OBJ_YAW_ANGLE_012 2000;
BA_ "GenSigStartValue" SG_ 715 OBJ_POS_LONG_012 32700;
BA_ "GenSigStartValue" SG_ 715 OBJ_POS_LAT_012 32700;
BA_ "GenSigStartValue" SG_ 715 OBJ_VELOCITY_LONG_012 16300;
BA_ "GenSigStartValue" SG_ 715 OBJ_VELOCITY_LAT_012 16300;
BA_ "GenSigStartValue" SG_ 715 OBJ_ACCELERATION_LONG_012 400;
BA_ "GenSigStartValue" SG_ 715 OBJ_ACCELERATION_LAT_012 400;
BA_ "GenSigStartValue" SG_ 715 OBJ_TIMESTAMP_OFFSET_012 127;
BA_ "GenSigStartValue" SG_ 715 OBJ_RCS_012 64;
BA_ "GenSigStartValue" SG_ 715 OBJ_YAW_RATE_012 448;
BA_ "GenSigStartValue" SG_ 715 OBJ_POS_ERR_CRR_COEF_012 120;
BA_ "GenSigStartValue" SG_ 715 OBJ_VELOCITY_ERR_CRR_COEF_012 120;
BA_ "GenSigStartValue" SG_ 715 OBJ_ACCEL_ERR_CRR_COEF_012 120;
BA_ "GenSigStartValue" SG_ 716 OBJ_YAW_ANGLE_013 2000;
BA_ "GenSigStartValue" SG_ 716 OBJ_POS_LONG_013 32700;
BA_ "GenSigStartValue" SG_ 716 OBJ_POS_LAT_013 32700;
BA_ "GenSigStartValue" SG_ 716 OBJ_VELOCITY_LONG_013 16300;
BA_ "GenSigStartValue" SG_ 716 OBJ_VELOCITY_LAT_013 16300;
BA_ "GenSigStartValue" SG_ 716 OBJ_ACCELERATION_LONG_013 400;
BA_ "GenSigStartValue" SG_ 716 OBJ_ACCELERATION_LAT_013 400;
BA_ "GenSigStartValue" SG_ 716 OBJ_TIMESTAMP_OFFSET_013 127;
BA_ "GenSigStartValue" SG_ 716 OBJ_RCS_013 64;
BA_ "GenSigStartValue" SG_ 716 OBJ_YAW_RATE_013 448;
BA_ "GenSigStartValue" SG_ 716 OBJ_POS_ERR_CRR_COEF_013 120;
BA_ "GenSigStartValue" SG_ 716 OBJ_VELOCITY_ERR_CRR_COEF_013 120;
BA_ "GenSigStartValue" SG_ 716 OBJ_ACCEL_ERR_CRR_COEF_013 120;
BA_ "GenSigStartValue" SG_ 717 OBJ_YAW_ANGLE_014 2000;
BA_ "GenSigStartValue" SG_ 717 OBJ_POS_LONG_014 32700;
BA_ "GenSigStartValue" SG_ 717 OBJ_POS_LAT_014 32700;
BA_ "GenSigStartValue" SG_ 717 OBJ_VELOCITY_LONG_014 16300;
BA_ "GenSigStartValue" SG_ 717 OBJ_VELOCITY_LAT_014 16300;
BA_ "GenSigStartValue" SG_ 717 OBJ_ACCELERATION_LONG_014 400;
BA_ "GenSigStartValue" SG_ 717 OBJ_ACCELERATION_LAT_014 400;
BA_ "GenSigStartValue" SG_ 717 OBJ_TIMESTAMP_OFFSET_014 127;
BA_ "GenSigStartValue" SG_ 717 OBJ_RCS_014 64;
BA_ "GenSigStartValue" SG_ 717 OBJ_YAW_RATE_014 448;
BA_ "GenSigStartValue" SG_ 717 OBJ_POS_ERR_CRR_COEF_014 120;
BA_ "GenSigStartValue" SG_ 717 OBJ_VELOCITY_ERR_CRR_COEF_014 120;
BA_ "GenSigStartValue" SG_ 717 OBJ_ACCEL_ERR_CRR_COEF_014 120;
VAL_ 700 DET_CONFD_AZIMUTH_241 0 "High" 1 "MidHigh" 2 "MidLow" 3 "Low";
VAL_ 700 DET_CONFD_ELEVATION_241 0 "High" 1 "MidHigh" 2 "MidLow" 3 "Low";
VAL_ 700 DET_CONFD_AZIMUTH_242 0 "High" 1 "MidHigh" 2 "MidLow" 3 "Low";
VAL_ 700 DET_CONFD_ELEVATION_242 0 "High" 1 "MidHigh" 2 "MidLow" 3 "Low";
VAL_ 700 DET_CONFD_AZIMUTH_243 0 "High" 1 "MidHigh" 2 "MidLow" 3 "Low";
VAL_ 700 DET_CONFD_ELEVATION_243 0 "High" 1 "MidHigh" 2 "MidLow" 3 "Low";
VAL_ 701 DET_CONFD_AZIMUTH_245 0 "High" 1 "MidHigh" 2 "MidLow" 3 "Low";
VAL_ 701 DET_CONFD_ELEVATION_245 0 "High" 1 "MidHigh" 2 "MidLow" 3 "Low";
VAL_ 701 DET_CONFD_AZIMUTH_246 0 "High" 1 "MidHigh" 2 "MidLow" 3 "Low";
VAL_ 701 DET_CONFD_ELEVATION_246 0 "High" 1 "MidHigh" 2 "MidLow" 3 "Low";
VAL_ 701 DET_CONFD_AZIMUTH_247 0 "High" 1 "MidHigh" 2 "MidLow" 3 "Low";
VAL_ 701 DET_CONFD_ELEVATION_247 0 "High" 1 "MidHigh" 2 "MidLow" 3 "Low";
VAL_ 702 DET_CONFD_AZIMUTH_249 0 "High" 1 "MidHigh" 2 "MidLow" 3 "Low";
VAL_ 702 DET_CONFD_ELEVATION_249 0 "High" 1 "MidHigh" 2 "MidLow" 3 "Low";
VAL_ 702 DET_CONFD_AZIMUTH_250 0 "High" 1 "MidHigh" 2 "MidLow" 3 "Low";
VAL_ 702 DET_CONFD_ELEVATION_250 0 "High" 1 "MidHigh" 2 "MidLow" 3 "Low";
VAL_ 702 DET_CONFD_AZIMUTH_251 0 "High" 1 "MidHigh" 2 "MidLow" 3 "Low";
VAL_ 702 DET_CONFD_ELEVATION_251 0 "High" 1 "MidHigh" 2 "MidLow" 3 "Low";
VAL_ 703 DET_CONFD_AZIMUTH_253 0 "High" 1 "MidHigh" 2 "MidLow" 3 "Low";
VAL_ 703 DET_CONFD_ELEVATION_253 0 "High" 1 "MidHigh" 2 "MidLow" 3 "Low";
VAL_ 703 DET_CONFD_AZIMUTH_254 0 "High" 1 "MidHigh" 2 "MidLow" 3 "Low";
VAL_ 703 DET_CONFD_ELEVATION_254 0 "High" 1 "MidHigh" 2 "MidLow" 3 "Low";
VAL_ 703 DET_CONFD_AZIMUTH_255 0 "High" 1 "MidHigh" 2 "MidLow" 3 "Low";
VAL_ 703 DET_CONFD_ELEVATION_255 0 "High" 1 "MidHigh" 2 "MidLow" 3 "Low";
VAL_ 705 OBJ_TRACK_MOTION_MODEL_002 0 "INVALID" 1 "CCV" 2 "CTCA" 3 "CCA";
VAL_ 705 OBJ_MOVEMENT_STATUS_002 0 "UNKNOWN" 1 "MOVING" 2 "SLOW_MOVING" 3 "FAST_MOVING" 4 "STATIONARY" 5 "STOPPED" 6 "RESERVED1" 7 "RESERVED2";
VAL_ 705 OBJ_MEASUREMENT_STATUS_002 0 "Invalid" 1 "New" 2 "Predicted" 3 "PartlyMeasured" 4 "Measured" 5 "Occluded";
VAL_ 705 OBJ_CLS_TYPE1_002 0 "UNKNOWN_MOVING_OBJ" 1 "CAR" 2 "TRUCK" 3 "MOTOR_BIKE" 4 "BICYCLE" 5 "PEDESTRIAN" 6 "ROAD_BOUNDRY" 7 "STATIC_OBJECT" 8 "TRAFFIC_LIGHT" 9 "TRAFFIC_SIGN" 10 "TWO_WHEELERS" 11 "RESERVED" 12 "RESERVED" 14 "OBJECT_UNDETERMIND" 15 "VEHICLE_UNDETERMIND";
VAL_ 705 OBJ_CLS_TYPE2_002 0 "UNKNOWN_MOVING_OBJ" 1 "CAR" 2 "TRUCK" 3 "MOTOR_BIKE" 4 "BICYCLE" 5 "PEDESTRIAN" 6 "ROAD_BOUNDRY" 7 "STATIC_OBJECT" 8 "TRAFFIC_LIGHT" 9 "TRAFFIC_SIGN" 10 "TWO_WHEELERS" 11 "RESERVED" 12 "RESERVED" 14 "OBJECT_UNDETERMIND" 15 "VEHICLE_UNDETERMIND";
VAL_ 705 OBJ_CLS_TYPE3_002 0 "UNKNOWN_MOVING_OBJ" 1 "CAR" 2 "TRUCK" 3 "MOTOR_BIKE" 4 "BICYCLE" 5 "PEDESTRIAN" 6 "ROAD_BOUNDRY" 7 "STATIC_OBJECT" 8 "TRAFFIC_LIGHT" 9 "TRAFFIC_SIGN" 10 "TWO_WHEELERS" 11 "RESERVED" 12 "RESERVED" 14 "OBJECT_UNDETERMIND" 15 "VEHICLE_UNDETERMIND";
VAL_ 705 OBJ_CLS_TYPE4_002 0 "UNKNOWN_MOVING_OBJ" 1 "CAR" 2 "TRUCK" 3 "MOTOR_BIKE" 4 "BICYCLE" 5 "PEDESTRIAN" 6 "ROAD_BOUNDRY" 7 "STATIC_OBJECT" 8 "TRAFFIC_LIGHT" 9 "TRAFFIC_SIGN" 10 "TWO_WHEELERS" 11 "RESERVED" 12 "RESERVED" 14 "OBJECT_UNDETERMIND" 15 "VEHICLE_UNDETERMIND";
VAL_ 705 OBJ_CLS_TYPE5_002 0 "UNKNOWN_MOVING_OBJ" 1 "CAR" 2 "TRUCK" 3 "MOTOR_BIKE" 4 "BICYCLE" 5 "PEDESTRIAN" 6 "ROAD_BOUNDRY" 7 "STATIC_OBJECT" 8 "TRAFFIC_LIGHT" 9 "TRAFFIC_SIGN" 10 "TWO_WHEELERS" 11 "RESERVED" 12 "RESERVED" 14 "OBJECT_UNDETERMIND" 15 "VEHICLE_UNDETERMIND";
VAL_ 705 OBJ_CLS_TYPE6_002 0 "UNKNOWN_MOVING_OBJ" 1 "CAR" 2 "TRUCK" 3 "MOTOR_BIKE" 4 "BICYCLE" 5 "PEDESTRIAN" 6 "ROAD_BOUNDRY" 7 "STATIC_OBJECT" 8 "TRAFFIC_LIGHT" 9 "TRAFFIC_SIGN" 10 "TWO_WHEELERS" 11 "RESERVED" 12 "RESERVED" 14 "OBJECT_UNDETERMIND" 15 "VEHICLE_UNDETERMIND";
VAL_ 706 OBJ_TRACK_MOTION_MODEL_003 0 "INVALID" 1 "CCV" 2 "CTCA" 3 "CCA";
VAL_ 706 OBJ_MOVEMENT_STATUS_003 0 "UNKNOWN" 1 "MOVING" 2 "SLOW_MOVING" 3 "FAST_MOVING" 4 "STATIONARY" 5 "STOPPED" 6 "RESERVED1" 7 "RESERVED2";
VAL_ 706 OBJ_MEASUREMENT_STATUS_003 0 "Invalid" 1 "New" 2 "Predicted" 3 "PartlyMeasured" 4 "Measured" 5 "Occluded";
VAL_ 706 OBJ_CLS_TYPE1_003 0 "UNKNOWN_MOVING_OBJ" 1 "CAR" 2 "TRUCK" 3 "MOTOR_BIKE" 4 "BICYCLE" 5 "PEDESTRIAN" 6 "ROAD_BOUNDRY" 7 "STATIC_OBJECT" 8 "TRAFFIC_LIGHT" 9 "TRAFFIC_SIGN" 10 "TWO_WHEELERS" 11 "RESERVED" 12 "RESERVED" 14 "OBJECT_UNDETERMIND" 15 "VEHICLE_UNDETERMIND";
VAL_ 706 OBJ_CLS_TYPE2_003 0 "UNKNOWN_MOVING_OBJ" 1 "CAR" 2 "TRUCK" 3 "MOTOR_BIKE" 4 "BICYCLE" 5 "PEDESTRIAN" 6 "ROAD_BOUNDRY" 7 "STATIC_OBJECT" 8 "TRAFFIC_LIGHT" 9 "TRAFFIC_SIGN" 10 "TWO_WHEELERS" 11 "RESERVED" 12 "RESERVED" 14 "OBJECT_UNDETERMIND" 15 "VEHICLE_UNDETERMIND";
VAL_ 706 OBJ_CLS_TYPE3_003 0 "UNKNOWN_MOVING_OBJ" 1 "CAR" 2 "TRUCK" 3 "MOTOR_BIKE" 4 "BICYCLE" 5 "PEDESTRIAN" 6 "ROAD_BOUNDRY" 7 "STATIC_OBJECT" 8 "TRAFFIC_LIGHT" 9 "TRAFFIC_SIGN" 10 "TWO_WHEELERS" 11 "RESERVED" 12 "RESERVED" 14 "OBJECT_UNDETERMIND" 15 "VEHICLE_UNDETERMIND";
VAL_ 706 OBJ_CLS_TYPE4_003 0 "UNKNOWN_MOVING_OBJ" 1 "CAR" 2 "TRUCK" 3 "MOTOR_BIKE" 4 "BICYCLE" 5 "PEDESTRIAN" 6 "ROAD_BOUNDRY" 7 "STATIC_OBJECT" 8 "TRAFFIC_LIGHT" 9 "TRAFFIC_SIGN" 10 "TWO_WHEELERS" 11 "RESERVED" 12 "RESERVED" 14 "OBJECT_UNDETERMIND" 15 "VEHICLE_UNDETERMIND";
VAL_ 706 OBJ_CLS_TYPE5_003 0 "UNKNOWN_MOVING_OBJ" 1 "CAR" 2 "TRUCK" 3 "MOTOR_BIKE" 4 "BICYCLE" 5 "PEDESTRIAN" 6 "ROAD_BOUNDRY" 7 "STATIC_OBJECT" 8 "TRAFFIC_LIGHT" 9 "TRAFFIC_SIGN" 10 "TWO_WHEELERS" 11 "RESERVED" 12 "RESERVED" 14 "OBJECT_UNDETERMIND" 15 "VEHICLE_UNDETERMIND";
VAL_ 706 OBJ_CLS_TYPE6_003 0 "UNKNOWN_MOVING_OBJ" 1 "CAR" 2 "TRUCK" 3 "MOTOR_BIKE" 4 "BICYCLE" 5 "PEDESTRIAN" 6 "ROAD_BOUNDRY" 7 "STATIC_OBJECT" 8 "TRAFFIC_LIGHT" 9 "TRAFFIC_SIGN" 10 "TWO_WHEELERS" 11 "RESERVED" 12 "RESERVED" 14 "OBJECT_UNDETERMIND" 15 "VEHICLE_UNDETERMIND";
VAL_ 707 OBJ_TRACK_MOTION_MODEL_004 0 "INVALID" 1 "CCV" 2 "CTCA" 3 "CCA";
VAL_ 707 OBJ_MOVEMENT_STATUS_004 0 "UNKNOWN" 1 "MOVING" 2 "SLOW_MOVING" 3 "FAST_MOVING" 4 "STATIONARY" 5 "STOPPED" 6 "RESERVED1" 7 "RESERVED2";
VAL_ 707 OBJ_MEASUREMENT_STATUS_004 0 "Invalid" 1 "New" 2 "Predicted" 3 "PartlyMeasured" 4 "Measured" 5 "Occluded";
VAL_ 707 OBJ_CLS_TYPE1_004 0 "UNKNOWN_MOVING_OBJ" 1 "CAR" 2 "TRUCK" 3 "MOTOR_BIKE" 4 "BICYCLE" 5 "PEDESTRIAN" 6 "ROAD_BOUNDRY" 7 "STATIC_OBJECT" 8 "TRAFFIC_LIGHT" 9 "TRAFFIC_SIGN" 10 "TWO_WHEELERS" 11 "RESERVED" 12 "RESERVED" 14 "OBJECT_UNDETERMIND" 15 "VEHICLE_UNDETERMIND";
VAL_ 707 OBJ_CLS_TYPE2_004 0 "UNKNOWN_MOVING_OBJ" 1 "CAR" 2 "TRUCK" 3 "MOTOR_BIKE" 4 "BICYCLE" 5 "PEDESTRIAN" 6 "ROAD_BOUNDRY" 7 "STATIC_OBJECT" 8 "TRAFFIC_LIGHT" 9 "TRAFFIC_SIGN" 10 "TWO_WHEELERS" 11 "RESERVED" 12 "RESERVED" 14 "OBJECT_UNDETERMIND" 15 "VEHICLE_UNDETERMIND";
VAL_ 707 OBJ_CLS_TYPE3_004 0 "UNKNOWN_MOVING_OBJ" 1 "CAR" 2 "TRUCK" 3 "MOTOR_BIKE" 4 "BICYCLE" 5 "PEDESTRIAN" 6 "ROAD_BOUNDRY" 7 "STATIC_OBJECT" 8 "TRAFFIC_LIGHT" 9 "TRAFFIC_SIGN" 10 "TWO_WHEELERS" 11 "RESERVED" 12 "RESERVED" 14 "OBJECT_UNDETERMIND" 15 "VEHICLE_UNDETERMIND";
VAL_ 707 OBJ_CLS_TYPE4_004 0 "UNKNOWN_MOVING_OBJ" 1 "CAR" 2 "TRUCK" 3 "MOTOR_BIKE" 4 "BICYCLE" 5 "PEDESTRIAN" 6 "ROAD_BOUNDRY" 7 "STATIC_OBJECT" 8 "TRAFFIC_LIGHT" 9 "TRAFFIC_SIGN" 10 "TWO_WHEELERS" 11 "RESERVED" 12 "RESERVED" 14 "OBJECT_UNDETERMIND" 15 "VEHICLE_UNDETERMIND";
VAL_ 707 OBJ_CLS_TYPE5_004 0 "UNKNOWN_MOVING_OBJ" 1 "CAR" 2 "TRUCK" 3 "MOTOR_BIKE" 4 "BICYCLE" 5 "PEDESTRIAN" 6 "ROAD_BOUNDRY" 7 "STATIC_OBJECT" 8 "TRAFFIC_LIGHT" 9 "TRAFFIC_SIGN" 10 "TWO_WHEELERS" 11 "RESERVED" 12 "RESERVED" 14 "OBJECT_UNDETERMIND" 15 "VEHICLE_UNDETERMIND";
VAL_ 707 OBJ_CLS_TYPE6_004 0 "UNKNOWN_MOVING_OBJ" 1 "CAR" 2 "TRUCK" 3 "MOTOR_BIKE" 4 "BICYCLE" 5 "PEDESTRIAN" 6 "ROAD_BOUNDRY" 7 "STATIC_OBJECT" 8 "TRAFFIC_LIGHT" 9 "TRAFFIC_SIGN" 10 "TWO_WHEELERS" 11 "RESERVED" 12 "RESERVED" 14 "OBJECT_UNDETERMIND" 15 "VEHICLE_UNDETERMIND";
VAL_ 708 OBJ_TRACK_MOTION_MODEL_005 0 "INVALID" 1 "CCV" 2 "CTCA" 3 "CCA";
VAL_ 708 OBJ_MOVEMENT_STATUS_005 0 "UNKNOWN" 1 "MOVING" 2 "SLOW_MOVING" 3 "FAST_MOVING" 4 "STATIONARY" 5 "STOPPED" 6 "RESERVED1" 7 "RESERVED2";
VAL_ 708 OBJ_MEASUREMENT_STATUS_005 0 "Invalid" 1 "New" 2 "Predicted" 3 "PartlyMeasured" 4 "Measured" 5 "Occluded";
VAL_ 708 OBJ_CLS_TYPE1_005 0 "UNKNOWN_MOVING_OBJ" 1 "CAR" 2 "TRUCK" 3 "MOTOR_BIKE" 4 "BICYCLE" 5 "PEDESTRIAN" 6 "ROAD_BOUNDRY" 7 "STATIC_OBJECT" 8 "TRAFFIC_LIGHT" 9 "TRAFFIC_SIGN" 10 "TWO_WHEELERS" 11 "RESERVED" 12 "RESERVED" 14 "OBJECT_UNDETERMIND" 15 "VEHICLE_UNDETERMIND";
VAL_ 708 OBJ_CLS_TYPE2_005 0 "UNKNOWN_MOVING_OBJ" 1 "CAR" 2 "TRUCK" 3 "MOTOR_BIKE" 4 "BICYCLE" 5 "PEDESTRIAN" 6 "ROAD_BOUNDRY" 7 "STATIC_OBJECT" 8 "TRAFFIC_LIGHT" 9 "TRAFFIC_SIGN" 10 "TWO_WHEELERS" 11 "RESERVED" 12 "RESERVED" 14 "OBJECT_UNDETERMIND" 15 "VEHICLE_UNDETERMIND";
VAL_ 708 OBJ_CLS_TYPE3_005 0 "UNKNOWN_MOVING_OBJ" 1 "CAR" 2 "TRUCK" 3 "MOTOR_BIKE" 4 "BICYCLE" 5 "PEDESTRIAN" 6 "ROAD_BOUNDRY" 7 "STATIC_OBJECT" 8 "TRAFFIC_LIGHT" 9 "TRAFFIC_SIGN" 10 "TWO_WHEELERS" 11 "RESERVED" 12 "RESERVED" 14 "OBJECT_UNDETERMIND" 15 "VEHICLE_UNDETERMIND";
VAL_ 708 OBJ_CLS_TYPE4_005 0 "UNKNOWN_MOVING_OBJ" 1 "CAR" 2 "TRUCK" 3 "MOTOR_BIKE" 4 "BICYCLE" 5 "PEDESTRIAN" 6 "ROAD_BOUNDRY" 7 "STATIC_OBJECT" 8 "TRAFFIC_LIGHT" 9 "TRAFFIC_SIGN" 10 "TWO_WHEELERS" 11 "RESERVED" 12 "RESERVED" 14 "OBJECT_UNDETERMIND" 15 "VEHICLE_UNDETERMIND";
VAL_ 708 OBJ_CLS_TYPE5_005 0 "UNKNOWN_MOVING_OBJ" 1 "CAR" 2 "TRUCK" 3 "MOTOR_BIKE" 4 "BICYCLE" 5 "PEDESTRIAN" 6 "ROAD_BOUNDRY" 7 "STATIC_OBJECT" 8 "TRAFFIC_LIGHT" 9 "TRAFFIC_SIGN" 10 "TWO_WHEELERS" 11 "RESERVED" 12 "RESERVED" 14 "OBJECT_UNDETERMIND" 15 "VEHICLE_UNDETERMIND";
VAL_ 708 OBJ_CLS_TYPE6_005 0 "UNKNOWN_MOVING_OBJ" 1 "CAR" 2 "TRUCK" 3 "MOTOR_BIKE" 4 "BICYCLE" 5 "PEDESTRIAN" 6 "ROAD_BOUNDRY" 7 "STATIC_OBJECT" 8 "TRAFFIC_LIGHT" 9 "TRAFFIC_SIGN" 10 "TWO_WHEELERS" 11 "RESERVED" 12 "RESERVED" 14 "OBJECT_UNDETERMIND" 15 "VEHICLE_UNDETERMIND";
VAL_ 709 OBJ_TRACK_MOTION_MODEL_006 0 "INVALID" 1 "CCV" 2 "CTCA" 3 "CCA";
VAL_ 709 OBJ_MOVEMENT_STATUS_006 0 "UNKNOWN" 1 "MOVING" 2 "SLOW_MOVING" 3 "FAST_MOVING" 4 "STATIONARY" 5 "STOPPED" 6 "RESERVED1" 7 "RESERVED2";
VAL_ 709 OBJ_MEASUREMENT_STATUS_006 0 "Invalid" 1 "New" 2 "Predicted" 3 "PartlyMeasured" 4 "Measured" 5 "Occluded";
VAL_ 709 OBJ_CLS_TYPE1_006 0 "UNKNOWN_MOVING_OBJ" 1 "CAR" 2 "TRUCK" 3 "MOTOR_BIKE" 4 "BICYCLE" 5 "PEDESTRIAN" 6 "ROAD_BOUNDRY" 7 "STATIC_OBJECT" 8 "TRAFFIC_LIGHT" 9 "TRAFFIC_SIGN" 10 "TWO_WHEELERS" 11 "RESERVED" 12 "RESERVED" 14 "OBJECT_UNDETERMIND" 15 "VEHICLE_UNDETERMIND";
VAL_ 709 OBJ_CLS_TYPE2_006 0 "UNKNOWN_MOVING_OBJ" 1 "CAR" 2 "TRUCK" 3 "MOTOR_BIKE" 4 "BICYCLE" 5 "PEDESTRIAN" 6 "ROAD_BOUNDRY" 7 "STATIC_OBJECT" 8 "TRAFFIC_LIGHT" 9 "TRAFFIC_SIGN" 10 "TWO_WHEELERS" 11 "RESERVED" 12 "RESERVED" 14 "OBJECT_UNDETERMIND" 15 "VEHICLE_UNDETERMIND";
VAL_ 709 OBJ_CLS_TYPE3_006 0 "UNKNOWN_MOVING_OBJ" 1 "CAR" 2 "TRUCK" 3 "MOTOR_BIKE" 4 "BICYCLE" 5 "PEDESTRIAN" 6 "ROAD_BOUNDRY" 7 "STATIC_OBJECT" 8 "TRAFFIC_LIGHT" 9 "TRAFFIC_SIGN" 10 "TWO_WHEELERS" 11 "RESERVED" 12 "RESERVED" 14 "OBJECT_UNDETERMIND" 15 "VEHICLE_UNDETERMIND";
VAL_ 709 OBJ_CLS_TYPE4_006 0 "UNKNOWN_MOVING_OBJ" 1 "CAR" 2 "TRUCK" 3 "MOTOR_BIKE" 4 "BICYCLE" 5 "PEDESTRIAN" 6 "ROAD_BOUNDRY" 7 "STATIC_OBJECT" 8 "TRAFFIC_LIGHT" 9 "TRAFFIC_SIGN" 10 "TWO_WHEELERS" 11 "RESERVED" 12 "RESERVED" 14 "OBJECT_UNDETERMIND" 15 "VEHICLE_UNDETERMIND";
VAL_ 709 OBJ_CLS_TYPE5_006 0 "UNKNOWN_MOVING_OBJ" 1 "CAR" 2 "TRUCK" 3 "MOTOR_BIKE" 4 "BICYCLE" 5 "PEDESTRIAN" 6 "ROAD_BOUNDRY" 7 "STATIC_OBJECT" 8 "TRAFFIC_LIGHT" 9 "TRAFFIC_SIGN" 10 "TWO_WHEELERS" 11 "RESERVED" 12 "RESERVED" 14 "OBJECT_UNDETERMIND" 15 "VEHICLE_UNDETERMIND";
VAL_ 709 OBJ_CLS_TYPE6_006 0 "UNKNOWN_MOVING_OBJ" 1 "CAR" 2 "TRUCK" 3 "MOTOR_BIKE" 4 "BICYCLE" 5 "PEDESTRIAN" 6 "ROAD_BOUNDRY" 7 "STATIC_OBJECT" 8 "TRAFFIC_LIGHT" 9 "TRAFFIC_SIGN" 10 "TWO_WHEELERS" 11 "RESERVED" 12 "RESERVED" 14 "OBJECT_UNDETERMIND" 15 "VEHICLE_UNDETERMIND";
VAL_ 710 OBJ_TRACK_MOTION_MODEL_007 0 "INVALID" 1 "CCV" 2 "CTCA" 3 "CCA";
VAL_ 710 OBJ_MOVEMENT_STATUS_007 0 "UNKNOWN" 1 "MOVING" 2 "SLOW_MOVING" 3 "FAST_MOVING" 4 "STATIONARY" 5 "STOPPED" 6 "RESERVED1" 7 "RESERVED2";
VAL_ 710 OBJ_MEASUREMENT_STATUS_007 0 "Invalid" 1 "New" 2 "Predicted" 3 "PartlyMeasured" 4 "Measured" 5 "Occluded";
VAL_ 710 OBJ_CLS_TYPE1_007 0 "UNKNOWN_MOVING_OBJ" 1 "CAR" 2 "TRUCK" 3 "MOTOR_BIKE" 4 "BICYCLE" 5 "PEDESTRIAN" 6 "ROAD_BOUNDRY" 7 "STATIC_OBJECT" 8 "TRAFFIC_LIGHT" 9 "TRAFFIC_SIGN" 10 "TWO_WHEELERS" 11 "RESERVED" 12 "RESERVED" 14 "OBJECT_UNDETERMIND" 15 "VEHICLE_UNDETERMIND";
VAL_ 710 OBJ_CLS_TYPE2_007 0 "UNKNOWN_MOVING_OBJ" 1 "CAR" 2 "TRUCK" 3 "MOTOR_BIKE" 4 "BICYCLE" 5 "PEDESTRIAN" 6 "ROAD_BOUNDRY" 7 "STATIC_OBJECT" 8 "TRAFFIC_LIGHT" 9 "TRAFFIC_SIGN" 10 "TWO_WHEELERS" 11 "RESERVED" 12 "RESERVED" 14 "OBJECT_UNDETERMIND" 15 "VEHICLE_UNDETERMIND";
VAL_ 710 OBJ_CLS_TYPE3_007 0 "UNKNOWN_MOVING_OBJ" 1 "CAR" 2 "TRUCK" 3 "MOTOR_BIKE" 4 "BICYCLE" 5 "PEDESTRIAN" 6 "ROAD_BOUNDRY" 7 "STATIC_OBJECT" 8 "TRAFFIC_LIGHT" 9 "TRAFFIC_SIGN" 10 "TWO_WHEELERS" 11 "RESERVED" 12 "RESERVED" 14 "OBJECT_UNDETERMIND" 15 "VEHICLE_UNDETERMIND";
VAL_ 710 OBJ_CLS_TYPE4_007 0 "UNKNOWN_MOVING_OBJ" 1 "CAR" 2 "TRUCK" 3 "MOTOR_BIKE" 4 "BICYCLE" 5 "PEDESTRIAN" 6 "ROAD_BOUNDRY" 7 "STATIC_OBJECT" 8 "TRAFFIC_LIGHT" 9 "TRAFFIC_SIGN" 10 "TWO_WHEELERS" 11 "RESERVED" 12 "RESERVED" 14 "OBJECT_UNDETERMIND" 15 "VEHICLE_UNDETERMIND";
VAL_ 710 OBJ_CLS_TYPE5_007 0 "UNKNOWN_MOVING_OBJ" 1 "CAR" 2 "TRUCK" 3 "MOTOR_BIKE" 4 "BICYCLE" 5 "PEDESTRIAN" 6 "ROAD_BOUNDRY" 7 "STATIC_OBJECT" 8 "TRAFFIC_LIGHT" 9 "TRAFFIC_SIGN" 10 "TWO_WHEELERS" 11 "RESERVED" 12 "RESERVED" 14 "OBJECT_UNDETERMIND" 15 "VEHICLE_UNDETERMIND";
VAL_ 710 OBJ_CLS_TYPE6_007 0 "UNKNOWN_MOVING_OBJ" 1 "CAR" 2 "TRUCK" 3 "MOTOR_BIKE" 4 "BICYCLE" 5 "PEDESTRIAN" 6 "ROAD_BOUNDRY" 7 "STATIC_OBJECT" 8 "TRAFFIC_LIGHT" 9 "TRAFFIC_SIGN" 10 "TWO_WHEELERS" 11 "RESERVED" 12 "RESERVED" 14 "OBJECT_UNDETERMIND" 15 "VEHICLE_UNDETERMIND";
VAL_ 711 OBJ_TRACK_MOTION_MODEL_008 0 "INVALID" 1 "CCV" 2 "CTCA" 3 "CCA";
VAL_ 711 OBJ_MOVEMENT_STATUS_008 0 "UNKNOWN" 1 "MOVING" 2 "SLOW_MOVING" 3 "FAST_MOVING" 4 "STATIONARY" 5 "STOPPED" 6 "RESERVED1" 7 "RESERVED2";
VAL_ 711 OBJ_MEASUREMENT_STATUS_008 0 "Invalid" 1 "New" 2 "Predicted" 3 "PartlyMeasured" 4 "Measured" 5 "Occluded";
VAL_ 711 OBJ_CLS_TYPE1_008 0 "UNKNOWN_MOVING_OBJ" 1 "CAR" 2 "TRUCK" 3 "MOTOR_BIKE" 4 "BICYCLE" 5 "PEDESTRIAN" 6 "ROAD_BOUNDRY" 7 "STATIC_OBJECT" 8 "TRAFFIC_LIGHT" 9 "TRAFFIC_SIGN" 10 "TWO_WHEELERS" 11 "RESERVED" 12 "RESERVED" 14 "OBJECT_UNDETERMIND" 15 "VEHICLE_UNDETERMIND";
VAL_ 711 OBJ_CLS_TYPE2_008 0 "UNKNOWN_MOVING_OBJ" 1 "CAR" 2 "TRUCK" 3 "MOTOR_BIKE" 4 "BICYCLE" 5 "PEDESTRIAN" 6 "ROAD_BOUNDRY" 7 "STATIC_OBJECT" 8 "TRAFFIC_LIGHT" 9 "TRAFFIC_SIGN" 10 "TWO_WHEELERS" 11 "RESERVED" 12 "RESERVED" 14 "OBJECT_UNDETERMIND" 15 "VEHICLE_UNDETERMIND";
VAL_ 711 OBJ_CLS_TYPE3_008 0 "UNKNOWN_MOVING_OBJ" 1 "CAR" 2 "TRUCK" 3 "MOTOR_BIKE" 4 "BICYCLE" 5 "PEDESTRIAN" 6 "ROAD_BOUNDRY" 7 "STATIC_OBJECT" 8 "TRAFFIC_LIGHT" 9 "TRAFFIC_SIGN" 10 "TWO_WHEELERS" 11 "RESERVED" 12 "RESERVED" 14 "OBJECT_UNDETERMIND" 15 "VEHICLE_UNDETERMIND";
VAL_ 711 OBJ_CLS_TYPE4_008 0 "UNKNOWN_MOVING_OBJ" 1 "CAR" 2 "TRUCK" 3 "MOTOR_BIKE" 4 "BICYCLE" 5 "PEDESTRIAN" 6 "ROAD_BOUNDRY" 7 "STATIC_OBJECT" 8 "TRAFFIC_LIGHT" 9 "TRAFFIC_SIGN" 10 "TWO_WHEELERS" 11 "RESERVED" 12 "RESERVED" 14 "OBJECT_UNDETERMIND" 15 "VEHICLE_UNDETERMIND";
VAL_ 711 OBJ_CLS_TYPE5_008 0 "UNKNOWN_MOVING_OBJ" 1 "CAR" 2 "TRUCK" 3 "MOTOR_BIKE" 4 "BICYCLE" 5 "PEDESTRIAN" 6 "ROAD_BOUNDRY" 7 "STATIC_OBJECT" 8 "TRAFFIC_LIGHT" 9 "TRAFFIC_SIGN" 10 "TWO_WHEELERS" 11 "RESERVED" 12 "RESERVED" 14 "OBJECT_UNDETERMIND" 15 "VEHICLE_UNDETERMIND";
VAL_ 711 OBJ_CLS_TYPE6_008 0 "UNKNOWN_MOVING_OBJ" 1 "CAR" 2 "TRUCK" 3 "MOTOR_BIKE" 4 "BICYCLE" 5 "PEDESTRIAN" 6 "ROAD_BOUNDRY" 7 "STATIC_OBJECT" 8 "TRAFFIC_LIGHT" 9 "TRAFFIC_SIGN" 10 "TWO_WHEELERS" 11 "RESERVED" 12 "RESERVED" 14 "OBJECT_UNDETERMIND" 15 "VEHICLE_UNDETERMIND";
VAL_ 712 OBJ_TRACK_MOTION_MODEL_009 0 "INVALID" 1 "CCV" 2 "CTCA" 3 "CCA";
VAL_ 712 OBJ_MOVEMENT_STATUS_009 0 "UNKNOWN" 1 "MOVING" 2 "SLOW_MOVING" 3 "FAST_MOVING" 4 "STATIONARY" 5 "STOPPED" 6 "RESERVED1" 7 "RESERVED2";
VAL_ 712 OBJ_MEASUREMENT_STATUS_009 0 "Invalid" 1 "New" 2 "Predicted" 3 "PartlyMeasured" 4 "Measured" 5 "Occluded";
VAL_ 712 OBJ_CLS_TYPE1_009 0 "UNKNOWN_MOVING_OBJ" 1 "CAR" 2 "TRUCK" 3 "MOTOR_BIKE" 4 "BICYCLE" 5 "PEDESTRIAN" 6 "ROAD_BOUNDRY" 7 "STATIC_OBJECT" 8 "TRAFFIC_LIGHT" 9 "TRAFFIC_SIGN" 10 "TWO_WHEELERS" 11 "RESERVED" 12 "RESERVED" 14 "OBJECT_UNDETERMIND" 15 "VEHICLE_UNDETERMIND";
VAL_ 712 OBJ_CLS_TYPE2_009 0 "UNKNOWN_MOVING_OBJ" 1 "CAR" 2 "TRUCK" 3 "MOTOR_BIKE" 4 "BICYCLE" 5 "PEDESTRIAN" 6 "ROAD_BOUNDRY" 7 "STATIC_OBJECT" 8 "TRAFFIC_LIGHT" 9 "TRAFFIC_SIGN" 10 "TWO_WHEELERS" 11 "RESERVED" 12 "RESERVED" 14 "OBJECT_UNDETERMIND" 15 "VEHICLE_UNDETERMIND";
VAL_ 712 OBJ_CLS_TYPE3_009 0 "UNKNOWN_MOVING_OBJ" 1 "CAR" 2 "TRUCK" 3 "MOTOR_BIKE" 4 "BICYCLE" 5 "PEDESTRIAN" 6 "ROAD_BOUNDRY" 7 "STATIC_OBJECT" 8 "TRAFFIC_LIGHT" 9 "TRAFFIC_SIGN" 10 "TWO_WHEELERS" 11 "RESERVED" 12 "RESERVED" 14 "OBJECT_UNDETERMIND" 15 "VEHICLE_UNDETERMIND";
VAL_ 712 OBJ_CLS_TYPE4_009 0 "UNKNOWN_MOVING_OBJ" 1 "CAR" 2 "TRUCK" 3 "MOTOR_BIKE" 4 "BICYCLE" 5 "PEDESTRIAN" 6 "ROAD_BOUNDRY" 7 "STATIC_OBJECT" 8 "TRAFFIC_LIGHT" 9 "TRAFFIC_SIGN" 10 "TWO_WHEELERS" 11 "RESERVED" 12 "RESERVED" 14 "OBJECT_UNDETERMIND" 15 "VEHICLE_UNDETERMIND";
VAL_ 712 OBJ_CLS_TYPE5_009 0 "UNKNOWN_MOVING_OBJ" 1 "CAR" 2 "TRUCK" 3 "MOTOR_BIKE" 4 "BICYCLE" 5 "PEDESTRIAN" 6 "ROAD_BOUNDRY" 7 "STATIC_OBJECT" 8 "TRAFFIC_LIGHT" 9 "TRAFFIC_SIGN" 10 "TWO_WHEELERS" 11 "RESERVED" 12 "RESERVED" 14 "OBJECT_UNDETERMIND" 15 "VEHICLE_UNDETERMIND";
VAL_ 712 OBJ_CLS_TYPE6_009 0 "UNKNOWN_MOVING_OBJ" 1 "CAR" 2 "TRUCK" 3 "MOTOR_BIKE" 4 "BICYCLE" 5 "PEDESTRIAN" 6 "ROAD_BOUNDRY" 7 "STATIC_OBJECT" 8 "TRAFFIC_LIGHT" 9 "TRAFFIC_SIGN" 10 "TWO_WHEELERS" 11 "RESERVED" 12 "RESERVED" 14 "OBJECT_UNDETERMIND" 15 "VEHICLE_UNDETERMIND";
VAL_ 713 OBJ_TRACK_MOTION_MODEL_010 0 "INVALID" 1 "CCV" 2 "CTCA" 3 "CCA";
VAL_ 713 OBJ_MOVEMENT_STATUS_010 0 "UNKNOWN" 1 "MOVING" 2 "SLOW_MOVING" 3 "FAST_MOVING" 4 "STATIONARY" 5 "STOPPED" 6 "RESERVED1" 7 "RESERVED2";
VAL_ 713 OBJ_MEASUREMENT_STATUS_010 0 "Invalid" 1 "New" 2 "Predicted" 3 "PartlyMeasured" 4 "Measured" 5 "Occluded";
VAL_ 713 OBJ_CLS_TYPE1_010 0 "UNKNOWN_MOVING_OBJ" 1 "CAR" 2 "TRUCK" 3 "MOTOR_BIKE" 4 "BICYCLE" 5 "PEDESTRIAN" 6 "ROAD_BOUNDRY" 7 "STATIC_OBJECT" 8 "TRAFFIC_LIGHT" 9 "TRAFFIC_SIGN" 10 "TWO_WHEELERS" 11 "RESERVED" 12 "RESERVED" 14 "OBJECT_UNDETERMIND" 15 "VEHICLE_UNDETERMIND";
VAL_ 713 OBJ_CLS_TYPE2_010 0 "UNKNOWN_MOVING_OBJ" 1 "CAR" 2 "TRUCK" 3 "MOTOR_BIKE" 4 "BICYCLE" 5 "PEDESTRIAN" 6 "ROAD_BOUNDRY" 7 "STATIC_OBJECT" 8 "TRAFFIC_LIGHT" 9 "TRAFFIC_SIGN" 10 "TWO_WHEELERS" 11 "RESERVED" 12 "RESERVED" 14 "OBJECT_UNDETERMIND" 15 "VEHICLE_UNDETERMIND";
VAL_ 713 OBJ_CLS_TYPE3_010 0 "UNKNOWN_MOVING_OBJ" 1 "CAR" 2 "TRUCK" 3 "MOTOR_BIKE" 4 "BICYCLE" 5 "PEDESTRIAN" 6 "ROAD_BOUNDRY" 7 "STATIC_OBJECT" 8 "TRAFFIC_LIGHT" 9 "TRAFFIC_SIGN" 10 "TWO_WHEELERS" 11 "RESERVED" 12 "RESERVED" 14 "OBJECT_UNDETERMIND" 15 "VEHICLE_UNDETERMIND";
VAL_ 713 OBJ_CLS_TYPE4_010 0 "UNKNOWN_MOVING_OBJ" 1 "CAR" 2 "TRUCK" 3 "MOTOR_BIKE" 4 "BICYCLE" 5 "PEDESTRIAN" 6 "ROAD_BOUNDRY" 7 "STATIC_OBJECT" 8 "TRAFFIC_LIGHT" 9 "TRAFFIC_SIGN" 10 "TWO_WHEELERS" 11 "RESERVED" 12 "RESERVED" 14 "OBJECT_UNDETERMIND" 15 "VEHICLE_UNDETERMIND";
VAL_ 713 OBJ_CLS_TYPE5_010 0 "UNKNOWN_MOVING_OBJ" 1 "CAR" 2 "TRUCK" 3 "MOTOR_BIKE" 4 "BICYCLE" 5 "PEDESTRIAN" 6 "ROAD_BOUNDRY" 7 "STATIC_OBJECT" 8 "TRAFFIC_LIGHT" 9 "TRAFFIC_SIGN" 10 "TWO_WHEELERS" 11 "RESERVED" 12 "RESERVED" 14 "OBJECT_UNDETERMIND" 15 "VEHICLE_UNDETERMIND";
VAL_ 713 OBJ_CLS_TYPE6_010 0 "UNKNOWN_MOVING_OBJ" 1 "CAR" 2 "TRUCK" 3 "MOTOR_BIKE" 4 "BICYCLE" 5 "PEDESTRIAN" 6 "ROAD_BOUNDRY" 7 "STATIC_OBJECT" 8 "TRAFFIC_LIGHT" 9 "TRAFFIC_SIGN" 10 "TWO_WHEELERS" 11 "RESERVED" 12 "RESERVED" 14 "OBJECT_UNDETERMIND" 15 "VEHICLE_UNDETERMIND";
VAL_ 714 OBJ_TRACK_MOTION_MODEL_011 0 "INVALID" 1 "CCV" 2 "CTCA" 3 "CCA";
VAL_ 714 OBJ_MOVEMENT_STATUS_011 0 "UNKNOWN" 1 "MOVING" 2 "SLOW_MOVING" 3 "FAST_MOVING" 4 "STATIONARY" 5 "STOPPED" 6 "RESERVED1" 7 "RESERVED2";
VAL_ 714 OBJ_MEASUREMENT_STATUS_011 0 "Invalid" 1 "New" 2 "Predicted" 3 "PartlyMeasured" 4 "Measured" 5 "Occluded";
VAL_ 714 OBJ_CLS_TYPE1_011 0 "UNKNOWN_MOVING_OBJ" 1 "CAR" 2 "TRUCK" 3 "MOTOR_BIKE" 4 "BICYCLE" 5 "PEDESTRIAN" 6 "ROAD_BOUNDRY" 7 "STATIC_OBJECT" 8 "TRAFFIC_LIGHT" 9 "TRAFFIC_SIGN" 10 "TWO_WHEELERS" 11 "RESERVED" 12 "RESERVED" 14 "OBJECT_UNDETERMIND" 15 "VEHICLE_UNDETERMIND";
VAL_ 714 OBJ_CLS_TYPE2_011 0 "UNKNOWN_MOVING_OBJ" 1 "CAR" 2 "TRUCK" 3 "MOTOR_BIKE" 4 "BICYCLE" 5 "PEDESTRIAN" 6 "ROAD_BOUNDRY" 7 "STATIC_OBJECT" 8 "TRAFFIC_LIGHT" 9 "TRAFFIC_SIGN" 10 "TWO_WHEELERS" 11 "RESERVED" 12 "RESERVED" 14 "OBJECT_UNDETERMIND" 15 "VEHICLE_UNDETERMIND";
VAL_ 714 OBJ_CLS_TYPE3_011 0 "UNKNOWN_MOVING_OBJ" 1 "CAR" 2 "TRUCK" 3 "MOTOR_BIKE" 4 "BICYCLE" 5 "PEDESTRIAN" 6 "ROAD_BOUNDRY" 7 "STATIC_OBJECT" 8 "TRAFFIC_LIGHT" 9 "TRAFFIC_SIGN" 10 "TWO_WHEELERS" 11 "RESERVED" 12 "RESERVED" 14 "OBJECT_UNDETERMIND" 15 "VEHICLE_UNDETERMIND";
VAL_ 714 OBJ_CLS_TYPE4_011 0 "UNKNOWN_MOVING_OBJ" 1 "CAR" 2 "TRUCK" 3 "MOTOR_BIKE" 4 "BICYCLE" 5 "PEDESTRIAN" 6 "ROAD_BOUNDRY" 7 "STATIC_OBJECT" 8 "TRAFFIC_LIGHT" 9 "TRAFFIC_SIGN" 10 "TWO_WHEELERS" 11 "RESERVED" 12 "RESERVED" 14 "OBJECT_UNDETERMIND" 15 "VEHICLE_UNDETERMIND";
VAL_ 714 OBJ_CLS_TYPE5_011 0 "UNKNOWN_MOVING_OBJ" 1 "CAR" 2 "TRUCK" 3 "MOTOR_BIKE" 4 "BICYCLE" 5 "PEDESTRIAN" 6 "ROAD_BOUNDRY" 7 "STATIC_OBJECT" 8 "TRAFFIC_LIGHT" 9 "TRAFFIC_SIGN" 10 "TWO_WHEELERS" 11 "RESERVED" 12 "RESERVED" 14 "OBJECT_UNDETERMIND" 15 "VEHICLE_UNDETERMIND";
VAL_ 714 OBJ_CLS_TYPE6_011 0 "UNKNOWN_MOVING_OBJ" 1 "CAR" 2 "TRUCK" 3 "MOTOR_BIKE" 4 "BICYCLE" 5 "PEDESTRIAN" 6 "ROAD_BOUNDRY" 7 "STATIC_OBJECT" 8 "TRAFFIC_LIGHT" 9 "TRAFFIC_SIGN" 10 "TWO_WHEELERS" 11 "RESERVED" 12 "RESERVED" 14 "OBJECT_UNDETERMIND" 15 "VEHICLE_UNDETERMIND";
VAL_ 715 OBJ_TRACK_MOTION_MODEL_012 0 "INVALID" 1 "CCV" 2 "CTCA" 3 "CCA";
VAL_ 715 OBJ_MOVEMENT_STATUS_012 0 "UNKNOWN" 1 "MOVING" 2 "SLOW_MOVING" 3 "FAST_MOVING" 4 "STATIONARY" 5 "STOPPED" 6 "RESERVED1" 7 "RESERVED2";
VAL_ 715 OBJ_MEASUREMENT_STATUS_012 0 "Invalid" 1 "New" 2 "Predicted" 3 "PartlyMeasured" 4 "Measured" 5 "Occluded";
VAL_ 715 OBJ_CLS_TYPE1_012 0 "UNKNOWN_MOVING_OBJ" 1 "CAR" 2 "TRUCK" 3 "MOTOR_BIKE" 4 "BICYCLE" 5 "PEDESTRIAN" 6 "ROAD_BOUNDRY" 7 "STATIC_OBJECT" 8 "TRAFFIC_LIGHT" 9 "TRAFFIC_SIGN" 10 "TWO_WHEELERS" 11 "RESERVED" 12 "RESERVED" 14 "OBJECT_UNDETERMIND" 15 "VEHICLE_UNDETERMIND";
VAL_ 715 OBJ_CLS_TYPE2_012 0 "UNKNOWN_MOVING_OBJ" 1 "CAR" 2 "TRUCK" 3 "MOTOR_BIKE" 4 "BICYCLE" 5 "PEDESTRIAN" 6 "ROAD_BOUNDRY" 7 "STATIC_OBJECT" 8 "TRAFFIC_LIGHT" 9 "TRAFFIC_SIGN" 10 "TWO_WHEELERS" 11 "RESERVED" 12 "RESERVED" 14 "OBJECT_UNDETERMIND" 15 "VEHICLE_UNDETERMIND";
VAL_ 715 OBJ_CLS_TYPE3_012 0 "UNKNOWN_MOVING_OBJ" 1 "CAR" 2 "TRUCK" 3 "MOTOR_BIKE" 4 "BICYCLE" 5 "PEDESTRIAN" 6 "ROAD_BOUNDRY" 7 "STATIC_OBJECT" 8 "TRAFFIC_LIGHT" 9 "TRAFFIC_SIGN" 10 "TWO_WHEELERS" 11 "RESERVED" 12 "RESERVED" 14 "OBJECT_UNDETERMIND" 15 "VEHICLE_UNDETERMIND";
VAL_ 715 OBJ_CLS_TYPE4_012 0 "UNKNOWN_MOVING_OBJ" 1 "CAR" 2 "TRUCK" 3 "MOTOR_BIKE" 4 "BICYCLE" 5 "PEDESTRIAN" 6 "ROAD_BOUNDRY" 7 "STATIC_OBJECT" 8 "TRAFFIC_LIGHT" 9 "TRAFFIC_SIGN" 10 "TWO_WHEELERS" 11 "RESERVED" 12 "RESERVED" 14 "OBJECT_UNDETERMIND" 15 "VEHICLE_UNDETERMIND";
VAL_ 715 OBJ_CLS_TYPE5_012 0 "UNKNOWN_MOVING_OBJ" 1 "CAR" 2 "TRUCK" 3 "MOTOR_BIKE" 4 "BICYCLE" 5 "PEDESTRIAN" 6 "ROAD_BOUNDRY" 7 "STATIC_OBJECT" 8 "TRAFFIC_LIGHT" 9 "TRAFFIC_SIGN" 10 "TWO_WHEELERS" 11 "RESERVED" 12 "RESERVED" 14 "OBJECT_UNDETERMIND" 15 "VEHICLE_UNDETERMIND";
VAL_ 715 OBJ_CLS_TYPE6_012 0 "UNKNOWN_MOVING_OBJ" 1 "CAR" 2 "TRUCK" 3 "MOTOR_BIKE" 4 "BICYCLE" 5 "PEDESTRIAN" 6 "ROAD_BOUNDRY" 7 "STATIC_OBJECT" 8 "TRAFFIC_LIGHT" 9 "TRAFFIC_SIGN" 10 "TWO_WHEELERS" 11 "RESERVED" 12 "RESERVED" 14 "OBJECT_UNDETERMIND" 15 "VEHICLE_UNDETERMIND";
VAL_ 716 OBJ_TRACK_MOTION_MODEL_013 0 "INVALID" 1 "CCV" 2 "CTCA" 3 "CCA";
VAL_ 716 OBJ_MOVEMENT_STATUS_013 0 "UNKNOWN" 1 "MOVING" 2 "SLOW_MOVING" 3 "FAST_MOVING" 4 "STATIONARY" 5 "STOPPED" 6 "RESERVED1" 7 "RESERVED2";
VAL_ 716 OBJ_MEASUREMENT_STATUS_013 0 "Invalid" 1 "New" 2 "Predicted" 3 "PartlyMeasured" 4 "Measured" 5 "Occluded";
VAL_ 716 OBJ_CLS_TYPE1_013 0 "UNKNOWN_MOVING_OBJ" 1 "CAR" 2 "TRUCK" 3 "MOTOR_BIKE" 4 "BICYCLE" 5 "PEDESTRIAN" 6 "ROAD_BOUNDRY" 7 "STATIC_OBJECT" 8 "TRAFFIC_LIGHT" 9 "TRAFFIC_SIGN" 10 "TWO_WHEELERS" 11 "RESERVED" 12 "RESERVED" 14 "OBJECT_UNDETERMIND" 15 "VEHICLE_UNDETERMIND";
VAL_ 716 OBJ_CLS_TYPE2_013 0 "UNKNOWN_MOVING_OBJ" 1 "CAR" 2 "TRUCK" 3 "MOTOR_BIKE" 4 "BICYCLE" 5 "PEDESTRIAN" 6 "ROAD_BOUNDRY" 7 "STATIC_OBJECT" 8 "TRAFFIC_LIGHT" 9 "TRAFFIC_SIGN" 10 "TWO_WHEELERS" 11 "RESERVED" 12 "RESERVED" 14 "OBJECT_UNDETERMIND" 15 "VEHICLE_UNDETERMIND";
VAL_ 716 OBJ_CLS_TYPE3_013 0 "UNKNOWN_MOVING_OBJ" 1 "CAR" 2 "TRUCK" 3 "MOTOR_BIKE" 4 "BICYCLE" 5 "PEDESTRIAN" 6 "ROAD_BOUNDRY" 7 "STATIC_OBJECT" 8 "TRAFFIC_LIGHT" 9 "TRAFFIC_SIGN" 10 "TWO_WHEELERS" 11 "RESERVED" 12 "RESERVED" 14 "OBJECT_UNDETERMIND" 15 "VEHICLE_UNDETERMIND";
VAL_ 716 OBJ_CLS_TYPE4_013 0 "UNKNOWN_MOVING_OBJ" 1 "CAR" 2 "TRUCK" 3 "MOTOR_BIKE" 4 "BICYCLE" 5 "PEDESTRIAN" 6 "ROAD_BOUNDRY" 7 "STATIC_OBJECT" 8 "TRAFFIC_LIGHT" 9 "TRAFFIC_SIGN" 10 "TWO_WHEELERS" 11 "RESERVED" 12 "RESERVED" 14 "OBJECT_UNDETERMIND" 15 "VEHICLE_UNDETERMIND";
VAL_ 716 OBJ_CLS_TYPE5_013 0 "UNKNOWN_MOVING_OBJ" 1 "CAR" 2 "TRUCK" 3 "MOTOR_BIKE" 4 "BICYCLE" 5 "PEDESTRIAN" 6 "ROAD_BOUNDRY" 7 "STATIC_OBJECT" 8 "TRAFFIC_LIGHT" 9 "TRAFFIC_SIGN" 10 "TWO_WHEELERS" 11 "RESERVED" 12 "RESERVED" 14 "OBJECT_UNDETERMIND" 15 "VEHICLE_UNDETERMIND";
VAL_ 716 OBJ_CLS_TYPE6_013 0 "UNKNOWN_MOVING_OBJ" 1 "CAR" 2 "TRUCK" 3 "MOTOR_BIKE" 4 "BICYCLE" 5 "PEDESTRIAN" 6 "ROAD_BOUNDRY" 7 "STATIC_OBJECT" 8 "TRAFFIC_LIGHT" 9 "TRAFFIC_SIGN" 10 "TWO_WHEELERS" 11 "RESERVED" 12 "RESERVED" 14 "OBJECT_UNDETERMIND" 15 "VEHICLE_UNDETERMIND";
VAL_ 717 OBJ_TRACK_MOTION_MODEL_014 0 "INVALID" 1 "CCV" 2 "CTCA" 3 "CCA";
VAL_ 717 OBJ_MOVEMENT_STATUS_014 0 "UNKNOWN" 1 "MOVING" 2 "SLOW_MOVING" 3 "FAST_MOVING" 4 "STATIONARY" 5 "STOPPED" 6 "RESERVED1" 7 "RESERVED2";
VAL_ 717 OBJ_MEASUREMENT_STATUS_014 0 "Invalid" 1 "New" 2 "Predicted" 3 "PartlyMeasured" 4 "Measured" 5 "Occluded";
VAL_ 717 OBJ_CLS_TYPE1_014 0 "UNKNOWN_MOVING_OBJ" 1 "CAR" 2 "TRUCK" 3 "MOTOR_BIKE" 4 "BICYCLE" 5 "PEDESTRIAN" 6 "ROAD_BOUNDRY" 7 "STATIC_OBJECT" 8 "TRAFFIC_LIGHT" 9 "TRAFFIC_SIGN" 10 "TWO_WHEELERS" 11 "RESERVED" 12 "RESERVED" 14 "OBJECT_UNDETERMIND" 15 "VEHICLE_UNDETERMIND";
VAL_ 717 OBJ_CLS_TYPE2_014 0 "UNKNOWN_MOVING_OBJ" 1 "CAR" 2 "TRUCK" 3 "MOTOR_BIKE" 4 "BICYCLE" 5 "PEDESTRIAN" 6 "ROAD_BOUNDRY" 7 "STATIC_OBJECT" 8 "TRAFFIC_LIGHT" 9 "TRAFFIC_SIGN" 10 "TWO_WHEELERS" 11 "RESERVED" 12 "RESERVED" 14 "OBJECT_UNDETERMIND" 15 "VEHICLE_UNDETERMIND";
VAL_ 717 OBJ_CLS_TYPE3_014 0 "UNKNOWN_MOVING_OBJ" 1 "CAR" 2 "TRUCK" 3 "MOTOR_BIKE" 4 "BICYCLE" 5 "PEDESTRIAN" 6 "ROAD_BOUNDRY" 7 "STATIC_OBJECT" 8 "TRAFFIC_LIGHT" 9 "TRAFFIC_SIGN" 10 "TWO_WHEELERS" 11 "RESERVED" 12 "RESERVED" 14 "OBJECT_UNDETERMIND" 15 "VEHICLE_UNDETERMIND";
VAL_ 717 OBJ_CLS_TYPE4_014 0 "UNKNOWN_MOVING_OBJ" 1 "CAR" 2 "TRUCK" 3 "MOTOR_BIKE" 4 "BICYCLE" 5 "PEDESTRIAN" 6 "ROAD_BOUNDRY" 7 "STATIC_OBJECT" 8 "TRAFFIC_LIGHT" 9 "TRAFFIC_SIGN" 10 "TWO_WHEELERS" 11 "RESERVED" 12 "RESERVED" 14 "OBJECT_UNDETERMIND" 15 "VEHICLE_UNDETERMIND";
VAL_ 717 OBJ_CLS_TYPE5_014 0 "UNKNOWN_MOVING_OBJ" 1 "CAR" 2 "TRUCK" 3 "MOTOR_BIKE" 4 "BICYCLE" 5 "PEDESTRIAN" 6 "ROAD_BOUNDRY" 7 "STATIC_OBJECT" 8 "TRAFFIC_LIGHT" 9 "TRAFFIC_SIGN" 10 "TWO_WHEELERS" 11 "RESERVED" 12 "RESERVED" 14 "OBJECT_UNDETERMIND" 15 "VEHICLE_UNDETERMIND";
VAL_ 717 OBJ_CLS_TYPE6_014 0 "UNKNOWN_MOVING_OBJ" 1 "CAR" 2 "TRUCK" 3 "MOTOR_BIKE" 4 "BICYCLE" 5 "PEDESTRIAN" 6 "ROAD_BOUNDRY" 7 "STATIC_OBJECT" 8 "TRAFFIC_LIGHT" 9 "TRAFFIC_SIGN" 10 "TWO_WHEELERS" 11 "RESERVED" 12 "RESERVED" 14 "OBJECT_UNDETERMIND" 15 "VEHICLE_UNDETERMIND";
SIG_GROUP_ 700 Detection241 1 : DET_BI_STATIC_FLAG_241 DET_AMBG_AZIMUTH_PROB_241 DET_AZIMUTH_AMB_ID_241 DET_CONFD_ELEVATION_241 DET_CONFD_AZIMUTH_241 DET_HVC_FLAG_241 DET_OUTSIDE_SECTOR_241 DET_AZIMUTH_ERR_241 DET_ELEVATION_ERR_241 DET_RANGE_ERR_241 DET_RANGE_VELOCITY_ERR_241 DET_EXISTENCE_PROB_241 DET_POINT_TARGET_PROB_241 DET_SNR_241 DET_SUPER_RES_TARGET_241 DET_VALID_FLAG_241 DET_RCS_241 DET_ELEVATION_241 DET_AZIMUTH_241 DET_RANGE_VELOCITY_241 DET_RANGE_241;
SIG_GROUP_ 700 Detection242 1 : DET_BI_STATIC_FLAG_242 DET_AMBG_AZIMUTH_PROB_242 DET_AZIMUTH_AMB_ID_242 DET_CONFD_ELEVATION_242 DET_CONFD_AZIMUTH_242 DET_HVC_FLAG_242 DET_OUTSIDE_SECTOR_242 DET_AZIMUTH_ERR_242 DET_ELEVATION_ERR_242 DET_RANGE_ERR_242 DET_RANGE_VELOCITY_ERR_242 DET_EXISTENCE_PROB_242 DET_POINT_TARGET_PROB_242 DET_SNR_242 DET_SUPER_RES_TARGET_242 DET_VALID_FLAG_242 DET_RCS_242 DET_ELEVATION_242 DET_AZIMUTH_242 DET_RANGE_VELOCITY_242 DET_RANGE_242;
SIG_GROUP_ 700 Detection243 1 : DET_BI_STATIC_FLAG_243 DET_AMBG_AZIMUTH_PROB_243 DET_AZIMUTH_AMB_ID_243 DET_CONFD_ELEVATION_243 DET_CONFD_AZIMUTH_243 DET_HVC_FLAG_243 DET_OUTSIDE_SECTOR_243 DET_AZIMUTH_ERR_243 DET_ELEVATION_ERR_243 DET_RANGE_ERR_243 DET_RANGE_VELOCITY_ERR_243 DET_EXISTENCE_PROB_243 DET_POINT_TARGET_PROB_243 DET_SNR_243 DET_SUPER_RES_TARGET_243 DET_VALID_FLAG_243 DET_RCS_243 DET_ELEVATION_243 DET_AZIMUTH_243 DET_RANGE_VELOCITY_243 DET_RANGE_243;
SIG_GROUP_ 700 Detection244 1 : DET_BI_STATIC_FLAG_244 DET_AMBG_AZIMUTH_PROB_244 DET_AZIMUTH_AMB_ID_244 DET_CONFD_ELEVATION_244 DET_CONFD_AZIMUTH_244 DET_HVC_FLAG_244 DET_OUTSIDE_SECTOR_244 DET_EXISTENCE_PROB_244 DET_POINT_TARGET_PROB_244 DET_SNR_244 DET_SUPER_RES_TARGET_244 DET_VALID_FLAG_244 DET_RCS_244 DET_ELEVATION_ERR_244 DET_ELEVATION_244 DET_AZIMUTH_ERR_244 DET_AZIMUTH_244 DET_RANGE_VELOCITY_ERR_244 DET_RANGE_VELOCITY_244 DET_RANGE_ERR_244 DET_RANGE_244;
SIG_GROUP_ 701 Detection245 1 : DET_BI_STATIC_FLAG_245 DET_AMBG_AZIMUTH_PROB_245 DET_AZIMUTH_AMB_ID_245 DET_CONFD_ELEVATION_245 DET_CONFD_AZIMUTH_245 DET_HVC_FLAG_245 DET_OUTSIDE_SECTOR_245 DET_AZIMUTH_ERR_245 DET_ELEVATION_ERR_245 DET_RANGE_ERR_245 DET_RANGE_VELOCITY_ERR_245 DET_EXISTENCE_PROB_245 DET_POINT_TARGET_PROB_245 DET_SNR_245 DET_SUPER_RES_TARGET_245 DET_VALID_FLAG_245 DET_RCS_245 DET_ELEVATION_245 DET_AZIMUTH_245 DET_RANGE_VELOCITY_245 DET_RANGE_245;
SIG_GROUP_ 701 Detection246 1 : DET_BI_STATIC_FLAG_246 DET_AMBG_AZIMUTH_PROB_246 DET_AZIMUTH_AMB_ID_246 DET_CONFD_ELEVATION_246 DET_CONFD_AZIMUTH_246 DET_HVC_FLAG_246 DET_OUTSIDE_SECTOR_246 DET_AZIMUTH_ERR_246 DET_ELEVATION_ERR_246 DET_RANGE_ERR_246 DET_RANGE_VELOCITY_ERR_246 DET_EXISTENCE_PROB_246 DET_POINT_TARGET_PROB_246 DET_SNR_246 DET_SUPER_RES_TARGET_246 DET_VALID_FLAG_246 DET_RCS_246 DET_ELEVATION_246 DET_AZIMUTH_246 DET_RANGE_VELOCITY_246 DET_RANGE_246;
SIG_GROUP_ 701 Detection247 1 : DET_BI_STATIC_FLAG_247 DET_AMBG_AZIMUTH_PROB_247 DET_AZIMUTH_AMB_ID_247 DET_CONFD_ELEVATION_247 DET_CONFD_AZIMUTH_247 DET_HVC_FLAG_247 DET_OUTSIDE_SECTOR_247 DET_AZIMUTH_ERR_247 DET_ELEVATION_ERR_247 DET_RANGE_ERR_247 DET_RANGE_VELOCITY_ERR_247 DET_EXISTENCE_PROB_247 DET_POINT_TARGET_PROB_247 DET_SNR_247 DET_SUPER_RES_TARGET_247 DET_VALID_FLAG_247 DET_RCS_247 DET_ELEVATION_247 DET_AZIMUTH_247 DET_RANGE_VELOCITY_247 DET_RANGE_247;
SIG_GROUP_ 701 Detection248 1 : DET_BI_STATIC_FLAG_248 DET_AMBG_AZIMUTH_PROB_248 DET_AZIMUTH_AMB_ID_248 DET_CONFD_ELEVATION_248 DET_CONFD_AZIMUTH_248 DET_HVC_FLAG_248 DET_OUTSIDE_SECTOR_248 DET_EXISTENCE_PROB_248 DET_POINT_TARGET_PROB_248 DET_SNR_248 DET_SUPER_RES_TARGET_248 DET_VALID_FLAG_248 DET_RCS_248 DET_ELEVATION_ERR_248 DET_ELEVATION_248 DET_AZIMUTH_ERR_248 DET_AZIMUTH_248 DET_RANGE_VELOCITY_ERR_248 DET_RANGE_VELOCITY_248 DET_RANGE_ERR_248 DET_RANGE_248;
SIG_GROUP_ 702 Detection249 1 : DET_BI_STATIC_FLAG_249 DET_AMBG_AZIMUTH_PROB_249 DET_AZIMUTH_AMB_ID_249 DET_CONFD_ELEVATION_249 DET_CONFD_AZIMUTH_249 DET_HVC_FLAG_249 DET_OUTSIDE_SECTOR_249 DET_AZIMUTH_ERR_249 DET_ELEVATION_ERR_249 DET_RANGE_ERR_249 DET_RANGE_VELOCITY_ERR_249 DET_EXISTENCE_PROB_249 DET_POINT_TARGET_PROB_249 DET_SNR_249 DET_SUPER_RES_TARGET_249 DET_VALID_FLAG_249 DET_RCS_249 DET_ELEVATION_249 DET_AZIMUTH_249 DET_RANGE_VELOCITY_249 DET_RANGE_249;
SIG_GROUP_ 702 Detection250 1 : DET_BI_STATIC_FLAG_250 DET_AMBG_AZIMUTH_PROB_250 DET_AZIMUTH_AMB_ID_250 DET_CONFD_ELEVATION_250 DET_CONFD_AZIMUTH_250 DET_HVC_FLAG_250 DET_OUTSIDE_SECTOR_250 DET_AZIMUTH_ERR_250 DET_ELEVATION_ERR_250 DET_RANGE_ERR_250 DET_RANGE_VELOCITY_ERR_250 DET_EXISTENCE_PROB_250 DET_POINT_TARGET_PROB_250 DET_SNR_250 DET_SUPER_RES_TARGET_250 DET_VALID_FLAG_250 DET_RCS_250 DET_ELEVATION_250 DET_AZIMUTH_250 DET_RANGE_VELOCITY_250 DET_RANGE_250;
SIG_GROUP_ 702 Detection251 1 : DET_BI_STATIC_FLAG_251 DET_AMBG_AZIMUTH_PROB_251 DET_AZIMUTH_AMB_ID_251 DET_CONFD_ELEVATION_251 DET_CONFD_AZIMUTH_251 DET_HVC_FLAG_251 DET_OUTSIDE_SECTOR_251 DET_AZIMUTH_ERR_251 DET_ELEVATION_ERR_251 DET_RANGE_ERR_251 DET_RANGE_VELOCITY_ERR_251 DET_EXISTENCE_PROB_251 DET_POINT_TARGET_PROB_251 DET_SNR_251 DET_SUPER_RES_TARGET_251 DET_VALID_FLAG_251 DET_RCS_251 DET_ELEVATION_251 DET_AZIMUTH_251 DET_RANGE_VELOCITY_251 DET_RANGE_251;
SIG_GROUP_ 702 Detection252 1 : DET_BI_STATIC_FLAG_252 DET_AMBG_AZIMUTH_PROB_252 DET_AZIMUTH_AMB_ID_252 DET_CONFD_ELEVATION_252 DET_CONFD_AZIMUTH_252 DET_HVC_FLAG_252 DET_OUTSIDE_SECTOR_252 DET_EXISTENCE_PROB_252 DET_POINT_TARGET_PROB_252 DET_SNR_252 DET_SUPER_RES_TARGET_252 DET_VALID_FLAG_252 DET_RCS_252 DET_ELEVATION_ERR_252 DET_ELEVATION_252 DET_AZIMUTH_ERR_252 DET_AZIMUTH_252 DET_RANGE_VELOCITY_ERR_252 DET_RANGE_VELOCITY_252 DET_RANGE_ERR_252 DET_RANGE_252;
SIG_GROUP_ 703 Detection253 1 : DET_BI_STATIC_FLAG_253 DET_AMBG_AZIMUTH_PROB_253 DET_AZIMUTH_AMB_ID_253 DET_CONFD_ELEVATION_253 DET_CONFD_AZIMUTH_253 DET_HVC_FLAG_253 DET_OUTSIDE_SECTOR_253 DET_AZIMUTH_ERR_253 DET_ELEVATION_ERR_253 DET_RANGE_ERR_253 DET_RANGE_VELOCITY_ERR_253 DET_EXISTENCE_PROB_253 DET_POINT_TARGET_PROB_253 DET_SNR_253 DET_SUPER_RES_TARGET_253 DET_VALID_FLAG_253 DET_RCS_253 DET_ELEVATION_253 DET_AZIMUTH_253 DET_RANGE_VELOCITY_253 DET_RANGE_253;
SIG_GROUP_ 703 Detection254 1 : DET_BI_STATIC_FLAG_254 DET_AMBG_AZIMUTH_PROB_254 DET_AZIMUTH_AMB_ID_254 DET_CONFD_ELEVATION_254 DET_CONFD_AZIMUTH_254 DET_HVC_FLAG_254 DET_OUTSIDE_SECTOR_254 DET_AZIMUTH_ERR_254 DET_ELEVATION_ERR_254 DET_RANGE_ERR_254 DET_RANGE_VELOCITY_ERR_254 DET_EXISTENCE_PROB_254 DET_POINT_TARGET_PROB_254 DET_SNR_254 DET_SUPER_RES_TARGET_254 DET_VALID_FLAG_254 DET_RCS_254 DET_ELEVATION_254 DET_AZIMUTH_254 DET_RANGE_VELOCITY_254 DET_RANGE_254;
SIG_GROUP_ 703 Detection255 1 : DET_BI_STATIC_FLAG_255 DET_AMBG_AZIMUTH_PROB_255 DET_AZIMUTH_AMB_ID_255 DET_CONFD_ELEVATION_255 DET_CONFD_AZIMUTH_255 DET_HVC_FLAG_255 DET_OUTSIDE_SECTOR_255 DET_AZIMUTH_ERR_255 DET_ELEVATION_ERR_255 DET_RANGE_ERR_255 DET_RANGE_VELOCITY_ERR_255 DET_EXISTENCE_PROB_255 DET_POINT_TARGET_PROB_255 DET_SNR_255 DET_SUPER_RES_TARGET_255 DET_VALID_FLAG_255 DET_RCS_255 DET_ELEVATION_255 DET_AZIMUTH_255 DET_RANGE_VELOCITY_255 DET_RANGE_255;
SIG_GROUP_ 703 Detection256 1 : DET_BI_STATIC_FLAG_256 DET_AMBG_AZIMUTH_PROB_256 DET_AZIMUTH_AMB_ID_256 DET_CONFD_ELEVATION_256 DET_CONFD_AZIMUTH_256 DET_HVC_FLAG_256 DET_OUTSIDE_SECTOR_256 DET_EXISTENCE_PROB_256 DET_POINT_TARGET_PROB_256 DET_SNR_256 DET_SUPER_RES_TARGET_256 DET_VALID_FLAG_256 DET_RCS_256 DET_ELEVATION_ERR_256 DET_ELEVATION_256 DET_AZIMUTH_ERR_256 DET_AZIMUTH_256 DET_RANGE_VELOCITY_ERR_256 DET_RANGE_VELOCITY_256 DET_RANGE_ERR_256 DET_RANGE_256;
SIG_GROUP_ 705 TrackerObject002 1 : OBJ_ACCEL_ERR_CRR_COEF_002 OBJ_VELOCITY_ERR_CRR_COEF_002 OBJ_POS_ERR_CRR_COEF_002 OBJ_YAW_RATE_002 OBJ_YAW_RATE_ERR_002 OBJ_GROUP_ID_002 OBJ_REF_PT_LAT_OFFSET_002 OBJ_REF_PT_LONG_OFFSET_002 OBJ_RCS_002 OBJ_YAW_ANGLE_ERR_002 OBJ_CLS_TYPE6_002 OBJ_CLS_TYPE6_PROB_002 OBJ_CLS_TYPE5_PROB_002 OBJ_CLS_TYPE5_002 OBJ_CLS_TYPE4_PROB_002 OBJ_CLS_TYPE4_002 OBJ_CLS_TYPE3_PROB_002 OBJ_CLS_TYPE3_002 OBJ_CLS_TYPE2_PROB_002 OBJ_CLS_TYPE2_002 OBJ_DIMENSION_WIDTH_ERR_002 OBJ_DIMENSION_LENGTH_ERR_002 OBJ_TIMESTAMP_OFFSET_002 OBJ_CLS_TYPE1_PROB_002 OBJ_VEH_TRACK_FLAG_002 OBJ_ACCELERATION_LAT_002 OBJ_ACCELERATION_LONG_002 OBJ_VELOCITY_LAT_002 OBJ_VELOCITY_LONG_002 OBJ_POS_LAT_002 OBJ_POS_LONG_002 OBJ_MEASUREMENT_STATUS_002 OBJ_MOVEMENT_STATUS_002 OBJ_CLS_TYPE1_002 OBJ_ID_002 OBJ_YAW_ANGLE_002 OBJ_EXISTENCE_PROB_002 OBJ_DIMENSION_LENGTH_002 OBJ_DIMENSION_WIDTH_002 OBJ_TRACK_MOTION_MODEL_002 OBJ_POS_LAT_ERR_002 OBJ_POS_LONG_ERR_002 OBJ_VELOCITY_LAT_ERR_002 OBJ_VELOCITY_LONG_ERR_002 OBJ_ACCELERATION_LAT_ERR_002 OBJ_ACCELERATION_LONG_ERR_002 OBJ_ALIVE_TIME_002;
SIG_GROUP_ 706 TrackerObject003 1 : OBJ_ACCEL_ERR_CRR_COEF_003 OBJ_VELOCITY_ERR_CRR_COEF_003 OBJ_POS_ERR_CRR_COEF_003 OBJ_YAW_RATE_003 OBJ_YAW_RATE_ERR_003 OBJ_GROUP_ID_003 OBJ_REF_PT_LAT_OFFSET_003 OBJ_REF_PT_LONG_OFFSET_003 OBJ_RCS_003 OBJ_YAW_ANGLE_ERR_003 OBJ_CLS_TYPE6_003 OBJ_CLS_TYPE6_PROB_003 OBJ_CLS_TYPE5_PROB_003 OBJ_CLS_TYPE5_003 OBJ_CLS_TYPE4_PROB_003 OBJ_CLS_TYPE4_003 OBJ_CLS_TYPE3_PROB_003 OBJ_CLS_TYPE3_003 OBJ_CLS_TYPE2_PROB_003 OBJ_CLS_TYPE2_003 OBJ_DIMENSION_WIDTH_ERR_003 OBJ_DIMENSION_LENGTH_ERR_003 OBJ_TIMESTAMP_OFFSET_003 OBJ_CLS_TYPE1_PROB_003 OBJ_VEH_TRACK_FLAG_003 OBJ_ACCELERATION_LAT_003 OBJ_ACCELERATION_LONG_003 OBJ_VELOCITY_LAT_003 OBJ_VELOCITY_LONG_003 OBJ_POS_LAT_003 OBJ_POS_LONG_003 OBJ_MEASUREMENT_STATUS_003 OBJ_MOVEMENT_STATUS_003 OBJ_CLS_TYPE1_003 OBJ_ID_003 OBJ_YAW_ANGLE_003 OBJ_EXISTENCE_PROB_003 OBJ_DIMENSION_LENGTH_003 OBJ_DIMENSION_WIDTH_003 OBJ_TRACK_MOTION_MODEL_003 OBJ_POS_LAT_ERR_003 OBJ_POS_LONG_ERR_003 OBJ_VELOCITY_LAT_ERR_003 OBJ_VELOCITY_LONG_ERR_003 OBJ_ACCELERATION_LAT_ERR_003 OBJ_ACCELERATION_LONG_ERR_003 OBJ_ALIVE_TIME_003;
SIG_GROUP_ 707 TrackerObject004 1 : OBJ_ACCEL_ERR_CRR_COEF_004 OBJ_VELOCITY_ERR_CRR_COEF_004 OBJ_POS_ERR_CRR_COEF_004 OBJ_YAW_RATE_004 OBJ_YAW_RATE_ERR_004 OBJ_GROUP_ID_004 OBJ_REF_PT_LAT_OFFSET_004 OBJ_REF_PT_LONG_OFFSET_004 OBJ_RCS_004 OBJ_YAW_ANGLE_ERR_004 OBJ_CLS_TYPE6_004 OBJ_CLS_TYPE6_PROB_004 OBJ_CLS_TYPE5_PROB_004 OBJ_CLS_TYPE5_004 OBJ_CLS_TYPE4_PROB_004 OBJ_CLS_TYPE4_004 OBJ_CLS_TYPE3_PROB_004 OBJ_CLS_TYPE3_004 OBJ_CLS_TYPE2_PROB_004 OBJ_CLS_TYPE2_004 OBJ_DIMENSION_WIDTH_ERR_004 OBJ_DIMENSION_LENGTH_ERR_004 OBJ_TIMESTAMP_OFFSET_004 OBJ_CLS_TYPE1_PROB_004 OBJ_VEH_TRACK_FLAG_004 OBJ_ACCELERATION_LAT_004 OBJ_ACCELERATION_LONG_004 OBJ_VELOCITY_LAT_004 OBJ_VELOCITY_LONG_004 OBJ_POS_LAT_004 OBJ_POS_LONG_004 OBJ_MEASUREMENT_STATUS_004 OBJ_MOVEMENT_STATUS_004 OBJ_CLS_TYPE1_004 OBJ_ID_004 OBJ_YAW_ANGLE_004 OBJ_EXISTENCE_PROB_004 OBJ_DIMENSION_LENGTH_004 OBJ_DIMENSION_WIDTH_004 OBJ_TRACK_MOTION_MODEL_004 OBJ_POS_LAT_ERR_004 OBJ_POS_LONG_ERR_004 OBJ_VELOCITY_LAT_ERR_004 OBJ_VELOCITY_LONG_ERR_004 OBJ_ACCELERATION_LAT_ERR_004 OBJ_ACCELERATION_LONG_ERR_004 OBJ_ALIVE_TIME_004;
SIG_GROUP_ 708 TrackerObject005 1 : OBJ_ACCEL_ERR_CRR_COEF_005 OBJ_VELOCITY_ERR_CRR_COEF_005 OBJ_POS_ERR_CRR_COEF_005 OBJ_YAW_RATE_005 OBJ_YAW_RATE_ERR_005 OBJ_GROUP_ID_005 OBJ_REF_PT_LAT_OFFSET_005 OBJ_REF_PT_LONG_OFFSET_005 OBJ_RCS_005 OBJ_YAW_ANGLE_ERR_005 OBJ_CLS_TYPE6_005 OBJ_CLS_TYPE6_PROB_005 OBJ_CLS_TYPE5_PROB_005 OBJ_CLS_TYPE5_005 OBJ_CLS_TYPE4_PROB_005 OBJ_CLS_TYPE4_005 OBJ_CLS_TYPE3_PROB_005 OBJ_CLS_TYPE3_005 OBJ_CLS_TYPE2_PROB_005 OBJ_CLS_TYPE2_005 OBJ_DIMENSION_WIDTH_ERR_005 OBJ_DIMENSION_LENGTH_ERR_005 OBJ_TIMESTAMP_OFFSET_005 OBJ_CLS_TYPE1_PROB_005 OBJ_VEH_TRACK_FLAG_005 OBJ_ACCELERATION_LAT_005 OBJ_ACCELERATION_LONG_005 OBJ_VELOCITY_LAT_005 OBJ_VELOCITY_LONG_005 OBJ_POS_LAT_005 OBJ_POS_LONG_005 OBJ_MEASUREMENT_STATUS_005 OBJ_MOVEMENT_STATUS_005 OBJ_CLS_TYPE1_005 OBJ_ID_005 OBJ_YAW_ANGLE_005 OBJ_EXISTENCE_PROB_005 OBJ_DIMENSION_LENGTH_005 OBJ_DIMENSION_WIDTH_005 OBJ_TRACK_MOTION_MODEL_005 OBJ_POS_LAT_ERR_005 OBJ_POS_LONG_ERR_005 OBJ_VELOCITY_LAT_ERR_005 OBJ_VELOCITY_LONG_ERR_005 OBJ_ACCELERATION_LAT_ERR_005 OBJ_ACCELERATION_LONG_ERR_005 OBJ_ALIVE_TIME_005;
SIG_GROUP_ 709 TrackerObject006 1 : OBJ_ACCEL_ERR_CRR_COEF_006 OBJ_VELOCITY_ERR_CRR_COEF_006 OBJ_POS_ERR_CRR_COEF_006 OBJ_YAW_RATE_006 OBJ_YAW_RATE_ERR_006 OBJ_GROUP_ID_006 OBJ_REF_PT_LAT_OFFSET_006 OBJ_REF_PT_LONG_OFFSET_006 OBJ_RCS_006 OBJ_YAW_ANGLE_ERR_006 OBJ_CLS_TYPE6_006 OBJ_CLS_TYPE6_PROB_006 OBJ_CLS_TYPE5_PROB_006 OBJ_CLS_TYPE5_006 OBJ_CLS_TYPE4_PROB_006 OBJ_CLS_TYPE4_006 OBJ_CLS_TYPE3_PROB_006 OBJ_CLS_TYPE3_006 OBJ_CLS_TYPE2_PROB_006 OBJ_CLS_TYPE2_006 OBJ_DIMENSION_WIDTH_ERR_006 OBJ_DIMENSION_LENGTH_ERR_006 OBJ_TIMESTAMP_OFFSET_006 OBJ_CLS_TYPE1_PROB_006 OBJ_VEH_TRACK_FLAG_006 OBJ_ACCELERATION_LAT_006 OBJ_ACCELERATION_LONG_006 OBJ_VELOCITY_LAT_006 OBJ_VELOCITY_LONG_006 OBJ_POS_LAT_006 OBJ_POS_LONG_006 OBJ_MEASUREMENT_STATUS_006 OBJ_MOVEMENT_STATUS_006 OBJ_CLS_TYPE1_006 OBJ_ID_006 OBJ_YAW_ANGLE_006 OBJ_EXISTENCE_PROB_006 OBJ_DIMENSION_LENGTH_006 OBJ_DIMENSION_WIDTH_006 OBJ_TRACK_MOTION_MODEL_006 OBJ_POS_LAT_ERR_006 OBJ_POS_LONG_ERR_006 OBJ_VELOCITY_LAT_ERR_006 OBJ_VELOCITY_LONG_ERR_006 OBJ_ACCELERATION_LAT_ERR_006 OBJ_ACCELERATION_LONG_ERR_006 OBJ_ALIVE_TIME_006;
SIG_GROUP_ 710 TrackerObject007 1 : OBJ_ACCEL_ERR_CRR_COEF_007 OBJ_VELOCITY_ERR_CRR_COEF_007 OBJ_POS_ERR_CRR_COEF_007 OBJ_YAW_RATE_007 OBJ_YAW_RATE_ERR_007 OBJ_GROUP_ID_007 OBJ_REF_PT_LAT_OFFSET_007 OBJ_REF_PT_LONG_OFFSET_007 OBJ_RCS_007 OBJ_YAW_ANGLE_ERR_007 OBJ_CLS_TYPE6_007 OBJ_CLS_TYPE6_PROB_007 OBJ_CLS_TYPE5_PROB_007 OBJ_CLS_TYPE5_007 OBJ_CLS_TYPE4_PROB_007 OBJ_CLS_TYPE4_007 OBJ_CLS_TYPE3_PROB_007 OBJ_CLS_TYPE3_007 OBJ_CLS_TYPE2_PROB_007 OBJ_CLS_TYPE2_007 OBJ_DIMENSION_WIDTH_ERR_007 OBJ_DIMENSION_LENGTH_ERR_007 OBJ_TIMESTAMP_OFFSET_007 OBJ_CLS_TYPE1_PROB_007 OBJ_VEH_TRACK_FLAG_007 OBJ_ACCELERATION_LAT_007 OBJ_ACCELERATION_LONG_007 OBJ_VELOCITY_LAT_007 OBJ_VELOCITY_LONG_007 OBJ_POS_LAT_007 OBJ_POS_LONG_007 OBJ_MEASUREMENT_STATUS_007 OBJ_MOVEMENT_STATUS_007 OBJ_CLS_TYPE1_007 OBJ_ID_007 OBJ_YAW_ANGLE_007 OBJ_EXISTENCE_PROB_007 OBJ_DIMENSION_LENGTH_007 OBJ_DIMENSION_WIDTH_007 OBJ_TRACK_MOTION_MODEL_007 OBJ_POS_LAT_ERR_007 OBJ_POS_LONG_ERR_007 OBJ_VELOCITY_LAT_ERR_007 OBJ_VELOCITY_LONG_ERR_007 OBJ_ACCELERATION_LAT_ERR_007 OBJ_ACCELERATION_LONG_ERR_007 OBJ_ALIVE_TIME_007;
SIG_GROUP_ 711 TrackerObject008 1 : OBJ_ACCEL_ERR_CRR_COEF_008 OBJ_VELOCITY_ERR_CRR_COEF_008 OBJ_POS_ERR_CRR_COEF_008 OBJ_YAW_RATE_008 OBJ_YAW_RATE_ERR_008 OBJ_GROUP_ID_008 OBJ_REF_PT_LAT_OFFSET_008 OBJ_REF_PT_LONG_OFFSET_008 OBJ_RCS_008 OBJ_YAW_ANGLE_ERR_008 OBJ_CLS_TYPE6_008 OBJ_CLS_TYPE6_PROB_008 OBJ_CLS_TYPE5_PROB_008 OBJ_CLS_TYPE5_008 OBJ_CLS_TYPE4_PROB_008 OBJ_CLS_TYPE4_008 OBJ_CLS_TYPE3_PROB_008 OBJ_CLS_TYPE3_008 OBJ_CLS_TYPE2_PROB_008 OBJ_CLS_TYPE2_008 OBJ_DIMENSION_WIDTH_ERR_008 OBJ_DIMENSION_LENGTH_ERR_008 OBJ_TIMESTAMP_OFFSET_008 OBJ_CLS_TYPE1_PROB_008 OBJ_VEH_TRACK_FLAG_008 OBJ_ACCELERATION_LAT_008 OBJ_ACCELERATION_LONG_008 OBJ_VELOCITY_LAT_008 OBJ_VELOCITY_LONG_008 OBJ_POS_LAT_008 OBJ_POS_LONG_008 OBJ_MEASUREMENT_STATUS_008 OBJ_MOVEMENT_STATUS_008 OBJ_CLS_TYPE1_008 OBJ_ID_008 OBJ_YAW_ANGLE_008 OBJ_EXISTENCE_PROB_008 OBJ_DIMENSION_LENGTH_008 OBJ_DIMENSION_WIDTH_008 OBJ_TRACK_MOTION_MODEL_008 OBJ_POS_LAT_ERR_008 OBJ_POS_LONG_ERR_008 OBJ_VELOCITY_LAT_ERR_008 OBJ_VELOCITY_LONG_ERR_008 OBJ_ACCELERATION_LAT_ERR_008 OBJ_ACCELERATION_LONG_ERR_008 OBJ_ALIVE_TIME_008;
SIG_GROUP_ 712 TrackerObject009 1 : OBJ_ACCEL_ERR_CRR_COEF_009 OBJ_VELOCITY_ERR_CRR_COEF_009 OBJ_POS_ERR_CRR_COEF_009 OBJ_YAW_RATE_009 OBJ_YAW_RATE_ERR_009 OBJ_GROUP_ID_009 OBJ_REF_PT_LAT_OFFSET_009 OBJ_REF_PT_LONG_OFFSET_009 OBJ_RCS_009 OBJ_YAW_ANGLE_ERR_009 OBJ_CLS_TYPE6_009 OBJ_CLS_TYPE6_PROB_009 OBJ_CLS_TYPE5_PROB_009 OBJ_CLS_TYPE5_009 OBJ_CLS_TYPE4_PROB_009 OBJ_CLS_TYPE4_009 OBJ_CLS_TYPE3_PROB_009 OBJ_CLS_TYPE3_009 OBJ_CLS_TYPE2_PROB_009 OBJ_CLS_TYPE2_009 OBJ_DIMENSION_WIDTH_ERR_009 OBJ_DIMENSION_LENGTH_ERR_009 OBJ_TIMESTAMP_OFFSET_009 OBJ_CLS_TYPE1_PROB_009 OBJ_VEH_TRACK_FLAG_009 OBJ_ACCELERATION_LAT_009 OBJ_ACCELERATION_LONG_009 OBJ_VELOCITY_LAT_009 OBJ_VELOCITY_LONG_009 OBJ_POS_LAT_009 OBJ_POS_LONG_009 OBJ_MEASUREMENT_STATUS_009 OBJ_MOVEMENT_STATUS_009 OBJ_CLS_TYPE1_009 OBJ_ID_009 OBJ_YAW_ANGLE_009 OBJ_EXISTENCE_PROB_009 OBJ_DIMENSION_LENGTH_009 OBJ_DIMENSION_WIDTH_009 OBJ_TRACK_MOTION_MODEL_009 OBJ_POS_LAT_ERR_009 OBJ_POS_LONG_ERR_009 OBJ_VELOCITY_LAT_ERR_009 OBJ_VELOCITY_LONG_ERR_009 OBJ_ACCELERATION_LAT_ERR_009 OBJ_ACCELERATION_LONG_ERR_009 OBJ_ALIVE_TIME_009;
SIG_GROUP_ 713 TrackerObject010 1 : OBJ_ACCEL_ERR_CRR_COEF_010 OBJ_VELOCITY_ERR_CRR_COEF_010 OBJ_POS_ERR_CRR_COEF_010 OBJ_YAW_RATE_010 OBJ_YAW_RATE_ERR_010 OBJ_GROUP_ID_010 OBJ_REF_PT_LAT_OFFSET_010 OBJ_REF_PT_LONG_OFFSET_010 OBJ_RCS_010 OBJ_YAW_ANGLE_ERR_010 OBJ_CLS_TYPE6_010 OBJ_CLS_TYPE6_PROB_010 OBJ_CLS_TYPE5_PROB_010 OBJ_CLS_TYPE5_010 OBJ_CLS_TYPE4_PROB_010 OBJ_CLS_TYPE4_010 OBJ_CLS_TYPE3_PROB_010 OBJ_CLS_TYPE3_010 OBJ_CLS_TYPE2_PROB_010 OBJ_CLS_TYPE2_010 OBJ_DIMENSION_WIDTH_ERR_010 OBJ_DIMENSION_LENGTH_ERR_010 OBJ_TIMESTAMP_OFFSET_010 OBJ_CLS_TYPE1_PROB_010 OBJ_VEH_TRACK_FLAG_010 OBJ_ACCELERATION_LAT_010 OBJ_ACCELERATION_LONG_010 OBJ_VELOCITY_LAT_010 OBJ_VELOCITY_LONG_010 OBJ_POS_LAT_010 OBJ_POS_LONG_010 OBJ_MEASUREMENT_STATUS_010 OBJ_MOVEMENT_STATUS_010 OBJ_CLS_TYPE1_010 OBJ_ID_010 OBJ_YAW_ANGLE_010 OBJ_EXISTENCE_PROB_010 OBJ_DIMENSION_LENGTH_010 OBJ_DIMENSION_WIDTH_010 OBJ_TRACK_MOTION_MODEL_010 OBJ_POS_LAT_ERR_010 OBJ_POS_LONG_ERR_010 OBJ_VELOCITY_LAT_ERR_010 OBJ_VELOCITY_LONG_ERR_010 OBJ_ACCELERATION_LAT_ERR_010 OBJ_ACCELERATION_LONG_ERR_010 OBJ_ALIVE_TIME_010;
SIG_GROUP_ 714 TrackerObject011 1 : OBJ_ACCEL_ERR_CRR_COEF_011 OBJ_VELOCITY_ERR_CRR_COEF_011 OBJ_POS_ERR_CRR_COEF_011 OBJ_YAW_RATE_011 OBJ_YAW_RATE_ERR_011 OBJ_GROUP_ID_011 OBJ_REF_PT_LAT_OFFSET_011 OBJ_REF_PT_LONG_OFFSET_011 OBJ_RCS_011 OBJ_YAW_ANGLE_ERR_011 OBJ_CLS_TYPE6_011 OBJ_CLS_TYPE6_PROB_011 OBJ_CLS_TYPE5_PROB_011 OBJ_CLS_TYPE5_011 OBJ_CLS_TYPE4_PROB_011 OBJ_CLS_TYPE4_011 OBJ_CLS_TYPE3_PROB_011 OBJ_CLS_TYPE3_011 OBJ_CLS_TYPE2_PROB_011 OBJ_CLS_TYPE2_011 OBJ_DIMENSION_WIDTH_ERR_011 OBJ_DIMENSION_LENGTH_ERR_011 OBJ_TIMESTAMP_OFFSET_011 OBJ_CLS_TYPE1_PROB_011 OBJ_VEH_TRACK_FLAG_011 OBJ_ACCELERATION_LAT_011 OBJ_ACCELERATION_LONG_011 OBJ_VELOCITY_LAT_011 OBJ_VELOCITY_LONG_011 OBJ_POS_LAT_011 OBJ_POS_LONG_011 OBJ_MEASUREMENT_STATUS_011 OBJ_MOVEMENT_STATUS_011 OBJ_CLS_TYPE1_011 OBJ_ID_011 OBJ_YAW_ANGLE_011 OBJ_EXISTENCE_PROB_011 OBJ_DIMENSION_LENGTH_011 OBJ_DIMENSION_WIDTH_011 OBJ_TRACK_MOTION_MODEL_011 OBJ_POS_LAT_ERR_011 OBJ_POS_LONG_ERR_011 OBJ_VELOCITY_LAT_ERR_011 OBJ_VELOCITY_LONG_ERR_011 OBJ_ACCELERATION_LAT_ERR_011 OBJ_ACCELERATION_LONG_ERR_011 OBJ_ALIVE_TIME_011;
SIG_GROUP_ 715 TrackerObject012 1 : OBJ_ACCEL_ERR_CRR_COEF_012 OBJ_VELOCITY_ERR_CRR_COEF_012 OBJ_POS_ERR_CRR_COEF_012 OBJ_YAW_RATE_012 OBJ_YAW_RATE_ERR_012 OBJ_GROUP_ID_012 OBJ_REF_PT_LAT_OFFSET_012 OBJ_REF_PT_LONG_OFFSET_012 OBJ_RCS_012 OBJ_YAW_ANGLE_ERR_012 OBJ_CLS_TYPE6_012 OBJ_CLS_TYPE6_PROB_012 OBJ_CLS_TYPE5_PROB_012 OBJ_CLS_TYPE5_012 OBJ_CLS_TYPE4_PROB_012 OBJ_CLS_TYPE4_012 OBJ_CLS_TYPE3_PROB_012 OBJ_CLS_TYPE3_012 OBJ_CLS_TYPE2_PROB_012 OBJ_CLS_TYPE2_012 OBJ_DIMENSION_WIDTH_ERR_012 OBJ_DIMENSION_LENGTH_ERR_012 OBJ_TIMESTAMP_OFFSET_012 OBJ_CLS_TYPE1_PROB_012 OBJ_VEH_TRACK_FLAG_012 OBJ_ACCELERATION_LAT_012 OBJ_ACCELERATION_LONG_012 OBJ_VELOCITY_LAT_012 OBJ_VELOCITY_LONG_012 OBJ_POS_LAT_012 OBJ_POS_LONG_012 OBJ_MEASUREMENT_STATUS_012 OBJ_MOVEMENT_STATUS_012 OBJ_CLS_TYPE1_012 OBJ_ID_012 OBJ_YAW_ANGLE_012 OBJ_EXISTENCE_PROB_012 OBJ_DIMENSION_LENGTH_012 OBJ_DIMENSION_WIDTH_012 OBJ_TRACK_MOTION_MODEL_012 OBJ_POS_LAT_ERR_012 OBJ_POS_LONG_ERR_012 OBJ_VELOCITY_LAT_ERR_012 OBJ_VELOCITY_LONG_ERR_012 OBJ_ACCELERATION_LAT_ERR_012 OBJ_ACCELERATION_LONG_ERR_012 OBJ_ALIVE_TIME_012;
SIG_GROUP_ 716 TrackerObject013 1 : OBJ_ACCEL_ERR_CRR_COEF_013 OBJ_VELOCITY_ERR_CRR_COEF_013 OBJ_POS_ERR_CRR_COEF_013 OBJ_YAW_RATE_013 OBJ_YAW_RATE_ERR_013 OBJ_GROUP_ID_013 OBJ_REF_PT_LAT_OFFSET_013 OBJ_REF_PT_LONG_OFFSET_013 OBJ_RCS_013 OBJ_YAW_ANGLE_ERR_013 OBJ_CLS_TYPE6_013 OBJ_CLS_TYPE6_PROB_013 OBJ_CLS_TYPE5_PROB_013 OBJ_CLS_TYPE5_013 OBJ_CLS_TYPE4_PROB_013 OBJ_CLS_TYPE4_013 OBJ_CLS_TYPE3_PROB_013 OBJ_CLS_TYPE3_013 OBJ_CLS_TYPE2_PROB_013 OBJ_CLS_TYPE2_013 OBJ_DIMENSION_WIDTH_ERR_013 OBJ_DIMENSION_LENGTH_ERR_013 OBJ_TIMESTAMP_OFFSET_013 OBJ_CLS_TYPE1_PROB_013 OBJ_VEH_TRACK_FLAG_013 OBJ_ACCELERATION_LAT_013 OBJ_ACCELERATION_LONG_013 OBJ_VELOCITY_LAT_013 OBJ_VELOCITY_LONG_013 OBJ_POS_LAT_013 OBJ_POS_LONG_013 OBJ_MEASUREMENT_STATUS_013 OBJ_MOVEMENT_STATUS_013 OBJ_CLS_TYPE1_013 OBJ_ID_013 OBJ_YAW_ANGLE_013 OBJ_EXISTENCE_PROB_013 OBJ_DIMENSION_LENGTH_013 OBJ_DIMENSION_WIDTH_013 OBJ_TRACK_MOTION_MODEL_013 OBJ_POS_LAT_ERR_013 OBJ_POS_LONG_ERR_013 OBJ_VELOCITY_LAT_ERR_013 OBJ_VELOCITY_LONG_ERR_013 OBJ_ACCELERATION_LAT_ERR_013 OBJ_ACCELERATION_LONG_ERR_013 OBJ_ALIVE_TIME_013;
SIG_GROUP_ 717 TrackerObject014 1 : OBJ_ACCEL_ERR_CRR_COEF_014 OBJ_VELOCITY_ERR_CRR_COEF_014 OBJ_POS_ERR_CRR_COEF_014 OBJ_YAW_RATE_014 OBJ_YAW_RATE_ERR_014 OBJ_GROUP_ID_014 OBJ_REF_PT_LAT_OFFSET_014 OBJ_REF_PT_LONG_OFFSET_014 OBJ_RCS_014 OBJ_YAW_ANGLE_ERR_014 OBJ_CLS_TYPE6_014 OBJ_CLS_TYPE6_PROB_014 OBJ_CLS_TYPE5_PROB_014 OBJ_CLS_TYPE5_014 OBJ_CLS_TYPE4_PROB_014 OBJ_CLS_TYPE4_014 OBJ_CLS_TYPE3_PROB_014 OBJ_CLS_TYPE3_014 OBJ_CLS_TYPE2_PROB_014 OBJ_CLS_TYPE2_014 OBJ_DIMENSION_WIDTH_ERR_014 OBJ_DIMENSION_LENGTH_ERR_014 OBJ_TIMESTAMP_OFFSET_014 OBJ_CLS_TYPE1_PROB_014 OBJ_VEH_TRACK_FLAG_014 OBJ_ACCELERATION_LAT_014 OBJ_ACCELERATION_LONG_014 OBJ_VELOCITY_LAT_014 OBJ_VELOCITY_LONG_014 OBJ_POS_LAT_014 OBJ_POS_LONG_014 OBJ_MEASUREMENT_STATUS_014 OBJ_MOVEMENT_STATUS_014 OBJ_CLS_TYPE1_014 OBJ_ID_014 OBJ_YAW_ANGLE_014 OBJ_EXISTENCE_PROB_014 OBJ_DIMENSION_LENGTH_014 OBJ_DIMENSION_WIDTH_014 OBJ_TRACK_MOTION_MODEL_014 OBJ_POS_LAT_ERR_014 OBJ_POS_LONG_ERR_014 OBJ_VELOCITY_LAT_ERR_014 OBJ_VELOCITY_LONG_ERR_014 OBJ_ACCELERATION_LAT_ERR_014 OBJ_ACCELERATION_LONG_ERR_014 OBJ_ALIVE_TIME_014;

VERSION "created by canmatrix"

NS_ :

BS_:

BU_: External_Tool ASDM G5_RDR04

BO_ 718 RDR_TRACKER_OBJ_015: 64 G5_RDR04
 SG_ OBJ_ALIVE_TIME_015 : 255|16@0+ (1,0) [0|65535] "ms" ASDM
 SG_ OBJ_ACCELERATION_LONG_ERR_015 : 215|8@0+ (0.025,0) [0|6.375] "m/s^2" ASDM
 SG_ OBJ_ACCELERATION_LAT_ERR_015 : 223|8@0+ (0.025,0) [0|6.375] "m/s^2" ASDM
 SG_ OBJ_VELOCITY_LONG_ERR_015 : 143|8@0+ (0.05,0) [0|12.75] "m/s" ASDM
 SG_ OBJ_VELOCITY_LAT_ERR_015 : 151|8@0+ (0.05,0) [0|12.75] "m/s" ASDM
 SG_ OBJ_POS_LONG_ERR_015 : 95|8@0+ (0.025,0) [0|6.375] "m" ASDM
 SG_ OBJ_POS_LAT_ERR_015 : 103|8@0+ (0.025,0) [0|6.375] "m" ASDM
 SG_ OBJ_TRACK_MOTION_MODEL_015 : 9|2@0+ (1,0) [1|3] "NA" ASDM
 SG_ OBJ_DIMENSION_WIDTH_015 : 17|10@0+ (0.01,0) [0|10.23] "m" ASDM
 SG_ OBJ_DIMENSION_LENGTH_015 : 37|12@0+ (0.01,0) [0|40.95] "m" ASDM
 SG_ OBJ_EXISTENCE_PROB_015 : 229|14@0+ (0.0001,0) [0|1] "NA" ASDM
 SG_ OBJ_YAW_ANGLE_015 : 155|12@0+ (0.005,-10) [-10|10.475] "rad" ASDM
 SG_ OBJ_YAW_ANGLE_ERR_015 : 175|7@0+ (0.01,0) [0|1.27] "rad" ASDM
 SG_ OBJ_ID_015 : 7|8@0+ (1,0) [0|255] "NA" ASDM
 SG_ OBJ_MOVEMENT_STATUS_015 : 196|3@0+ (1,0) [0|3] "NA" ASDM
 SG_ OBJ_MEASUREMENT_STATUS_015 : 14|3@0+ (1,0) [0|7] "NA" ASDM
 SG_ OBJ_POS_LONG_015 : 63|16@0+ (0.01,-327) [-327|327] "m" ASDM
 SG_ OBJ_POS_LAT_015 : 79|16@0+ (0.01,-327) [-327|327] "m" ASDM
 SG_ OBJ_VELOCITY_LONG_015 : 110|15@0+ (0.01,-163) [-163|163] "m/s" ASDM
 SG_ OBJ_VELOCITY_LAT_015 : 126|15@0+ (0.01,-163) [-163|163] "m/s" ASDM
 SG_ OBJ_ACCELERATION_LONG_015 : 193|10@0+ (0.05,-20) [-20|20] "m/s^2" ASDM
 SG_ OBJ_ACCELERATION_LAT_015 : 177|10@0+ (0.05,-20) [-20|20] "m/s^2" ASDM
 SG_ OBJ_VEH_TRACK_FLAG_015 : 10|1@0+ (1,0) [0|1] "NA" ASDM
 SG_ OBJ_MH_CYCLE_COUNTER_015 : 487|8@0+ (1,0) [0|255] "NA" ASDM
 SG_ OBJ_MH_CRC16_015 : 495|16@0+ (1,0) [0|65535] "NA" ASDM
 SG_ OBJ_TIMESTAMP_OFFSET_015 : 247|8@0+ (1,-127) [-127|128] "ms" ASDM
 SG_ OBJ_DIMENSION_WIDTH_ERR_015 : 23|6@0+ (0.01,0) [0|0.63] "m" ASDM
 SG_ OBJ_DIMENSION_LENGTH_ERR_015 : 41|10@0+ (0.01,0) [0|10.23] "m" ASDM
 SG_ OBJ_CLS_TYPE1_015 : 271|4@0+ (1,0) [0|15] "NA" ASDM
 SG_ OBJ_CLS_TYPE1_PROB_015 : 303|8@0+ (0.004,0) [0|1] "NA" ASDM
 SG_ OBJ_CLS_TYPE2_015 : 267|4@0+ (1,0) [0|15] "NA" ASDM
 SG_ OBJ_CLS_TYPE2_PROB_015 : 311|8@0+ (0.004,0) [0|1] "NA" ASDM
 SG_ OBJ_CLS_TYPE3_015 : 279|4@0+ (1,0) [0|15] "NA" ASDM
 SG_ OBJ_CLS_TYPE3_PROB_015 : 319|8@0+ (0.004,0) [0|1] "NA" ASDM
 SG_ OBJ_CLS_TYPE4_015 : 275|4@0+ (1,0) [0|15] "NA" ASDM
 SG_ OBJ_CLS_TYPE4_PROB_015 : 327|8@0+ (0.004,0) [0|1] "NA" ASDM
 SG_ OBJ_CLS_TYPE5_015 : 287|4@0+ (1,0) [0|15] "NA" ASDM
 SG_ OBJ_CLS_TYPE5_PROB_015 : 335|8@0+ (0.004,0) [0|1] "NA" ASDM
 SG_ OBJ_CLS_TYPE6_015 : 282|4@0+ (1,0) [0|15] "NA" ASDM
 SG_ OBJ_CLS_TYPE6_PROB_015 : 343|8@0+ (0.004,0) [0|1] "NA" ASDM
 SG_ OBJ_RCS_015 : 351|7@0+ (1,-64) [-64|63] "dBsm" ASDM
 SG_ OBJ_REF_PT_LONG_OFFSET_015 : 357|14@0+ (0.0001,0) [0|1] "NA" ASDM
 SG_ OBJ_REF_PT_LAT_OFFSET_015 : 370|14@0+ (0.0001,0) [0|1] "NA" ASDM
 SG_ OBJ_YAW_RATE_015 : 399|10@0+ (0.005,-2.24) [-2.24|2.24] "rad/s" ASDM
 SG_ OBJ_YAW_RATE_ERR_015 : 388|5@0+ (0.025,0) [0|0.775] "rad/s" ASDM
 SG_ OBJ_GROUP_ID_015 : 405|6@0+ (1,0) [0|63] "NA" ASDM
 SG_ OBJ_POS_ERR_CRR_COEF_015 : 415|8@0+ (0.01,-1.2) [-1.2|1] "NA" ASDM
 SG_ OBJ_VELOCITY_ERR_CRR_COEF_015 : 423|8@0+ (0.01,-1.2) [-1.2|1] "NA" ASDM
 SG_ OBJ_ACCEL_ERR_CRR_COEF_015 : 431|8@0+ (0.01,-1.2) [-1.2|1] "NA" ASDM

BO_ 719 RDR_TRACKER_OBJ_016: 64 G5_RDR04
 SG_ OBJ_ALIVE_TIME_016 : 255|16@0+ (1,0) [0|65535] "ms" ASDM
 SG_ OBJ_ACCELERATION_LONG_ERR_016 : 215|8@0+ (0.025,0) [0|6.375] "m/s^2" ASDM
 SG_ OBJ_ACCELERATION_LAT_ERR_016 : 223|8@0+ (0.025,0) [0|6.375] "m/s^2" ASDM
 SG_ OBJ_VELOCITY_LONG_ERR_016 : 143|8@0+ (0.05,0) [0|12.75] "m/s" ASDM
 SG_ OBJ_VELOCITY_LAT_ERR_016 : 151|8@0+ (0.05,0) [0|12.75] "m/s" ASDM
 SG_ OBJ_POS_LONG_ERR_016 : 95|8@0+ (0.025,0) [0|6.375] "m" ASDM
 SG_ OBJ_POS_LAT_ERR_016 : 103|8@0+ (0.025,0) [0|6.375] "m" ASDM
 SG_ OBJ_TRACK_MOTION_MODEL_016 : 9|2@0+ (1,0) [1|3] "NA" ASDM
 SG_ OBJ_DIMENSION_WIDTH_016 : 17|10@0+ (0.01,0) [0|10.23] "m" ASDM
 SG_ OBJ_DIMENSION_LENGTH_016 : 37|12@0+ (0.01,0) [0|40.95] "m" ASDM
 SG_ OBJ_EXISTENCE_PROB_016 : 229|14@0+ (0.0001,0) [0|1] "NA" ASDM
 SG_ OBJ_YAW_ANGLE_016 : 155|12@0+ (0.005,-10) [-10|10.475] "rad" ASDM
 SG_ OBJ_YAW_ANGLE_ERR_016 : 175|7@0+ (0.01,0) [0|1.27] "rad" ASDM
 SG_ OBJ_ID_016 : 7|8@0+ (1,0) [0|255] "NA" ASDM
 SG_ OBJ_MOVEMENT_STATUS_016 : 196|3@0+ (1,0) [0|3] "NA" ASDM
 SG_ OBJ_MEASUREMENT_STATUS_016 : 14|3@0+ (1,0) [0|7] "NA" ASDM
 SG_ OBJ_POS_LONG_016 : 63|16@0+ (0.01,-327) [-327|327] "m" ASDM
 SG_ OBJ_POS_LAT_016 : 79|16@0+ (0.01,-327) [-327|327] "m" ASDM
 SG_ OBJ_VELOCITY_LONG_016 : 110|15@0+ (0.01,-163) [-163|163] "m/s" ASDM
 SG_ OBJ_VELOCITY_LAT_016 : 126|15@0+ (0.01,-163) [-163|163] "m/s" ASDM
 SG_ OBJ_ACCELERATION_LONG_016 : 193|10@0+ (0.05,-20) [-20|20] "m/s^2" ASDM
 SG_ OBJ_ACCELERATION_LAT_016 : 177|10@0+ (0.05,-20) [-20|20] "m/s^2" ASDM
 SG_ OBJ_VEH_TRACK_FLAG_016 : 10|1@0+ (1,0) [0|1] "NA" ASDM
 SG_ OBJ_MH_CYCLE_COUNTER_016 : 487|8@0+ (1,0) [0|255] "NA" ASDM
 SG_ OBJ_MH_CRC16_016 : 495|16@0+ (1,0) [0|65535] "NA" ASDM
 SG_ OBJ_TIMESTAMP_OFFSET_016 : 247|8@0+ (1,-127) [-127|128] "ms" ASDM
 SG_ OBJ_DIMENSION_WIDTH_ERR_016 : 23|6@0+ (0.01,0) [0|0.63] "m" ASDM
 SG_ OBJ_DIMENSION_LENGTH_ERR_016 : 41|10@0+ (0.01,0) [0|10.23] "m" ASDM
 SG_ OBJ_CLS_TYPE1_016 : 271|4@0+ (1,0) [0|15] "NA" ASDM
 SG_ OBJ_CLS_TYPE1_PROB_016 : 303|8@0+ (0.004,0) [0|1] "NA" ASDM
 SG_ OBJ_CLS_TYPE2_016 : 267|4@0+ (1,0) [0|15] "NA" ASDM
 SG_ OBJ_CLS_TYPE2_PROB_016 : 311|8@0+ (0.004,0) [0|1] "NA" ASDM
 SG_ OBJ_CLS_TYPE3_016 : 279|4@0+ (1,0) [0|15] "NA" ASDM
 SG_ OBJ_CLS_TYPE3_PROB_016 : 319|8@0+ (0.004,0) [0|1] "NA" ASDM
 SG_ OBJ_CLS_TYPE4_016 : 275|4@0+ (1,0) [0|15] "NA" ASDM
 SG_ OBJ_CLS_TYPE4_PROB_016 : 327|8@0+ (0.004,0) [0|1] "NA" ASDM
 SG_ OBJ_CLS_TYPE5_016 : 287|4@0+ (1,0) [0|15] "NA" ASDM
 SG_ OBJ_CLS_TYPE5_PROB_016 : 335|8@0+ (0.004,0) [0|1] "NA" ASDM
 SG_ OBJ_CLS_TYPE6_016 : 282|4@0+ (1,0) [0|15] "NA" ASDM
 SG_ OBJ_CLS_TYPE6_PROB_016 : 343|8@0+ (0.004,0) [0|1] "NA" ASDM
 SG_ OBJ_RCS_016 : 351|7@0+ (1,-64) [-64|63] "dBsm" ASDM
 SG_ OBJ_REF_PT_LONG_OFFSET_016 : 357|14@0+ (0.0001,0) [0|1] "NA" ASDM
 SG_ OBJ_REF_PT_LAT_OFFSET_016 : 370|14@0+ (0.0001,0) [0|1] "NA" ASDM
 SG_ OBJ_YAW_RATE_016 : 399|10@0+ (0.005,-2.24) [-2.24|2.24] "rad/s" ASDM
 SG_ OBJ_YAW_RATE_ERR_016 : 388|5@0+ (0.025,0) [0|0.775] "rad/s" ASDM
 SG_ OBJ_GROUP_ID_016 : 405|6@0+ (1,0) [0|63] "NA" ASDM
 SG_ OBJ_POS_ERR_CRR_COEF_016 : 415|8@0+ (0.01,-1.2) [-1.2|1] "NA" ASDM
 SG_ OBJ_VELOCITY_ERR_CRR_COEF_016 : 423|8@0+ (0.01,-1.2) [-1.2|1] "NA" ASDM
 SG_ OBJ_ACCEL_ERR_CRR_COEF_016 : 431|8@0+ (0.01,-1.2) [-1.2|1] "NA" ASDM

BO_ 720 RDR_TRACKER_OBJ_017: 64 G5_RDR04
 SG_ OBJ_ALIVE_TIME_017 : 255|16@0+ (1,0) [0|65535] "ms" ASDM
 SG_ OBJ_ACCELERATION_LONG_ERR_017 : 215|8@0+ (0.025,0) [0|6.375] "m/s^2" ASDM
 SG_ OBJ_ACCELERATION_LAT_ERR_017 : 223|8@0+ (0.025,0) [0|6.375] "m/s^2" ASDM
 SG_ OBJ_VELOCITY_LONG_ERR_017 : 143|8@0+ (0.05,0) [0|12.75] "m/s" ASDM
 SG_ OBJ_VELOCITY_LAT_ERR_017 : 151|8@0+ (0.05,0) [0|12.75] "m/s" ASDM
 SG_ OBJ_POS_LONG_ERR_017 : 95|8@0+ (0.025,0) [0|6.375] "m" ASDM
 SG_ OBJ_POS_LAT_ERR_017 : 103|8@0+ (0.025,0) [0|6.375] "m" ASDM
 SG_ OBJ_TRACK_MOTION_MODEL_017 : 9|2@0+ (1,0) [1|3] "NA" ASDM
 SG_ OBJ_DIMENSION_WIDTH_017 : 17|10@0+ (0.01,0) [0|10.23] "m" ASDM
 SG_ OBJ_DIMENSION_LENGTH_017 : 37|12@0+ (0.01,0) [0|40.95] "m" ASDM
 SG_ OBJ_EXISTENCE_PROB_017 : 229|14@0+ (0.0001,0) [0|1] "NA" ASDM
 SG_ OBJ_YAW_ANGLE_017 : 155|12@0+ (0.005,-10) [-10|10.475] "rad" ASDM
 SG_ OBJ_YAW_ANGLE_ERR_017 : 175|7@0+ (0.01,0) [0|1.27] "rad" ASDM
 SG_ OBJ_ID_017 : 7|8@0+ (1,0) [0|255] "NA" ASDM
 SG_ OBJ_MOVEMENT_STATUS_017 : 196|3@0+ (1,0) [0|3] "NA" ASDM
 SG_ OBJ_MEASUREMENT_STATUS_017 : 14|3@0+ (1,0) [0|7] "NA" ASDM
 SG_ OBJ_POS_LONG_017 : 63|16@0+ (0.01,-327) [-327|327] "m" ASDM
 SG_ OBJ_POS_LAT_017 : 79|16@0+ (0.01,-327) [-327|327] "m" ASDM
 SG_ OBJ_VELOCITY_LONG_017 : 110|15@0+ (0.01,-163) [-163|163] "m/s" ASDM
 SG_ OBJ_VELOCITY_LAT_017 : 126|15@0+ (0.01,-163) [-163|163] "m/s" ASDM
 SG_ OBJ_ACCELERATION_LONG_017 : 193|10@0+ (0.05,-20) [-20|20] "m/s^2" ASDM
 SG_ OBJ_ACCELERATION_LAT_017 : 177|10@0+ (0.05,-20) [-20|20] "m/s^2" ASDM
 SG_ OBJ_VEH_TRACK_FLAG_017 : 10|1@0+ (1,0) [0|1] "NA" ASDM
 SG_ OBJ_MH_CYCLE_COUNTER_017 : 487|8@0+ (1,0) [0|255] "NA" ASDM
 SG_ OBJ_MH_CRC16_017 : 495|16@0+ (1,0) [0|65535] "NA" ASDM
 SG_ OBJ_TIMESTAMP_OFFSET_017 : 247|8@0+ (1,-127) [-127|128] "ms" ASDM
 SG_ OBJ_DIMENSION_WIDTH_ERR_017 : 23|6@0+ (0.01,0) [0|0.63] "m" ASDM
 SG_ OBJ_DIMENSION_LENGTH_ERR_017 : 41|10@0+ (0.01,0) [0|10.23] "m" ASDM
 SG_ OBJ_CLS_TYPE1_017 : 271|4@0+ (1,0) [0|15] "NA" ASDM
 SG_ OBJ_CLS_TYPE1_PROB_017 : 303|8@0+ (0.004,0) [0|1] "NA" ASDM
 SG_ OBJ_CLS_TYPE2_017 : 267|4@0+ (1,0) [0|15] "NA" ASDM
 SG_ OBJ_CLS_TYPE2_PROB_017 : 311|8@0+ (0.004,0) [0|1] "NA" ASDM
 SG_ OBJ_CLS_TYPE3_017 : 279|4@0+ (1,0) [0|15] "NA" ASDM
 SG_ OBJ_CLS_TYPE3_PROB_017 : 319|8@0+ (0.004,0) [0|1] "NA" ASDM
 SG_ OBJ_CLS_TYPE4_017 : 275|4@0+ (1,0) [0|15] "NA" ASDM
 SG_ OBJ_CLS_TYPE4_PROB_017 : 327|8@0+ (0.004,0) [0|1] "NA" ASDM
 SG_ OBJ_CLS_TYPE5_017 : 287|4@0+ (1,0) [0|15] "NA" ASDM
 SG_ OBJ_CLS_TYPE5_PROB_017 : 335|8@0+ (0.004,0) [0|1] "NA" ASDM
 SG_ OBJ_CLS_TYPE6_017 : 282|4@0+ (1,0) [0|15] "NA" ASDM
 SG_ OBJ_CLS_TYPE6_PROB_017 : 343|8@0+ (0.004,0) [0|1] "NA" ASDM
 SG_ OBJ_RCS_017 : 351|7@0+ (1,-64) [-64|63] "dBsm" ASDM
 SG_ OBJ_REF_PT_LONG_OFFSET_017 : 357|14@0+ (0.0001,0) [0|1] "NA" ASDM
 SG_ OBJ_REF_PT_LAT_OFFSET_017 : 370|14@0+ (0.0001,0) [0|1] "NA" ASDM
 SG_ OBJ_YAW_RATE_017 : 399|10@0+ (0.005,-2.24) [-2.24|2.24] "rad/s" ASDM
 SG_ OBJ_YAW_RATE_ERR_017 : 388|5@0+ (0.025,0) [0|0.775] "rad/s" ASDM
 SG_ OBJ_GROUP_ID_017 : 405|6@0+ (1,0) [0|63] "NA" ASDM
 SG_ OBJ_POS_ERR_CRR_COEF_017 : 415|8@0+ (0.01,-1.2) [-1.2|1] "NA" ASDM
 SG_ OBJ_VELOCITY_ERR_CRR_COEF_017 : 423|8@0+ (0.01,-1.2) [-1.2|1] "NA" ASDM
 SG_ OBJ_ACCEL_ERR_CRR_COEF_017 : 431|8@0+ (0.01,-1.2) [-1.2|1] "NA" ASDM

BO_ 721 RDR_TRACKER_OBJ_018: 64 G5_RDR04
 SG_ OBJ_ALIVE_TIME_018 : 255|16@0+ (1,0) [0|65535] "ms" ASDM
 SG_ OBJ_ACCELERATION_LONG_ERR_018 : 215|8@0+ (0.025,0) [0|6.375] "m/s^2" ASDM
 SG_ OBJ_ACCELERATION_LAT_ERR_018 : 223|8@0+ (0.025,0) [0|6.375] "m/s^2" ASDM
 SG_ OBJ_VELOCITY_LONG_ERR_018 : 143|8@0+ (0.05,0) [0|12.75] "m/s" ASDM
 SG_ OBJ_VELOCITY_LAT_ERR_018 : 151|8@0+ (0.05,0) [0|12.75] "m/s" ASDM
 SG_ OBJ_POS_LONG_ERR_018 : 95|8@0+ (0.025,0) [0|6.375] "m" ASDM
 SG_ OBJ_POS_LAT_ERR_018 : 103|8@0+ (0.025,0) [0|6.375] "m" ASDM
 SG_ OBJ_TRACK_MOTION_MODEL_018 : 9|2@0+ (1,0) [1|3] "NA" ASDM
 SG_ OBJ_DIMENSION_WIDTH_018 : 17|10@0+ (0.01,0) [0|10.23] "m" ASDM
 SG_ OBJ_DIMENSION_LENGTH_018 : 37|12@0+ (0.01,0) [0|40.95] "m" ASDM
 SG_ OBJ_EXISTENCE_PROB_018 : 229|14@0+ (0.0001,0) [0|1] "NA" ASDM
 SG_ OBJ_YAW_ANGLE_018 : 155|12@0+ (0.005,-10) [-10|10.475] "rad" ASDM
 SG_ OBJ_YAW_ANGLE_ERR_018 : 175|7@0+ (0.01,0) [0|1.27] "rad" ASDM
 SG_ OBJ_ID_018 : 7|8@0+ (1,0) [0|255] "NA" ASDM
 SG_ OBJ_MOVEMENT_STATUS_018 : 196|3@0+ (1,0) [0|3] "NA" ASDM
 SG_ OBJ_MEASUREMENT_STATUS_018 : 14|3@0+ (1,0) [0|7] "NA" ASDM
 SG_ OBJ_POS_LONG_018 : 63|16@0+ (0.01,-327) [-327|327] "m" ASDM
 SG_ OBJ_POS_LAT_018 : 79|16@0+ (0.01,-327) [-327|327] "m" ASDM
 SG_ OBJ_VELOCITY_LONG_018 : 110|15@0+ (0.01,-163) [-163|163] "m/s" ASDM
 SG_ OBJ_VELOCITY_LAT_018 : 126|15@0+ (0.01,-163) [-163|163] "m/s" ASDM
 SG_ OBJ_ACCELERATION_LONG_018 : 193|10@0+ (0.05,-20) [-20|20] "m/s^2" ASDM
 SG_ OBJ_ACCELERATION_LAT_018 : 177|10@0+ (0.05,-20) [-20|20] "m/s^2" ASDM
 SG_ OBJ_VEH_TRACK_FLAG_018 : 10|1@0+ (1,0) [0|1] "NA" ASDM
 SG_ OBJ_MH_CYCLE_COUNTER_018 : 487|8@0+ (1,0) [0|255] "NA" ASDM
 SG_ OBJ_MH_CRC16_018 : 495|16@0+ (1,0) [0|65535] "NA" ASDM
 SG_ OBJ_TIMESTAMP_OFFSET_018 : 247|8@0+ (1,-127) [-127|128] "ms" ASDM
 SG_ OBJ_DIMENSION_WIDTH_ERR_018 : 23|6@0+ (0.01,0) [0|0.63] "m" ASDM
 SG_ OBJ_DIMENSION_LENGTH_ERR_018 : 41|10@0+ (0.01,0) [0|10.23] "m" ASDM
 SG_ OBJ_CLS_TYPE1_018 : 271|4@0+ (1,0) [0|15] "NA" ASDM
 SG_ OBJ_CLS_TYPE1_PROB_018 : 303|8@0+ (0.004,0) [0|1] "NA" ASDM
 SG_ OBJ_CLS_TYPE2_018 : 267|4@0+ (1,0) [0|15] "NA" ASDM
 SG_ OBJ_CLS_TYPE2_PROB_018 : 311|8@0+ (0.004,0) [0|1] "NA" ASDM
 SG_ OBJ_CLS_TYPE3_018 : 279|4@0+ (1,0) [0|15] "NA" ASDM
 SG_ OBJ_CLS_TYPE3_PROB_018 : 319|8@0+ (0.004,0) [0|1] "NA" ASDM
 SG_ OBJ_CLS_TYPE4_018 : 275|4@0+ (1,0) [0|15] "NA" ASDM
 SG_ OBJ_CLS_TYPE4_PROB_018 : 327|8@0+ (0.004,0) [0|1] "NA" ASDM
 SG_ OBJ_CLS_TYPE5_018 : 287|4@0+ (1,0) [0|15] "NA" ASDM
 SG_ OBJ_CLS_TYPE5_PROB_018 : 335|8@0+ (0.004,0) [0|1] "NA" ASDM
 SG_ OBJ_CLS_TYPE6_018 : 282|4@0+ (1,0) [0|15] "NA" ASDM
 SG_ OBJ_CLS_TYPE6_PROB_018 : 343|8@0+ (0.004,0) [0|1] "NA" ASDM
 SG_ OBJ_RCS_018 : 351|7@0+ (1,-64) [-64|63] "dBsm" ASDM
 SG_ OBJ_REF_PT_LONG_OFFSET_018 : 357|14@0+ (0.0001,0) [0|1] "NA" ASDM
 SG_ OBJ_REF_PT_LAT_OFFSET_018 : 370|14@0+ (0.0001,0) [0|1] "NA" ASDM
 SG_ OBJ_YAW_RATE_018 : 399|10@0+ (0.005,-2.24) [-2.24|2.24] "rad/s" ASDM
 SG_ OBJ_YAW_RATE_ERR_018 : 388|5@0+ (0.025,0) [0|0.775] "rad/s" ASDM
 SG_ OBJ_GROUP_ID_018 : 405|6@0+ (1,0) [0|63] "NA" ASDM
 SG_ OBJ_POS_ERR_CRR_COEF_018 : 415|8@0+ (0.01,-1.2) [-1.2|1] "NA" ASDM
 SG_ OBJ_VELOCITY_ERR_CRR_COEF_018 : 423|8@0+ (0.01,-1.2) [-1.2|1] "NA" ASDM
 SG_ OBJ_ACCEL_ERR_CRR_COEF_018 : 431|8@0+ (0.01,-1.2) [-1.2|1] "NA" ASDM

BO_ 722 RDR_TRACKER_OBJ_019: 64 G5_RDR04
 SG_ OBJ_ALIVE_TIME_019 : 255|16@0+ (1,0) [0|65535] "ms" ASDM
 SG_ OBJ_ACCELERATION_LONG_ERR_019 : 215|8@0+ (0.025,0) [0|6.375] "m/s^2" ASDM
 SG_ OBJ_ACCELERATION_LAT_ERR_019 : 223|8@0+ (0.025,0) [0|6.375] "m/s^2" ASDM
 SG_ OBJ_VELOCITY_LONG_ERR_019 : 143|8@0+ (0.05,0) [0|12.75] "m/s" ASDM
 SG_ OBJ_VELOCITY_LAT_ERR_019 : 151|8@0+ (0.05,0) [0|12.75] "m/s" ASDM
 SG_ OBJ_POS_LONG_ERR_019 : 95|8@0+ (0.025,0) [0|6.375] "m" ASDM
 SG_ OBJ_POS_LAT_ERR_019 : 103|8@0+ (0.025,0) [0|6.375] "m" ASDM
 SG_ OBJ_TRACK_MOTION_MODEL_019 : 9|2@0+ (1,0) [1|3] "NA" ASDM
 SG_ OBJ_DIMENSION_WIDTH_019 : 17|10@0+ (0.01,0) [0|10.23] "m" ASDM
 SG_ OBJ_DIMENSION_LENGTH_019 : 37|12@0+ (0.01,0) [0|40.95] "m" ASDM
 SG_ OBJ_EXISTENCE_PROB_019 : 229|14@0+ (0.0001,0) [0|1] "NA" ASDM
 SG_ OBJ_YAW_ANGLE_019 : 155|12@0+ (0.005,-10) [-10|10.475] "rad" ASDM
 SG_ OBJ_YAW_ANGLE_ERR_019 : 175|7@0+ (0.01,0) [0|1.27] "rad" ASDM
 SG_ OBJ_ID_019 : 7|8@0+ (1,0) [0|255] "NA" ASDM
 SG_ OBJ_MOVEMENT_STATUS_019 : 196|3@0+ (1,0) [0|3] "NA" ASDM
 SG_ OBJ_MEASUREMENT_STATUS_019 : 14|3@0+ (1,0) [0|7] "NA" ASDM
 SG_ OBJ_POS_LONG_019 : 63|16@0+ (0.01,-327) [-327|327] "m" ASDM
 SG_ OBJ_POS_LAT_019 : 79|16@0+ (0.01,-327) [-327|327] "m" ASDM
 SG_ OBJ_VELOCITY_LONG_019 : 110|15@0+ (0.01,-163) [-163|163] "m/s" ASDM
 SG_ OBJ_VELOCITY_LAT_019 : 126|15@0+ (0.01,-163) [-163|163] "m/s" ASDM
 SG_ OBJ_ACCELERATION_LONG_019 : 193|10@0+ (0.05,-20) [-20|20] "m/s^2" ASDM
 SG_ OBJ_ACCELERATION_LAT_019 : 177|10@0+ (0.05,-20) [-20|20] "m/s^2" ASDM
 SG_ OBJ_VEH_TRACK_FLAG_019 : 10|1@0+ (1,0) [0|1] "NA" ASDM
 SG_ OBJ_MH_CYCLE_COUNTER_019 : 487|8@0+ (1,0) [0|255] "NA" ASDM
 SG_ OBJ_MH_CRC16_019 : 495|16@0+ (1,0) [0|65535] "NA" ASDM
 SG_ OBJ_TIMESTAMP_OFFSET_019 : 247|8@0+ (1,-127) [-127|128] "ms" ASDM
 SG_ OBJ_DIMENSION_WIDTH_ERR_019 : 23|6@0+ (0.01,0) [0|0.63] "m" ASDM
 SG_ OBJ_DIMENSION_LENGTH_ERR_019 : 41|10@0+ (0.01,0) [0|10.23] "m" ASDM
 SG_ OBJ_CLS_TYPE1_019 : 271|4@0+ (1,0) [0|15] "NA" ASDM
 SG_ OBJ_CLS_TYPE1_PROB_019 : 303|8@0+ (0.004,0) [0|1] "NA" ASDM
 SG_ OBJ_CLS_TYPE2_019 : 267|4@0+ (1,0) [0|15] "NA" ASDM
 SG_ OBJ_CLS_TYPE2_PROB_019 : 311|8@0+ (0.004,0) [0|1] "NA" ASDM
 SG_ OBJ_CLS_TYPE3_019 : 279|4@0+ (1,0) [0|15] "NA" ASDM
 SG_ OBJ_CLS_TYPE3_PROB_019 : 319|8@0+ (0.004,0) [0|1] "NA" ASDM
 SG_ OBJ_CLS_TYPE4_019 : 275|4@0+ (1,0) [0|15] "NA" ASDM
 SG_ OBJ_CLS_TYPE4_PROB_019 : 327|8@0+ (0.004,0) [0|1] "NA" ASDM
 SG_ OBJ_CLS_TYPE5_019 : 287|4@0+ (1,0) [0|15] "NA" ASDM
 SG_ OBJ_CLS_TYPE5_PROB_019 : 335|8@0+ (0.004,0) [0|1] "NA" ASDM
 SG_ OBJ_CLS_TYPE6_019 : 282|4@0+ (1,0) [0|15] "NA" ASDM
 SG_ OBJ_CLS_TYPE6_PROB_019 : 343|8@0+ (0.004,0) [0|1] "NA" ASDM
 SG_ OBJ_RCS_019 : 351|7@0+ (1,-64) [-64|63] "dBsm" ASDM
 SG_ OBJ_REF_PT_LONG_OFFSET_019 : 357|14@0+ (0.0001,0) [0|1] "NA" ASDM
 SG_ OBJ_REF_PT_LAT_OFFSET_019 : 370|14@0+ (0.0001,0) [0|1] "NA" ASDM
 SG_ OBJ_YAW_RATE_019 : 399|10@0+ (0.005,-2.24) [-2.24|2.24] "rad/s" ASDM
 SG_ OBJ_YAW_RATE_ERR_019 : 388|5@0+ (0.025,0) [0|0.775] "rad/s" ASDM
 SG_ OBJ_GROUP_ID_019 : 405|6@0+ (1,0) [0|63] "NA" ASDM
 SG_ OBJ_POS_ERR_CRR_COEF_019 : 415|8@0+ (0.01,-1.2) [-1.2|1] "NA" ASDM
 SG_ OBJ_VELOCITY_ERR_CRR_COEF_019 : 423|8@0+ (0.01,-1.2) [-1.2|1] "NA" ASDM
 SG_ OBJ_ACCEL_ERR_CRR_COEF_019 : 431|8@0+ (0.01,-1.2) [-1.2|1] "NA" ASDM

BO_ 723 RDR_TRACKER_OBJ_020: 64 G5_RDR04
 SG_ OBJ_ALIVE_TIME_020 : 255|16@0+ (1,0) [0|65535] "ms" ASDM
 SG_ OBJ_ACCELERATION_LONG_ERR_020 : 215|8@0+ (0.025,0) [0|6.375] "m/s^2" ASDM
 SG_ OBJ_ACCELERATION_LAT_ERR_020 : 223|8@0+ (0.025,0) [0|6.375] "m/s^2" ASDM
 SG_ OBJ_VELOCITY_LONG_ERR_020 : 143|8@0+ (0.05,0) [0|12.75] "m/s" ASDM
 SG_ OBJ_VELOCITY_LAT_ERR_020 : 151|8@0+ (0.05,0) [0|12.75] "m/s" ASDM
 SG_ OBJ_POS_LONG_ERR_020 : 95|8@0+ (0.025,0) [0|6.375] "m" ASDM
 SG_ OBJ_POS_LAT_ERR_020 : 103|8@0+ (0.025,0) [0|6.375] "m" ASDM
 SG_ OBJ_TRACK_MOTION_MODEL_020 : 9|2@0+ (1,0) [1|3] "NA" ASDM
 SG_ OBJ_DIMENSION_WIDTH_020 : 17|10@0+ (0.01,0) [0|10.23] "m" ASDM
 SG_ OBJ_DIMENSION_LENGTH_020 : 37|12@0+ (0.01,0) [0|40.95] "m" ASDM
 SG_ OBJ_EXISTENCE_PROB_020 : 229|14@0+ (0.0001,0) [0|1] "NA" ASDM
 SG_ OBJ_YAW_ANGLE_020 : 155|12@0+ (0.005,-10) [-10|10.475] "rad" ASDM
 SG_ OBJ_YAW_ANGLE_ERR_020 : 175|7@0+ (0.01,0) [0|1.27] "rad" ASDM
 SG_ OBJ_ID_020 : 7|8@0+ (1,0) [0|255] "NA" ASDM
 SG_ OBJ_MOVEMENT_STATUS_020 : 196|3@0+ (1,0) [0|3] "NA" ASDM
 SG_ OBJ_MEASUREMENT_STATUS_020 : 14|3@0+ (1,0) [0|7] "NA" ASDM
 SG_ OBJ_POS_LONG_020 : 63|16@0+ (0.01,-327) [-327|327] "m" ASDM
 SG_ OBJ_POS_LAT_020 : 79|16@0+ (0.01,-327) [-327|327] "m" ASDM
 SG_ OBJ_VELOCITY_LONG_020 : 110|15@0+ (0.01,-163) [-163|163] "m/s" ASDM
 SG_ OBJ_VELOCITY_LAT_020 : 126|15@0+ (0.01,-163) [-163|163] "m/s" ASDM
 SG_ OBJ_ACCELERATION_LONG_020 : 193|10@0+ (0.05,-20) [-20|20] "m/s^2" ASDM
 SG_ OBJ_ACCELERATION_LAT_020 : 177|10@0+ (0.05,-20) [-20|20] "m/s^2" ASDM
 SG_ OBJ_VEH_TRACK_FLAG_020 : 10|1@0+ (1,0) [0|1] "NA" ASDM
 SG_ OBJ_MH_CYCLE_COUNTER_020 : 487|8@0+ (1,0) [0|255] "NA" ASDM
 SG_ OBJ_MH_CRC16_020 : 495|16@0+ (1,0) [0|65535] "NA" ASDM
 SG_ OBJ_TIMESTAMP_OFFSET_020 : 247|8@0+ (1,-127) [-127|128] "ms" ASDM
 SG_ OBJ_DIMENSION_WIDTH_ERR_020 : 23|6@0+ (0.01,0) [0|0.63] "m" ASDM
 SG_ OBJ_DIMENSION_LENGTH_ERR_020 : 41|10@0+ (0.01,0) [0|10.23] "m" ASDM
 SG_ OBJ_CLS_TYPE1_020 : 271|4@0+ (1,0) [0|15] "NA" ASDM
 SG_ OBJ_CLS_TYPE1_PROB_020 : 303|8@0+ (0.004,0) [0|1] "NA" ASDM
 SG_ OBJ_CLS_TYPE2_020 : 267|4@0+ (1,0) [0|15] "NA" ASDM
 SG_ OBJ_CLS_TYPE2_PROB_020 : 311|8@0+ (0.004,0) [0|1] "NA" ASDM
 SG_ OBJ_CLS_TYPE3_020 : 279|4@0+ (1,0) [0|15] "NA" ASDM
 SG_ OBJ_CLS_TYPE3_PROB_020 : 319|8@0+ (0.004,0) [0|1] "NA" ASDM
 SG_ OBJ_CLS_TYPE4_020 : 275|4@0+ (1,0) [0|15] "NA" ASDM
 SG_ OBJ_CLS_TYPE4_PROB_020 : 327|8@0+ (0.004,0) [0|1] "NA" ASDM
 SG_ OBJ_CLS_TYPE5_020 : 287|4@0+ (1,0) [0|15] "NA" ASDM
 SG_ OBJ_CLS_TYPE5_PROB_020 : 335|8@0+ (0.004,0) [0|1] "NA" ASDM
 SG_ OBJ_CLS_TYPE6_020 : 282|4@0+ (1,0) [0|15] "NA" ASDM
 SG_ OBJ_CLS_TYPE6_PROB_020 : 343|8@0+ (0.004,0) [0|1] "NA" ASDM
 SG_ OBJ_RCS_020 : 351|7@0+ (1,-64) [-64|63] "dBsm" ASDM
 SG_ OBJ_REF_PT_LONG_OFFSET_020 : 357|14@0+ (0.0001,0) [0|1] "NA" ASDM
 SG_ OBJ_REF_PT_LAT_OFFSET_020 : 370|14@0+ (0.0001,0) [0|1] "NA" ASDM
 SG_ OBJ_YAW_RATE_020 : 399|10@0+ (0.005,-2.24) [-2.24|2.24] "rad/s" ASDM
 SG_ OBJ_YAW_RATE_ERR_020 : 388|5@0+ (0.025,0) [0|0.775] "rad/s" ASDM
 SG_ OBJ_GROUP_ID_020 : 405|6@0+ (1,0) [0|63] "NA" ASDM
 SG_ OBJ_POS_ERR_CRR_COEF_020 : 415|8@0+ (0.01,-1.2) [-1.2|1] "NA" ASDM
 SG_ OBJ_VELOCITY_ERR_CRR_COEF_020 : 423|8@0+ (0.01,-1.2) [-1.2|1] "NA" ASDM
 SG_ OBJ_ACCEL_ERR_CRR_COEF_020 : 431|8@0+ (0.01,-1.2) [-1.2|1] "NA" ASDM

BO_ 724 RDR_TRACKER_OBJ_021: 64 G5_RDR04
 SG_ OBJ_ALIVE_TIME_021 : 255|16@0+ (1,0) [0|65535] "ms" ASDM
 SG_ OBJ_ACCELERATION_LONG_ERR_021 : 215|8@0+ (0.025,0) [0|6.375] "m/s^2" ASDM
 SG_ OBJ_ACCELERATION_LAT_ERR_021 : 223|8@0+ (0.025,0) [0|6.375] "m/s^2" ASDM
 SG_ OBJ_VELOCITY_LONG_ERR_021 : 143|8@0+ (0.05,0) [0|12.75] "m/s" ASDM
 SG_ OBJ_VELOCITY_LAT_ERR_021 : 151|8@0+ (0.05,0) [0|12.75] "m/s" ASDM
 SG_ OBJ_POS_LONG_ERR_021 : 95|8@0+ (0.025,0) [0|6.375] "m" ASDM
 SG_ OBJ_POS_LAT_ERR_021 : 103|8@0+ (0.025,0) [0|6.375] "m" ASDM
 SG_ OBJ_TRACK_MOTION_MODEL_021 : 9|2@0+ (1,0) [1|3] "NA" ASDM
 SG_ OBJ_DIMENSION_WIDTH_021 : 17|10@0+ (0.01,0) [0|10.23] "m" ASDM
 SG_ OBJ_DIMENSION_LENGTH_021 : 37|12@0+ (0.01,0) [0|40.95] "m" ASDM
 SG_ OBJ_EXISTENCE_PROB_021 : 229|14@0+ (0.0001,0) [0|1] "NA" ASDM
 SG_ OBJ_YAW_ANGLE_021 : 155|12@0+ (0.005,-10) [-10|10.475] "rad" ASDM
 SG_ OBJ_YAW_ANGLE_ERR_021 : 175|7@0+ (0.01,0) [0|1.27] "rad" ASDM
 SG_ OBJ_ID_021 : 7|8@0+ (1,0) [0|255] "NA" ASDM
 SG_ OBJ_MOVEMENT_STATUS_021 : 196|3@0+ (1,0) [0|3] "NA" ASDM
 SG_ OBJ_MEASUREMENT_STATUS_021 : 14|3@0+ (1,0) [0|7] "NA" ASDM
 SG_ OBJ_POS_LONG_021 : 63|16@0+ (0.01,-327) [-327|327] "m" ASDM
 SG_ OBJ_POS_LAT_021 : 79|16@0+ (0.01,-327) [-327|327] "m" ASDM
 SG_ OBJ_VELOCITY_LONG_021 : 110|15@0+ (0.01,-163) [-163|163] "m/s" ASDM
 SG_ OBJ_VELOCITY_LAT_021 : 126|15@0+ (0.01,-163) [-163|163] "m/s" ASDM
 SG_ OBJ_ACCELERATION_LONG_021 : 193|10@0+ (0.05,-20) [-20|20] "m/s^2" ASDM
 SG_ OBJ_ACCELERATION_LAT_021 : 177|10@0+ (0.05,-20) [-20|20] "m/s^2" ASDM
 SG_ OBJ_VEH_TRACK_FLAG_021 : 10|1@0+ (1,0) [0|1] "NA" ASDM
 SG_ OBJ_MH_CYCLE_COUNTER_021 : 487|8@0+ (1,0) [0|255] "NA" ASDM
 SG_ OBJ_MH_CRC16_021 : 495|16@0+ (1,0) [0|65535] "NA" ASDM
 SG_ OBJ_TIMESTAMP_OFFSET_021 : 247|8@0+ (1,-127) [-127|128] "ms" ASDM
 SG_ OBJ_DIMENSION_WIDTH_ERR_021 : 23|6@0+ (0.01,0) [0|0.63] "m" ASDM
 SG_ OBJ_DIMENSION_LENGTH_ERR_021 : 41|10@0+ (0.01,0) [0|10.23] "m" ASDM
 SG_ OBJ_CLS_TYPE1_021 : 271|4@0+ (1,0) [0|15] "NA" ASDM
 SG_ OBJ_CLS_TYPE1_PROB_021 : 303|8@0+ (0.004,0) [0|1] "NA" ASDM
 SG_ OBJ_CLS_TYPE2_021 : 267|4@0+ (1,0) [0|15] "NA" ASDM
 SG_ OBJ_CLS_TYPE2_PROB_021 : 311|8@0+ (0.004,0) [0|1] "NA" ASDM
 SG_ OBJ_CLS_TYPE3_021 : 279|4@0+ (1,0) [0|15] "NA" ASDM
 SG_ OBJ_CLS_TYPE3_PROB_021 : 319|8@0+ (0.004,0) [0|1] "NA" ASDM
 SG_ OBJ_CLS_TYPE4_021 : 275|4@0+ (1,0) [0|15] "NA" ASDM
 SG_ OBJ_CLS_TYPE4_PROB_021 : 327|8@0+ (0.004,0) [0|1] "NA" ASDM
 SG_ OBJ_CLS_TYPE5_021 : 287|4@0+ (1,0) [0|15] "NA" ASDM
 SG_ OBJ_CLS_TYPE5_PROB_021 : 335|8@0+ (0.004,0) [0|1] "NA" ASDM
 SG_ OBJ_CLS_TYPE6_021 : 282|4@0+ (1,0) [0|15] "NA" ASDM
 SG_ OBJ_CLS_TYPE6_PROB_021 : 343|8@0+ (0.004,0) [0|1] "NA" ASDM
 SG_ OBJ_RCS_021 : 351|7@0+ (1,-64) [-64|63] "dBsm" ASDM
 SG_ OBJ_REF_PT_LONG_OFFSET_021 : 357|14@0+ (0.0001,0) [0|1] "NA" ASDM
 SG_ OBJ_REF_PT_LAT_OFFSET_021 : 370|14@0+ (0.0001,0) [0|1] "NA" ASDM
 SG_ OBJ_YAW_RATE_021 : 399|10@0+ (0.005,-2.24) [-2.24|2.24] "rad/s" ASDM
 SG_ OBJ_YAW_RATE_ERR_021 : 388|5@0+ (0.025,0) [0|0.775] "rad/s" ASDM
 SG_ OBJ_GROUP_ID_021 : 405|6@0+ (1,0) [0|63] "NA" ASDM
 SG_ OBJ_POS_ERR_CRR_COEF_021 : 415|8@0+ (0.01,-1.2) [-1.2|1] "NA" ASDM
 SG_ OBJ_VELOCITY_ERR_CRR_COEF_021 : 423|8@0+ (0.01,-1.2) [-1.2|1] "NA" ASDM
 SG_ OBJ_ACCEL_ERR_CRR_COEF_021 : 431|8@0+ (0.01,-1.2) [-1.2|1] "NA" ASDM

BO_ 725 RDR_TRACKER_OBJ_022: 64 G5_RDR04
 SG_ OBJ_ALIVE_TIME_022 : 255|16@0+ (1,0) [0|65535] "ms" ASDM
 SG_ OBJ_ACCELERATION_LONG_ERR_022 : 215|8@0+ (0.025,0) [0|6.375] "m/s^2" ASDM
 SG_ OBJ_ACCELERATION_LAT_ERR_022 : 223|8@0+ (0.025,0) [0|6.375] "m/s^2" ASDM
 SG_ OBJ_VELOCITY_LONG_ERR_022 : 143|8@0+ (0.05,0) [0|12.75] "m/s" ASDM
 SG_ OBJ_VELOCITY_LAT_ERR_022 : 151|8@0+ (0.05,0) [0|12.75] "m/s" ASDM
 SG_ OBJ_POS_LONG_ERR_022 : 95|8@0+ (0.025,0) [0|6.375] "m" ASDM
 SG_ OBJ_POS_LAT_ERR_022 : 103|8@0+ (0.025,0) [0|6.375] "m" ASDM
 SG_ OBJ_TRACK_MOTION_MODEL_022 : 9|2@0+ (1,0) [1|3] "NA" ASDM
 SG_ OBJ_DIMENSION_WIDTH_022 : 17|10@0+ (0.01,0) [0|10.23] "m" ASDM
 SG_ OBJ_DIMENSION_LENGTH_022 : 37|12@0+ (0.01,0) [0|40.95] "m" ASDM
 SG_ OBJ_EXISTENCE_PROB_022 : 229|14@0+ (0.0001,0) [0|1] "NA" ASDM
 SG_ OBJ_YAW_ANGLE_022 : 155|12@0+ (0.005,-10) [-10|10.475] "rad" ASDM
 SG_ OBJ_YAW_ANGLE_ERR_022 : 175|7@0+ (0.01,0) [0|1.27] "rad" ASDM
 SG_ OBJ_ID_022 : 7|8@0+ (1,0) [0|255] "NA" ASDM
 SG_ OBJ_MOVEMENT_STATUS_022 : 196|3@0+ (1,0) [0|3] "NA" ASDM
 SG_ OBJ_MEASUREMENT_STATUS_022 : 14|3@0+ (1,0) [0|7] "NA" ASDM
 SG_ OBJ_POS_LONG_022 : 63|16@0+ (0.01,-327) [-327|327] "m" ASDM
 SG_ OBJ_POS_LAT_022 : 79|16@0+ (0.01,-327) [-327|327] "m" ASDM
 SG_ OBJ_VELOCITY_LONG_022 : 110|15@0+ (0.01,-163) [-163|163] "m/s" ASDM
 SG_ OBJ_VELOCITY_LAT_022 : 126|15@0+ (0.01,-163) [-163|163] "m/s" ASDM
 SG_ OBJ_ACCELERATION_LONG_022 : 193|10@0+ (0.05,-20) [-20|20] "m/s^2" ASDM
 SG_ OBJ_ACCELERATION_LAT_022 : 177|10@0+ (0.05,-20) [-20|20] "m/s^2" ASDM
 SG_ OBJ_VEH_TRACK_FLAG_022 : 10|1@0+ (1,0) [0|1] "NA" ASDM
 SG_ OBJ_MH_CYCLE_COUNTER_022 : 487|8@0+ (1,0) [0|255] "NA" ASDM
 SG_ OBJ_MH_CRC16_022 : 495|16@0+ (1,0) [0|65535] "NA" ASDM
 SG_ OBJ_TIMESTAMP_OFFSET_022 : 247|8@0+ (1,-127) [-127|128] "ms" ASDM
 SG_ OBJ_DIMENSION_WIDTH_ERR_022 : 23|6@0+ (0.01,0) [0|0.63] "m" ASDM
 SG_ OBJ_DIMENSION_LENGTH_ERR_022 : 41|10@0+ (0.01,0) [0|10.23] "m" ASDM
 SG_ OBJ_CLS_TYPE1_022 : 271|4@0+ (1,0) [0|15] "NA" ASDM
 SG_ OBJ_CLS_TYPE1_PROB_022 : 303|8@0+ (0.004,0) [0|1] "NA" ASDM
 SG_ OBJ_CLS_TYPE2_022 : 267|4@0+ (1,0) [0|15] "NA" ASDM
 SG_ OBJ_CLS_TYPE2_PROB_022 : 311|8@0+ (0.004,0) [0|1] "NA" ASDM
 SG_ OBJ_CLS_TYPE3_022 : 279|4@0+ (1,0) [0|15] "NA" ASDM
 SG_ OBJ_CLS_TYPE3_PROB_022 : 319|8@0+ (0.004,0) [0|1] "NA" ASDM
 SG_ OBJ_CLS_TYPE4_022 : 275|4@0+ (1,0) [0|15] "NA" ASDM
 SG_ OBJ_CLS_TYPE4_PROB_022 : 327|8@0+ (0.004,0) [0|1] "NA" ASDM
 SG_ OBJ_CLS_TYPE5_022 : 287|4@0+ (1,0) [0|15] "NA" ASDM
 SG_ OBJ_CLS_TYPE5_PROB_022 : 335|8@0+ (0.004,0) [0|1] "NA" ASDM
 SG_ OBJ_CLS_TYPE6_022 : 282|4@0+ (1,0) [0|15] "NA" ASDM
 SG_ OBJ_CLS_TYPE6_PROB_022 : 343|8@0+ (0.004,0) [0|1] "NA" ASDM
 SG_ OBJ_RCS_022 : 351|7@0+ (1,-64) [-64|63] "dBsm" ASDM
 SG_ OBJ_REF_PT_LONG_OFFSET_022 : 357|14@0+ (0.0001,0) [0|1] "NA" ASDM
 SG_ OBJ_REF_PT_LAT_OFFSET_022 : 370|14@0+ (0.0001,0) [0|1] "NA" ASDM
 SG_ OBJ_YAW_RATE_022 : 399|10@0+ (0.005,-2.24) [-2.24|2.24] "rad/s" ASDM
 SG_ OBJ_YAW_RATE_ERR_022 : 388|5@0+ (0.025,0) [0|0.775] "rad/s" ASDM
 SG_ OBJ_GROUP_ID_022 : 405|6@0+ (1,0) [0|63] "NA" ASDM
 SG_ OBJ_POS_ERR_CRR_COEF_022 : 415|8@0+ (0.01,-1.2) [-1.2|1] "NA" ASDM
 SG_ OBJ_VELOCITY_ERR_CRR_COEF_022 : 423|8@0+ (0.01,-1.2) [-1.2|1] "NA" ASDM
 SG_ OBJ_ACCEL_ERR_CRR_COEF_022 : 431|8@0+ (0.01,-1.2) [-1.2|1] "NA" ASDM

BO_ 726 RDR_TRACKER_OBJ_023: 64 G5_RDR04
 SG_ OBJ_ALIVE_TIME_023 : 255|16@0+ (1,0) [0|65535] "ms" ASDM
 SG_ OBJ_ACCELERATION_LONG_ERR_023 : 215|8@0+ (0.025,0) [0|6.375] "m/s^2" ASDM
 SG_ OBJ_ACCELERATION_LAT_ERR_023 : 223|8@0+ (0.025,0) [0|6.375] "m/s^2" ASDM
 SG_ OBJ_VELOCITY_LONG_ERR_023 : 143|8@0+ (0.05,0) [0|12.75] "m/s" ASDM
 SG_ OBJ_VELOCITY_LAT_ERR_023 : 151|8@0+ (0.05,0) [0|12.75] "m/s" ASDM
 SG_ OBJ_POS_LONG_ERR_023 : 95|8@0+ (0.025,0) [0|6.375] "m" ASDM
 SG_ OBJ_POS_LAT_ERR_023 : 103|8@0+ (0.025,0) [0|6.375] "m" ASDM
 SG_ OBJ_TRACK_MOTION_MODEL_023 : 9|2@0+ (1,0) [1|3] "NA" ASDM
 SG_ OBJ_DIMENSION_WIDTH_023 : 17|10@0+ (0.01,0) [0|10.23] "m" ASDM
 SG_ OBJ_DIMENSION_LENGTH_023 : 37|12@0+ (0.01,0) [0|40.95] "m" ASDM
 SG_ OBJ_EXISTENCE_PROB_023 : 229|14@0+ (0.0001,0) [0|1] "NA" ASDM
 SG_ OBJ_YAW_ANGLE_023 : 155|12@0+ (0.005,-10) [-10|10.475] "rad" ASDM
 SG_ OBJ_YAW_ANGLE_ERR_023 : 175|7@0+ (0.01,0) [0|1.27] "rad" ASDM
 SG_ OBJ_ID_023 : 7|8@0+ (1,0) [0|255] "NA" ASDM
 SG_ OBJ_MOVEMENT_STATUS_023 : 196|3@0+ (1,0) [0|3] "NA" ASDM
 SG_ OBJ_MEASUREMENT_STATUS_023 : 14|3@0+ (1,0) [0|7] "NA" ASDM
 SG_ OBJ_POS_LONG_023 : 63|16@0+ (0.01,-327) [-327|327] "m" ASDM
 SG_ OBJ_POS_LAT_023 : 79|16@0+ (0.01,-327) [-327|327] "m" ASDM
 SG_ OBJ_VELOCITY_LONG_023 : 110|15@0+ (0.01,-163) [-163|163] "m/s" ASDM
 SG_ OBJ_VELOCITY_LAT_023 : 126|15@0+ (0.01,-163) [-163|163] "m/s" ASDM
 SG_ OBJ_ACCELERATION_LONG_023 : 193|10@0+ (0.05,-20) [-20|20] "m/s^2" ASDM
 SG_ OBJ_ACCELERATION_LAT_023 : 177|10@0+ (0.05,-20) [-20|20] "m/s^2" ASDM
 SG_ OBJ_VEH_TRACK_FLAG_023 : 10|1@0+ (1,0) [0|1] "NA" ASDM
 SG_ OBJ_MH_CYCLE_COUNTER_023 : 487|8@0+ (1,0) [0|255] "NA" ASDM
 SG_ OBJ_MH_CRC16_023 : 495|16@0+ (1,0) [0|65535] "NA" ASDM
 SG_ OBJ_TIMESTAMP_OFFSET_023 : 247|8@0+ (1,-127) [-127|128] "ms" ASDM
 SG_ OBJ_DIMENSION_WIDTH_ERR_023 : 23|6@0+ (0.01,0) [0|0.63] "m" ASDM
 SG_ OBJ_DIMENSION_LENGTH_ERR_023 : 41|10@0+ (0.01,0) [0|10.23] "m" ASDM
 SG_ OBJ_CLS_TYPE1_023 : 271|4@0+ (1,0) [0|15] "NA" ASDM
 SG_ OBJ_CLS_TYPE1_PROB_023 : 303|8@0+ (0.004,0) [0|1] "NA" ASDM
 SG_ OBJ_CLS_TYPE2_023 : 267|4@0+ (1,0) [0|15] "NA" ASDM
 SG_ OBJ_CLS_TYPE2_PROB_023 : 311|8@0+ (0.004,0) [0|1] "NA" ASDM
 SG_ OBJ_CLS_TYPE3_023 : 279|4@0+ (1,0) [0|15] "NA" ASDM
 SG_ OBJ_CLS_TYPE3_PROB_023 : 319|8@0+ (0.004,0) [0|1] "NA" ASDM
 SG_ OBJ_CLS_TYPE4_023 : 275|4@0+ (1,0) [0|15] "NA" ASDM
 SG_ OBJ_CLS_TYPE4_PROB_023 : 327|8@0+ (0.004,0) [0|1] "NA" ASDM
 SG_ OBJ_CLS_TYPE5_023 : 287|4@0+ (1,0) [0|15] "NA" ASDM
 SG_ OBJ_CLS_TYPE5_PROB_023 : 335|8@0+ (0.004,0) [0|1] "NA" ASDM
 SG_ OBJ_CLS_TYPE6_023 : 282|4@0+ (1,0) [0|15] "NA" ASDM
 SG_ OBJ_CLS_TYPE6_PROB_023 : 343|8@0+ (0.004,0) [0|1] "NA" ASDM
 SG_ OBJ_RCS_023 : 351|7@0+ (1,-64) [-64|63] "dBsm" ASDM
 SG_ OBJ_REF_PT_LONG_OFFSET_023 : 357|14@0+ (0.0001,0) [0|1] "NA" ASDM
 SG_ OBJ_REF_PT_LAT_OFFSET_023 : 370|14@0+ (0.0001,0) [0|1] "NA" ASDM
 SG_ OBJ_YAW_RATE_023 : 399|10@0+ (0.005,-2.24) [-2.24|2.24] "rad/s" ASDM
 SG_ OBJ_YAW_RATE_ERR_023 : 388|5@0+ (0.025,0) [0|0.775] "rad/s" ASDM
 SG_ OBJ_GROUP_ID_023 : 405|6@0+ (1,0) [0|63] "NA" ASDM
 SG_ OBJ_POS_ERR_CRR_COEF_023 : 415|8@0+ (0.01,-1.2) [-1.2|1] "NA" ASDM
 SG_ OBJ_VELOCITY_ERR_CRR_COEF_023 : 423|8@0+ (0.01,-1.2) [-1.2|1] "NA" ASDM
 SG_ OBJ_ACCEL_ERR_CRR_COEF_023 : 431|8@0+ (0.01,-1.2) [-1.2|1] "NA" ASDM

BO_ 727 RDR_TRACKER_OBJ_024: 64 G5_RDR04
 SG_ OBJ_ALIVE_TIME_024 : 255|16@0+ (1,0) [0|65535] "ms" ASDM
 SG_ OBJ_ACCELERATION_LONG_ERR_024 : 215|8@0+ (0.025,0) [0|6.375] "m/s^2" ASDM
 SG_ OBJ_ACCELERATION_LAT_ERR_024 : 223|8@0+ (0.025,0) [0|6.375] "m/s^2" ASDM
 SG_ OBJ_VELOCITY_LONG_ERR_024 : 143|8@0+ (0.05,0) [0|12.75] "m/s" ASDM
 SG_ OBJ_VELOCITY_LAT_ERR_024 : 151|8@0+ (0.05,0) [0|12.75] "m/s" ASDM
 SG_ OBJ_POS_LONG_ERR_024 : 95|8@0+ (0.025,0) [0|6.375] "m" ASDM
 SG_ OBJ_POS_LAT_ERR_024 : 103|8@0+ (0.025,0) [0|6.375] "m" ASDM
 SG_ OBJ_TRACK_MOTION_MODEL_024 : 9|2@0+ (1,0) [1|3] "NA" ASDM
 SG_ OBJ_DIMENSION_WIDTH_024 : 17|10@0+ (0.01,0) [0|10.23] "m" ASDM
 SG_ OBJ_DIMENSION_LENGTH_024 : 37|12@0+ (0.01,0) [0|40.95] "m" ASDM
 SG_ OBJ_EXISTENCE_PROB_024 : 229|14@0+ (0.0001,0) [0|1] "NA" ASDM
 SG_ OBJ_YAW_ANGLE_024 : 155|12@0+ (0.005,-10) [-10|10.475] "rad" ASDM
 SG_ OBJ_YAW_ANGLE_ERR_024 : 175|7@0+ (0.01,0) [0|1.27] "rad" ASDM
 SG_ OBJ_ID_024 : 7|8@0+ (1,0) [0|255] "NA" ASDM
 SG_ OBJ_MOVEMENT_STATUS_024 : 196|3@0+ (1,0) [0|3] "NA" ASDM
 SG_ OBJ_MEASUREMENT_STATUS_024 : 14|3@0+ (1,0) [0|7] "NA" ASDM
 SG_ OBJ_POS_LONG_024 : 63|16@0+ (0.01,-327) [-327|327] "m" ASDM
 SG_ OBJ_POS_LAT_024 : 79|16@0+ (0.01,-327) [-327|327] "m" ASDM
 SG_ OBJ_VELOCITY_LONG_024 : 110|15@0+ (0.01,-163) [-163|163] "m/s" ASDM
 SG_ OBJ_VELOCITY_LAT_024 : 126|15@0+ (0.01,-163) [-163|163] "m/s" ASDM
 SG_ OBJ_ACCELERATION_LONG_024 : 193|10@0+ (0.05,-20) [-20|20] "m/s^2" ASDM
 SG_ OBJ_ACCELERATION_LAT_024 : 177|10@0+ (0.05,-20) [-20|20] "m/s^2" ASDM
 SG_ OBJ_VEH_TRACK_FLAG_024 : 10|1@0+ (1,0) [0|1] "NA" ASDM
 SG_ OBJ_MH_CYCLE_COUNTER_024 : 487|8@0+ (1,0) [0|255] "NA" ASDM
 SG_ OBJ_MH_CRC16_024 : 495|16@0+ (1,0) [0|65535] "NA" ASDM
 SG_ OBJ_TIMESTAMP_OFFSET_024 : 247|8@0+ (1,-127) [-127|128] "ms" ASDM
 SG_ OBJ_DIMENSION_WIDTH_ERR_024 : 23|6@0+ (0.01,0) [0|0.63] "m" ASDM
 SG_ OBJ_DIMENSION_LENGTH_ERR_024 : 41|10@0+ (0.01,0) [0|10.23] "m" ASDM
 SG_ OBJ_CLS_TYPE1_024 : 271|4@0+ (1,0) [0|15] "NA" ASDM
 SG_ OBJ_CLS_TYPE1_PROB_024 : 303|8@0+ (0.004,0) [0|1] "NA" ASDM
 SG_ OBJ_CLS_TYPE2_024 : 267|4@0+ (1,0) [0|15] "NA" ASDM
 SG_ OBJ_CLS_TYPE2_PROB_024 : 311|8@0+ (0.004,0) [0|1] "NA" ASDM
 SG_ OBJ_CLS_TYPE3_024 : 279|4@0+ (1,0) [0|15] "NA" ASDM
 SG_ OBJ_CLS_TYPE3_PROB_024 : 319|8@0+ (0.004,0) [0|1] "NA" ASDM
 SG_ OBJ_CLS_TYPE4_024 : 275|4@0+ (1,0) [0|15] "NA" ASDM
 SG_ OBJ_CLS_TYPE4_PROB_024 : 327|8@0+ (0.004,0) [0|1] "NA" ASDM
 SG_ OBJ_CLS_TYPE5_024 : 287|4@0+ (1,0) [0|15] "NA" ASDM
 SG_ OBJ_CLS_TYPE5_PROB_024 : 335|8@0+ (0.004,0) [0|1] "NA" ASDM
 SG_ OBJ_CLS_TYPE6_024 : 282|4@0+ (1,0) [0|15] "NA" ASDM
 SG_ OBJ_CLS_TYPE6_PROB_024 : 343|8@0+ (0.004,0) [0|1] "NA" ASDM
 SG_ OBJ_RCS_024 : 351|7@0+ (1,-64) [-64|63] "dBsm" ASDM
 SG_ OBJ_REF_PT_LONG_OFFSET_024 : 357|14@0+ (0.0001,0) [0|1] "NA" ASDM
 SG_ OBJ_REF_PT_LAT_OFFSET_024 : 370|14@0+ (0.0001,0) [0|1] "NA" ASDM
 SG_ OBJ_YAW_RATE_024 : 399|10@0+ (0.005,-2.24) [-2.24|2.24] "rad/s" ASDM
 SG_ OBJ_YAW_RATE_ERR_024 : 388|5@0+ (0.025,0) [0|0.775] "rad/s" ASDM
 SG_ OBJ_GROUP_ID_024 : 405|6@0+ (1,0) [0|63] "NA" ASDM
 SG_ OBJ_POS_ERR_CRR_COEF_024 : 415|8@0+ (0.01,-1.2) [-1.2|1] "NA" ASDM
 SG_ OBJ_VELOCITY_ERR_CRR_COEF_024 : 423|8@0+ (0.01,-1.2) [-1.2|1] "NA" ASDM
 SG_ OBJ_ACCEL_ERR_CRR_COEF_024 : 431|8@0+ (0.01,-1.2) [-1.2|1] "NA" ASDM

BO_ 728 RDR_TRACKER_OBJ_025: 64 G5_RDR04
 SG_ OBJ_ALIVE_TIME_025 : 255|16@0+ (1,0) [0|65535] "ms" ASDM
 SG_ OBJ_ACCELERATION_LONG_ERR_025 : 215|8@0+ (0.025,0) [0|6.375] "m/s^2" ASDM
 SG_ OBJ_ACCELERATION_LAT_ERR_025 : 223|8@0+ (0.025,0) [0|6.375] "m/s^2" ASDM
 SG_ OBJ_VELOCITY_LONG_ERR_025 : 143|8@0+ (0.05,0) [0|12.75] "m/s" ASDM
 SG_ OBJ_VELOCITY_LAT_ERR_025 : 151|8@0+ (0.05,0) [0|12.75] "m/s" ASDM
 SG_ OBJ_POS_LONG_ERR_025 : 95|8@0+ (0.025,0) [0|6.375] "m" ASDM
 SG_ OBJ_POS_LAT_ERR_025 : 103|8@0+ (0.025,0) [0|6.375] "m" ASDM
 SG_ OBJ_TRACK_MOTION_MODEL_025 : 9|2@0+ (1,0) [1|3] "NA" ASDM
 SG_ OBJ_DIMENSION_WIDTH_025 : 17|10@0+ (0.01,0) [0|10.23] "m" ASDM
 SG_ OBJ_DIMENSION_LENGTH_025 : 37|12@0+ (0.01,0) [0|40.95] "m" ASDM
 SG_ OBJ_EXISTENCE_PROB_025 : 229|14@0+ (0.0001,0) [0|1] "NA" ASDM
 SG_ OBJ_YAW_ANGLE_025 : 155|12@0+ (0.005,-10) [-10|10.475] "rad" ASDM
 SG_ OBJ_YAW_ANGLE_ERR_025 : 175|7@0+ (0.01,0) [0|1.27] "rad" ASDM
 SG_ OBJ_ID_025 : 7|8@0+ (1,0) [0|255] "NA" ASDM
 SG_ OBJ_MOVEMENT_STATUS_025 : 196|3@0+ (1,0) [0|3] "NA" ASDM
 SG_ OBJ_MEASUREMENT_STATUS_025 : 14|3@0+ (1,0) [0|7] "NA" ASDM
 SG_ OBJ_POS_LONG_025 : 63|16@0+ (0.01,-327) [-327|327] "m" ASDM
 SG_ OBJ_POS_LAT_025 : 79|16@0+ (0.01,-327) [-327|327] "m" ASDM
 SG_ OBJ_VELOCITY_LONG_025 : 110|15@0+ (0.01,-163) [-163|163] "m/s" ASDM
 SG_ OBJ_VELOCITY_LAT_025 : 126|15@0+ (0.01,-163) [-163|163] "m/s" ASDM
 SG_ OBJ_ACCELERATION_LONG_025 : 193|10@0+ (0.05,-20) [-20|20] "m/s^2" ASDM
 SG_ OBJ_ACCELERATION_LAT_025 : 177|10@0+ (0.05,-20) [-20|20] "m/s^2" ASDM
 SG_ OBJ_VEH_TRACK_FLAG_025 : 10|1@0+ (1,0) [0|1] "NA" ASDM
 SG_ OBJ_MH_CYCLE_COUNTER_025 : 487|8@0+ (1,0) [0|255] "NA" ASDM
 SG_ OBJ_MH_CRC16_025 : 495|16@0+ (1,0) [0|65535] "NA" ASDM
 SG_ OBJ_TIMESTAMP_OFFSET_025 : 247|8@0+ (1,-127) [-127|128] "ms" ASDM
 SG_ OBJ_DIMENSION_WIDTH_ERR_025 : 23|6@0+ (0.01,0) [0|0.63] "m" ASDM
 SG_ OBJ_DIMENSION_LENGTH_ERR_025 : 41|10@0+ (0.01,0) [0|10.23] "m" ASDM
 SG_ OBJ_CLS_TYPE1_025 : 271|4@0+ (1,0) [0|15] "NA" ASDM
 SG_ OBJ_CLS_TYPE1_PROB_025 : 303|8@0+ (0.004,0) [0|1] "NA" ASDM
 SG_ OBJ_CLS_TYPE2_025 : 267|4@0+ (1,0) [0|15] "NA" ASDM
 SG_ OBJ_CLS_TYPE2_PROB_025 : 311|8@0+ (0.004,0) [0|1] "NA" ASDM
 SG_ OBJ_CLS_TYPE3_025 : 279|4@0+ (1,0) [0|15] "NA" ASDM
 SG_ OBJ_CLS_TYPE3_PROB_025 : 319|8@0+ (0.004,0) [0|1] "NA" ASDM
 SG_ OBJ_CLS_TYPE4_025 : 275|4@0+ (1,0) [0|15] "NA" ASDM
 SG_ OBJ_CLS_TYPE4_PROB_025 : 327|8@0+ (0.004,0) [0|1] "NA" ASDM
 SG_ OBJ_CLS_TYPE5_025 : 287|4@0+ (1,0) [0|15] "NA" ASDM
 SG_ OBJ_CLS_TYPE5_PROB_025 : 335|8@0+ (0.004,0) [0|1] "NA" ASDM
 SG_ OBJ_CLS_TYPE6_025 : 282|4@0+ (1,0) [0|15] "NA" ASDM
 SG_ OBJ_CLS_TYPE6_PROB_025 : 343|8@0+ (0.004,0) [0|1] "NA" ASDM
 SG_ OBJ_RCS_025 : 351|7@0+ (1,-64) [-64|63] "dBsm" ASDM
 SG_ OBJ_REF_PT_LONG_OFFSET_025 : 357|14@0+ (0.0001,0) [0|1] "NA" ASDM
 SG_ OBJ_REF_PT_LAT_OFFSET_025 : 370|14@0+ (0.0001,0) [0|1] "NA" ASDM
 SG_ OBJ_YAW_RATE_025 : 399|10@0+ (0.005,-2.24) [-2.24|2.24] "rad/s" ASDM
 SG_ OBJ_YAW_RATE_ERR_025 : 388|5@0+ (0.025,0) [0|0.775] "rad/s" ASDM
 SG_ OBJ_GROUP_ID_025 : 405|6@0+ (1,0) [0|63] "NA" ASDM
 SG_ OBJ_POS_ERR_CRR_COEF_025 : 415|8@0+ (0.01,-1.2) [-1.2|1] "NA" ASDM
 SG_ OBJ_VELOCITY_ERR_CRR_COEF_025 : 423|8@0+ (0.01,-1.2) [-1.2|1] "NA" ASDM
 SG_ OBJ_ACCEL_ERR_CRR_COEF_025 : 431|8@0+ (0.01,-1.2) [-1.2|1] "NA" ASDM

BO_ 729 RDR_TRACKER_OBJ_026: 64 G5_RDR04
 SG_ OBJ_ALIVE_TIME_026 : 255|16@0+ (1,0) [0|65535] "ms" ASDM
 SG_ OBJ_ACCELERATION_LONG_ERR_026 : 215|8@0+ (0.025,0) [0|6.375] "m/s^2" ASDM
 SG_ OBJ_ACCELERATION_LAT_ERR_026 : 223|8@0+ (0.025,0) [0|6.375] "m/s^2" ASDM
 SG_ OBJ_VELOCITY_LONG_ERR_026 : 143|8@0+ (0.05,0) [0|12.75] "m/s" ASDM
 SG_ OBJ_VELOCITY_LAT_ERR_026 : 151|8@0+ (0.05,0) [0|12.75] "m/s" ASDM
 SG_ OBJ_POS_LONG_ERR_026 : 95|8@0+ (0.025,0) [0|6.375] "m" ASDM
 SG_ OBJ_POS_LAT_ERR_026 : 103|8@0+ (0.025,0) [0|6.375] "m" ASDM
 SG_ OBJ_TRACK_MOTION_MODEL_026 : 9|2@0+ (1,0) [1|3] "NA" ASDM
 SG_ OBJ_DIMENSION_WIDTH_026 : 17|10@0+ (0.01,0) [0|10.23] "m" ASDM
 SG_ OBJ_DIMENSION_LENGTH_026 : 37|12@0+ (0.01,0) [0|40.95] "m" ASDM
 SG_ OBJ_EXISTENCE_PROB_026 : 229|14@0+ (0.0001,0) [0|1] "NA" ASDM
 SG_ OBJ_YAW_ANGLE_026 : 155|12@0+ (0.005,-10) [-10|10.475] "rad" ASDM
 SG_ OBJ_YAW_ANGLE_ERR_026 : 175|7@0+ (0.01,0) [0|1.27] "rad" ASDM
 SG_ OBJ_ID_026 : 7|8@0+ (1,0) [0|255] "NA" ASDM
 SG_ OBJ_MOVEMENT_STATUS_026 : 196|3@0+ (1,0) [0|3] "NA" ASDM
 SG_ OBJ_MEASUREMENT_STATUS_026 : 14|3@0+ (1,0) [0|7] "NA" ASDM
 SG_ OBJ_POS_LONG_026 : 63|16@0+ (0.01,-327) [-327|327] "m" ASDM
 SG_ OBJ_POS_LAT_026 : 79|16@0+ (0.01,-327) [-327|327] "m" ASDM
 SG_ OBJ_VELOCITY_LONG_026 : 110|15@0+ (0.01,-163) [-163|163] "m/s" ASDM
 SG_ OBJ_VELOCITY_LAT_026 : 126|15@0+ (0.01,-163) [-163|163] "m/s" ASDM
 SG_ OBJ_ACCELERATION_LONG_026 : 193|10@0+ (0.05,-20) [-20|20] "m/s^2" ASDM
 SG_ OBJ_ACCELERATION_LAT_026 : 177|10@0+ (0.05,-20) [-20|20] "m/s^2" ASDM
 SG_ OBJ_VEH_TRACK_FLAG_026 : 10|1@0+ (1,0) [0|1] "NA" ASDM
 SG_ OBJ_MH_CYCLE_COUNTER_026 : 487|8@0+ (1,0) [0|255] "NA" ASDM
 SG_ OBJ_MH_CRC16_026 : 495|16@0+ (1,0) [0|65535] "NA" ASDM
 SG_ OBJ_TIMESTAMP_OFFSET_026 : 247|8@0+ (1,-127) [-127|128] "ms" ASDM
 SG_ OBJ_DIMENSION_WIDTH_ERR_026 : 23|6@0+ (0.01,0) [0|0.63] "m" ASDM
 SG_ OBJ_DIMENSION_LENGTH_ERR_026 : 41|10@0+ (0.01,0) [0|10.23] "m" ASDM
 SG_ OBJ_CLS_TYPE1_026 : 271|4@0+ (1,0) [0|15] "NA" ASDM
 SG_ OBJ_CLS_TYPE1_PROB_026 : 303|8@0+ (0.004,0) [0|1] "NA" ASDM
 SG_ OBJ_CLS_TYPE2_026 : 267|4@0+ (1,0) [0|15] "NA" ASDM
 SG_ OBJ_CLS_TYPE2_PROB_026 : 311|8@0+ (0.004,0) [0|1] "NA" ASDM
 SG_ OBJ_CLS_TYPE3_026 : 279|4@0+ (1,0) [0|15] "NA" ASDM
 SG_ OBJ_CLS_TYPE3_PROB_026 : 319|8@0+ (0.004,0) [0|1] "NA" ASDM
 SG_ OBJ_CLS_TYPE4_026 : 275|4@0+ (1,0) [0|15] "NA" ASDM
 SG_ OBJ_CLS_TYPE4_PROB_026 : 327|8@0+ (0.004,0) [0|1] "NA" ASDM
 SG_ OBJ_CLS_TYPE5_026 : 287|4@0+ (1,0) [0|15] "NA" ASDM
 SG_ OBJ_CLS_TYPE5_PROB_026 : 335|8@0+ (0.004,0) [0|1] "NA" ASDM
 SG_ OBJ_CLS_TYPE6_026 : 282|4@0+ (1,0) [0|15] "NA" ASDM
 SG_ OBJ_CLS_TYPE6_PROB_026 : 343|8@0+ (0.004,0) [0|1] "NA" ASDM
 SG_ OBJ_RCS_026 : 351|7@0+ (1,-64) [-64|63] "dBsm" ASDM
 SG_ OBJ_REF_PT_LONG_OFFSET_026 : 357|14@0+ (0.0001,0) [0|1] "NA" ASDM
 SG_ OBJ_REF_PT_LAT_OFFSET_026 : 370|14@0+ (0.0001,0) [0|1] "NA" ASDM
 SG_ OBJ_YAW_RATE_026 : 399|10@0+ (0.005,-2.24) [-2.24|2.24] "rad/s" ASDM
 SG_ OBJ_YAW_RATE_ERR_026 : 388|5@0+ (0.025,0) [0|0.775] "rad/s" ASDM
 SG_ OBJ_GROUP_ID_026 : 405|6@0+ (1,0) [0|63] "NA" ASDM
 SG_ OBJ_POS_ERR_CRR_COEF_026 : 415|8@0+ (0.01,-1.2) [-1.2|1] "NA" ASDM
 SG_ OBJ_VELOCITY_ERR_CRR_COEF_026 : 423|8@0+ (0.01,-1.2) [-1.2|1] "NA" ASDM
 SG_ OBJ_ACCEL_ERR_CRR_COEF_026 : 431|8@0+ (0.01,-1.2) [-1.2|1] "NA" ASDM

BO_ 730 RDR_TRACKER_OBJ_027: 64 G5_RDR04
 SG_ OBJ_ALIVE_TIME_027 : 255|16@0+ (1,0) [0|65535] "ms" ASDM
 SG_ OBJ_ACCELERATION_LONG_ERR_027 : 215|8@0+ (0.025,0) [0|6.375] "m/s^2" ASDM
 SG_ OBJ_ACCELERATION_LAT_ERR_027 : 223|8@0+ (0.025,0) [0|6.375] "m/s^2" ASDM
 SG_ OBJ_VELOCITY_LONG_ERR_027 : 143|8@0+ (0.05,0) [0|12.75] "m/s" ASDM
 SG_ OBJ_VELOCITY_LAT_ERR_027 : 151|8@0+ (0.05,0) [0|12.75] "m/s" ASDM
 SG_ OBJ_POS_LONG_ERR_027 : 95|8@0+ (0.025,0) [0|6.375] "m" ASDM
 SG_ OBJ_POS_LAT_ERR_027 : 103|8@0+ (0.025,0) [0|6.375] "m" ASDM
 SG_ OBJ_TRACK_MOTION_MODEL_027 : 9|2@0+ (1,0) [1|3] "NA" ASDM
 SG_ OBJ_DIMENSION_WIDTH_027 : 17|10@0+ (0.01,0) [0|10.23] "m" ASDM
 SG_ OBJ_DIMENSION_LENGTH_027 : 37|12@0+ (0.01,0) [0|40.95] "m" ASDM
 SG_ OBJ_EXISTENCE_PROB_027 : 229|14@0+ (0.0001,0) [0|1] "NA" ASDM
 SG_ OBJ_YAW_ANGLE_027 : 155|12@0+ (0.005,-10) [-10|10.475] "rad" ASDM
 SG_ OBJ_YAW_ANGLE_ERR_027 : 175|7@0+ (0.01,0) [0|1.27] "rad" ASDM
 SG_ OBJ_ID_027 : 7|8@0+ (1,0) [0|255] "NA" ASDM
 SG_ OBJ_MOVEMENT_STATUS_027 : 196|3@0+ (1,0) [0|3] "NA" ASDM
 SG_ OBJ_MEASUREMENT_STATUS_027 : 14|3@0+ (1,0) [0|7] "NA" ASDM
 SG_ OBJ_POS_LONG_027 : 63|16@0+ (0.01,-327) [-327|327] "m" ASDM
 SG_ OBJ_POS_LAT_027 : 79|16@0+ (0.01,-327) [-327|327] "m" ASDM
 SG_ OBJ_VELOCITY_LONG_027 : 110|15@0+ (0.01,-163) [-163|163] "m/s" ASDM
 SG_ OBJ_VELOCITY_LAT_027 : 126|15@0+ (0.01,-163) [-163|163] "m/s" ASDM
 SG_ OBJ_ACCELERATION_LONG_027 : 193|10@0+ (0.05,-20) [-20|20] "m/s^2" ASDM
 SG_ OBJ_ACCELERATION_LAT_027 : 177|10@0+ (0.05,-20) [-20|20] "m/s^2" ASDM
 SG_ OBJ_VEH_TRACK_FLAG_027 : 10|1@0+ (1,0) [0|1] "NA" ASDM
 SG_ OBJ_MH_CYCLE_COUNTER_027 : 487|8@0+ (1,0) [0|255] "NA" ASDM
 SG_ OBJ_MH_CRC16_027 : 495|16@0+ (1,0) [0|65535] "NA" ASDM
 SG_ OBJ_TIMESTAMP_OFFSET_027 : 247|8@0+ (1,-127) [-127|128] "ms" ASDM
 SG_ OBJ_DIMENSION_WIDTH_ERR_027 : 23|6@0+ (0.01,0) [0|0.63] "m" ASDM
 SG_ OBJ_DIMENSION_LENGTH_ERR_027 : 41|10@0+ (0.01,0) [0|10.23] "m" ASDM
 SG_ OBJ_CLS_TYPE1_027 : 271|4@0+ (1,0) [0|15] "NA" ASDM
 SG_ OBJ_CLS_TYPE1_PROB_027 : 303|8@0+ (0.004,0) [0|1] "NA" ASDM
 SG_ OBJ_CLS_TYPE2_027 : 267|4@0+ (1,0) [0|15] "NA" ASDM
 SG_ OBJ_CLS_TYPE2_PROB_027 : 311|8@0+ (0.004,0) [0|1] "NA" ASDM
 SG_ OBJ_CLS_TYPE3_027 : 279|4@0+ (1,0) [0|15] "NA" ASDM
 SG_ OBJ_CLS_TYPE3_PROB_027 : 319|8@0+ (0.004,0) [0|1] "NA" ASDM
 SG_ OBJ_CLS_TYPE4_027 : 275|4@0+ (1,0) [0|15] "NA" ASDM
 SG_ OBJ_CLS_TYPE4_PROB_027 : 327|8@0+ (0.004,0) [0|1] "NA" ASDM
 SG_ OBJ_CLS_TYPE5_027 : 287|4@0+ (1,0) [0|15] "NA" ASDM
 SG_ OBJ_CLS_TYPE5_PROB_027 : 335|8@0+ (0.004,0) [0|1] "NA" ASDM
 SG_ OBJ_CLS_TYPE6_027 : 282|4@0+ (1,0) [0|15] "NA" ASDM
 SG_ OBJ_CLS_TYPE6_PROB_027 : 343|8@0+ (0.004,0) [0|1] "NA" ASDM
 SG_ OBJ_RCS_027 : 351|7@0+ (1,-64) [-64|63] "dBsm" ASDM
 SG_ OBJ_REF_PT_LONG_OFFSET_027 : 357|14@0+ (0.0001,0) [0|1] "NA" ASDM
 SG_ OBJ_REF_PT_LAT_OFFSET_027 : 370|14@0+ (0.0001,0) [0|1] "NA" ASDM
 SG_ OBJ_YAW_RATE_027 : 399|10@0+ (0.005,-2.24) [-2.24|2.24] "rad/s" ASDM
 SG_ OBJ_YAW_RATE_ERR_027 : 388|5@0+ (0.025,0) [0|0.775] "rad/s" ASDM
 SG_ OBJ_GROUP_ID_027 : 405|6@0+ (1,0) [0|63] "NA" ASDM
 SG_ OBJ_POS_ERR_CRR_COEF_027 : 415|8@0+ (0.01,-1.2) [-1.2|1] "NA" ASDM
 SG_ OBJ_VELOCITY_ERR_CRR_COEF_027 : 423|8@0+ (0.01,-1.2) [-1.2|1] "NA" ASDM
 SG_ OBJ_ACCEL_ERR_CRR_COEF_027 : 431|8@0+ (0.01,-1.2) [-1.2|1] "NA" ASDM

BO_ 731 RDR_TRACKER_OBJ_028: 64 G5_RDR04
 SG_ OBJ_ALIVE_TIME_028 : 255|16@0+ (1,0) [0|65535] "ms" ASDM
 SG_ OBJ_ACCELERATION_LONG_ERR_028 : 215|8@0+ (0.025,0) [0|6.375] "m/s^2" ASDM
 SG_ OBJ_ACCELERATION_LAT_ERR_028 : 223|8@0+ (0.025,0) [0|6.375] "m/s^2" ASDM
 SG_ OBJ_VELOCITY_LONG_ERR_028 : 143|8@0+ (0.05,0) [0|12.75] "m/s" ASDM
 SG_ OBJ_VELOCITY_LAT_ERR_028 : 151|8@0+ (0.05,0) [0|12.75] "m/s" ASDM
 SG_ OBJ_POS_LONG_ERR_028 : 95|8@0+ (0.025,0) [0|6.375] "m" ASDM
 SG_ OBJ_POS_LAT_ERR_028 : 103|8@0+ (0.025,0) [0|6.375] "m" ASDM
 SG_ OBJ_TRACK_MOTION_MODEL_028 : 9|2@0+ (1,0) [1|3] "NA" ASDM
 SG_ OBJ_DIMENSION_WIDTH_028 : 17|10@0+ (0.01,0) [0|10.23] "m" ASDM
 SG_ OBJ_DIMENSION_LENGTH_028 : 37|12@0+ (0.01,0) [0|40.95] "m" ASDM
 SG_ OBJ_EXISTENCE_PROB_028 : 229|14@0+ (0.0001,0) [0|1] "NA" ASDM
 SG_ OBJ_YAW_ANGLE_028 : 155|12@0+ (0.005,-10) [-10|10.475] "rad" ASDM
 SG_ OBJ_YAW_ANGLE_ERR_028 : 175|7@0+ (0.01,0) [0|1.27] "rad" ASDM
 SG_ OBJ_ID_028 : 7|8@0+ (1,0) [0|255] "NA" ASDM
 SG_ OBJ_MOVEMENT_STATUS_028 : 196|3@0+ (1,0) [0|3] "NA" ASDM
 SG_ OBJ_MEASUREMENT_STATUS_028 : 14|3@0+ (1,0) [0|7] "NA" ASDM
 SG_ OBJ_POS_LONG_028 : 63|16@0+ (0.01,-327) [-327|327] "m" ASDM
 SG_ OBJ_POS_LAT_028 : 79|16@0+ (0.01,-327) [-327|327] "m" ASDM
 SG_ OBJ_VELOCITY_LONG_028 : 110|15@0+ (0.01,-163) [-163|163] "m/s" ASDM
 SG_ OBJ_VELOCITY_LAT_028 : 126|15@0+ (0.01,-163) [-163|163] "m/s" ASDM
 SG_ OBJ_ACCELERATION_LONG_028 : 193|10@0+ (0.05,-20) [-20|20] "m/s^2" ASDM
 SG_ OBJ_ACCELERATION_LAT_028 : 177|10@0+ (0.05,-20) [-20|20] "m/s^2" ASDM
 SG_ OBJ_VEH_TRACK_FLAG_028 : 10|1@0+ (1,0) [0|1] "NA" ASDM
 SG_ OBJ_MH_CYCLE_COUNTER_028 : 487|8@0+ (1,0) [0|255] "NA" ASDM
 SG_ OBJ_MH_CRC16_028 : 495|16@0+ (1,0) [0|65535] "NA" ASDM
 SG_ OBJ_TIMESTAMP_OFFSET_028 : 247|8@0+ (1,-127) [-127|128] "ms" ASDM
 SG_ OBJ_DIMENSION_WIDTH_ERR_028 : 23|6@0+ (0.01,0) [0|0.63] "m" ASDM
 SG_ OBJ_DIMENSION_LENGTH_ERR_028 : 41|10@0+ (0.01,0) [0|10.23] "m" ASDM
 SG_ OBJ_CLS_TYPE1_028 : 271|4@0+ (1,0) [0|15] "NA" ASDM
 SG_ OBJ_CLS_TYPE1_PROB_028 : 303|8@0+ (0.004,0) [0|1] "NA" ASDM
 SG_ OBJ_CLS_TYPE2_028 : 267|4@0+ (1,0) [0|15] "NA" ASDM
 SG_ OBJ_CLS_TYPE2_PROB_028 : 311|8@0+ (0.004,0) [0|1] "NA" ASDM
 SG_ OBJ_CLS_TYPE3_028 : 279|4@0+ (1,0) [0|15] "NA" ASDM
 SG_ OBJ_CLS_TYPE3_PROB_028 : 319|8@0+ (0.004,0) [0|1] "NA" ASDM
 SG_ OBJ_CLS_TYPE4_028 : 275|4@0+ (1,0) [0|15] "NA" ASDM
 SG_ OBJ_CLS_TYPE4_PROB_028 : 327|8@0+ (0.004,0) [0|1] "NA" ASDM
 SG_ OBJ_CLS_TYPE5_028 : 287|4@0+ (1,0) [0|15] "NA" ASDM
 SG_ OBJ_CLS_TYPE5_PROB_028 : 335|8@0+ (0.004,0) [0|1] "NA" ASDM
 SG_ OBJ_CLS_TYPE6_028 : 282|4@0+ (1,0) [0|15] "NA" ASDM
 SG_ OBJ_CLS_TYPE6_PROB_028 : 343|8@0+ (0.004,0) [0|1] "NA" ASDM
 SG_ OBJ_RCS_028 : 351|7@0+ (1,-64) [-64|63] "dBsm" ASDM
 SG_ OBJ_REF_PT_LONG_OFFSET_028 : 357|14@0+ (0.0001,0) [0|1] "NA" ASDM
 SG_ OBJ_REF_PT_LAT_OFFSET_028 : 370|14@0+ (0.0001,0) [0|1] "NA" ASDM
 SG_ OBJ_YAW_RATE_028 : 399|10@0+ (0.005,-2.24) [-2.24|2.24] "rad/s" ASDM
 SG_ OBJ_YAW_RATE_ERR_028 : 388|5@0+ (0.025,0) [0|0.775] "rad/s" ASDM
 SG_ OBJ_GROUP_ID_028 : 405|6@0+ (1,0) [0|63] "NA" ASDM
 SG_ OBJ_POS_ERR_CRR_COEF_028 : 415|8@0+ (0.01,-1.2) [-1.2|1] "NA" ASDM
 SG_ OBJ_VELOCITY_ERR_CRR_COEF_028 : 423|8@0+ (0.01,-1.2) [-1.2|1] "NA" ASDM
 SG_ OBJ_ACCEL_ERR_CRR_COEF_028 : 431|8@0+ (0.01,-1.2) [-1.2|1] "NA" ASDM

BO_ 732 RDR_TRACKER_OBJ_029: 64 G5_RDR04
 SG_ OBJ_ALIVE_TIME_029 : 255|16@0+ (1,0) [0|65535] "ms" ASDM
 SG_ OBJ_ACCELERATION_LONG_ERR_029 : 215|8@0+ (0.025,0) [0|6.375] "m/s^2" ASDM
 SG_ OBJ_ACCELERATION_LAT_ERR_029 : 223|8@0+ (0.025,0) [0|6.375] "m/s^2" ASDM
 SG_ OBJ_VELOCITY_LONG_ERR_029 : 143|8@0+ (0.05,0) [0|12.75] "m/s" ASDM
 SG_ OBJ_VELOCITY_LAT_ERR_029 : 151|8@0+ (0.05,0) [0|12.75] "m/s" ASDM
 SG_ OBJ_POS_LONG_ERR_029 : 95|8@0+ (0.025,0) [0|6.375] "m" ASDM
 SG_ OBJ_POS_LAT_ERR_029 : 103|8@0+ (0.025,0) [0|6.375] "m" ASDM
 SG_ OBJ_TRACK_MOTION_MODEL_029 : 9|2@0+ (1,0) [1|3] "NA" ASDM
 SG_ OBJ_DIMENSION_WIDTH_029 : 17|10@0+ (0.01,0) [0|10.23] "m" ASDM
 SG_ OBJ_DIMENSION_LENGTH_029 : 37|12@0+ (0.01,0) [0|40.95] "m" ASDM
 SG_ OBJ_EXISTENCE_PROB_029 : 229|14@0+ (0.0001,0) [0|1] "NA" ASDM
 SG_ OBJ_YAW_ANGLE_029 : 155|12@0+ (0.005,-10) [-10|10.475] "rad" ASDM
 SG_ OBJ_YAW_ANGLE_ERR_029 : 175|7@0+ (0.01,0) [0|1.27] "rad" ASDM
 SG_ OBJ_ID_029 : 7|8@0+ (1,0) [0|255] "NA" ASDM
 SG_ OBJ_MOVEMENT_STATUS_029 : 196|3@0+ (1,0) [0|3] "NA" ASDM
 SG_ OBJ_MEASUREMENT_STATUS_029 : 14|3@0+ (1,0) [0|7] "NA" ASDM
 SG_ OBJ_POS_LONG_029 : 63|16@0+ (0.01,-327) [-327|327] "m" ASDM
 SG_ OBJ_POS_LAT_029 : 79|16@0+ (0.01,-327) [-327|327] "m" ASDM
 SG_ OBJ_VELOCITY_LONG_029 : 110|15@0+ (0.01,-163) [-163|163] "m/s" ASDM
 SG_ OBJ_VELOCITY_LAT_029 : 126|15@0+ (0.01,-163) [-163|163] "m/s" ASDM
 SG_ OBJ_ACCELERATION_LONG_029 : 193|10@0+ (0.05,-20) [-20|20] "m/s^2" ASDM
 SG_ OBJ_ACCELERATION_LAT_029 : 177|10@0+ (0.05,-20) [-20|20] "m/s^2" ASDM
 SG_ OBJ_VEH_TRACK_FLAG_029 : 10|1@0+ (1,0) [0|1] "NA" ASDM
 SG_ OBJ_MH_CYCLE_COUNTER_029 : 487|8@0+ (1,0) [0|255] "NA" ASDM
 SG_ OBJ_MH_CRC16_029 : 495|16@0+ (1,0) [0|65535] "NA" ASDM
 SG_ OBJ_TIMESTAMP_OFFSET_029 : 247|8@0+ (1,-127) [-127|128] "ms" ASDM
 SG_ OBJ_DIMENSION_WIDTH_ERR_029 : 23|6@0+ (0.01,0) [0|0.63] "m" ASDM
 SG_ OBJ_DIMENSION_LENGTH_ERR_029 : 41|10@0+ (0.01,0) [0|10.23] "m" ASDM
 SG_ OBJ_CLS_TYPE1_029 : 271|4@0+ (1,0) [0|15] "NA" ASDM
 SG_ OBJ_CLS_TYPE1_PROB_029 : 303|8@0+ (0.004,0) [0|1] "NA" ASDM
 SG_ OBJ_CLS_TYPE2_029 : 267|4@0+ (1,0) [0|15] "NA" ASDM
 SG_ OBJ_CLS_TYPE2_PROB_029 : 311|8@0+ (0.004,0) [0|1] "NA" ASDM
 SG_ OBJ_CLS_TYPE3_029 : 279|4@0+ (1,0) [0|15] "NA" ASDM
 SG_ OBJ_CLS_TYPE3_PROB_029 : 319|8@0+ (0.004,0) [0|1] "NA" ASDM
 SG_ OBJ_CLS_TYPE4_029 : 275|4@0+ (1,0) [0|15] "NA" ASDM
 SG_ OBJ_CLS_TYPE4_PROB_029 : 327|8@0+ (0.004,0) [0|1] "NA" ASDM
 SG_ OBJ_CLS_TYPE5_029 : 287|4@0+ (1,0) [0|15] "NA" ASDM
 SG_ OBJ_CLS_TYPE5_PROB_029 : 335|8@0+ (0.004,0) [0|1] "NA" ASDM
 SG_ OBJ_CLS_TYPE6_029 : 282|4@0+ (1,0) [0|15] "NA" ASDM
 SG_ OBJ_CLS_TYPE6_PROB_029 : 343|8@0+ (0.004,0) [0|1] "NA" ASDM
 SG_ OBJ_RCS_029 : 351|7@0+ (1,-64) [-64|63] "dBsm" ASDM
 SG_ OBJ_REF_PT_LONG_OFFSET_029 : 357|14@0+ (0.0001,0) [0|1] "NA" ASDM
 SG_ OBJ_REF_PT_LAT_OFFSET_029 : 370|14@0+ (0.0001,0) [0|1] "NA" ASDM
 SG_ OBJ_YAW_RATE_029 : 399|10@0+ (0.005,-2.24) [-2.24|2.24] "rad/s" ASDM
 SG_ OBJ_YAW_RATE_ERR_029 : 388|5@0+ (0.025,0) [0|0.775] "rad/s" ASDM
 SG_ OBJ_GROUP_ID_029 : 405|6@0+ (1,0) [0|63] "NA" ASDM
 SG_ OBJ_POS_ERR_CRR_COEF_029 : 415|8@0+ (0.01,-1.2) [-1.2|1] "NA" ASDM
 SG_ OBJ_VELOCITY_ERR_CRR_COEF_029 : 423|8@0+ (0.01,-1.2) [-1.2|1] "NA" ASDM
 SG_ OBJ_ACCEL_ERR_CRR_COEF_029 : 431|8@0+ (0.01,-1.2) [-1.2|1] "NA" ASDM

BO_ 733 RDR_TRACKER_OBJ_030: 64 G5_RDR04
 SG_ OBJ_ALIVE_TIME_030 : 255|16@0+ (1,0) [0|65535] "ms" ASDM
 SG_ OBJ_ACCELERATION_LONG_ERR_030 : 215|8@0+ (0.025,0) [0|6.375] "m/s^2" ASDM
 SG_ OBJ_ACCELERATION_LAT_ERR_030 : 223|8@0+ (0.025,0) [0|6.375] "m/s^2" ASDM
 SG_ OBJ_VELOCITY_LONG_ERR_030 : 143|8@0+ (0.05,0) [0|12.75] "m/s" ASDM
 SG_ OBJ_VELOCITY_LAT_ERR_030 : 151|8@0+ (0.05,0) [0|12.75] "m/s" ASDM
 SG_ OBJ_POS_LONG_ERR_030 : 95|8@0+ (0.025,0) [0|6.375] "m" ASDM
 SG_ OBJ_POS_LAT_ERR_030 : 103|8@0+ (0.025,0) [0|6.375] "m" ASDM
 SG_ OBJ_TRACK_MOTION_MODEL_030 : 9|2@0+ (1,0) [1|3] "NA" ASDM
 SG_ OBJ_DIMENSION_WIDTH_030 : 17|10@0+ (0.01,0) [0|10.23] "m" ASDM
 SG_ OBJ_DIMENSION_LENGTH_030 : 37|12@0+ (0.01,0) [0|40.95] "m" ASDM
 SG_ OBJ_EXISTENCE_PROB_030 : 229|14@0+ (0.0001,0) [0|1] "NA" ASDM
 SG_ OBJ_YAW_ANGLE_030 : 155|12@0+ (0.005,-10) [-10|10.475] "rad" ASDM
 SG_ OBJ_YAW_ANGLE_ERR_030 : 175|7@0+ (0.01,0) [0|1.27] "rad" ASDM
 SG_ OBJ_ID_030 : 7|8@0+ (1,0) [0|255] "NA" ASDM
 SG_ OBJ_MOVEMENT_STATUS_030 : 196|3@0+ (1,0) [0|3] "NA" ASDM
 SG_ OBJ_MEASUREMENT_STATUS_030 : 14|3@0+ (1,0) [0|7] "NA" ASDM
 SG_ OBJ_POS_LONG_030 : 63|16@0+ (0.01,-327) [-327|327] "m" ASDM
 SG_ OBJ_POS_LAT_030 : 79|16@0+ (0.01,-327) [-327|327] "m" ASDM
 SG_ OBJ_VELOCITY_LONG_030 : 110|15@0+ (0.01,-163) [-163|163] "m/s" ASDM
 SG_ OBJ_VELOCITY_LAT_030 : 126|15@0+ (0.01,-163) [-163|163] "m/s" ASDM
 SG_ OBJ_ACCELERATION_LONG_030 : 193|10@0+ (0.05,-20) [-20|20] "m/s^2" ASDM
 SG_ OBJ_ACCELERATION_LAT_030 : 177|10@0+ (0.05,-20) [-20|20] "m/s^2" ASDM
 SG_ OBJ_VEH_TRACK_FLAG_030 : 10|1@0+ (1,0) [0|1] "NA" ASDM
 SG_ OBJ_MH_CYCLE_COUNTER_030 : 487|8@0+ (1,0) [0|255] "NA" ASDM
 SG_ OBJ_MH_CRC16_030 : 495|16@0+ (1,0) [0|65535] "NA" ASDM
 SG_ OBJ_TIMESTAMP_OFFSET_030 : 247|8@0+ (1,-127) [-127|128] "ms" ASDM
 SG_ OBJ_DIMENSION_WIDTH_ERR_030 : 23|6@0+ (0.01,0) [0|0.63] "m" ASDM
 SG_ OBJ_DIMENSION_LENGTH_ERR_030 : 41|10@0+ (0.01,0) [0|10.23] "m" ASDM
 SG_ OBJ_CLS_TYPE1_030 : 271|4@0+ (1,0) [0|15] "NA" ASDM
 SG_ OBJ_CLS_TYPE1_PROB_030 : 303|8@0+ (0.004,0) [0|1] "NA" ASDM
 SG_ OBJ_CLS_TYPE2_030 : 267|4@0+ (1,0) [0|15] "NA" ASDM
 SG_ OBJ_CLS_TYPE2_PROB_030 : 311|8@0+ (0.004,0) [0|1] "NA" ASDM
 SG_ OBJ_CLS_TYPE3_030 : 279|4@0+ (1,0) [0|15] "NA" ASDM
 SG_ OBJ_CLS_TYPE3_PROB_030 : 319|8@0+ (0.004,0) [0|1] "NA" ASDM
 SG_ OBJ_CLS_TYPE4_030 : 275|4@0+ (1,0) [0|15] "NA" ASDM
 SG_ OBJ_CLS_TYPE4_PROB_030 : 327|8@0+ (0.004,0) [0|1] "NA" ASDM
 SG_ OBJ_CLS_TYPE5_030 : 287|4@0+ (1,0) [0|15] "NA" ASDM
 SG_ OBJ_CLS_TYPE5_PROB_030 : 335|8@0+ (0.004,0) [0|1] "NA" ASDM
 SG_ OBJ_CLS_TYPE6_030 : 282|4@0+ (1,0) [0|15] "NA" ASDM
 SG_ OBJ_CLS_TYPE6_PROB_030 : 343|8@0+ (0.004,0) [0|1] "NA" ASDM
 SG_ OBJ_RCS_030 : 351|7@0+ (1,-64) [-64|63] "dBsm" ASDM
 SG_ OBJ_REF_PT_LONG_OFFSET_030 : 357|14@0+ (0.0001,0) [0|1] "NA" ASDM
 SG_ OBJ_REF_PT_LAT_OFFSET_030 : 370|14@0+ (0.0001,0) [0|1] "NA" ASDM
 SG_ OBJ_YAW_RATE_030 : 399|10@0+ (0.005,-2.24) [-2.24|2.24] "rad/s" ASDM
 SG_ OBJ_YAW_RATE_ERR_030 : 388|5@0+ (0.025,0) [0|0.775] "rad/s" ASDM
 SG_ OBJ_GROUP_ID_030 : 405|6@0+ (1,0) [0|63] "NA" ASDM
 SG_ OBJ_POS_ERR_CRR_COEF_030 : 415|8@0+ (0.01,-1.2) [-1.2|1] "NA" ASDM
 SG_ OBJ_VELOCITY_ERR_CRR_COEF_030 : 423|8@0+ (0.01,-1.2) [-1.2|1] "NA" ASDM
 SG_ OBJ_ACCEL_ERR_CRR_COEF_030 : 431|8@0+ (0.01,-1.2) [-1.2|1] "NA" ASDM

BO_ 734 RDR_TRACKER_OBJ_031: 64 G5_RDR04
 SG_ OBJ_ALIVE_TIME_031 : 255|16@0+ (1,0) [0|65535] "ms" ASDM
 SG_ OBJ_ACCELERATION_LONG_ERR_031 : 215|8@0+ (0.025,0) [0|6.375] "m/s^2" ASDM
 SG_ OBJ_ACCELERATION_LAT_ERR_031 : 223|8@0+ (0.025,0) [0|6.375] "m/s^2" ASDM
 SG_ OBJ_VELOCITY_LONG_ERR_031 : 143|8@0+ (0.05,0) [0|12.75] "m/s" ASDM
 SG_ OBJ_VELOCITY_LAT_ERR_031 : 151|8@0+ (0.05,0) [0|12.75] "m/s" ASDM
 SG_ OBJ_POS_LONG_ERR_031 : 95|8@0+ (0.025,0) [0|6.375] "m" ASDM
 SG_ OBJ_POS_LAT_ERR_031 : 103|8@0+ (0.025,0) [0|6.375] "m" ASDM
 SG_ OBJ_TRACK_MOTION_MODEL_031 : 9|2@0+ (1,0) [1|3] "NA" ASDM
 SG_ OBJ_DIMENSION_WIDTH_031 : 17|10@0+ (0.01,0) [0|10.23] "m" ASDM
 SG_ OBJ_DIMENSION_LENGTH_031 : 37|12@0+ (0.01,0) [0|40.95] "m" ASDM
 SG_ OBJ_EXISTENCE_PROB_031 : 229|14@0+ (0.0001,0) [0|1] "NA" ASDM
 SG_ OBJ_YAW_ANGLE_031 : 155|12@0+ (0.005,-10) [-10|10.475] "rad" ASDM
 SG_ OBJ_YAW_ANGLE_ERR_031 : 175|7@0+ (0.01,0) [0|1.27] "rad" ASDM
 SG_ OBJ_ID_031 : 7|8@0+ (1,0) [0|255] "NA" ASDM
 SG_ OBJ_MOVEMENT_STATUS_031 : 196|3@0+ (1,0) [0|3] "NA" ASDM
 SG_ OBJ_MEASUREMENT_STATUS_031 : 14|3@0+ (1,0) [0|7] "NA" ASDM
 SG_ OBJ_POS_LONG_031 : 63|16@0+ (0.01,-327) [-327|327] "m" ASDM
 SG_ OBJ_POS_LAT_031 : 79|16@0+ (0.01,-327) [-327|327] "m" ASDM
 SG_ OBJ_VELOCITY_LONG_031 : 110|15@0+ (0.01,-163) [-163|163] "m/s" ASDM
 SG_ OBJ_VELOCITY_LAT_031 : 126|15@0+ (0.01,-163) [-163|163] "m/s" ASDM
 SG_ OBJ_ACCELERATION_LONG_031 : 193|10@0+ (0.05,-20) [-20|20] "m/s^2" ASDM
 SG_ OBJ_ACCELERATION_LAT_031 : 177|10@0+ (0.05,-20) [-20|20] "m/s^2" ASDM
 SG_ OBJ_VEH_TRACK_FLAG_031 : 10|1@0+ (1,0) [0|1] "NA" ASDM
 SG_ OBJ_MH_CYCLE_COUNTER_031 : 487|8@0+ (1,0) [0|255] "NA" ASDM
 SG_ OBJ_MH_CRC16_031 : 495|16@0+ (1,0) [0|65535] "NA" ASDM
 SG_ OBJ_TIMESTAMP_OFFSET_031 : 247|8@0+ (1,-127) [-127|128] "ms" ASDM
 SG_ OBJ_DIMENSION_WIDTH_ERR_031 : 23|6@0+ (0.01,0) [0|0.63] "m" ASDM
 SG_ OBJ_DIMENSION_LENGTH_ERR_031 : 41|10@0+ (0.01,0) [0|10.23] "m" ASDM
 SG_ OBJ_CLS_TYPE1_031 : 271|4@0+ (1,0) [0|15] "NA" ASDM
 SG_ OBJ_CLS_TYPE1_PROB_031 : 303|8@0+ (0.004,0) [0|1] "NA" ASDM
 SG_ OBJ_CLS_TYPE2_031 : 267|4@0+ (1,0) [0|15] "NA" ASDM
 SG_ OBJ_CLS_TYPE2_PROB_031 : 311|8@0+ (0.004,0) [0|1] "NA" ASDM
 SG_ OBJ_CLS_TYPE3_031 : 279|4@0+ (1,0) [0|15] "NA" ASDM
 SG_ OBJ_CLS_TYPE3_PROB_031 : 319|8@0+ (0.004,0) [0|1] "NA" ASDM
 SG_ OBJ_CLS_TYPE4_031 : 275|4@0+ (1,0) [0|15] "NA" ASDM
 SG_ OBJ_CLS_TYPE4_PROB_031 : 327|8@0+ (0.004,0) [0|1] "NA" ASDM
 SG_ OBJ_CLS_TYPE5_031 : 287|4@0+ (1,0) [0|15] "NA" ASDM
 SG_ OBJ_CLS_TYPE5_PROB_031 : 335|8@0+ (0.004,0) [0|1] "NA" ASDM
 SG_ OBJ_CLS_TYPE6_031 : 282|4@0+ (1,0) [0|15] "NA" ASDM
 SG_ OBJ_CLS_TYPE6_PROB_031 : 343|8@0+ (0.004,0) [0|1] "NA" ASDM
 SG_ OBJ_RCS_031 : 351|7@0+ (1,-64) [-64|63] "dBsm" ASDM
 SG_ OBJ_REF_PT_LONG_OFFSET_031 : 357|14@0+ (0.0001,0) [0|1] "NA" ASDM
 SG_ OBJ_REF_PT_LAT_OFFSET_031 : 370|14@0+ (0.0001,0) [0|1] "NA" ASDM
 SG_ OBJ_YAW_RATE_031 : 399|10@0+ (0.005,-2.24) [-2.24|2.24] "rad/s" ASDM
 SG_ OBJ_YAW_RATE_ERR_031 : 388|5@0+ (0.025,0) [0|0.775] "rad/s" ASDM
 SG_ OBJ_GROUP_ID_031 : 405|6@0+ (1,0) [0|63] "NA" ASDM
 SG_ OBJ_POS_ERR_CRR_COEF_031 : 415|8@0+ (0.01,-1.2) [-1.2|1] "NA" ASDM
 SG_ OBJ_VELOCITY_ERR_CRR_COEF_031 : 423|8@0+ (0.01,-1.2) [-1.2|1] "NA" ASDM
 SG_ OBJ_ACCEL_ERR_CRR_COEF_031 : 431|8@0+ (0.01,-1.2) [-1.2|1] "NA" ASDM

CM_ SG_ 718 OBJ_ALIVE_TIME_015 "Time since object initialization in msec. Tracker internal may have bigger values. On the output interface, we should saturate the signal in that case.";
CM_ SG_ 718 OBJ_ACCELERATION_LONG_ERR_015 "acceleration along Longi  direction";
CM_ SG_ 718 OBJ_ACCELERATION_LAT_ERR_015 "acceleration along Lat direction error";
CM_ SG_ 718 OBJ_POS_LONG_ERR_015 "Lat-position error of object track's centroid in VCS coordinate";
CM_ SG_ 718 OBJ_POS_LAT_ERR_015 "Lat-position error of object track's centroid in VCS coordinate";
CM_ SG_ 718 OBJ_TRACK_MOTION_MODEL_015 "Object tracking uses a motion model for tracking moving items";
CM_ SG_ 718 OBJ_DIMENSION_WIDTH_015 "Lat distance from centroid to edge of bounding box.";
CM_ SG_ 718 OBJ_DIMENSION_LENGTH_015 "Longi distance from centroid to edge of bounding box.";
CM_ SG_ 718 OBJ_EXISTENCE_PROB_015 "Probability that the target is an actual target";
CM_ SG_ 718 OBJ_YAW_ANGLE_015 "Orientation of track's bounding box in VCS coordinate";
CM_ SG_ 718 OBJ_ID_015 "ID of object tracks, zero-ID represents an inactive track";
CM_ SG_ 718 OBJ_MOVEMENT_STATUS_015 "Information about a possible movement of the object during tracking";
CM_ SG_ 718 OBJ_MEASUREMENT_STATUS_015 "Objects should be sent out as fast as possible, even if not all statuses are observed and the object’s
signals might not be fully filled.";
CM_ SG_ 718 OBJ_POS_LONG_015 "Long-position of object track's centroid in VCS coordinate";
CM_ SG_ 718 OBJ_POS_LAT_015 "Lat-position of object track's centroid in VCS coordinate";
CM_ SG_ 718 OBJ_VELOCITY_LONG_015 "Over-the-ground velocity of object track's centroid along Long direction (in VCS coordinate)";
CM_ SG_ 718 OBJ_VELOCITY_LAT_015 "Over-the-ground velocity of object track's centroid along Lat direction (in VCS coordinate)";
CM_ SG_ 718 OBJ_ACCELERATION_LONG_015 "Over-the-ground track acceleration along Longi direction (in VCS coordinate)";
CM_ SG_ 718 OBJ_ACCELERATION_LAT_015 "Over-the-ground track acceleration along Lat direction (in VCS coordinate)";
CM_ SG_ 718 OBJ_VEH_TRACK_FLAG_015 "Indicates if current track is a vehicle";
CM_ SG_ 718 OBJ_TIMESTAMP_OFFSET_015 "A timestamp offset from the object list header timestamp for each object as we have different timestamps from different sensors leading to different timestamps on each object";
CM_ SG_ 718 OBJ_DIMENSION_WIDTH_ERR_015 "Lat distance or length error";
CM_ SG_ 718 OBJ_DIMENSION_LENGTH_ERR_015 "Longi distance or length error";
CM_ SG_ 718 OBJ_CLS_TYPE1_015 "Classification Type 1(Highest Prob), selected from ENUM list";
CM_ SG_ 718 OBJ_CLS_TYPE1_PROB_015 "Classification Type 1 probablity";
CM_ SG_ 718 OBJ_CLS_TYPE6_015 "Classification Type 6(Lowest Prob), selected from ENUM list";
CM_ SG_ 718 OBJ_CLS_TYPE6_PROB_015 "Classification Type 1 probablity";
CM_ SG_ 718 OBJ_RCS_015 "Representative RCS of the complete recognized object, Not implemented";
CM_ SG_ 718 OBJ_REF_PT_LONG_OFFSET_015 "Outer edges of the recognized object’s bounding box in Y axis";
CM_ SG_ 718 OBJ_REF_PT_LAT_OFFSET_015 "Outer edges of the recognized object’s bounding box in X axis";
CM_ SG_ 718 OBJ_YAW_RATE_015 "Orientation rate of track's bounding box in VCS coordinate";
CM_ SG_ 718 OBJ_GROUP_ID_015 "Objects which are linked together shall have same group ID";
CM_ SG_ 718 OBJ_POS_ERR_CRR_COEF_015 "vx-vy correlation due to small error in radial direction and big in cross radial - position Correlation Coefficient Error";
CM_ SG_ 718 OBJ_VELOCITY_ERR_CRR_COEF_015 "vx-vy correlation due to small error in radial direction and big in cross radial - velocity Correlation Coefficient Error";
CM_ SG_ 718 OBJ_ACCEL_ERR_CRR_COEF_015 "vx-vy correlation due to small error in radial direction and big in cross radial - Acceleration Correlation Coefficient Error";
CM_ SG_ 719 OBJ_ALIVE_TIME_016 "Time since object initialization in msec. Tracker internal may have bigger values. On the output interface, we should saturate the signal in that case.";
CM_ SG_ 719 OBJ_ACCELERATION_LONG_ERR_016 "acceleration along Longi  direction";
CM_ SG_ 719 OBJ_ACCELERATION_LAT_ERR_016 "acceleration along Lat direction error";
CM_ SG_ 719 OBJ_POS_LONG_ERR_016 "Lat-position error of object track's centroid in VCS coordinate";
CM_ SG_ 719 OBJ_POS_LAT_ERR_016 "Lat-position error of object track's centroid in VCS coordinate";
CM_ SG_ 719 OBJ_TRACK_MOTION_MODEL_016 "Object tracking uses a motion model for tracking moving items";
CM_ SG_ 719 OBJ_DIMENSION_WIDTH_016 "Lat distance from centroid to edge of bounding box.";
CM_ SG_ 719 OBJ_DIMENSION_LENGTH_016 "Longi distance from centroid to edge of bounding box.";
CM_ SG_ 719 OBJ_EXISTENCE_PROB_016 "Probability that the target is an actual target";
CM_ SG_ 719 OBJ_YAW_ANGLE_016 "Orientation of track's bounding box in VCS coordinate";
CM_ SG_ 719 OBJ_ID_016 "ID of object tracks, zero-ID represents an inactive track";
CM_ SG_ 719 OBJ_MOVEMENT_STATUS_016 "Information about a possible movement of the object during tracking";
CM_ SG_ 719 OBJ_MEASUREMENT_STATUS_016 "Objects should be sent out as fast as possible, even if not all statuses are observed and the object’s
signals might not be fully filled.";
CM_ SG_ 719 OBJ_POS_LONG_016 "Long-position of object track's centroid in VCS coordinate";
CM_ SG_ 719 OBJ_POS_LAT_016 "Lat-position of object track's centroid in VCS coordinate";
CM_ SG_ 719 OBJ_VELOCITY_LONG_016 "Over-the-ground velocity of object track's centroid along Long direction (in VCS coordinate)";
CM_ SG_ 719 OBJ_VELOCITY_LAT_016 "Over-the-ground velocity of object track's centroid along Lat direction (in VCS coordinate)";
CM_ SG_ 719 OBJ_ACCELERATION_LONG_016 "Over-the-ground track acceleration along Longi direction (in VCS coordinate)";
CM_ SG_ 719 OBJ_ACCELERATION_LAT_016 "Over-the-ground track acceleration along Lat direction (in VCS coordinate)";
CM_ SG_ 719 OBJ_VEH_TRACK_FLAG_016 "Indicates if current track is a vehicle";
CM_ SG_ 719 OBJ_TIMESTAMP_OFFSET_016 "A timestamp offset from the object list header timestamp for each object as we have different timestamps from different sensors leading to different timestamps on each object";
CM_ SG_ 719 OBJ_DIMENSION_WIDTH_ERR_016 "Lat distance or length error";
CM_ SG_ 719 OBJ_DIMENSION_LENGTH_ERR_016 "Longi distance or length error";
CM_ SG_ 719 OBJ_CLS_TYPE1_016 "Classification Type 1(Highest Prob), selected from ENUM list";
CM_ SG_ 719 OBJ_CLS_TYPE1_PROB_016 "Classification Type 1 probablity";
CM_ SG_ 719 OBJ_CLS_TYPE6_016 "Classification Type 6(Lowest Prob), selected from ENUM list";
CM_ SG_ 719 OBJ_CLS_TYPE6_PROB_016 "Classification Type 1 probablity";
CM_ SG_ 719 OBJ_RCS_016 "Representative RCS of the complete recognized object, Not implemented";
CM_ SG_ 719 OBJ_REF_PT_LONG_OFFSET_016 "Outer edges of the recognized object’s bounding box in Y axis";
CM_ SG_ 719 OBJ_REF_PT_LAT_OFFSET_016 "Outer edges of the recognized object’s bounding box in X axis";
CM_ SG_ 719 OBJ_YAW_RATE_016 "Orientation rate of track's bounding box in VCS coordinate";
CM_ SG_ 719 OBJ_GROUP_ID_016 "Objects which are linked together shall have same group ID";
CM_ SG_ 719 OBJ_POS_ERR_CRR_COEF_016 "vx-vy correlation due to small error in radial direction and big in cross radial - position Correlation Coefficient Error";
CM_ SG_ 719 OBJ_VELOCITY_ERR_CRR_COEF_016 "vx-vy correlation due to small error in radial direction and big in cross radial - velocity Correlation Coefficient Error";
CM_ SG_ 719 OBJ_ACCEL_ERR_CRR_COEF_016 "vx-vy correlation due to small error in radial direction and big in cross radial - Acceleration Correlation Coefficient Error";
CM_ SG_ 720 OBJ_ALIVE_TIME_017 "Time since object initialization in msec. Tracker internal may have bigger values. On the output interface, we should saturate the signal in that case.";
CM_ SG_ 720 OBJ_ACCELERATION_LONG_ERR_017 "acceleration along Longi  direction";
CM_ SG_ 720 OBJ_ACCELERATION_LAT_ERR_017 "acceleration along Lat direction error";
CM_ SG_ 720 OBJ_POS_LONG_ERR_017 "Lat-position error of object track's centroid in VCS coordinate";
CM_ SG_ 720 OBJ_POS_LAT_ERR_017 "Lat-position error of object track's centroid in VCS coordinate";
CM_ SG_ 720 OBJ_TRACK_MOTION_MODEL_017 "Object tracking uses a motion model for tracking moving items";
CM_ SG_ 720 OBJ_DIMENSION_WIDTH_017 "Lat distance from centroid to edge of bounding box.";
CM_ SG_ 720 OBJ_DIMENSION_LENGTH_017 "Longi distance from centroid to edge of bounding box.";
CM_ SG_ 720 OBJ_EXISTENCE_PROB_017 "Probability that the target is an actual target";
CM_ SG_ 720 OBJ_YAW_ANGLE_017 "Orientation of track's bounding box in VCS coordinate";
CM_ SG_ 720 OBJ_ID_017 "ID of object tracks, zero-ID represents an inactive track";
CM_ SG_ 720 OBJ_MOVEMENT_STATUS_017 "Information about a possible movement of the object during tracking";
CM_ SG_ 720 OBJ_MEASUREMENT_STATUS_017 "Objects should be sent out as fast as possible, even if not all statuses are observed and the object’s
signals might not be fully filled.";
CM_ SG_ 720 OBJ_POS_LONG_017 "Long-position of object track's centroid in VCS coordinate";
CM_ SG_ 720 OBJ_POS_LAT_017 "Lat-position of object track's centroid in VCS coordinate";
CM_ SG_ 720 OBJ_VELOCITY_LONG_017 "Over-the-ground velocity of object track's centroid along Long direction (in VCS coordinate)";
CM_ SG_ 720 OBJ_VELOCITY_LAT_017 "Over-the-ground velocity of object track's centroid along Lat direction (in VCS coordinate)";
CM_ SG_ 720 OBJ_ACCELERATION_LONG_017 "Over-the-ground track acceleration along Longi direction (in VCS coordinate)";
CM_ SG_ 720 OBJ_ACCELERATION_LAT_017 "Over-the-ground track acceleration along Lat direction (in VCS coordinate)";
CM_ SG_ 720 OBJ_VEH_TRACK_FLAG_017 "Indicates if current track is a vehicle";
CM_ SG_ 720 OBJ_TIMESTAMP_OFFSET_017 "A timestamp offset from the object list header timestamp for each object as we have different timestamps from different sensors leading to different timestamps on each object";
CM_ SG_ 720 OBJ_DIMENSION_WIDTH_ERR_017 "Lat distance or length error";
CM_ SG_ 720 OBJ_DIMENSION_LENGTH_ERR_017 "Longi distance or length error";
CM_ SG_ 720 OBJ_CLS_TYPE1_017 "Classification Type 1(Highest Prob), selected from ENUM list";
CM_ SG_ 720 OBJ_CLS_TYPE1_PROB_017 "Classification Type 1 probablity";
CM_ SG_ 720 OBJ_CLS_TYPE6_017 "Classification Type 6(Lowest Prob), selected from ENUM list";
CM_ SG_ 720 OBJ_CLS_TYPE6_PROB_017 "Classification Type 1 probablity";
CM_ SG_ 720 OBJ_RCS_017 "Representative RCS of the complete recognized object, Not implemented";
CM_ SG_ 720 OBJ_REF_PT_LONG_OFFSET_017 "Outer edges of the recognized object’s bounding box in Y axis";
CM_ SG_ 720 OBJ_REF_PT_LAT_OFFSET_017 "Outer edges of the recognized object’s bounding box in X axis";
CM_ SG_ 720 OBJ_YAW_RATE_017 "Orientation rate of track's bounding box in VCS coordinate";
CM_ SG_ 720 OBJ_GROUP_ID_017 "Objects which are linked together shall have same group ID";
CM_ SG_ 720 OBJ_POS_ERR_CRR_COEF_017 "vx-vy correlation due to small error in radial direction and big in cross radial - position Correlation Coefficient Error";
CM_ SG_ 720 OBJ_VELOCITY_ERR_CRR_COEF_017 "vx-vy correlation due to small error in radial direction and big in cross radial - velocity Correlation Coefficient Error";
CM_ SG_ 720 OBJ_ACCEL_ERR_CRR_COEF_017 "vx-vy correlation due to small error in radial direction and big in cross radial - Acceleration Correlation Coefficient Error";
CM_ SG_ 721 OBJ_ALIVE_TIME_018 "Time since object initialization in msec. Tracker internal may have bigger values. On the output interface, we should saturate the signal in that case.";
CM_ SG_ 721 OBJ_ACCELERATION_LONG_ERR_018 "acceleration along Longi  direction";
CM_ SG_ 721 OBJ_ACCELERATION_LAT_ERR_018 "acceleration along Lat direction error";
CM_ SG_ 721 OBJ_POS_LONG_ERR_018 "Lat-position error of object track's centroid in VCS coordinate";
CM_ SG_ 721 OBJ_POS_LAT_ERR_018 "Lat-position error of object track's centroid in VCS coordinate";
CM_ SG_ 721 OBJ_TRACK_MOTION_MODEL_018 "Object tracking uses a motion model for tracking moving items";
CM_ SG_ 721 OBJ_DIMENSION_WIDTH_018 "Lat distance from centroid to edge of bounding box.";
CM_ SG_ 721 OBJ_DIMENSION_LENGTH_018 "Longi distance from centroid to edge of bounding box.";
CM_ SG_ 721 OBJ_EXISTENCE_PROB_018 "Probability that the target is an actual target";
CM_ SG_ 721 OBJ_YAW_ANGLE_018 "Orientation of track's bounding box in VCS coordinate";
CM_ SG_ 721 OBJ_ID_018 "ID of object tracks, zero-ID represents an inactive track";
CM_ SG_ 721 OBJ_MOVEMENT_STATUS_018 "Information about a possible movement of the object during tracking";
CM_ SG_ 721 OBJ_MEASUREMENT_STATUS_018 "Objects should be sent out as fast as possible, even if not all statuses are observed and the object’s
signals might not be fully filled.";
CM_ SG_ 721 OBJ_POS_LONG_018 "Long-position of object track's centroid in VCS coordinate";
CM_ SG_ 721 OBJ_POS_LAT_018 "Lat-position of object track's centroid in VCS coordinate";
CM_ SG_ 721 OBJ_VELOCITY_LONG_018 "Over-the-ground velocity of object track's centroid along Long direction (in VCS coordinate)";
CM_ SG_ 721 OBJ_VELOCITY_LAT_018 "Over-the-ground velocity of object track's centroid along Lat direction (in VCS coordinate)";
CM_ SG_ 721 OBJ_ACCELERATION_LONG_018 "Over-the-ground track acceleration along Longi direction (in VCS coordinate)";
CM_ SG_ 721 OBJ_ACCELERATION_LAT_018 "Over-the-ground track acceleration along Lat direction (in VCS coordinate)";
CM_ SG_ 721 OBJ_VEH_TRACK_FLAG_018 "Indicates if current track is a vehicle";
CM_ SG_ 721 OBJ_TIMESTAMP_OFFSET_018 "A timestamp offset from the object list header timestamp for each object as we have different timestamps from different sensors leading to different timestamps on each object";
CM_ SG_ 721 OBJ_DIMENSION_WIDTH_ERR_018 "Lat distance or length error";
CM_ SG_ 721 OBJ_DIMENSION_LENGTH_ERR_018 "Longi distance or length error";
CM_ SG_ 721 OBJ_CLS_TYPE1_018 "Classification Type 1(Highest Prob), selected from ENUM list";
CM_ SG_ 721 OBJ_CLS_TYPE1_PROB_018 "Classification Type 1 probablity";
CM_ SG_ 721 OBJ_CLS_TYPE6_018 "Classification Type 6(Lowest Prob), selected from ENUM list";
CM_ SG_ 721 OBJ_CLS_TYPE6_PROB_018 "Classification Type 1 probablity";
CM_ SG_ 721 OBJ_RCS_018 "Representative RCS of the complete recognized object, Not implemented";
CM_ SG_ 721 OBJ_REF_PT_LONG_OFFSET_018 "Outer edges of the recognized object’s bounding box in Y axis";
CM_ SG_ 721 OBJ_REF_PT_LAT_OFFSET_018 "Outer edges of the recognized object’s bounding box in X axis";
CM_ SG_ 721 OBJ_YAW_RATE_018 "Orientation rate of track's bounding box in VCS coordinate";
CM_ SG_ 721 OBJ_GROUP_ID_018 "Objects which are linked together shall have same group ID";
CM_ SG_ 721 OBJ_POS_ERR_CRR_COEF_018 "vx-vy correlation due to small error in radial direction and big in cross radial - position Correlation Coefficient Error";
CM_ SG_ 721 OBJ_VELOCITY_ERR_CRR_COEF_018 "vx-vy correlation due to small error in radial direction and big in cross radial - velocity Correlation Coefficient Error";
CM_ SG_ 721 OBJ_ACCEL_ERR_CRR_COEF_018 "vx-vy correlation due to small error in radial direction and big in cross radial - Acceleration Correlation Coefficient Error";
CM_ SG_ 722 OBJ_ALIVE_TIME_019 "Time since object initialization in msec. Tracker internal may have bigger values. On the output interface, we should saturate the signal in that case.";
CM_ SG_ 722 OBJ_ACCELERATION_LONG_ERR_019 "acceleration along Longi  direction";
CM_ SG_ 722 OBJ_ACCELERATION_LAT_ERR_019 "acceleration along Lat direction error";
CM_ SG_ 722 OBJ_POS_LONG_ERR_019 "Lat-position error of object track's centroid in VCS coordinate";
CM_ SG_ 722 OBJ_POS_LAT_ERR_019 "Lat-position error of object track's centroid in VCS coordinate";
CM_ SG_ 722 OBJ_TRACK_MOTION_MODEL_019 "Object tracking uses a motion model for tracking moving items";
CM_ SG_ 722 OBJ_DIMENSION_WIDTH_019 "Lat distance from centroid to edge of bounding box.";
CM_ SG_ 722 OBJ_DIMENSION_LENGTH_019 "Longi distance from centroid to edge of bounding box.";
CM_ SG_ 722 OBJ_EXISTENCE_PROB_019 "Probability that the target is an actual target";
CM_ SG_ 722 OBJ_YAW_ANGLE_019 "Orientation of track's bounding box in VCS coordinate";
CM_ SG_ 722 OBJ_ID_019 "ID of object tracks, zero-ID represents an inactive track";
CM_ SG_ 722 OBJ_MOVEMENT_STATUS_019 "Information about a possible movement of the object during tracking";
CM_ SG_ 722 OBJ_MEASUREMENT_STATUS_019 "Objects should be sent out as fast as possible, even if not all statuses are observed and the object’s
signals might not be fully filled.";
CM_ SG_ 722 OBJ_POS_LONG_019 "Long-position of object track's centroid in VCS coordinate";
CM_ SG_ 722 OBJ_POS_LAT_019 "Lat-position of object track's centroid in VCS coordinate";
CM_ SG_ 722 OBJ_VELOCITY_LONG_019 "Over-the-ground velocity of object track's centroid along Long direction (in VCS coordinate)";
CM_ SG_ 722 OBJ_VELOCITY_LAT_019 "Over-the-ground velocity of object track's centroid along Lat direction (in VCS coordinate)";
CM_ SG_ 722 OBJ_ACCELERATION_LONG_019 "Over-the-ground track acceleration along Longi direction (in VCS coordinate)";
CM_ SG_ 722 OBJ_ACCELERATION_LAT_019 "Over-the-ground track acceleration along Lat direction (in VCS coordinate)";
CM_ SG_ 722 OBJ_VEH_TRACK_FLAG_019 "Indicates if current track is a vehicle";
CM_ SG_ 722 OBJ_TIMESTAMP_OFFSET_019 "A timestamp offset from the object list header timestamp for each object as we have different timestamps from different sensors leading to different timestamps on each object";
CM_ SG_ 722 OBJ_DIMENSION_WIDTH_ERR_019 "Lat distance or length error";
CM_ SG_ 722 OBJ_DIMENSION_LENGTH_ERR_019 "Longi distance or length error";
CM_ SG_ 722 OBJ_CLS_TYPE1_019 "Classification Type 1(Highest Prob), selected from ENUM list";
CM_ SG_ 722 OBJ_CLS_TYPE1_PROB_019 "Classification Type 1 probablity";
CM_ SG_ 722 OBJ_CLS_TYPE6_019 "Classification Type 6(Lowest Prob), selected from ENUM list";
CM_ SG_ 722 OBJ_CLS_TYPE6_PROB_019 "Classification Type 1 probablity";
CM_ SG_ 722 OBJ_RCS_019 "Representative RCS of the complete recognized object, Not implemented";
CM_ SG_ 722 OBJ_REF_PT_LONG_OFFSET_019 "Outer edges of the recognized object’s bounding box in Y axis";
CM_ SG_ 722 OBJ_REF_PT_LAT_OFFSET_019 "Outer edges of the recognized object’s bounding box in X axis";
CM_ SG_ 722 OBJ_YAW_RATE_019 "Orientation rate of track's bounding box in VCS coordinate";
CM_ SG_ 722 OBJ_GROUP_ID_019 "Objects which are linked together shall have same group ID";
CM_ SG_ 722 OBJ_POS_ERR_CRR_COEF_019 "vx-vy correlation due to small error in radial direction and big in cross radial - position Correlation Coefficient Error";
CM_ SG_ 722 OBJ_VELOCITY_ERR_CRR_COEF_019 "vx-vy correlation due to small error in radial direction and big in cross radial - velocity Correlation Coefficient Error";
CM_ SG_ 722 OBJ_ACCEL_ERR_CRR_COEF_019 "vx-vy correlation due to small error in radial direction and big in cross radial - Acceleration Correlation Coefficient Error";
CM_ SG_ 723 OBJ_ALIVE_TIME_020 "Time since object initialization in msec. Tracker internal may have bigger values. On the output interface, we should saturate the signal in that case.";
CM_ SG_ 723 OBJ_ACCELERATION_LONG_ERR_020 "acceleration along Longi  direction";
CM_ SG_ 723 OBJ_ACCELERATION_LAT_ERR_020 "acceleration along Lat direction error";
CM_ SG_ 723 OBJ_POS_LONG_ERR_020 "Lat-position error of object track's centroid in VCS coordinate";
CM_ SG_ 723 OBJ_POS_LAT_ERR_020 "Lat-position error of object track's centroid in VCS coordinate";
CM_ SG_ 723 OBJ_TRACK_MOTION_MODEL_020 "Object tracking uses a motion model for tracking moving items";
CM_ SG_ 723 OBJ_DIMENSION_WIDTH_020 "Lat distance from centroid to edge of bounding box.";
CM_ SG_ 723 OBJ_DIMENSION_LENGTH_020 "Longi distance from centroid to edge of bounding box.";
CM_ SG_ 723 OBJ_EXISTENCE_PROB_020 "Probability that the target is an actual target";
CM_ SG_ 723 OBJ_YAW_ANGLE_020 "Orientation of track's bounding box in VCS coordinate";
CM_ SG_ 723 OBJ_ID_020 "ID of object tracks, zero-ID represents an inactive track";
CM_ SG_ 723 OBJ_MOVEMENT_STATUS_020 "Information about a possible movement of the object during tracking";
CM_ SG_ 723 OBJ_MEASUREMENT_STATUS_020 "Objects should be sent out as fast as possible, even if not all statuses are observed and the object’s
signals might not be fully filled.";
CM_ SG_ 723 OBJ_POS_LONG_020 "Long-position of object track's centroid in VCS coordinate";
CM_ SG_ 723 OBJ_POS_LAT_020 "Lat-position of object track's centroid in VCS coordinate";
CM_ SG_ 723 OBJ_VELOCITY_LONG_020 "Over-the-ground velocity of object track's centroid along Long direction (in VCS coordinate)";
CM_ SG_ 723 OBJ_VELOCITY_LAT_020 "Over-the-ground velocity of object track's centroid along Lat direction (in VCS coordinate)";
CM_ SG_ 723 OBJ_ACCELERATION_LONG_020 "Over-the-ground track acceleration along Longi direction (in VCS coordinate)";
CM_ SG_ 723 OBJ_ACCELERATION_LAT_020 "Over-the-ground track acceleration along Lat direction (in VCS coordinate)";
CM_ SG_ 723 OBJ_VEH_TRACK_FLAG_020 "Indicates if current track is a vehicle";
CM_ SG_ 723 OBJ_TIMESTAMP_OFFSET_020 "A timestamp offset from the object list header timestamp for each object as we have different timestamps from different sensors leading to different timestamps on each object";
CM_ SG_ 723 OBJ_DIMENSION_WIDTH_ERR_020 "Lat distance or length error";
CM_ SG_ 723 OBJ_DIMENSION_LENGTH_ERR_020 "Longi distance or length error";
CM_ SG_ 723 OBJ_CLS_TYPE1_020 "Classification Type 1(Highest Prob), selected from ENUM list";
CM_ SG_ 723 OBJ_CLS_TYPE1_PROB_020 "Classification Type 1 probablity";
CM_ SG_ 723 OBJ_CLS_TYPE6_020 "Classification Type 6(Lowest Prob), selected from ENUM list";
CM_ SG_ 723 OBJ_CLS_TYPE6_PROB_020 "Classification Type 1 probablity";
CM_ SG_ 723 OBJ_RCS_020 "Representative RCS of the complete recognized object, Not implemented";
CM_ SG_ 723 OBJ_REF_PT_LONG_OFFSET_020 "Outer edges of the recognized object’s bounding box in Y axis";
CM_ SG_ 723 OBJ_REF_PT_LAT_OFFSET_020 "Outer edges of the recognized object’s bounding box in X axis";
CM_ SG_ 723 OBJ_YAW_RATE_020 "Orientation rate of track's bounding box in VCS coordinate";
CM_ SG_ 723 OBJ_GROUP_ID_020 "Objects which are linked together shall have same group ID";
CM_ SG_ 723 OBJ_POS_ERR_CRR_COEF_020 "vx-vy correlation due to small error in radial direction and big in cross radial - position Correlation Coefficient Error";
CM_ SG_ 723 OBJ_VELOCITY_ERR_CRR_COEF_020 "vx-vy correlation due to small error in radial direction and big in cross radial - velocity Correlation Coefficient Error";
CM_ SG_ 723 OBJ_ACCEL_ERR_CRR_COEF_020 "vx-vy correlation due to small error in radial direction and big in cross radial - Acceleration Correlation Coefficient Error";
CM_ SG_ 724 OBJ_ALIVE_TIME_021 "Time since object initialization in msec. Tracker internal may have bigger values. On the output interface, we should saturate the signal in that case.";
CM_ SG_ 724 OBJ_ACCELERATION_LONG_ERR_021 "acceleration along Longi  direction";
CM_ SG_ 724 OBJ_ACCELERATION_LAT_ERR_021 "acceleration along Lat direction error";
CM_ SG_ 724 OBJ_POS_LONG_ERR_021 "Lat-position error of object track's centroid in VCS coordinate";
CM_ SG_ 724 OBJ_POS_LAT_ERR_021 "Lat-position error of object track's centroid in VCS coordinate";
CM_ SG_ 724 OBJ_TRACK_MOTION_MODEL_021 "Object tracking uses a motion model for tracking moving items";
CM_ SG_ 724 OBJ_DIMENSION_WIDTH_021 "Lat distance from centroid to edge of bounding box.";
CM_ SG_ 724 OBJ_DIMENSION_LENGTH_021 "Longi distance from centroid to edge of bounding box.";
CM_ SG_ 724 OBJ_EXISTENCE_PROB_021 "Probability that the target is an actual target";
CM_ SG_ 724 OBJ_YAW_ANGLE_021 "Orientation of track's bounding box in VCS coordinate";
CM_ SG_ 724 OBJ_ID_021 "ID of object tracks, zero-ID represents an inactive track";
CM_ SG_ 724 OBJ_MOVEMENT_STATUS_021 "Information about a possible movement of the object during tracking";
CM_ SG_ 724 OBJ_MEASUREMENT_STATUS_021 "Objects should be sent out as fast as possible, even if not all statuses are observed and the object’s
signals might not be fully filled.";
CM_ SG_ 724 OBJ_POS_LONG_021 "Long-position of object track's centroid in VCS coordinate";
CM_ SG_ 724 OBJ_POS_LAT_021 "Lat-position of object track's centroid in VCS coordinate";
CM_ SG_ 724 OBJ_VELOCITY_LONG_021 "Over-the-ground velocity of object track's centroid along Long direction (in VCS coordinate)";
CM_ SG_ 724 OBJ_VELOCITY_LAT_021 "Over-the-ground velocity of object track's centroid along Lat direction (in VCS coordinate)";
CM_ SG_ 724 OBJ_ACCELERATION_LONG_021 "Over-the-ground track acceleration along Longi direction (in VCS coordinate)";
CM_ SG_ 724 OBJ_ACCELERATION_LAT_021 "Over-the-ground track acceleration along Lat direction (in VCS coordinate)";
CM_ SG_ 724 OBJ_VEH_TRACK_FLAG_021 "Indicates if current track is a vehicle";
CM_ SG_ 724 OBJ_TIMESTAMP_OFFSET_021 "A timestamp offset from the object list header timestamp for each object as we have different timestamps from different sensors leading to different timestamps on each object";
CM_ SG_ 724 OBJ_DIMENSION_WIDTH_ERR_021 "Lat distance or length error";
CM_ SG_ 724 OBJ_DIMENSION_LENGTH_ERR_021 "Longi distance or length error";
CM_ SG_ 724 OBJ_CLS_TYPE1_021 "Classification Type 1(Highest Prob), selected from ENUM list";
CM_ SG_ 724 OBJ_CLS_TYPE1_PROB_021 "Classification Type 1 probablity";
CM_ SG_ 724 OBJ_CLS_TYPE6_021 "Classification Type 6(Lowest Prob), selected from ENUM list";
CM_ SG_ 724 OBJ_CLS_TYPE6_PROB_021 "Classification Type 1 probablity";
CM_ SG_ 724 OBJ_RCS_021 "Representative RCS of the complete recognized object, Not implemented";
CM_ SG_ 724 OBJ_REF_PT_LONG_OFFSET_021 "Outer edges of the recognized object’s bounding box in Y axis";
CM_ SG_ 724 OBJ_REF_PT_LAT_OFFSET_021 "Outer edges of the recognized object’s bounding box in X axis";
CM_ SG_ 724 OBJ_YAW_RATE_021 "Orientation rate of track's bounding box in VCS coordinate";
CM_ SG_ 724 OBJ_GROUP_ID_021 "Objects which are linked together shall have same group ID";
CM_ SG_ 724 OBJ_POS_ERR_CRR_COEF_021 "vx-vy correlation due to small error in radial direction and big in cross radial - position Correlation Coefficient Error";
CM_ SG_ 724 OBJ_VELOCITY_ERR_CRR_COEF_021 "vx-vy correlation due to small error in radial direction and big in cross radial - velocity Correlation Coefficient Error";
CM_ SG_ 724 OBJ_ACCEL_ERR_CRR_COEF_021 "vx-vy correlation due to small error in radial direction and big in cross radial - Acceleration Correlation Coefficient Error";
CM_ SG_ 725 OBJ_ALIVE_TIME_022 "Time since object initialization in msec. Tracker internal may have bigger values. On the output interface, we should saturate the signal in that case.";
CM_ SG_ 725 OBJ_ACCELERATION_LONG_ERR_022 "acceleration along Longi  direction";
CM_ SG_ 725 OBJ_ACCELERATION_LAT_ERR_022 "acceleration along Lat direction error";
CM_ SG_ 725 OBJ_POS_LONG_ERR_022 "Lat-position error of object track's centroid in VCS coordinate";
CM_ SG_ 725 OBJ_POS_LAT_ERR_022 "Lat-position error of object track's centroid in VCS coordinate";
CM_ SG_ 725 OBJ_TRACK_MOTION_MODEL_022 "Object tracking uses a motion model for tracking moving items";
CM_ SG_ 725 OBJ_DIMENSION_WIDTH_022 "Lat distance from centroid to edge of bounding box.";
CM_ SG_ 725 OBJ_DIMENSION_LENGTH_022 "Longi distance from centroid to edge of bounding box.";
CM_ SG_ 725 OBJ_EXISTENCE_PROB_022 "Probability that the target is an actual target";
CM_ SG_ 725 OBJ_YAW_ANGLE_022 "Orientation of track's bounding box in VCS coordinate";
CM_ SG_ 725 OBJ_ID_022 "ID of object tracks, zero-ID represents an inactive track";
CM_ SG_ 725 OBJ_MOVEMENT_STATUS_022 "Information about a possible movement of the object during tracking";
CM_ SG_ 725 OBJ_MEASUREMENT_STATUS_022 "Objects should be sent out as fast as possible, even if not all statuses are observed and the object’s
signals might not be fully filled.";
CM_ SG_ 725 OBJ_POS_LONG_022 "Long-position of object track's centroid in VCS coordinate";
CM_ SG_ 725 OBJ_POS_LAT_022 "Lat-position of object track's centroid in VCS coordinate";
CM_ SG_ 725 OBJ_VELOCITY_LONG_022 "Over-the-ground velocity of object track's centroid along Long direction (in VCS coordinate)";
CM_ SG_ 725 OBJ_VELOCITY_LAT_022 "Over-the-ground velocity of object track's centroid along Lat direction (in VCS coordinate)";
CM_ SG_ 725 OBJ_ACCELERATION_LONG_022 "Over-the-ground track acceleration along Longi direction (in VCS coordinate)";
CM_ SG_ 725 OBJ_ACCELERATION_LAT_022 "Over-the-ground track acceleration along Lat direction (in VCS coordinate)";
CM_ SG_ 725 OBJ_VEH_TRACK_FLAG_022 "Indicates if current track is a vehicle";
CM_ SG_ 725 OBJ_TIMESTAMP_OFFSET_022 "A timestamp offset from the object list header timestamp for each object as we have different timestamps from different sensors leading to different timestamps on each object";
CM_ SG_ 725 OBJ_DIMENSION_WIDTH_ERR_022 "Lat distance or length error";
CM_ SG_ 725 OBJ_DIMENSION_LENGTH_ERR_022 "Longi distance or length error";
CM_ SG_ 725 OBJ_CLS_TYPE1_022 "Classification Type 1(Highest Prob), selected from ENUM list";
CM_ SG_ 725 OBJ_CLS_TYPE1_PROB_022 "Classification Type 1 probablity";
CM_ SG_ 725 OBJ_CLS_TYPE6_022 "Classification Type 6(Lowest Prob), selected from ENUM list";
CM_ SG_ 725 OBJ_CLS_TYPE6_PROB_022 "Classification Type 1 probablity";
CM_ SG_ 725 OBJ_RCS_022 "Representative RCS of the complete recognized object, Not implemented";
CM_ SG_ 725 OBJ_REF_PT_LONG_OFFSET_022 "Outer edges of the recognized object’s bounding box in Y axis";
CM_ SG_ 725 OBJ_REF_PT_LAT_OFFSET_022 "Outer edges of the recognized object’s bounding box in X axis";
CM_ SG_ 725 OBJ_YAW_RATE_022 "Orientation rate of track's bounding box in VCS coordinate";
CM_ SG_ 725 OBJ_GROUP_ID_022 "Objects which are linked together shall have same group ID";
CM_ SG_ 725 OBJ_POS_ERR_CRR_COEF_022 "vx-vy correlation due to small error in radial direction and big in cross radial - position Correlation Coefficient Error";
CM_ SG_ 725 OBJ_VELOCITY_ERR_CRR_COEF_022 "vx-vy correlation due to small error in radial direction and big in cross radial - velocity Correlation Coefficient Error";
CM_ SG_ 725 OBJ_ACCEL_ERR_CRR_COEF_022 "vx-vy correlation due to small error in radial direction and big in cross radial - Acceleration Correlation Coefficient Error";
CM_ SG_ 726 OBJ_ALIVE_TIME_023 "Time since object initialization in msec. Tracker internal may have bigger values. On the output interface, we should saturate the signal in that case.";
CM_ SG_ 726 OBJ_ACCELERATION_LONG_ERR_023 "acceleration along Longi  direction";
CM_ SG_ 726 OBJ_ACCELERATION_LAT_ERR_023 "acceleration along Lat direction error";
CM_ SG_ 726 OBJ_POS_LONG_ERR_023 "Lat-position error of object track's centroid in VCS coordinate";
CM_ SG_ 726 OBJ_POS_LAT_ERR_023 "Lat-position error of object track's centroid in VCS coordinate";
CM_ SG_ 726 OBJ_TRACK_MOTION_MODEL_023 "Object tracking uses a motion model for tracking moving items";
CM_ SG_ 726 OBJ_DIMENSION_WIDTH_023 "Lat distance from centroid to edge of bounding box.";
CM_ SG_ 726 OBJ_DIMENSION_LENGTH_023 "Longi distance from centroid to edge of bounding box.";
CM_ SG_ 726 OBJ_EXISTENCE_PROB_023 "Probability that the target is an actual target";
CM_ SG_ 726 OBJ_YAW_ANGLE_023 "Orientation of track's bounding box in VCS coordinate";
CM_ SG_ 726 OBJ_ID_023 "ID of object tracks, zero-ID represents an inactive track";
CM_ SG_ 726 OBJ_MOVEMENT_STATUS_023 "Information about a possible movement of the object during tracking";
CM_ SG_ 726 OBJ_MEASUREMENT_STATUS_023 "Objects should be sent out as fast as possible, even if not all statuses are observed and the object’s
signals might not be fully filled.";
CM_ SG_ 726 OBJ_POS_LONG_023 "Long-position of object track's centroid in VCS coordinate";
CM_ SG_ 726 OBJ_POS_LAT_023 "Lat-position of object track's centroid in VCS coordinate";
CM_ SG_ 726 OBJ_VELOCITY_LONG_023 "Over-the-ground velocity of object track's centroid along Long direction (in VCS coordinate)";
CM_ SG_ 726 OBJ_VELOCITY_LAT_023 "Over-the-ground velocity of object track's centroid along Lat direction (in VCS coordinate)";
CM_ SG_ 726 OBJ_ACCELERATION_LONG_023 "Over-the-ground track acceleration along Longi direction (in VCS coordinate)";
CM_ SG_ 726 OBJ_ACCELERATION_LAT_023 "Over-the-ground track acceleration along Lat direction (in VCS coordinate)";
CM_ SG_ 726 OBJ_VEH_TRACK_FLAG_023 "Indicates if current track is a vehicle";
CM_ SG_ 726 OBJ_TIMESTAMP_OFFSET_023 "A timestamp offset from the object list header timestamp for each object as we have different timestamps from different sensors leading to different timestamps on each object";
CM_ SG_ 726 OBJ_DIMENSION_WIDTH_ERR_023 "Lat distance or length error";
CM_ SG_ 726 OBJ_DIMENSION_LENGTH_ERR_023 "Longi distance or length error";
CM_ SG_ 726 OBJ_CLS_TYPE1_023 "Classification Type 1(Highest Prob), selected from ENUM list";
CM_ SG_ 726 OBJ_CLS_TYPE1_PROB_023 "Classification Type 1 probablity";
CM_ SG_ 726 OBJ_CLS_TYPE6_023 "Classification Type 6(Lowest Prob), selected from ENUM list";
CM_ SG_ 726 OBJ_CLS_TYPE6_PROB_023 "Classification Type 1 probablity";
CM_ SG_ 726 OBJ_RCS_023 "Representative RCS of the complete recognized object, Not implemented";
CM_ SG_ 726 OBJ_REF_PT_LONG_OFFSET_023 "Outer edges of the recognized object’s bounding box in Y axis";
CM_ SG_ 726 OBJ_REF_PT_LAT_OFFSET_023 "Outer edges of the recognized object’s bounding box in X axis";
CM_ SG_ 726 OBJ_YAW_RATE_023 "Orientation rate of track's bounding box in VCS coordinate";
CM_ SG_ 726 OBJ_GROUP_ID_023 "Objects which are linked together shall have same group ID";
CM_ SG_ 726 OBJ_POS_ERR_CRR_COEF_023 "vx-vy correlation due to small error in radial direction and big in cross radial - position Correlation Coefficient Error";
CM_ SG_ 726 OBJ_VELOCITY_ERR_CRR_COEF_023 "vx-vy correlation due to small error in radial direction and big in cross radial - velocity Correlation Coefficient Error";
CM_ SG_ 726 OBJ_ACCEL_ERR_CRR_COEF_023 "vx-vy correlation due to small error in radial direction and big in cross radial - Acceleration Correlation Coefficient Error";
CM_ SG_ 727 OBJ_ALIVE_TIME_024 "Time since object initialization in msec. Tracker internal may have bigger values. On the output interface, we should saturate the signal in that case.";
CM_ SG_ 727 OBJ_ACCELERATION_LONG_ERR_024 "acceleration along Longi  direction";
CM_ SG_ 727 OBJ_ACCELERATION_LAT_ERR_024 "acceleration along Lat direction error";
CM_ SG_ 727 OBJ_POS_LONG_ERR_024 "Lat-position error of object track's centroid in VCS coordinate";
CM_ SG_ 727 OBJ_POS_LAT_ERR_024 "Lat-position error of object track's centroid in VCS coordinate";
CM_ SG_ 727 OBJ_TRACK_MOTION_MODEL_024 "Object tracking uses a motion model for tracking moving items";
CM_ SG_ 727 OBJ_DIMENSION_WIDTH_024 "Lat distance from centroid to edge of bounding box.";
CM_ SG_ 727 OBJ_DIMENSION_LENGTH_024 "Longi distance from centroid to edge of bounding box.";
CM_ SG_ 727 OBJ_EXISTENCE_PROB_024 "Probability that the target is an actual target";
CM_ SG_ 727 OBJ_YAW_ANGLE_024 "Orientation of track's bounding box in VCS coordinate";
CM_ SG_ 727 OBJ_ID_024 "ID of object tracks, zero-ID represents an inactive track";
CM_ SG_ 727 OBJ_MOVEMENT_STATUS_024 "Information about a possible movement of the object during tracking";
CM_ SG_ 727 OBJ_MEASUREMENT_STATUS_024 "Objects should be sent out as fast as possible, even if not all statuses are observed and the object’s
signals might not be fully filled.";
CM_ SG_ 727 OBJ_POS_LONG_024 "Long-position of object track's centroid in VCS coordinate";
CM_ SG_ 727 OBJ_POS_LAT_024 "Lat-position of object track's centroid in VCS coordinate";
CM_ SG_ 727 OBJ_VELOCITY_LONG_024 "Over-the-ground velocity of object track's centroid along Long direction (in VCS coordinate)";
CM_ SG_ 727 OBJ_VELOCITY_LAT_024 "Over-the-ground velocity of object track's centroid along Lat direction (in VCS coordinate)";
CM_ SG_ 727 OBJ_ACCELERATION_LONG_024 "Over-the-ground track acceleration along Longi direction (in VCS coordinate)";
CM_ SG_ 727 OBJ_ACCELERATION_LAT_024 "Over-the-ground track acceleration along Lat direction (in VCS coordinate)";
CM_ SG_ 727 OBJ_VEH_TRACK_FLAG_024 "Indicates if current track is a vehicle";
CM_ SG_ 727 OBJ_TIMESTAMP_OFFSET_024 "A timestamp offset from the object list header timestamp for each object as we have different timestamps from different sensors leading to different timestamps on each object";
CM_ SG_ 727 OBJ_DIMENSION_WIDTH_ERR_024 "Lat distance or length error";
CM_ SG_ 727 OBJ_DIMENSION_LENGTH_ERR_024 "Longi distance or length error";
CM_ SG_ 727 OBJ_CLS_TYPE1_024 "Classification Type 1(Highest Prob), selected from ENUM list";
CM_ SG_ 727 OBJ_CLS_TYPE1_PROB_024 "Classification Type 1 probablity";
CM_ SG_ 727 OBJ_CLS_TYPE6_024 "Classification Type 6(Lowest Prob), selected from ENUM list";
CM_ SG_ 727 OBJ_CLS_TYPE6_PROB_024 "Classification Type 1 probablity";
CM_ SG_ 727 OBJ_RCS_024 "Representative RCS of the complete recognized object, Not implemented";
CM_ SG_ 727 OBJ_REF_PT_LONG_OFFSET_024 "Outer edges of the recognized object’s bounding box in Y axis";
CM_ SG_ 727 OBJ_REF_PT_LAT_OFFSET_024 "Outer edges of the recognized object’s bounding box in X axis";
CM_ SG_ 727 OBJ_YAW_RATE_024 "Orientation rate of track's bounding box in VCS coordinate";
CM_ SG_ 727 OBJ_GROUP_ID_024 "Objects which are linked together shall have same group ID";
CM_ SG_ 727 OBJ_POS_ERR_CRR_COEF_024 "vx-vy correlation due to small error in radial direction and big in cross radial - position Correlation Coefficient Error";
CM_ SG_ 727 OBJ_VELOCITY_ERR_CRR_COEF_024 "vx-vy correlation due to small error in radial direction and big in cross radial - velocity Correlation Coefficient Error";
CM_ SG_ 727 OBJ_ACCEL_ERR_CRR_COEF_024 "vx-vy correlation due to small error in radial direction and big in cross radial - Acceleration Correlation Coefficient Error";
CM_ SG_ 728 OBJ_ALIVE_TIME_025 "Time since object initialization in msec. Tracker internal may have bigger values. On the output interface, we should saturate the signal in that case.";
CM_ SG_ 728 OBJ_ACCELERATION_LONG_ERR_025 "acceleration along Longi  direction";
CM_ SG_ 728 OBJ_ACCELERATION_LAT_ERR_025 "acceleration along Lat direction error";
CM_ SG_ 728 OBJ_POS_LONG_ERR_025 "Lat-position error of object track's centroid in VCS coordinate";
CM_ SG_ 728 OBJ_POS_LAT_ERR_025 "Lat-position error of object track's centroid in VCS coordinate";
CM_ SG_ 728 OBJ_TRACK_MOTION_MODEL_025 "Object tracking uses a motion model for tracking moving items";
CM_ SG_ 728 OBJ_DIMENSION_WIDTH_025 "Lat distance from centroid to edge of bounding box.";
CM_ SG_ 728 OBJ_DIMENSION_LENGTH_025 "Longi distance from centroid to edge of bounding box.";
CM_ SG_ 728 OBJ_EXISTENCE_PROB_025 "Probability that the target is an actual target";
CM_ SG_ 728 OBJ_YAW_ANGLE_025 "Orientation of track's bounding box in VCS coordinate";
CM_ SG_ 728 OBJ_ID_025 "ID of object tracks, zero-ID represents an inactive track";
CM_ SG_ 728 OBJ_MOVEMENT_STATUS_025 "Information about a possible movement of the object during tracking";
CM_ SG_ 728 OBJ_MEASUREMENT_STATUS_025 "Objects should be sent out as fast as possible, even if not all statuses are observed and the object’s
signals might not be fully filled.";
CM_ SG_ 728 OBJ_POS_LONG_025 "Long-position of object track's centroid in VCS coordinate";
CM_ SG_ 728 OBJ_POS_LAT_025 "Lat-position of object track's centroid in VCS coordinate";
CM_ SG_ 728 OBJ_VELOCITY_LONG_025 "Over-the-ground velocity of object track's centroid along Long direction (in VCS coordinate)";
CM_ SG_ 728 OBJ_VELOCITY_LAT_025 "Over-the-ground velocity of object track's centroid along Lat direction (in VCS coordinate)";
CM_ SG_ 728 OBJ_ACCELERATION_LONG_025 "Over-the-ground track acceleration along Longi direction (in VCS coordinate)";
CM_ SG_ 728 OBJ_ACCELERATION_LAT_025 "Over-the-ground track acceleration along Lat direction (in VCS coordinate)";
CM_ SG_ 728 OBJ_VEH_TRACK_FLAG_025 "Indicates if current track is a vehicle";
CM_ SG_ 728 OBJ_TIMESTAMP_OFFSET_025 "A timestamp offset from the object list header timestamp for each object as we have different timestamps from different sensors leading to different timestamps on each object";
CM_ SG_ 728 OBJ_DIMENSION_WIDTH_ERR_025 "Lat distance or length error";
CM_ SG_ 728 OBJ_DIMENSION_LENGTH_ERR_025 "Longi distance or length error";
CM_ SG_ 728 OBJ_CLS_TYPE1_025 "Classification Type 1(Highest Prob), selected from ENUM list";
CM_ SG_ 728 OBJ_CLS_TYPE1_PROB_025 "Classification Type 1 probablity";
CM_ SG_ 728 OBJ_CLS_TYPE6_025 "Classification Type 6(Lowest Prob), selected from ENUM list";
CM_ SG_ 728 OBJ_CLS_TYPE6_PROB_025 "Classification Type 1 probablity";
CM_ SG_ 728 OBJ_RCS_025 "Representative RCS of the complete recognized object, Not implemented";
CM_ SG_ 728 OBJ_REF_PT_LONG_OFFSET_025 "Outer edges of the recognized object’s bounding box in Y axis";
CM_ SG_ 728 OBJ_REF_PT_LAT_OFFSET_025 "Outer edges of the recognized object’s bounding box in X axis";
CM_ SG_ 728 OBJ_YAW_RATE_025 "Orientation rate of track's bounding box in VCS coordinate";
CM_ SG_ 728 OBJ_GROUP_ID_025 "Objects which are linked together shall have same group ID";
CM_ SG_ 728 OBJ_POS_ERR_CRR_COEF_025 "vx-vy correlation due to small error in radial direction and big in cross radial - position Correlation Coefficient Error";
CM_ SG_ 728 OBJ_VELOCITY_ERR_CRR_COEF_025 "vx-vy correlation due to small error in radial direction and big in cross radial - velocity Correlation Coefficient Error";
CM_ SG_ 728 OBJ_ACCEL_ERR_CRR_COEF_025 "vx-vy correlation due to small error in radial direction and big in cross radial - Acceleration Correlation Coefficient Error";
CM_ SG_ 729 OBJ_ALIVE_TIME_026 "Time since object initialization in msec. Tracker internal may have bigger values. On the output interface, we should saturate the signal in that case.";
CM_ SG_ 729 OBJ_ACCELERATION_LONG_ERR_026 "acceleration along Longi  direction";
CM_ SG_ 729 OBJ_ACCELERATION_LAT_ERR_026 "acceleration along Lat direction error";
CM_ SG_ 729 OBJ_POS_LONG_ERR_026 "Lat-position error of object track's centroid in VCS coordinate";
CM_ SG_ 729 OBJ_POS_LAT_ERR_026 "Lat-position error of object track's centroid in VCS coordinate";
CM_ SG_ 729 OBJ_TRACK_MOTION_MODEL_026 "Object tracking uses a motion model for tracking moving items";
CM_ SG_ 729 OBJ_DIMENSION_WIDTH_026 "Lat distance from centroid to edge of bounding box.";
CM_ SG_ 729 OBJ_DIMENSION_LENGTH_026 "Longi distance from centroid to edge of bounding box.";
CM_ SG_ 729 OBJ_EXISTENCE_PROB_026 "Probability that the target is an actual target";
CM_ SG_ 729 OBJ_YAW_ANGLE_026 "Orientation of track's bounding box in VCS coordinate";
CM_ SG_ 729 OBJ_ID_026 "ID of object tracks, zero-ID represents an inactive track";
CM_ SG_ 729 OBJ_MOVEMENT_STATUS_026 "Information about a possible movement of the object during tracking";
CM_ SG_ 729 OBJ_MEASUREMENT_STATUS_026 "Objects should be sent out as fast as possible, even if not all statuses are observed and the object’s
signals might not be fully filled.";
CM_ SG_ 729 OBJ_POS_LONG_026 "Long-position of object track's centroid in VCS coordinate";
CM_ SG_ 729 OBJ_POS_LAT_026 "Lat-position of object track's centroid in VCS coordinate";
CM_ SG_ 729 OBJ_VELOCITY_LONG_026 "Over-the-ground velocity of object track's centroid along Long direction (in VCS coordinate)";
CM_ SG_ 729 OBJ_VELOCITY_LAT_026 "Over-the-ground velocity of object track's centroid along Lat direction (in VCS coordinate)";
CM_ SG_ 729 OBJ_ACCELERATION_LONG_026 "Over-the-ground track acceleration along Longi direction (in VCS coordinate)";
CM_ SG_ 729 OBJ_ACCELERATION_LAT_026 "Over-the-ground track acceleration along Lat direction (in VCS coordinate)";
CM_ SG_ 729 OBJ_VEH_TRACK_FLAG_026 "Indicates if current track is a vehicle";
CM_ SG_ 729 OBJ_TIMESTAMP_OFFSET_026 "A timestamp offset from the object list header timestamp for each object as we have different timestamps from different sensors leading to different timestamps on each object";
CM_ SG_ 729 OBJ_DIMENSION_WIDTH_ERR_026 "Lat distance or length error";
CM_ SG_ 729 OBJ_DIMENSION_LENGTH_ERR_026 "Longi distance or length error";
CM_ SG_ 729 OBJ_CLS_TYPE1_026 "Classification Type 1(Highest Prob), selected from ENUM list";
CM_ SG_ 729 OBJ_CLS_TYPE1_PROB_026 "Classification Type 1 probablity";
CM_ SG_ 729 OBJ_CLS_TYPE6_026 "Classification Type 6(Lowest Prob), selected from ENUM list";
CM_ SG_ 729 OBJ_CLS_TYPE6_PROB_026 "Classification Type 1 probablity";
CM_ SG_ 729 OBJ_RCS_026 "Representative RCS of the complete recognized object, Not implemented";
CM_ SG_ 729 OBJ_REF_PT_LONG_OFFSET_026 "Outer edges of the recognized object’s bounding box in Y axis";
CM_ SG_ 729 OBJ_REF_PT_LAT_OFFSET_026 "Outer edges of the recognized object’s bounding box in X axis";
CM_ SG_ 729 OBJ_YAW_RATE_026 "Orientation rate of track's bounding box in VCS coordinate";
CM_ SG_ 729 OBJ_GROUP_ID_026 "Objects which are linked together shall have same group ID";
CM_ SG_ 729 OBJ_POS_ERR_CRR_COEF_026 "vx-vy correlation due to small error in radial direction and big in cross radial - position Correlation Coefficient Error";
CM_ SG_ 729 OBJ_VELOCITY_ERR_CRR_COEF_026 "vx-vy correlation due to small error in radial direction and big in cross radial - velocity Correlation Coefficient Error";
CM_ SG_ 729 OBJ_ACCEL_ERR_CRR_COEF_026 "vx-vy correlation due to small error in radial direction and big in cross radial - Acceleration Correlation Coefficient Error";
CM_ SG_ 730 OBJ_ALIVE_TIME_027 "Time since object initialization in msec. Tracker internal may have bigger values. On the output interface, we should saturate the signal in that case.";
CM_ SG_ 730 OBJ_ACCELERATION_LONG_ERR_027 "acceleration along Longi  direction";
CM_ SG_ 730 OBJ_ACCELERATION_LAT_ERR_027 "acceleration along Lat direction error";
CM_ SG_ 730 OBJ_POS_LONG_ERR_027 "Lat-position error of object track's centroid in VCS coordinate";
CM_ SG_ 730 OBJ_POS_LAT_ERR_027 "Lat-position error of object track's centroid in VCS coordinate";
CM_ SG_ 730 OBJ_TRACK_MOTION_MODEL_027 "Object tracking uses a motion model for tracking moving items";
CM_ SG_ 730 OBJ_DIMENSION_WIDTH_027 "Lat distance from centroid to edge of bounding box.";
CM_ SG_ 730 OBJ_DIMENSION_LENGTH_027 "Longi distance from centroid to edge of bounding box.";
CM_ SG_ 730 OBJ_EXISTENCE_PROB_027 "Probability that the target is an actual target";
CM_ SG_ 730 OBJ_YAW_ANGLE_027 "Orientation of track's bounding box in VCS coordinate";
CM_ SG_ 730 OBJ_ID_027 "ID of object tracks, zero-ID represents an inactive track";
CM_ SG_ 730 OBJ_MOVEMENT_STATUS_027 "Information about a possible movement of the object during tracking";
CM_ SG_ 730 OBJ_MEASUREMENT_STATUS_027 "Objects should be sent out as fast as possible, even if not all statuses are observed and the object’s
signals might not be fully filled.";
CM_ SG_ 730 OBJ_POS_LONG_027 "Long-position of object track's centroid in VCS coordinate";
CM_ SG_ 730 OBJ_POS_LAT_027 "Lat-position of object track's centroid in VCS coordinate";
CM_ SG_ 730 OBJ_VELOCITY_LONG_027 "Over-the-ground velocity of object track's centroid along Long direction (in VCS coordinate)";
CM_ SG_ 730 OBJ_VELOCITY_LAT_027 "Over-the-ground velocity of object track's centroid along Lat direction (in VCS coordinate)";
CM_ SG_ 730 OBJ_ACCELERATION_LONG_027 "Over-the-ground track acceleration along Longi direction (in VCS coordinate)";
CM_ SG_ 730 OBJ_ACCELERATION_LAT_027 "Over-the-ground track acceleration along Lat direction (in VCS coordinate)";
CM_ SG_ 730 OBJ_VEH_TRACK_FLAG_027 "Indicates if current track is a vehicle";
CM_ SG_ 730 OBJ_TIMESTAMP_OFFSET_027 "A timestamp offset from the object list header timestamp for each object as we have different timestamps from different sensors leading to different timestamps on each object";
CM_ SG_ 730 OBJ_DIMENSION_WIDTH_ERR_027 "Lat distance or length error";
CM_ SG_ 730 OBJ_DIMENSION_LENGTH_ERR_027 "Longi distance or length error";
CM_ SG_ 730 OBJ_CLS_TYPE1_027 "Classification Type 1(Highest Prob), selected from ENUM list";
CM_ SG_ 730 OBJ_CLS_TYPE1_PROB_027 "Classification Type 1 probablity";
CM_ SG_ 730 OBJ_CLS_TYPE6_027 "Classification Type 6(Lowest Prob), selected from ENUM list";
CM_ SG_ 730 OBJ_CLS_TYPE6_PROB_027 "Classification Type 1 probablity";
CM_ SG_ 730 OBJ_RCS_027 "Representative RCS of the complete recognized object, Not implemented";
CM_ SG_ 730 OBJ_REF_PT_LONG_OFFSET_027 "Outer edges of the recognized object’s bounding box in Y axis";
CM_ SG_ 730 OBJ_REF_PT_LAT_OFFSET_027 "Outer edges of the recognized object’s bounding box in X axis";
CM_ SG_ 730 OBJ_YAW_RATE_027 "Orientation rate of track's bounding box in VCS coordinate";
CM_ SG_ 730 OBJ_GROUP_ID_027 "Objects which are linked together shall have same group ID";
CM_ SG_ 730 OBJ_POS_ERR_CRR_COEF_027 "vx-vy correlation due to small error in radial direction and big in cross radial - position Correlation Coefficient Error";
CM_ SG_ 730 OBJ_VELOCITY_ERR_CRR_COEF_027 "vx-vy correlation due to small error in radial direction and big in cross radial - velocity Correlation Coefficient Error";
CM_ SG_ 730 OBJ_ACCEL_ERR_CRR_COEF_027 "vx-vy correlation due to small error in radial direction and big in cross radial - Acceleration Correlation Coefficient Error";
CM_ SG_ 731 OBJ_ALIVE_TIME_028 "Time since object initialization in msec. Tracker internal may have bigger values. On the output interface, we should saturate the signal in that case.";
CM_ SG_ 731 OBJ_ACCELERATION_LONG_ERR_028 "acceleration along Longi  direction";
CM_ SG_ 731 OBJ_ACCELERATION_LAT_ERR_028 "acceleration along Lat direction error";
CM_ SG_ 731 OBJ_POS_LONG_ERR_028 "Lat-position error of object track's centroid in VCS coordinate";
CM_ SG_ 731 OBJ_POS_LAT_ERR_028 "Lat-position error of object track's centroid in VCS coordinate";
CM_ SG_ 731 OBJ_TRACK_MOTION_MODEL_028 "Object tracking uses a motion model for tracking moving items";
CM_ SG_ 731 OBJ_DIMENSION_WIDTH_028 "Lat distance from centroid to edge of bounding box.";
CM_ SG_ 731 OBJ_DIMENSION_LENGTH_028 "Longi distance from centroid to edge of bounding box.";
CM_ SG_ 731 OBJ_EXISTENCE_PROB_028 "Probability that the target is an actual target";
CM_ SG_ 731 OBJ_YAW_ANGLE_028 "Orientation of track's bounding box in VCS coordinate";
CM_ SG_ 731 OBJ_ID_028 "ID of object tracks, zero-ID represents an inactive track";
CM_ SG_ 731 OBJ_MOVEMENT_STATUS_028 "Information about a possible movement of the object during tracking";
CM_ SG_ 731 OBJ_MEASUREMENT_STATUS_028 "Objects should be sent out as fast as possible, even if not all statuses are observed and the object’s
signals might not be fully filled.";
CM_ SG_ 731 OBJ_POS_LONG_028 "Long-position of object track's centroid in VCS coordinate";
CM_ SG_ 731 OBJ_POS_LAT_028 "Lat-position of object track's centroid in VCS coordinate";
CM_ SG_ 731 OBJ_VELOCITY_LONG_028 "Over-the-ground velocity of object track's centroid along Long direction (in VCS coordinate)";
CM_ SG_ 731 OBJ_VELOCITY_LAT_028 "Over-the-ground velocity of object track's centroid along Lat direction (in VCS coordinate)";
CM_ SG_ 731 OBJ_ACCELERATION_LONG_028 "Over-the-ground track acceleration along Longi direction (in VCS coordinate)";
CM_ SG_ 731 OBJ_ACCELERATION_LAT_028 "Over-the-ground track acceleration along Lat direction (in VCS coordinate)";
CM_ SG_ 731 OBJ_VEH_TRACK_FLAG_028 "Indicates if current track is a vehicle";
CM_ SG_ 731 OBJ_TIMESTAMP_OFFSET_028 "A timestamp offset from the object list header timestamp for each object as we have different timestamps from different sensors leading to different timestamps on each object";
CM_ SG_ 731 OBJ_DIMENSION_WIDTH_ERR_028 "Lat distance or length error";
CM_ SG_ 731 OBJ_DIMENSION_LENGTH_ERR_028 "Longi distance or length error";
CM_ SG_ 731 OBJ_CLS_TYPE1_028 "Classification Type 1(Highest Prob), selected from ENUM list";
CM_ SG_ 731 OBJ_CLS_TYPE1_PROB_028 "Classification Type 1 probablity";
CM_ SG_ 731 OBJ_CLS_TYPE6_028 "Classification Type 6(Lowest Prob), selected from ENUM list";
CM_ SG_ 731 OBJ_CLS_TYPE6_PROB_028 "Classification Type 1 probablity";
CM_ SG_ 731 OBJ_RCS_028 "Representative RCS of the complete recognized object, Not implemented";
CM_ SG_ 731 OBJ_REF_PT_LONG_OFFSET_028 "Outer edges of the recognized object’s bounding box in Y axis";
CM_ SG_ 731 OBJ_REF_PT_LAT_OFFSET_028 "Outer edges of the recognized object’s bounding box in X axis";
CM_ SG_ 731 OBJ_YAW_RATE_028 "Orientation rate of track's bounding box in VCS coordinate";
CM_ SG_ 731 OBJ_GROUP_ID_028 "Objects which are linked together shall have same group ID";
CM_ SG_ 731 OBJ_POS_ERR_CRR_COEF_028 "vx-vy correlation due to small error in radial direction and big in cross radial - position Correlation Coefficient Error";
CM_ SG_ 731 OBJ_VELOCITY_ERR_CRR_COEF_028 "vx-vy correlation due to small error in radial direction and big in cross radial - velocity Correlation Coefficient Error";
CM_ SG_ 731 OBJ_ACCEL_ERR_CRR_COEF_028 "vx-vy correlation due to small error in radial direction and big in cross radial - Acceleration Correlation Coefficient Error";
CM_ SG_ 732 OBJ_ALIVE_TIME_029 "Time since object initialization in msec. Tracker internal may have bigger values. On the output interface, we should saturate the signal in that case.";
CM_ SG_ 732 OBJ_ACCELERATION_LONG_ERR_029 "acceleration along Longi  direction";
CM_ SG_ 732 OBJ_ACCELERATION_LAT_ERR_029 "acceleration along Lat direction error";
CM_ SG_ 732 OBJ_POS_LONG_ERR_029 "Lat-position error of object track's centroid in VCS coordinate";
CM_ SG_ 732 OBJ_POS_LAT_ERR_029 "Lat-position error of object track's centroid in VCS coordinate";
CM_ SG_ 732 OBJ_TRACK_MOTION_MODEL_029 "Object tracking uses a motion model for tracking moving items";
CM_ SG_ 732 OBJ_DIMENSION_WIDTH_029 "Lat distance from centroid to edge of bounding box.";
CM_ SG_ 732 OBJ_DIMENSION_LENGTH_029 "Longi distance from centroid to edge of bounding box.";
CM_ SG_ 732 OBJ_EXISTENCE_PROB_029 "Probability that the target is an actual target";
CM_ SG_ 732 OBJ_YAW_ANGLE_029 "Orientation of track's bounding box in VCS coordinate";
CM_ SG_ 732 OBJ_ID_029 "ID of object tracks, zero-ID represents an inactive track";
CM_ SG_ 732 OBJ_MOVEMENT_STATUS_029 "Information about a possible movement of the object during tracking";
CM_ SG_ 732 OBJ_MEASUREMENT_STATUS_029 "Objects should be sent out as fast as possible, even if not all statuses are observed and the object’s
signals might not be fully filled.";
CM_ SG_ 732 OBJ_POS_LONG_029 "Long-position of object track's centroid in VCS coordinate";
CM_ SG_ 732 OBJ_POS_LAT_029 "Lat-position of object track's centroid in VCS coordinate";
CM_ SG_ 732 OBJ_VELOCITY_LONG_029 "Over-the-ground velocity of object track's centroid along Long direction (in VCS coordinate)";
CM_ SG_ 732 OBJ_VELOCITY_LAT_029 "Over-the-ground velocity of object track's centroid along Lat direction (in VCS coordinate)";
CM_ SG_ 732 OBJ_ACCELERATION_LONG_029 "Over-the-ground track acceleration along Longi direction (in VCS coordinate)";
CM_ SG_ 732 OBJ_ACCELERATION_LAT_029 "Over-the-ground track acceleration along Lat direction (in VCS coordinate)";
CM_ SG_ 732 OBJ_VEH_TRACK_FLAG_029 "Indicates if current track is a vehicle";
CM_ SG_ 732 OBJ_TIMESTAMP_OFFSET_029 "A timestamp offset from the object list header timestamp for each object as we have different timestamps from different sensors leading to different timestamps on each object";
CM_ SG_ 732 OBJ_DIMENSION_WIDTH_ERR_029 "Lat distance or length error";
CM_ SG_ 732 OBJ_DIMENSION_LENGTH_ERR_029 "Longi distance or length error";
CM_ SG_ 732 OBJ_CLS_TYPE1_029 "Classification Type 1(Highest Prob), selected from ENUM list";
CM_ SG_ 732 OBJ_CLS_TYPE1_PROB_029 "Classification Type 1 probablity";
CM_ SG_ 732 OBJ_CLS_TYPE6_029 "Classification Type 6(Lowest Prob), selected from ENUM list";
CM_ SG_ 732 OBJ_CLS_TYPE6_PROB_029 "Classification Type 1 probablity";
CM_ SG_ 732 OBJ_RCS_029 "Representative RCS of the complete recognized object, Not implemented";
CM_ SG_ 732 OBJ_REF_PT_LONG_OFFSET_029 "Outer edges of the recognized object’s bounding box in Y axis";
CM_ SG_ 732 OBJ_REF_PT_LAT_OFFSET_029 "Outer edges of the recognized object’s bounding box in X axis";
CM_ SG_ 732 OBJ_YAW_RATE_029 "Orientation rate of track's bounding box in VCS coordinate";
CM_ SG_ 732 OBJ_GROUP_ID_029 "Objects which are linked together shall have same group ID";
CM_ SG_ 732 OBJ_POS_ERR_CRR_COEF_029 "vx-vy correlation due to small error in radial direction and big in cross radial - position Correlation Coefficient Error";
CM_ SG_ 732 OBJ_VELOCITY_ERR_CRR_COEF_029 "vx-vy correlation due to small error in radial direction and big in cross radial - velocity Correlation Coefficient Error";
CM_ SG_ 732 OBJ_ACCEL_ERR_CRR_COEF_029 "vx-vy correlation due to small error in radial direction and big in cross radial - Acceleration Correlation Coefficient Error";
CM_ SG_ 733 OBJ_ALIVE_TIME_030 "Time since object initialization in msec. Tracker internal may have bigger values. On the output interface, we should saturate the signal in that case.";
CM_ SG_ 733 OBJ_ACCELERATION_LONG_ERR_030 "acceleration along Longi  direction";
CM_ SG_ 733 OBJ_ACCELERATION_LAT_ERR_030 "acceleration along Lat direction error";
CM_ SG_ 733 OBJ_POS_LONG_ERR_030 "Lat-position error of object track's centroid in VCS coordinate";
CM_ SG_ 733 OBJ_POS_LAT_ERR_030 "Lat-position error of object track's centroid in VCS coordinate";
CM_ SG_ 733 OBJ_TRACK_MOTION_MODEL_030 "Object tracking uses a motion model for tracking moving items";
CM_ SG_ 733 OBJ_DIMENSION_WIDTH_030 "Lat distance from centroid to edge of bounding box.";
CM_ SG_ 733 OBJ_DIMENSION_LENGTH_030 "Longi distance from centroid to edge of bounding box.";
CM_ SG_ 733 OBJ_EXISTENCE_PROB_030 "Probability that the target is an actual target";
CM_ SG_ 733 OBJ_YAW_ANGLE_030 "Orientation of track's bounding box in VCS coordinate";
CM_ SG_ 733 OBJ_ID_030 "ID of object tracks, zero-ID represents an inactive track";
CM_ SG_ 733 OBJ_MOVEMENT_STATUS_030 "Information about a possible movement of the object during tracking";
CM_ SG_ 733 OBJ_MEASUREMENT_STATUS_030 "Objects should be sent out as fast as possible, even if not all statuses are observed and the object’s
signals might not be fully filled.";
CM_ SG_ 733 OBJ_POS_LONG_030 "Long-position of object track's centroid in VCS coordinate";
CM_ SG_ 733 OBJ_POS_LAT_030 "Lat-position of object track's centroid in VCS coordinate";
CM_ SG_ 733 OBJ_VELOCITY_LONG_030 "Over-the-ground velocity of object track's centroid along Long direction (in VCS coordinate)";
CM_ SG_ 733 OBJ_VELOCITY_LAT_030 "Over-the-ground velocity of object track's centroid along Lat direction (in VCS coordinate)";
CM_ SG_ 733 OBJ_ACCELERATION_LONG_030 "Over-the-ground track acceleration along Longi direction (in VCS coordinate)";
CM_ SG_ 733 OBJ_ACCELERATION_LAT_030 "Over-the-ground track acceleration along Lat direction (in VCS coordinate)";
CM_ SG_ 733 OBJ_VEH_TRACK_FLAG_030 "Indicates if current track is a vehicle";
CM_ SG_ 733 OBJ_TIMESTAMP_OFFSET_030 "A timestamp offset from the object list header timestamp for each object as we have different timestamps from different sensors leading to different timestamps on each object";
CM_ SG_ 733 OBJ_DIMENSION_WIDTH_ERR_030 "Lat distance or length error";
CM_ SG_ 733 OBJ_DIMENSION_LENGTH_ERR_030 "Longi distance or length error";
CM_ SG_ 733 OBJ_CLS_TYPE1_030 "Classification Type 1(Highest Prob), selected from ENUM list";
CM_ SG_ 733 OBJ_CLS_TYPE1_PROB_030 "Classification Type 1 probablity";
CM_ SG_ 733 OBJ_CLS_TYPE6_030 "Classification Type 6(Lowest Prob), selected from ENUM list";
CM_ SG_ 733 OBJ_CLS_TYPE6_PROB_030 "Classification Type 1 probablity";
CM_ SG_ 733 OBJ_RCS_030 "Representative RCS of the complete recognized object, Not implemented";
CM_ SG_ 733 OBJ_REF_PT_LONG_OFFSET_030 "Outer edges of the recognized object’s bounding box in Y axis";
CM_ SG_ 733 OBJ_REF_PT_LAT_OFFSET_030 "Outer edges of the recognized object’s bounding box in X axis";
CM_ SG_ 733 OBJ_YAW_RATE_030 "Orientation rate of track's bounding box in VCS coordinate";
CM_ SG_ 733 OBJ_GROUP_ID_030 "Objects which are linked together shall have same group ID";
CM_ SG_ 733 OBJ_POS_ERR_CRR_COEF_030 "vx-vy correlation due to small error in radial direction and big in cross radial - position Correlation Coefficient Error";
CM_ SG_ 733 OBJ_VELOCITY_ERR_CRR_COEF_030 "vx-vy correlation due to small error in radial direction and big in cross radial - velocity Correlation Coefficient Error";
CM_ SG_ 733 OBJ_ACCEL_ERR_CRR_COEF_030 "vx-vy correlation due to small error in radial direction and big in cross radial - Acceleration Correlation Coefficient Error";
CM_ SG_ 734 OBJ_ALIVE_TIME_031 "Time since object initialization in msec. Tracker internal may have bigger values. On the output interface, we should saturate the signal in that case.";
CM_ SG_ 734 OBJ_ACCELERATION_LONG_ERR_031 "acceleration along Longi  direction";
CM_ SG_ 734 OBJ_ACCELERATION_LAT_ERR_031 "acceleration along Lat direction error";
CM_ SG_ 734 OBJ_POS_LONG_ERR_031 "Lat-position error of object track's centroid in VCS coordinate";
CM_ SG_ 734 OBJ_POS_LAT_ERR_031 "Lat-position error of object track's centroid in VCS coordinate";
CM_ SG_ 734 OBJ_TRACK_MOTION_MODEL_031 "Object tracking uses a motion model for tracking moving items";
CM_ SG_ 734 OBJ_DIMENSION_WIDTH_031 "Lat distance from centroid to edge of bounding box.";
CM_ SG_ 734 OBJ_DIMENSION_LENGTH_031 "Longi distance from centroid to edge of bounding box.";
CM_ SG_ 734 OBJ_EXISTENCE_PROB_031 "Probability that the target is an actual target";
CM_ SG_ 734 OBJ_YAW_ANGLE_031 "Orientation of track's bounding box in VCS coordinate";
CM_ SG_ 734 OBJ_ID_031 "ID of object tracks, zero-ID represents an inactive track";
CM_ SG_ 734 OBJ_MOVEMENT_STATUS_031 "Information about a possible movement of the object during tracking";
CM_ SG_ 734 OBJ_MEASUREMENT_STATUS_031 "Objects should be sent out as fast as possible, even if not all statuses are observed and the object’s
signals might not be fully filled.";
CM_ SG_ 734 OBJ_POS_LONG_031 "Long-position of object track's centroid in VCS coordinate";
CM_ SG_ 734 OBJ_POS_LAT_031 "Lat-position of object track's centroid in VCS coordinate";
CM_ SG_ 734 OBJ_VELOCITY_LONG_031 "Over-the-ground velocity of object track's centroid along Long direction (in VCS coordinate)";
CM_ SG_ 734 OBJ_VELOCITY_LAT_031 "Over-the-ground velocity of object track's centroid along Lat direction (in VCS coordinate)";
CM_ SG_ 734 OBJ_ACCELERATION_LONG_031 "Over-the-ground track acceleration along Longi direction (in VCS coordinate)";
CM_ SG_ 734 OBJ_ACCELERATION_LAT_031 "Over-the-ground track acceleration along Lat direction (in VCS coordinate)";
CM_ SG_ 734 OBJ_VEH_TRACK_FLAG_031 "Indicates if current track is a vehicle";
CM_ SG_ 734 OBJ_TIMESTAMP_OFFSET_031 "A timestamp offset from the object list header timestamp for each object as we have different timestamps from different sensors leading to different timestamps on each object";
CM_ SG_ 734 OBJ_DIMENSION_WIDTH_ERR_031 "Lat distance or length error";
CM_ SG_ 734 OBJ_DIMENSION_LENGTH_ERR_031 "Longi distance or length error";
CM_ SG_ 734 OBJ_CLS_TYPE1_031 "Classification Type 1(Highest Prob), selected from ENUM list";
CM_ SG_ 734 OBJ_CLS_TYPE1_PROB_031 "Classification Type 1 probablity";
CM_ SG_ 734 OBJ_CLS_TYPE6_031 "Classification Type 6(Lowest Prob), selected from ENUM list";
CM_ SG_ 734 OBJ_CLS_TYPE6_PROB_031 "Classification Type 1 probablity";
CM_ SG_ 734 OBJ_RCS_031 "Representative RCS of the complete recognized object, Not implemented";
CM_ SG_ 734 OBJ_REF_PT_LONG_OFFSET_031 "Outer edges of the recognized object’s bounding box in Y axis";
CM_ SG_ 734 OBJ_REF_PT_LAT_OFFSET_031 "Outer edges of the recognized object’s bounding box in X axis";
CM_ SG_ 734 OBJ_YAW_RATE_031 "Orientation rate of track's bounding box in VCS coordinate";
CM_ SG_ 734 OBJ_GROUP_ID_031 "Objects which are linked together shall have same group ID";
CM_ SG_ 734 OBJ_POS_ERR_CRR_COEF_031 "vx-vy correlation due to small error in radial direction and big in cross radial - position Correlation Coefficient Error";
CM_ SG_ 734 OBJ_VELOCITY_ERR_CRR_COEF_031 "vx-vy correlation due to small error in radial direction and big in cross radial - velocity Correlation Coefficient Error";
CM_ SG_ 734 OBJ_ACCEL_ERR_CRR_COEF_031 "vx-vy correlation due to small error in radial direction and big in cross radial - Acceleration Correlation Coefficient Error";

BA_DEF_ BO_ "CanTpBs" INT 0 255;
BA_DEF_ BO_ "EventRateOfChange" INT 10 10000;
BA_DEF_ BO_ "GenMsgCycleTime" INT 0 100000;
BA_DEF_ BO_ "GenMsgILSupport" ENUM  "No","Yes";
BA_DEF_ BO_ "GenMsgNrOfRepetition" INT 0 100;
BA_DEF_ BO_ "GenMsgSendType" ENUM  "FixedPeriodic","Event","EnabledPeriodic","NotUsed","NotUsed","EventPeriodic","NotUsed","NotUsed","NoMsgSendType";
BA_DEF_ BO_ "NetworkInitialization" ENUM  "No","Yes";
BA_DEF_ BO_ "VFrameFormat" ENUM  "StandardCAN","ExtendedCAN","reserved","reserved","reserved","reserved","reserved","reserved","reserved","reserved","reserved","reserved","reserved","reserved","StandardCAN_FD","ExtendedCAN_FD";
BA_DEF_ SG_ "GenSigCmt" STRING;
BA_DEF_ SG_ "GenSigCycleTime" INT 0 0;
BA_DEF_ SG_ "GenSigSendType" ENUM  "Cyclic","OnWrite","vector_leerstring","OnChange","vector_leerstring","IfActive","vector_leerstring","NoSigSendType";
BA_DEF_ SG_ "GenSigStartValue" INT 0 1000000000;
BA_DEF_ SG_ "GenSigTimeoutTime" INT 0 0;
BA_DEF_ SG_ "GenSigVtEn" STRING;
BA_DEF_ SG_ "GenSigVtName" STRING;
BA_DEF_DEF_ "CanTpBs" 255;
BA_DEF_DEF_ "EventRateOfChange" 10000;
BA_DEF_DEF_ "GenMsgCycleTime" 0;
BA_DEF_DEF_ "GenMsgILSupport" "Yes";
BA_DEF_DEF_ "GenMsgNrOfRepetition" 0;
BA_DEF_DEF_ "GenMsgSendType" "NoMsgSendType";
BA_DEF_DEF_ "GenSigCmt" "";
BA_DEF_DEF_ "GenSigCycleTime" 0;
BA_DEF_DEF_ "GenSigSendType" "NoSigSendType";
BA_DEF_DEF_ "GenSigStartValue" 0;
BA_DEF_DEF_ "GenSigTimeoutTime" 0;
BA_DEF_DEF_ "GenSigVtEn" "";
BA_DEF_DEF_ "GenSigVtName" "";
BA_DEF_DEF_ "NetworkInitialization" "Yes";
BA_DEF_DEF_ "VFrameFormat" "StandardCAN_FD";
BA_ "GenMsgSendType" BO_ 718 1;
BA_ "GenMsgSendType" BO_ 719 1;
BA_ "GenMsgSendType" BO_ 720 1;
BA_ "GenMsgSendType" BO_ 721 1;
BA_ "GenMsgSendType" BO_ 722 1;
BA_ "GenMsgSendType" BO_ 723 1;
BA_ "GenMsgSendType" BO_ 724 1;
BA_ "GenMsgSendType" BO_ 725 1;
BA_ "GenMsgSendType" BO_ 726 1;
BA_ "GenMsgSendType" BO_ 727 1;
BA_ "GenMsgSendType" BO_ 728 1;
BA_ "GenMsgSendType" BO_ 729 1;
BA_ "GenMsgSendType" BO_ 730 1;
BA_ "GenMsgSendType" BO_ 731 1;
BA_ "GenMsgSendType" BO_ 732 1;
BA_ "GenMsgSendType" BO_ 733 1;
BA_ "GenMsgSendType" BO_ 734 1;
BA_ "GenSigStartValue" SG_ 718 OBJ_YAW_ANGLE_015 2000;
BA_ "GenSigStartValue" SG_ 718 OBJ_POS_LONG_015 32700;
BA_ "GenSigStartValue" SG_ 718 OBJ_POS_LAT_015 32700;
BA_ "GenSigStartValue" SG_ 718 OBJ_VELOCITY_LONG_015 16300;
BA_ "GenSigStartValue" SG_ 718 OBJ_VELOCITY_LAT_015 16300;
BA_ "GenSigStartValue" SG_ 718 OBJ_ACCELERATION_LONG_015 400;
BA_ "GenSigStartValue" SG_ 718 OBJ_ACCELERATION_LAT_015 400;
BA_ "GenSigStartValue" SG_ 718 OBJ_TIMESTAMP_OFFSET_015 127;
BA_ "GenSigStartValue" SG_ 718 OBJ_RCS_015 64;
BA_ "GenSigStartValue" SG_ 718 OBJ_YAW_RATE_015 448;
BA_ "GenSigStartValue" SG_ 718 OBJ_POS_ERR_CRR_COEF_015 120;
BA_ "GenSigStartValue" SG_ 718 OBJ_VELOCITY_ERR_CRR_COEF_015 120;
BA_ "GenSigStartValue" SG_ 718 OBJ_ACCEL_ERR_CRR_COEF_015 120;
BA_ "GenSigStartValue" SG_ 719 OBJ_YAW_ANGLE_016 2000;
BA_ "GenSigStartValue" SG_ 719 OBJ_POS_LONG_016 32700;
BA_ "GenSigStartValue" SG_ 719 OBJ_POS_LAT_016 32700;
BA_ "GenSigStartValue" SG_ 719 OBJ_VELOCITY_LONG_016 16300;
BA_ "GenSigStartValue" SG_ 719 OBJ_VELOCITY_LAT_016 16300;
BA_ "GenSigStartValue" SG_ 719 OBJ_ACCELERATION_LONG_016 400;
BA_ "GenSigStartValue" SG_ 719 OBJ_ACCELERATION_LAT_016 400;
BA_ "GenSigStartValue" SG_ 719 OBJ_TIMESTAMP_OFFSET_016 127;
BA_ "GenSigStartValue" SG_ 719 OBJ_RCS_016 64;
BA_ "GenSigStartValue" SG_ 719 OBJ_YAW_RATE_016 448;
BA_ "GenSigStartValue" SG_ 719 OBJ_POS_ERR_CRR_COEF_016 120;
BA_ "GenSigStartValue" SG_ 719 OBJ_VELOCITY_ERR_CRR_COEF_016 120;
BA_ "GenSigStartValue" SG_ 719 OBJ_ACCEL_ERR_CRR_COEF_016 120;
BA_ "GenSigStartValue" SG_ 720 OBJ_YAW_ANGLE_017 2000;
BA_ "GenSigStartValue" SG_ 720 OBJ_POS_LONG_017 32700;
BA_ "GenSigStartValue" SG_ 720 OBJ_POS_LAT_017 32700;
BA_ "GenSigStartValue" SG_ 720 OBJ_VELOCITY_LONG_017 16300;
BA_ "GenSigStartValue" SG_ 720 OBJ_VELOCITY_LAT_017 16300;
BA_ "GenSigStartValue" SG_ 720 OBJ_ACCELERATION_LONG_017 400;
BA_ "GenSigStartValue" SG_ 720 OBJ_ACCELERATION_LAT_017 400;
BA_ "GenSigStartValue" SG_ 720 OBJ_TIMESTAMP_OFFSET_017 127;
BA_ "GenSigStartValue" SG_ 720 OBJ_RCS_017 64;
BA_ "GenSigStartValue" SG_ 720 OBJ_YAW_RATE_017 448;
BA_ "GenSigStartValue" SG_ 720 OBJ_POS_ERR_CRR_COEF_017 120;
BA_ "GenSigStartValue" SG_ 720 OBJ_VELOCITY_ERR_CRR_COEF_017 120;
BA_ "GenSigStartValue" SG_ 720 OBJ_ACCEL_ERR_CRR_COEF_017 120;
BA_ "GenSigStartValue" SG_ 721 OBJ_YAW_ANGLE_018 2000;
BA_ "GenSigStartValue" SG_ 721 OBJ_POS_LONG_018 32700;
BA_ "GenSigStartValue" SG_ 721 OBJ_POS_LAT_018 32700;
BA_ "GenSigStartValue" SG_ 721 OBJ_VELOCITY_LONG_018 16300;
BA_ "GenSigStartValue" SG_ 721 OBJ_VELOCITY_LAT_018 16300;
BA_ "GenSigStartValue" SG_ 721 OBJ_ACCELERATION_LONG_018 400;
BA_ "GenSigStartValue" SG_ 721 OBJ_ACCELERATION_LAT_018 400;
BA_ "GenSigStartValue" SG_ 721 OBJ_TIMESTAMP_OFFSET_018 127;
BA_ "GenSigStartValue" SG_ 721 OBJ_RCS_018 64;
BA_ "GenSigStartValue" SG_ 721 OBJ_YAW_RATE_018 448;
BA_ "GenSigStartValue" SG_ 721 OBJ_POS_ERR_CRR_COEF_018 120;
BA_ "GenSigStartValue" SG_ 721 OBJ_VELOCITY_ERR_CRR_COEF_018 120;
BA_ "GenSigStartValue" SG_ 721 OBJ_ACCEL_ERR_CRR_COEF_018 120;
BA_ "GenSigStartValue" SG_ 722 OBJ_YAW_ANGLE_019 2000;
BA_ "GenSigStartValue" SG_ 722 OBJ_POS_LONG_019 32700;
BA_ "GenSigStartValue" SG_ 722 OBJ_POS_LAT_019 32700;
BA_ "GenSigStartValue" SG_ 722 OBJ_VELOCITY_LONG_019 16300;
BA_ "GenSigStartValue" SG_ 722 OBJ_VELOCITY_LAT_019 16300;
BA_ "GenSigStartValue" SG_ 722 OBJ_ACCELERATION_LONG_019 400;
BA_ "GenSigStartValue" SG_ 722 OBJ_ACCELERATION_LAT_019 400;
BA_ "GenSigStartValue" SG_ 722 OBJ_TIMESTAMP_OFFSET_019 127;
BA_ "GenSigStartValue" SG_ 722 OBJ_RCS_019 64;
BA_ "GenSigStartValue" SG_ 722 OBJ_YAW_RATE_019 448;
BA_ "GenSigStartValue" SG_ 722 OBJ_POS_ERR_CRR_COEF_019 120;
BA_ "GenSigStartValue" SG_ 722 OBJ_VELOCITY_ERR_CRR_COEF_019 120;
BA_ "GenSigStartValue" SG_ 722 OBJ_ACCEL_ERR_CRR_COEF_019 120;
BA_ "GenSigStartValue" SG_ 723 OBJ_YAW_ANGLE_020 2000;
BA_ "GenSigStartValue" SG_ 723 OBJ_POS_LONG_020 32700;
BA_ "GenSigStartValue" SG_ 723 OBJ_POS_LAT_020 32700;
BA_ "GenSigStartValue" SG_ 723 OBJ_VELOCITY_LONG_020 16300;
BA_ "GenSigStartValue" SG_ 723 OBJ_VELOCITY_LAT_020 16300;
BA_ "GenSigStartValue" SG_ 723 OBJ_ACCELERATION_LONG_020 400;
BA_ "GenSigStartValue" SG_ 723 OBJ_ACCELERATION_LAT_020 400;
BA_ "GenSigStartValue" SG_ 723 OBJ_TIMESTAMP_OFFSET_020 127;
BA_ "GenSigStartValue" SG_ 723 OBJ_RCS_020 64;
BA_ "GenSigStartValue" SG_ 723 OBJ_YAW_RATE_020 448;
BA_ "GenSigStartValue" SG_ 723 OBJ_POS_ERR_CRR_COEF_020 120;
BA_ "GenSigStartValue" SG_ 723 OBJ_VELOCITY_ERR_CRR_COEF_020 120;
BA_ "GenSigStartValue" SG_ 723 OBJ_ACCEL_ERR_CRR_COEF_020 120;
BA_ "GenSigStartValue" SG_ 724 OBJ_YAW_ANGLE_021 2000;
BA_ "GenSigStartValue" SG_ 724 OBJ_POS_LONG_021 32700;
BA_ "GenSigStartValue" SG_ 724 OBJ_POS_LAT_021 32700;
BA_ "GenSigStartValue" SG_ 724 OBJ_VELOCITY_LONG_021 16300;
BA_ "GenSigStartValue" SG_ 724 OBJ_VELOCITY_LAT_021 16300;
BA_ "GenSigStartValue" SG_ 724 OBJ_ACCELERATION_LONG_021 400;
BA_ "GenSigStartValue" SG_ 724 OBJ_ACCELERATION_LAT_021 400;
BA_ "GenSigStartValue" SG_ 724 OBJ_TIMESTAMP_OFFSET_021 127;
BA_ "GenSigStartValue" SG_ 724 OBJ_RCS_021 64;
BA_ "GenSigStartValue" SG_ 724 OBJ_YAW_RATE_021 448;
BA_ "GenSigStartValue" SG_ 724 OBJ_POS_ERR_CRR_COEF_021 120;
BA_ "GenSigStartValue" SG_ 724 OBJ_VELOCITY_ERR_CRR_COEF_021 120;
BA_ "GenSigStartValue" SG_ 724 OBJ_ACCEL_ERR_CRR_COEF_021 120;
BA_ "GenSigStartValue" SG_ 725 OBJ_YAW_ANGLE_022 2000;
BA_ "GenSigStartValue" SG_ 725 OBJ_POS_LONG_022 32700;
BA_ "GenSigStartValue" SG_ 725 OBJ_POS_LAT_022 32700;
BA_ "GenSigStartValue" SG_ 725 OBJ_VELOCITY_LONG_022 16300;
BA_ "GenSigStartValue" SG_ 725 OBJ_VELOCITY_LAT_022 16300;
BA_ "GenSigStartValue" SG_ 725 OBJ_ACCELERATION_LONG_022 400;
BA_ "GenSigStartValue" SG_ 725 OBJ_ACCELERATION_LAT_022 400;
BA_ "GenSigStartValue" SG_ 725 OBJ_TIMESTAMP_OFFSET_022 127;
BA_ "GenSigStartValue" SG_ 725 OBJ_RCS_022 64;
BA_ "GenSigStartValue" SG_ 725 OBJ_YAW_RATE_022 448;
BA_ "GenSigStartValue" SG_ 725 OBJ_POS_ERR_CRR_COEF_022 120;
BA_ "GenSigStartValue" SG_ 725 OBJ_VELOCITY_ERR_CRR_COEF_022 120;
BA_ "GenSigStartValue" SG_ 725 OBJ_ACCEL_ERR_CRR_COEF_022 120;
BA_ "GenSigStartValue" SG_ 726 OBJ_YAW_ANGLE_023 2000;
BA_ "GenSigStartValue" SG_ 726 OBJ_POS_LONG_023 32700;
BA_ "GenSigStartValue" SG_ 726 OBJ_POS_LAT_023 32700;
BA_ "GenSigStartValue" SG_ 726 OBJ_VELOCITY_LONG_023 16300;
BA_ "GenSigStartValue" SG_ 726 OBJ_VELOCITY_LAT_023 16300;
BA_ "GenSigStartValue" SG_ 726 OBJ_ACCELERATION_LONG_023 400;
BA_ "GenSigStartValue" SG_ 726 OBJ_ACCELERATION_LAT_023 400;
BA_ "GenSigStartValue" SG_ 726 OBJ_TIMESTAMP_OFFSET_023 127;
BA_ "GenSigStartValue" SG_ 726 OBJ_RCS_023 64;
BA_ "GenSigStartValue" SG_ 726 OBJ_YAW_RATE_023 448;
BA_ "GenSigStartValue" SG_ 726 OBJ_POS_ERR_CRR_COEF_023 120;
BA_ "GenSigStartValue" SG_ 726 OBJ_VELOCITY_ERR_CRR_COEF_023 120;
BA_ "GenSigStartValue" SG_ 726 OBJ_ACCEL_ERR_CRR_COEF_023 120;
BA_ "GenSigStartValue" SG_ 727 OBJ_YAW_ANGLE_024 2000;
BA_ "GenSigStartValue" SG_ 727 OBJ_POS_LONG_024 32700;
BA_ "GenSigStartValue" SG_ 727 OBJ_POS_LAT_024 32700;
BA_ "GenSigStartValue" SG_ 727 OBJ_VELOCITY_LONG_024 16300;
BA_ "GenSigStartValue" SG_ 727 OBJ_VELOCITY_LAT_024 16300;
BA_ "GenSigStartValue" SG_ 727 OBJ_ACCELERATION_LONG_024 400;
BA_ "GenSigStartValue" SG_ 727 OBJ_ACCELERATION_LAT_024 400;
BA_ "GenSigStartValue" SG_ 727 OBJ_TIMESTAMP_OFFSET_024 127;
BA_ "GenSigStartValue" SG_ 727 OBJ_RCS_024 64;
BA_ "GenSigStartValue" SG_ 727 OBJ_YAW_RATE_024 448;
BA_ "GenSigStartValue" SG_ 727 OBJ_POS_ERR_CRR_COEF_024 120;
BA_ "GenSigStartValue" SG_ 727 OBJ_VELOCITY_ERR_CRR_COEF_024 120;
BA_ "GenSigStartValue" SG_ 727 OBJ_ACCEL_ERR_CRR_COEF_024 120;
BA_ "GenSigStartValue" SG_ 728 OBJ_YAW_ANGLE_025 2000;
BA_ "GenSigStartValue" SG_ 728 OBJ_POS_LONG_025 32700;
BA_ "GenSigStartValue" SG_ 728 OBJ_POS_LAT_025 32700;
BA_ "GenSigStartValue" SG_ 728 OBJ_VELOCITY_LONG_025 16300;
BA_ "GenSigStartValue" SG_ 728 OBJ_VELOCITY_LAT_025 16300;
BA_ "GenSigStartValue" SG_ 728 OBJ_ACCELERATION_LONG_025 400;
BA_ "GenSigStartValue" SG_ 728 OBJ_ACCELERATION_LAT_025 400;
BA_ "GenSigStartValue" SG_ 728 OBJ_TIMESTAMP_OFFSET_025 127;
BA_ "GenSigStartValue" SG_ 728 OBJ_RCS_025 64;
BA_ "GenSigStartValue" SG_ 728 OBJ_YAW_RATE_025 448;
BA_ "GenSigStartValue" SG_ 728 OBJ_POS_ERR_CRR_COEF_025 120;
BA_ "GenSigStartValue" SG_ 728 OBJ_VELOCITY_ERR_CRR_COEF_025 120;
BA_ "GenSigStartValue" SG_ 728 OBJ_ACCEL_ERR_CRR_COEF_025 120;
BA_ "GenSigStartValue" SG_ 729 OBJ_YAW_ANGLE_026 2000;
BA_ "GenSigStartValue" SG_ 729 OBJ_POS_LONG_026 32700;
BA_ "GenSigStartValue" SG_ 729 OBJ_POS_LAT_026 32700;
BA_ "GenSigStartValue" SG_ 729 OBJ_VELOCITY_LONG_026 16300;
BA_ "GenSigStartValue" SG_ 729 OBJ_VELOCITY_LAT_026 16300;
BA_ "GenSigStartValue" SG_ 729 OBJ_ACCELERATION_LONG_026 400;
BA_ "GenSigStartValue" SG_ 729 OBJ_ACCELERATION_LAT_026 400;
BA_ "GenSigStartValue" SG_ 729 OBJ_TIMESTAMP_OFFSET_026 127;
BA_ "GenSigStartValue" SG_ 729 OBJ_RCS_026 64;
BA_ "GenSigStartValue" SG_ 729 OBJ_YAW_RATE_026 448;
BA_ "GenSigStartValue" SG_ 729 OBJ_POS_ERR_CRR_COEF_026 120;
BA_ "GenSigStartValue" SG_ 729 OBJ_VELOCITY_ERR_CRR_COEF_026 120;
BA_ "GenSigStartValue" SG_ 729 OBJ_ACCEL_ERR_CRR_COEF_026 120;
BA_ "GenSigStartValue" SG_ 730 OBJ_YAW_ANGLE_027 2000;
BA_ "GenSigStartValue" SG_ 730 OBJ_POS_LONG_027 32700;
BA_ "GenSigStartValue" SG_ 730 OBJ_POS_LAT_027 32700;
BA_ "GenSigStartValue" SG_ 730 OBJ_VELOCITY_LONG_027 16300;
BA_ "GenSigStartValue" SG_ 730 OBJ_VELOCITY_LAT_027 16300;
BA_ "GenSigStartValue" SG_ 730 OBJ_ACCELERATION_LONG_027 400;
BA_ "GenSigStartValue" SG_ 730 OBJ_ACCELERATION_LAT_027 400;
BA_ "GenSigStartValue" SG_ 730 OBJ_TIMESTAMP_OFFSET_027 127;
BA_ "GenSigStartValue" SG_ 730 OBJ_RCS_027 64;
BA_ "GenSigStartValue" SG_ 730 OBJ_YAW_RATE_027 448;
BA_ "GenSigStartValue" SG_ 730 OBJ_POS_ERR_CRR_COEF_027 120;
BA_ "GenSigStartValue" SG_ 730 OBJ_VELOCITY_ERR_CRR_COEF_027 120;
BA_ "GenSigStartValue" SG_ 730 OBJ_ACCEL_ERR_CRR_COEF_027 120;
BA_ "GenSigStartValue" SG_ 731 OBJ_YAW_ANGLE_028 2000;
BA_ "GenSigStartValue" SG_ 731 OBJ_POS_LONG_028 32700;
BA_ "GenSigStartValue" SG_ 731 OBJ_POS_LAT_028 32700;
BA_ "GenSigStartValue" SG_ 731 OBJ_VELOCITY_LONG_028 16300;
BA_ "GenSigStartValue" SG_ 731 OBJ_VELOCITY_LAT_028 16300;
BA_ "GenSigStartValue" SG_ 731 OBJ_ACCELERATION_LONG_028 400;
BA_ "GenSigStartValue" SG_ 731 OBJ_ACCELERATION_LAT_028 400;
BA_ "GenSigStartValue" SG_ 731 OBJ_TIMESTAMP_OFFSET_028 127;
BA_ "GenSigStartValue" SG_ 731 OBJ_RCS_028 64;
BA_ "GenSigStartValue" SG_ 731 OBJ_YAW_RATE_028 448;
BA_ "GenSigStartValue" SG_ 731 OBJ_POS_ERR_CRR_COEF_028 120;
BA_ "GenSigStartValue" SG_ 731 OBJ_VELOCITY_ERR_CRR_COEF_028 120;
BA_ "GenSigStartValue" SG_ 731 OBJ_ACCEL_ERR_CRR_COEF_028 120;
BA_ "GenSigStartValue" SG_ 732 OBJ_YAW_ANGLE_029 2000;
BA_ "GenSigStartValue" SG_ 732 OBJ_POS_LONG_029 32700;
BA_ "GenSigStartValue" SG_ 732 OBJ_POS_LAT_029 32700;
BA_ "GenSigStartValue" SG_ 732 OBJ_VELOCITY_LONG_029 16300;
BA_ "GenSigStartValue" SG_ 732 OBJ_VELOCITY_LAT_029 16300;
BA_ "GenSigStartValue" SG_ 732 OBJ_ACCELERATION_LONG_029 400;
BA_ "GenSigStartValue" SG_ 732 OBJ_ACCELERATION_LAT_029 400;
BA_ "GenSigStartValue" SG_ 732 OBJ_TIMESTAMP_OFFSET_029 127;
BA_ "GenSigStartValue" SG_ 732 OBJ_RCS_029 64;
BA_ "GenSigStartValue" SG_ 732 OBJ_YAW_RATE_029 448;
BA_ "GenSigStartValue" SG_ 732 OBJ_POS_ERR_CRR_COEF_029 120;
BA_ "GenSigStartValue" SG_ 732 OBJ_VELOCITY_ERR_CRR_COEF_029 120;
BA_ "GenSigStartValue" SG_ 732 OBJ_ACCEL_ERR_CRR_COEF_029 120;
BA_ "GenSigStartValue" SG_ 733 OBJ_YAW_ANGLE_030 2000;
BA_ "GenSigStartValue" SG_ 733 OBJ_POS_LONG_030 32700;
BA_ "GenSigStartValue" SG_ 733 OBJ_POS_LAT_030 32700;
BA_ "GenSigStartValue" SG_ 733 OBJ_VELOCITY_LONG_030 16300;
BA_ "GenSigStartValue" SG_ 733 OBJ_VELOCITY_LAT_030 16300;
BA_ "GenSigStartValue" SG_ 733 OBJ_ACCELERATION_LONG_030 400;
BA_ "GenSigStartValue" SG_ 733 OBJ_ACCELERATION_LAT_030 400;
BA_ "GenSigStartValue" SG_ 733 OBJ_TIMESTAMP_OFFSET_030 127;
BA_ "GenSigStartValue" SG_ 733 OBJ_RCS_030 64;
BA_ "GenSigStartValue" SG_ 733 OBJ_YAW_RATE_030 448;
BA_ "GenSigStartValue" SG_ 733 OBJ_POS_ERR_CRR_COEF_030 120;
BA_ "GenSigStartValue" SG_ 733 OBJ_VELOCITY_ERR_CRR_COEF_030 120;
BA_ "GenSigStartValue" SG_ 733 OBJ_ACCEL_ERR_CRR_COEF_030 120;
BA_ "GenSigStartValue" SG_ 734 OBJ_YAW_ANGLE_031 2000;
BA_ "GenSigStartValue" SG_ 734 OBJ_POS_LONG_031 32700;
BA_ "GenSigStartValue" SG_ 734 OBJ_POS_LAT_031 32700;
BA_ "GenSigStartValue" SG_ 734 OBJ_VELOCITY_LONG_031 16300;
BA_ "GenSigStartValue" SG_ 734 OBJ_VELOCITY_LAT_031 16300;
BA_ "GenSigStartValue" SG_ 734 OBJ_ACCELERATION_LONG_031 400;
BA_ "GenSigStartValue" SG_ 734 OBJ_ACCELERATION_LAT_031 400;
BA_ "GenSigStartValue" SG_ 734 OBJ_TIMESTAMP_OFFSET_031 127;
BA_ "GenSigStartValue" SG_ 734 OBJ_RCS_031 64;
BA_ "GenSigStartValue" SG_ 734 OBJ_YAW_RATE_031 448;
BA_ "GenSigStartValue" SG_ 734 OBJ_POS_ERR_CRR_COEF_031 120;
BA_ "GenSigStartValue" SG_ 734 OBJ_VELOCITY_ERR_CRR_COEF_031 120;
BA_ "GenSigStartValue" SG_ 734 OBJ_ACCEL_ERR_CRR_COEF_031 120;
VAL_ 718 OBJ_TRACK_MOTION_MODEL_015 0 "INVALID" 1 "CCV" 2 "CTCA" 3 "CCA";
VAL_ 718 OBJ_MOVEMENT_STATUS_015 0 "UNKNOWN" 1 "MOVING" 2 "SLOW_MOVING" 3 "FAST_MOVING" 4 "STATIONARY" 5 "STOPPED" 6 "RESERVED1" 7 "RESERVED2";
VAL_ 718 OBJ_MEASUREMENT_STATUS_015 0 "Invalid" 1 "New" 2 "Predicted" 3 "PartlyMeasured" 4 "Measured" 5 "Occluded";
VAL_ 718 OBJ_CLS_TYPE1_015 0 "UNKNOWN_MOVING_OBJ" 1 "CAR" 2 "TRUCK" 3 "MOTOR_BIKE" 4 "BICYCLE" 5 "PEDESTRIAN" 6 "ROAD_BOUNDRY" 7 "STATIC_OBJECT" 8 "TRAFFIC_LIGHT" 9 "TRAFFIC_SIGN" 10 "TWO_WHEELERS" 11 "RESERVED" 12 "RESERVED" 14 "OBJECT_UNDETERMIND" 15 "VEHICLE_UNDETERMIND";
VAL_ 718 OBJ_CLS_TYPE2_015 0 "UNKNOWN_MOVING_OBJ" 1 "CAR" 2 "TRUCK" 3 "MOTOR_BIKE" 4 "BICYCLE" 5 "PEDESTRIAN" 6 "ROAD_BOUNDRY" 7 "STATIC_OBJECT" 8 "TRAFFIC_LIGHT" 9 "TRAFFIC_SIGN" 10 "TWO_WHEELERS" 11 "RESERVED" 12 "RESERVED" 14 "OBJECT_UNDETERMIND" 15 "VEHICLE_UNDETERMIND";
VAL_ 718 OBJ_CLS_TYPE3_015 0 "UNKNOWN_MOVING_OBJ" 1 "CAR" 2 "TRUCK" 3 "MOTOR_BIKE" 4 "BICYCLE" 5 "PEDESTRIAN" 6 "ROAD_BOUNDRY" 7 "STATIC_OBJECT" 8 "TRAFFIC_LIGHT" 9 "TRAFFIC_SIGN" 10 "TWO_WHEELERS" 11 "RESERVED" 12 "RESERVED" 14 "OBJECT_UNDETERMIND" 15 "VEHICLE_UNDETERMIND";
VAL_ 718 OBJ_CLS_TYPE4_015 0 "UNKNOWN_MOVING_OBJ" 1 "CAR" 2 "TRUCK" 3 "MOTOR_BIKE" 4 "BICYCLE" 5 "PEDESTRIAN" 6 "ROAD_BOUNDRY" 7 "STATIC_OBJECT" 8 "TRAFFIC_LIGHT" 9 "TRAFFIC_SIGN" 10 "TWO_WHEELERS" 11 "RESERVED" 12 "RESERVED" 14 "OBJECT_UNDETERMIND" 15 "VEHICLE_UNDETERMIND";
VAL_ 718 OBJ_CLS_TYPE5_015 0 "UNKNOWN_MOVING_OBJ" 1 "CAR" 2 "TRUCK" 3 "MOTOR_BIKE" 4 "BICYCLE" 5 "PEDESTRIAN" 6 "ROAD_BOUNDRY" 7 "STATIC_OBJECT" 8 "TRAFFIC_LIGHT" 9 "TRAFFIC_SIGN" 10 "TWO_WHEELERS" 11 "RESERVED" 12 "RESERVED" 14 "OBJECT_UNDETERMIND" 15 "VEHICLE_UNDETERMIND";
VAL_ 718 OBJ_CLS_TYPE6_015 0 "UNKNOWN_MOVING_OBJ" 1 "CAR" 2 "TRUCK" 3 "MOTOR_BIKE" 4 "BICYCLE" 5 "PEDESTRIAN" 6 "ROAD_BOUNDRY" 7 "STATIC_OBJECT" 8 "TRAFFIC_LIGHT" 9 "TRAFFIC_SIGN" 10 "TWO_WHEELERS" 11 "RESERVED" 12 "RESERVED" 14 "OBJECT_UNDETERMIND" 15 "VEHICLE_UNDETERMIND";
VAL_ 719 OBJ_TRACK_MOTION_MODEL_016 0 "INVALID" 1 "CCV" 2 "CTCA" 3 "CCA";
VAL_ 719 OBJ_MOVEMENT_STATUS_016 0 "UNKNOWN" 1 "MOVING" 2 "SLOW_MOVING" 3 "FAST_MOVING" 4 "STATIONARY" 5 "STOPPED" 6 "RESERVED1" 7 "RESERVED2";
VAL_ 719 OBJ_MEASUREMENT_STATUS_016 0 "Invalid" 1 "New" 2 "Predicted" 3 "PartlyMeasured" 4 "Measured" 5 "Occluded";
VAL_ 719 OBJ_CLS_TYPE1_016 0 "UNKNOWN_MOVING_OBJ" 1 "CAR" 2 "TRUCK" 3 "MOTOR_BIKE" 4 "BICYCLE" 5 "PEDESTRIAN" 6 "ROAD_BOUNDRY" 7 "STATIC_OBJECT" 8 "TRAFFIC_LIGHT" 9 "TRAFFIC_SIGN" 10 "TWO_WHEELERS" 11 "RESERVED" 12 "RESERVED" 14 "OBJECT_UNDETERMIND" 15 "VEHICLE_UNDETERMIND";
VAL_ 719 OBJ_CLS_TYPE2_016 0 "UNKNOWN_MOVING_OBJ" 1 "CAR" 2 "TRUCK" 3 "MOTOR_BIKE" 4 "BICYCLE" 5 "PEDESTRIAN" 6 "ROAD_BOUNDRY" 7 "STATIC_OBJECT" 8 "TRAFFIC_LIGHT" 9 "TRAFFIC_SIGN" 10 "TWO_WHEELERS" 11 "RESERVED" 12 "RESERVED" 14 "OBJECT_UNDETERMIND" 15 "VEHICLE_UNDETERMIND";
VAL_ 719 OBJ_CLS_TYPE3_016 0 "UNKNOWN_MOVING_OBJ" 1 "CAR" 2 "TRUCK" 3 "MOTOR_BIKE" 4 "BICYCLE" 5 "PEDESTRIAN" 6 "ROAD_BOUNDRY" 7 "STATIC_OBJECT" 8 "TRAFFIC_LIGHT" 9 "TRAFFIC_SIGN" 10 "TWO_WHEELERS" 11 "RESERVED" 12 "RESERVED" 14 "OBJECT_UNDETERMIND" 15 "VEHICLE_UNDETERMIND";
VAL_ 719 OBJ_CLS_TYPE4_016 0 "UNKNOWN_MOVING_OBJ" 1 "CAR" 2 "TRUCK" 3 "MOTOR_BIKE" 4 "BICYCLE" 5 "PEDESTRIAN" 6 "ROAD_BOUNDRY" 7 "STATIC_OBJECT" 8 "TRAFFIC_LIGHT" 9 "TRAFFIC_SIGN" 10 "TWO_WHEELERS" 11 "RESERVED" 12 "RESERVED" 14 "OBJECT_UNDETERMIND" 15 "VEHICLE_UNDETERMIND";
VAL_ 719 OBJ_CLS_TYPE5_016 0 "UNKNOWN_MOVING_OBJ" 1 "CAR" 2 "TRUCK" 3 "MOTOR_BIKE" 4 "BICYCLE" 5 "PEDESTRIAN" 6 "ROAD_BOUNDRY" 7 "STATIC_OBJECT" 8 "TRAFFIC_LIGHT" 9 "TRAFFIC_SIGN" 10 "TWO_WHEELERS" 11 "RESERVED" 12 "RESERVED" 14 "OBJECT_UNDETERMIND" 15 "VEHICLE_UNDETERMIND";
VAL_ 719 OBJ_CLS_TYPE6_016 0 "UNKNOWN_MOVING_OBJ" 1 "CAR" 2 "TRUCK" 3 "MOTOR_BIKE" 4 "BICYCLE" 5 "PEDESTRIAN" 6 "ROAD_BOUNDRY" 7 "STATIC_OBJECT" 8 "TRAFFIC_LIGHT" 9 "TRAFFIC_SIGN" 10 "TWO_WHEELERS" 11 "RESERVED" 12 "RESERVED" 14 "OBJECT_UNDETERMIND" 15 "VEHICLE_UNDETERMIND";
VAL_ 720 OBJ_TRACK_MOTION_MODEL_017 0 "INVALID" 1 "CCV" 2 "CTCA" 3 "CCA";
VAL_ 720 OBJ_MOVEMENT_STATUS_017 0 "UNKNOWN" 1 "MOVING" 2 "SLOW_MOVING" 3 "FAST_MOVING" 4 "STATIONARY" 5 "STOPPED" 6 "RESERVED1" 7 "RESERVED2";
VAL_ 720 OBJ_MEASUREMENT_STATUS_017 0 "Invalid" 1 "New" 2 "Predicted" 3 "PartlyMeasured" 4 "Measured" 5 "Occluded";
VAL_ 720 OBJ_CLS_TYPE1_017 0 "UNKNOWN_MOVING_OBJ" 1 "CAR" 2 "TRUCK" 3 "MOTOR_BIKE" 4 "BICYCLE" 5 "PEDESTRIAN" 6 "ROAD_BOUNDRY" 7 "STATIC_OBJECT" 8 "TRAFFIC_LIGHT" 9 "TRAFFIC_SIGN" 10 "TWO_WHEELERS" 11 "RESERVED" 12 "RESERVED" 14 "OBJECT_UNDETERMIND" 15 "VEHICLE_UNDETERMIND";
VAL_ 720 OBJ_CLS_TYPE2_017 0 "UNKNOWN_MOVING_OBJ" 1 "CAR" 2 "TRUCK" 3 "MOTOR_BIKE" 4 "BICYCLE" 5 "PEDESTRIAN" 6 "ROAD_BOUNDRY" 7 "STATIC_OBJECT" 8 "TRAFFIC_LIGHT" 9 "TRAFFIC_SIGN" 10 "TWO_WHEELERS" 11 "RESERVED" 12 "RESERVED" 14 "OBJECT_UNDETERMIND" 15 "VEHICLE_UNDETERMIND";
VAL_ 720 OBJ_CLS_TYPE3_017 0 "UNKNOWN_MOVING_OBJ" 1 "CAR" 2 "TRUCK" 3 "MOTOR_BIKE" 4 "BICYCLE" 5 "PEDESTRIAN" 6 "ROAD_BOUNDRY" 7 "STATIC_OBJECT" 8 "TRAFFIC_LIGHT" 9 "TRAFFIC_SIGN" 10 "TWO_WHEELERS" 11 "RESERVED" 12 "RESERVED" 14 "OBJECT_UNDETERMIND" 15 "VEHICLE_UNDETERMIND";
VAL_ 720 OBJ_CLS_TYPE4_017 0 "UNKNOWN_MOVING_OBJ" 1 "CAR" 2 "TRUCK" 3 "MOTOR_BIKE" 4 "BICYCLE" 5 "PEDESTRIAN" 6 "ROAD_BOUNDRY" 7 "STATIC_OBJECT" 8 "TRAFFIC_LIGHT" 9 "TRAFFIC_SIGN" 10 "TWO_WHEELERS" 11 "RESERVED" 12 "RESERVED" 14 "OBJECT_UNDETERMIND" 15 "VEHICLE_UNDETERMIND";
VAL_ 720 OBJ_CLS_TYPE5_017 0 "UNKNOWN_MOVING_OBJ" 1 "CAR" 2 "TRUCK" 3 "MOTOR_BIKE" 4 "BICYCLE" 5 "PEDESTRIAN" 6 "ROAD_BOUNDRY" 7 "STATIC_OBJECT" 8 "TRAFFIC_LIGHT" 9 "TRAFFIC_SIGN" 10 "TWO_WHEELERS" 11 "RESERVED" 12 "RESERVED" 14 "OBJECT_UNDETERMIND" 15 "VEHICLE_UNDETERMIND";
VAL_ 720 OBJ_CLS_TYPE6_017 0 "UNKNOWN_MOVING_OBJ" 1 "CAR" 2 "TRUCK" 3 "MOTOR_BIKE" 4 "BICYCLE" 5 "PEDESTRIAN" 6 "ROAD_BOUNDRY" 7 "STATIC_OBJECT" 8 "TRAFFIC_LIGHT" 9 "TRAFFIC_SIGN" 10 "TWO_WHEELERS" 11 "RESERVED" 12 "RESERVED" 14 "OBJECT_UNDETERMIND" 15 "VEHICLE_UNDETERMIND";
VAL_ 721 OBJ_TRACK_MOTION_MODEL_018 0 "INVALID" 1 "CCV" 2 "CTCA" 3 "CCA";
VAL_ 721 OBJ_MOVEMENT_STATUS_018 0 "UNKNOWN" 1 "MOVING" 2 "SLOW_MOVING" 3 "FAST_MOVING" 4 "STATIONARY" 5 "STOPPED" 6 "RESERVED1" 7 "RESERVED2";
VAL_ 721 OBJ_MEASUREMENT_STATUS_018 0 "Invalid" 1 "New" 2 "Predicted" 3 "PartlyMeasured" 4 "Measured" 5 "Occluded";
VAL_ 721 OBJ_CLS_TYPE1_018 0 "UNKNOWN_MOVING_OBJ" 1 "CAR" 2 "TRUCK" 3 "MOTOR_BIKE" 4 "BICYCLE" 5 "PEDESTRIAN" 6 "ROAD_BOUNDRY" 7 "STATIC_OBJECT" 8 "TRAFFIC_LIGHT" 9 "TRAFFIC_SIGN" 10 "TWO_WHEELERS" 11 "RESERVED" 12 "RESERVED" 14 "OBJECT_UNDETERMIND" 15 "VEHICLE_UNDETERMIND";
VAL_ 721 OBJ_CLS_TYPE2_018 0 "UNKNOWN_MOVING_OBJ" 1 "CAR" 2 "TRUCK" 3 "MOTOR_BIKE" 4 "BICYCLE" 5 "PEDESTRIAN" 6 "ROAD_BOUNDRY" 7 "STATIC_OBJECT" 8 "TRAFFIC_LIGHT" 9 "TRAFFIC_SIGN" 10 "TWO_WHEELERS" 11 "RESERVED" 12 "RESERVED" 14 "OBJECT_UNDETERMIND" 15 "VEHICLE_UNDETERMIND";
VAL_ 721 OBJ_CLS_TYPE3_018 0 "UNKNOWN_MOVING_OBJ" 1 "CAR" 2 "TRUCK" 3 "MOTOR_BIKE" 4 "BICYCLE" 5 "PEDESTRIAN" 6 "ROAD_BOUNDRY" 7 "STATIC_OBJECT" 8 "TRAFFIC_LIGHT" 9 "TRAFFIC_SIGN" 10 "TWO_WHEELERS" 11 "RESERVED" 12 "RESERVED" 14 "OBJECT_UNDETERMIND" 15 "VEHICLE_UNDETERMIND";
VAL_ 721 OBJ_CLS_TYPE4_018 0 "UNKNOWN_MOVING_OBJ" 1 "CAR" 2 "TRUCK" 3 "MOTOR_BIKE" 4 "BICYCLE" 5 "PEDESTRIAN" 6 "ROAD_BOUNDRY" 7 "STATIC_OBJECT" 8 "TRAFFIC_LIGHT" 9 "TRAFFIC_SIGN" 10 "TWO_WHEELERS" 11 "RESERVED" 12 "RESERVED" 14 "OBJECT_UNDETERMIND" 15 "VEHICLE_UNDETERMIND";
VAL_ 721 OBJ_CLS_TYPE5_018 0 "UNKNOWN_MOVING_OBJ" 1 "CAR" 2 "TRUCK" 3 "MOTOR_BIKE" 4 "BICYCLE" 5 "PEDESTRIAN" 6 "ROAD_BOUNDRY" 7 "STATIC_OBJECT" 8 "TRAFFIC_LIGHT" 9 "TRAFFIC_SIGN" 10 "TWO_WHEELERS" 11 "RESERVED" 12 "RESERVED" 14 "OBJECT_UNDETERMIND" 15 "VEHICLE_UNDETERMIND";
VAL_ 721 OBJ_CLS_TYPE6_018 0 "UNKNOWN_MOVING_OBJ" 1 "CAR" 2 "TRUCK" 3 "MOTOR_BIKE" 4 "BICYCLE" 5 "PEDESTRIAN" 6 "ROAD_BOUNDRY" 7 "STATIC_OBJECT" 8 "TRAFFIC_LIGHT" 9 "TRAFFIC_SIGN" 10 "TWO_WHEELERS" 11 "RESERVED" 12 "RESERVED" 14 "OBJECT_UNDETERMIND" 15 "VEHICLE_UNDETERMIND";
VAL_ 722 OBJ_TRACK_MOTION_MODEL_019 0 "INVALID" 1 "CCV" 2 "CTCA" 3 "CCA";
VAL_ 722 OBJ_MOVEMENT_STATUS_019 0 "UNKNOWN" 1 "MOVING" 2 "SLOW_MOVING" 3 "FAST_MOVING" 4 "STATIONARY" 5 "STOPPED" 6 "RESERVED1" 7 "RESERVED2";
VAL_ 722 OBJ_MEASUREMENT_STATUS_019 0 "Invalid" 1 "New" 2 "Predicted" 3 "PartlyMeasured" 4 "Measured" 5 "Occluded";
VAL_ 722 OBJ_CLS_TYPE1_019 0 "UNKNOWN_MOVING_OBJ" 1 "CAR" 2 "TRUCK" 3 "MOTOR_BIKE" 4 "BICYCLE" 5 "PEDESTRIAN" 6 "ROAD_BOUNDRY" 7 "STATIC_OBJECT" 8 "TRAFFIC_LIGHT" 9 "TRAFFIC_SIGN" 10 "TWO_WHEELERS" 11 "RESERVED" 12 "RESERVED" 14 "OBJECT_UNDETERMIND" 15 "VEHICLE_UNDETERMIND";
VAL_ 722 OBJ_CLS_TYPE2_019 0 "UNKNOWN_MOVING_OBJ" 1 "CAR" 2 "TRUCK" 3 "MOTOR_BIKE" 4 "BICYCLE" 5 "PEDESTRIAN" 6 "ROAD_BOUNDRY" 7 "STATIC_OBJECT" 8 "TRAFFIC_LIGHT" 9 "TRAFFIC_SIGN" 10 "TWO_WHEELERS" 11 "RESERVED" 12 "RESERVED" 14 "OBJECT_UNDETERMIND" 15 "VEHICLE_UNDETERMIND";
VAL_ 722 OBJ_CLS_TYPE3_019 0 "UNKNOWN_MOVING_OBJ" 1 "CAR" 2 "TRUCK" 3 "MOTOR_BIKE" 4 "BICYCLE" 5 "PEDESTRIAN" 6 "ROAD_BOUNDRY" 7 "STATIC_OBJECT" 8 "TRAFFIC_LIGHT" 9 "TRAFFIC_SIGN" 10 "TWO_WHEELERS" 11 "RESERVED" 12 "RESERVED" 14 "OBJECT_UNDETERMIND" 15 "VEHICLE_UNDETERMIND";
VAL_ 722 OBJ_CLS_TYPE4_019 0 "UNKNOWN_MOVING_OBJ" 1 "CAR" 2 "TRUCK" 3 "MOTOR_BIKE" 4 "BICYCLE" 5 "PEDESTRIAN" 6 "ROAD_BOUNDRY" 7 "STATIC_OBJECT" 8 "TRAFFIC_LIGHT" 9 "TRAFFIC_SIGN" 10 "TWO_WHEELERS" 11 "RESERVED" 12 "RESERVED" 14 "OBJECT_UNDETERMIND" 15 "VEHICLE_UNDETERMIND";
VAL_ 722 OBJ_CLS_TYPE5_019 0 "UNKNOWN_MOVING_OBJ" 1 "CAR" 2 "TRUCK" 3 "MOTOR_BIKE" 4 "BICYCLE" 5 "PEDESTRIAN" 6 "ROAD_BOUNDRY" 7 "STATIC_OBJECT" 8 "TRAFFIC_LIGHT" 9 "TRAFFIC_SIGN" 10 "TWO_WHEELERS" 11 "RESERVED" 12 "RESERVED" 14 "OBJECT_UNDETERMIND" 15 "VEHICLE_UNDETERMIND";
VAL_ 722 OBJ_CLS_TYPE6_019 0 "UNKNOWN_MOVING_OBJ" 1 "CAR" 2 "TRUCK" 3 "MOTOR_BIKE" 4 "BICYCLE" 5 "PEDESTRIAN" 6 "ROAD_BOUNDRY" 7 "STATIC_OBJECT" 8 "TRAFFIC_LIGHT" 9 "TRAFFIC_SIGN" 10 "TWO_WHEELERS" 11 "RESERVED" 12 "RESERVED" 14 "OBJECT_UNDETERMIND" 15 "VEHICLE_UNDETERMIND";
VAL_ 723 OBJ_TRACK_MOTION_MODEL_020 0 "INVALID" 1 "CCV" 2 "CTCA" 3 "CCA";
VAL_ 723 OBJ_MOVEMENT_STATUS_020 0 "UNKNOWN" 1 "MOVING" 2 "SLOW_MOVING" 3 "FAST_MOVING" 4 "STATIONARY" 5 "STOPPED" 6 "RESERVED1" 7 "RESERVED2";
VAL_ 723 OBJ_MEASUREMENT_STATUS_020 0 "Invalid" 1 "New" 2 "Predicted" 3 "PartlyMeasured" 4 "Measured" 5 "Occluded";
VAL_ 723 OBJ_CLS_TYPE1_020 0 "UNKNOWN_MOVING_OBJ" 1 "CAR" 2 "TRUCK" 3 "MOTOR_BIKE" 4 "BICYCLE" 5 "PEDESTRIAN" 6 "ROAD_BOUNDRY" 7 "STATIC_OBJECT" 8 "TRAFFIC_LIGHT" 9 "TRAFFIC_SIGN" 10 "TWO_WHEELERS" 11 "RESERVED" 12 "RESERVED" 14 "OBJECT_UNDETERMIND" 15 "VEHICLE_UNDETERMIND";
VAL_ 723 OBJ_CLS_TYPE2_020 0 "UNKNOWN_MOVING_OBJ" 1 "CAR" 2 "TRUCK" 3 "MOTOR_BIKE" 4 "BICYCLE" 5 "PEDESTRIAN" 6 "ROAD_BOUNDRY" 7 "STATIC_OBJECT" 8 "TRAFFIC_LIGHT" 9 "TRAFFIC_SIGN" 10 "TWO_WHEELERS" 11 "RESERVED" 12 "RESERVED" 14 "OBJECT_UNDETERMIND" 15 "VEHICLE_UNDETERMIND";
VAL_ 723 OBJ_CLS_TYPE3_020 0 "UNKNOWN_MOVING_OBJ" 1 "CAR" 2 "TRUCK" 3 "MOTOR_BIKE" 4 "BICYCLE" 5 "PEDESTRIAN" 6 "ROAD_BOUNDRY" 7 "STATIC_OBJECT" 8 "TRAFFIC_LIGHT" 9 "TRAFFIC_SIGN" 10 "TWO_WHEELERS" 11 "RESERVED" 12 "RESERVED" 14 "OBJECT_UNDETERMIND" 15 "VEHICLE_UNDETERMIND";
VAL_ 723 OBJ_CLS_TYPE4_020 0 "UNKNOWN_MOVING_OBJ" 1 "CAR" 2 "TRUCK" 3 "MOTOR_BIKE" 4 "BICYCLE" 5 "PEDESTRIAN" 6 "ROAD_BOUNDRY" 7 "STATIC_OBJECT" 8 "TRAFFIC_LIGHT" 9 "TRAFFIC_SIGN" 10 "TWO_WHEELERS" 11 "RESERVED" 12 "RESERVED" 14 "OBJECT_UNDETERMIND" 15 "VEHICLE_UNDETERMIND";
VAL_ 723 OBJ_CLS_TYPE5_020 0 "UNKNOWN_MOVING_OBJ" 1 "CAR" 2 "TRUCK" 3 "MOTOR_BIKE" 4 "BICYCLE" 5 "PEDESTRIAN" 6 "ROAD_BOUNDRY" 7 "STATIC_OBJECT" 8 "TRAFFIC_LIGHT" 9 "TRAFFIC_SIGN" 10 "TWO_WHEELERS" 11 "RESERVED" 12 "RESERVED" 14 "OBJECT_UNDETERMIND" 15 "VEHICLE_UNDETERMIND";
VAL_ 723 OBJ_CLS_TYPE6_020 0 "UNKNOWN_MOVING_OBJ" 1 "CAR" 2 "TRUCK" 3 "MOTOR_BIKE" 4 "BICYCLE" 5 "PEDESTRIAN" 6 "ROAD_BOUNDRY" 7 "STATIC_OBJECT" 8 "TRAFFIC_LIGHT" 9 "TRAFFIC_SIGN" 10 "TWO_WHEELERS" 11 "RESERVED" 12 "RESERVED" 14 "OBJECT_UNDETERMIND" 15 "VEHICLE_UNDETERMIND";
VAL_ 724 OBJ_TRACK_MOTION_MODEL_021 0 "INVALID" 1 "CCV" 2 "CTCA" 3 "CCA";
VAL_ 724 OBJ_MOVEMENT_STATUS_021 0 "UNKNOWN" 1 "MOVING" 2 "SLOW_MOVING" 3 "FAST_MOVING" 4 "STATIONARY" 5 "STOPPED" 6 "RESERVED1" 7 "RESERVED2";
VAL_ 724 OBJ_MEASUREMENT_STATUS_021 0 "Invalid" 1 "New" 2 "Predicted" 3 "PartlyMeasured" 4 "Measured" 5 "Occluded";
VAL_ 724 OBJ_CLS_TYPE1_021 0 "UNKNOWN_MOVING_OBJ" 1 "CAR" 2 "TRUCK" 3 "MOTOR_BIKE" 4 "BICYCLE" 5 "PEDESTRIAN" 6 "ROAD_BOUNDRY" 7 "STATIC_OBJECT" 8 "TRAFFIC_LIGHT" 9 "TRAFFIC_SIGN" 10 "TWO_WHEELERS" 11 "RESERVED" 12 "RESERVED" 14 "OBJECT_UNDETERMIND" 15 "VEHICLE_UNDETERMIND";
VAL_ 724 OBJ_CLS_TYPE2_021 0 "UNKNOWN_MOVING_OBJ" 1 "CAR" 2 "TRUCK" 3 "MOTOR_BIKE" 4 "BICYCLE" 5 "PEDESTRIAN" 6 "ROAD_BOUNDRY" 7 "STATIC_OBJECT" 8 "TRAFFIC_LIGHT" 9 "TRAFFIC_SIGN" 10 "TWO_WHEELERS" 11 "RESERVED" 12 "RESERVED" 14 "OBJECT_UNDETERMIND" 15 "VEHICLE_UNDETERMIND";
VAL_ 724 OBJ_CLS_TYPE3_021 0 "UNKNOWN_MOVING_OBJ" 1 "CAR" 2 "TRUCK" 3 "MOTOR_BIKE" 4 "BICYCLE" 5 "PEDESTRIAN" 6 "ROAD_BOUNDRY" 7 "STATIC_OBJECT" 8 "TRAFFIC_LIGHT" 9 "TRAFFIC_SIGN" 10 "TWO_WHEELERS" 11 "RESERVED" 12 "RESERVED" 14 "OBJECT_UNDETERMIND" 15 "VEHICLE_UNDETERMIND";
VAL_ 724 OBJ_CLS_TYPE4_021 0 "UNKNOWN_MOVING_OBJ" 1 "CAR" 2 "TRUCK" 3 "MOTOR_BIKE" 4 "BICYCLE" 5 "PEDESTRIAN" 6 "ROAD_BOUNDRY" 7 "STATIC_OBJECT" 8 "TRAFFIC_LIGHT" 9 "TRAFFIC_SIGN" 10 "TWO_WHEELERS" 11 "RESERVED" 12 "RESERVED" 14 "OBJECT_UNDETERMIND" 15 "VEHICLE_UNDETERMIND";
VAL_ 724 OBJ_CLS_TYPE5_021 0 "UNKNOWN_MOVING_OBJ" 1 "CAR" 2 "TRUCK" 3 "MOTOR_BIKE" 4 "BICYCLE" 5 "PEDESTRIAN" 6 "ROAD_BOUNDRY" 7 "STATIC_OBJECT" 8 "TRAFFIC_LIGHT" 9 "TRAFFIC_SIGN" 10 "TWO_WHEELERS" 11 "RESERVED" 12 "RESERVED" 14 "OBJECT_UNDETERMIND" 15 "VEHICLE_UNDETERMIND";
VAL_ 724 OBJ_CLS_TYPE6_021 0 "UNKNOWN_MOVING_OBJ" 1 "CAR" 2 "TRUCK" 3 "MOTOR_BIKE" 4 "BICYCLE" 5 "PEDESTRIAN" 6 "ROAD_BOUNDRY" 7 "STATIC_OBJECT" 8 "TRAFFIC_LIGHT" 9 "TRAFFIC_SIGN" 10 "TWO_WHEELERS" 11 "RESERVED" 12 "RESERVED" 14 "OBJECT_UNDETERMIND" 15 "VEHICLE_UNDETERMIND";
VAL_ 725 OBJ_TRACK_MOTION_MODEL_022 0 "INVALID" 1 "CCV" 2 "CTCA" 3 "CCA";
VAL_ 725 OBJ_MOVEMENT_STATUS_022 0 "UNKNOWN" 1 "MOVING" 2 "SLOW_MOVING" 3 "FAST_MOVING" 4 "STATIONARY" 5 "STOPPED" 6 "RESERVED1" 7 "RESERVED2";
VAL_ 725 OBJ_MEASUREMENT_STATUS_022 0 "Invalid" 1 "New" 2 "Predicted" 3 "PartlyMeasured" 4 "Measured" 5 "Occluded";
VAL_ 725 OBJ_CLS_TYPE1_022 0 "UNKNOWN_MOVING_OBJ" 1 "CAR" 2 "TRUCK" 3 "MOTOR_BIKE" 4 "BICYCLE" 5 "PEDESTRIAN" 6 "ROAD_BOUNDRY" 7 "STATIC_OBJECT" 8 "TRAFFIC_LIGHT" 9 "TRAFFIC_SIGN" 10 "TWO_WHEELERS" 11 "RESERVED" 12 "RESERVED" 14 "OBJECT_UNDETERMIND" 15 "VEHICLE_UNDETERMIND";
VAL_ 725 OBJ_CLS_TYPE2_022 0 "UNKNOWN_MOVING_OBJ" 1 "CAR" 2 "TRUCK" 3 "MOTOR_BIKE" 4 "BICYCLE" 5 "PEDESTRIAN" 6 "ROAD_BOUNDRY" 7 "STATIC_OBJECT" 8 "TRAFFIC_LIGHT" 9 "TRAFFIC_SIGN" 10 "TWO_WHEELERS" 11 "RESERVED" 12 "RESERVED" 14 "OBJECT_UNDETERMIND" 15 "VEHICLE_UNDETERMIND";
VAL_ 725 OBJ_CLS_TYPE3_022 0 "UNKNOWN_MOVING_OBJ" 1 "CAR" 2 "TRUCK" 3 "MOTOR_BIKE" 4 "BICYCLE" 5 "PEDESTRIAN" 6 "ROAD_BOUNDRY" 7 "STATIC_OBJECT" 8 "TRAFFIC_LIGHT" 9 "TRAFFIC_SIGN" 10 "TWO_WHEELERS" 11 "RESERVED" 12 "RESERVED" 14 "OBJECT_UNDETERMIND" 15 "VEHICLE_UNDETERMIND";
VAL_ 725 OBJ_CLS_TYPE4_022 0 "UNKNOWN_MOVING_OBJ" 1 "CAR" 2 "TRUCK" 3 "MOTOR_BIKE" 4 "BICYCLE" 5 "PEDESTRIAN" 6 "ROAD_BOUNDRY" 7 "STATIC_OBJECT" 8 "TRAFFIC_LIGHT" 9 "TRAFFIC_SIGN" 10 "TWO_WHEELERS" 11 "RESERVED" 12 "RESERVED" 14 "OBJECT_UNDETERMIND" 15 "VEHICLE_UNDETERMIND";
VAL_ 725 OBJ_CLS_TYPE5_022 0 "UNKNOWN_MOVING_OBJ" 1 "CAR" 2 "TRUCK" 3 "MOTOR_BIKE" 4 "BICYCLE" 5 "PEDESTRIAN" 6 "ROAD_BOUNDRY" 7 "STATIC_OBJECT" 8 "TRAFFIC_LIGHT" 9 "TRAFFIC_SIGN" 10 "TWO_WHEELERS" 11 "RESERVED" 12 "RESERVED" 14 "OBJECT_UNDETERMIND" 15 "VEHICLE_UNDETERMIND";
VAL_ 725 OBJ_CLS_TYPE6_022 0 "UNKNOWN_MOVING_OBJ" 1 "CAR" 2 "TRUCK" 3 "MOTOR_BIKE" 4 "BICYCLE" 5 "PEDESTRIAN" 6 "ROAD_BOUNDRY" 7 "STATIC_OBJECT" 8 "TRAFFIC_LIGHT" 9 "TRAFFIC_SIGN" 10 "TWO_WHEELERS" 11 "RESERVED" 12 "RESERVED" 14 "OBJECT_UNDETERMIND" 15 "VEHICLE_UNDETERMIND";
VAL_ 726 OBJ_TRACK_MOTION_MODEL_023 0 "INVALID" 1 "CCV" 2 "CTCA" 3 "CCA";
VAL_ 726 OBJ_MOVEMENT_STATUS_023 0 "UNKNOWN" 1 "MOVING" 2 "SLOW_MOVING" 3 "FAST_MOVING" 4 "STATIONARY" 5 "STOPPED" 6 "RESERVED1" 7 "RESERVED2";
VAL_ 726 OBJ_MEASUREMENT_STATUS_023 0 "Invalid" 1 "New" 2 "Predicted" 3 "PartlyMeasured" 4 "Measured" 5 "Occluded";
VAL_ 726 OBJ_CLS_TYPE1_023 0 "UNKNOWN_MOVING_OBJ" 1 "CAR" 2 "TRUCK" 3 "MOTOR_BIKE" 4 "BICYCLE" 5 "PEDESTRIAN" 6 "ROAD_BOUNDRY" 7 "STATIC_OBJECT" 8 "TRAFFIC_LIGHT" 9 "TRAFFIC_SIGN" 10 "TWO_WHEELERS" 11 "RESERVED" 12 "RESERVED" 14 "OBJECT_UNDETERMIND" 15 "VEHICLE_UNDETERMIND";
VAL_ 726 OBJ_CLS_TYPE2_023 0 "UNKNOWN_MOVING_OBJ" 1 "CAR" 2 "TRUCK" 3 "MOTOR_BIKE" 4 "BICYCLE" 5 "PEDESTRIAN" 6 "ROAD_BOUNDRY" 7 "STATIC_OBJECT" 8 "TRAFFIC_LIGHT" 9 "TRAFFIC_SIGN" 10 "TWO_WHEELERS" 11 "RESERVED" 12 "RESERVED" 14 "OBJECT_UNDETERMIND" 15 "VEHICLE_UNDETERMIND";
VAL_ 726 OBJ_CLS_TYPE3_023 0 "UNKNOWN_MOVING_OBJ" 1 "CAR" 2 "TRUCK" 3 "MOTOR_BIKE" 4 "BICYCLE" 5 "PEDESTRIAN" 6 "ROAD_BOUNDRY" 7 "STATIC_OBJECT" 8 "TRAFFIC_LIGHT" 9 "TRAFFIC_SIGN" 10 "TWO_WHEELERS" 11 "RESERVED" 12 "RESERVED" 14 "OBJECT_UNDETERMIND" 15 "VEHICLE_UNDETERMIND";
VAL_ 726 OBJ_CLS_TYPE4_023 0 "UNKNOWN_MOVING_OBJ" 1 "CAR" 2 "TRUCK" 3 "MOTOR_BIKE" 4 "BICYCLE" 5 "PEDESTRIAN" 6 "ROAD_BOUNDRY" 7 "STATIC_OBJECT" 8 "TRAFFIC_LIGHT" 9 "TRAFFIC_SIGN" 10 "TWO_WHEELERS" 11 "RESERVED" 12 "RESERVED" 14 "OBJECT_UNDETERMIND" 15 "VEHICLE_UNDETERMIND";
VAL_ 726 OBJ_CLS_TYPE5_023 0 "UNKNOWN_MOVING_OBJ" 1 "CAR" 2 "TRUCK" 3 "MOTOR_BIKE" 4 "BICYCLE" 5 "PEDESTRIAN" 6 "ROAD_BOUNDRY" 7 "STATIC_OBJECT" 8 "TRAFFIC_LIGHT" 9 "TRAFFIC_SIGN" 10 "TWO_WHEELERS" 11 "RESERVED" 12 "RESERVED" 14 "OBJECT_UNDETERMIND" 15 "VEHICLE_UNDETERMIND";
VAL_ 726 OBJ_CLS_TYPE6_023 0 "UNKNOWN_MOVING_OBJ" 1 "CAR" 2 "TRUCK" 3 "MOTOR_BIKE" 4 "BICYCLE" 5 "PEDESTRIAN" 6 "ROAD_BOUNDRY" 7 "STATIC_OBJECT" 8 "TRAFFIC_LIGHT" 9 "TRAFFIC_SIGN" 10 "TWO_WHEELERS" 11 "RESERVED" 12 "RESERVED" 14 "OBJECT_UNDETERMIND" 15 "VEHICLE_UNDETERMIND";
VAL_ 727 OBJ_TRACK_MOTION_MODEL_024 0 "INVALID" 1 "CCV" 2 "CTCA" 3 "CCA";
VAL_ 727 OBJ_MOVEMENT_STATUS_024 0 "UNKNOWN" 1 "MOVING" 2 "SLOW_MOVING" 3 "FAST_MOVING" 4 "STATIONARY" 5 "STOPPED" 6 "RESERVED1" 7 "RESERVED2";
VAL_ 727 OBJ_MEASUREMENT_STATUS_024 0 "Invalid" 1 "New" 2 "Predicted" 3 "PartlyMeasured" 4 "Measured" 5 "Occluded";
VAL_ 727 OBJ_CLS_TYPE1_024 0 "UNKNOWN_MOVING_OBJ" 1 "CAR" 2 "TRUCK" 3 "MOTOR_BIKE" 4 "BICYCLE" 5 "PEDESTRIAN" 6 "ROAD_BOUNDRY" 7 "STATIC_OBJECT" 8 "TRAFFIC_LIGHT" 9 "TRAFFIC_SIGN" 10 "TWO_WHEELERS" 11 "RESERVED" 12 "RESERVED" 14 "OBJECT_UNDETERMIND" 15 "VEHICLE_UNDETERMIND";
VAL_ 727 OBJ_CLS_TYPE2_024 0 "UNKNOWN_MOVING_OBJ" 1 "CAR" 2 "TRUCK" 3 "MOTOR_BIKE" 4 "BICYCLE" 5 "PEDESTRIAN" 6 "ROAD_BOUNDRY" 7 "STATIC_OBJECT" 8 "TRAFFIC_LIGHT" 9 "TRAFFIC_SIGN" 10 "TWO_WHEELERS" 11 "RESERVED" 12 "RESERVED" 14 "OBJECT_UNDETERMIND" 15 "VEHICLE_UNDETERMIND";
VAL_ 727 OBJ_CLS_TYPE3_024 0 "UNKNOWN_MOVING_OBJ" 1 "CAR" 2 "TRUCK" 3 "MOTOR_BIKE" 4 "BICYCLE" 5 "PEDESTRIAN" 6 "ROAD_BOUNDRY" 7 "STATIC_OBJECT" 8 "TRAFFIC_LIGHT" 9 "TRAFFIC_SIGN" 10 "TWO_WHEELERS" 11 "RESERVED" 12 "RESERVED" 14 "OBJECT_UNDETERMIND" 15 "VEHICLE_UNDETERMIND";
VAL_ 727 OBJ_CLS_TYPE4_024 0 "UNKNOWN_MOVING_OBJ" 1 "CAR" 2 "TRUCK" 3 "MOTOR_BIKE" 4 "BICYCLE" 5 "PEDESTRIAN" 6 "ROAD_BOUNDRY" 7 "STATIC_OBJECT" 8 "TRAFFIC_LIGHT" 9 "TRAFFIC_SIGN" 10 "TWO_WHEELERS" 11 "RESERVED" 12 "RESERVED" 14 "OBJECT_UNDETERMIND" 15 "VEHICLE_UNDETERMIND";
VAL_ 727 OBJ_CLS_TYPE5_024 0 "UNKNOWN_MOVING_OBJ" 1 "CAR" 2 "TRUCK" 3 "MOTOR_BIKE" 4 "BICYCLE" 5 "PEDESTRIAN" 6 "ROAD_BOUNDRY" 7 "STATIC_OBJECT" 8 "TRAFFIC_LIGHT" 9 "TRAFFIC_SIGN" 10 "TWO_WHEELERS" 11 "RESERVED" 12 "RESERVED" 14 "OBJECT_UNDETERMIND" 15 "VEHICLE_UNDETERMIND";
VAL_ 727 OBJ_CLS_TYPE6_024 0 "UNKNOWN_MOVING_OBJ" 1 "CAR" 2 "TRUCK" 3 "MOTOR_BIKE" 4 "BICYCLE" 5 "PEDESTRIAN" 6 "ROAD_BOUNDRY" 7 "STATIC_OBJECT" 8 "TRAFFIC_LIGHT" 9 "TRAFFIC_SIGN" 10 "TWO_WHEELERS" 11 "RESERVED" 12 "RESERVED" 14 "OBJECT_UNDETERMIND" 15 "VEHICLE_UNDETERMIND";
VAL_ 728 OBJ_TRACK_MOTION_MODEL_025 0 "INVALID" 1 "CCV" 2 "CTCA" 3 "CCA";
VAL_ 728 OBJ_MOVEMENT_STATUS_025 0 "UNKNOWN" 1 "MOVING" 2 "SLOW_MOVING" 3 "FAST_MOVING" 4 "STATIONARY" 5 "STOPPED" 6 "RESERVED1" 7 "RESERVED2";
VAL_ 728 OBJ_MEASUREMENT_STATUS_025 0 "Invalid" 1 "New" 2 "Predicted" 3 "PartlyMeasured" 4 "Measured" 5 "Occluded";
VAL_ 728 OBJ_CLS_TYPE1_025 0 "UNKNOWN_MOVING_OBJ" 1 "CAR" 2 "TRUCK" 3 "MOTOR_BIKE" 4 "BICYCLE" 5 "PEDESTRIAN" 6 "ROAD_BOUNDRY" 7 "STATIC_OBJECT" 8 "TRAFFIC_LIGHT" 9 "TRAFFIC_SIGN" 10 "TWO_WHEELERS" 11 "RESERVED" 12 "RESERVED" 14 "OBJECT_UNDETERMIND" 15 "VEHICLE_UNDETERMIND";
VAL_ 728 OBJ_CLS_TYPE2_025 0 "UNKNOWN_MOVING_OBJ" 1 "CAR" 2 "TRUCK" 3 "MOTOR_BIKE" 4 "BICYCLE" 5 "PEDESTRIAN" 6 "ROAD_BOUNDRY" 7 "STATIC_OBJECT" 8 "TRAFFIC_LIGHT" 9 "TRAFFIC_SIGN" 10 "TWO_WHEELERS" 11 "RESERVED" 12 "RESERVED" 14 "OBJECT_UNDETERMIND" 15 "VEHICLE_UNDETERMIND";
VAL_ 728 OBJ_CLS_TYPE3_025 0 "UNKNOWN_MOVING_OBJ" 1 "CAR" 2 "TRUCK" 3 "MOTOR_BIKE" 4 "BICYCLE" 5 "PEDESTRIAN" 6 "ROAD_BOUNDRY" 7 "STATIC_OBJECT" 8 "TRAFFIC_LIGHT" 9 "TRAFFIC_SIGN" 10 "TWO_WHEELERS" 11 "RESERVED" 12 "RESERVED" 14 "OBJECT_UNDETERMIND" 15 "VEHICLE_UNDETERMIND";
VAL_ 728 OBJ_CLS_TYPE4_025 0 "UNKNOWN_MOVING_OBJ" 1 "CAR" 2 "TRUCK" 3 "MOTOR_BIKE" 4 "BICYCLE" 5 "PEDESTRIAN" 6 "ROAD_BOUNDRY" 7 "STATIC_OBJECT" 8 "TRAFFIC_LIGHT" 9 "TRAFFIC_SIGN" 10 "TWO_WHEELERS" 11 "RESERVED" 12 "RESERVED" 14 "OBJECT_UNDETERMIND" 15 "VEHICLE_UNDETERMIND";
VAL_ 728 OBJ_CLS_TYPE5_025 0 "UNKNOWN_MOVING_OBJ" 1 "CAR" 2 "TRUCK" 3 "MOTOR_BIKE" 4 "BICYCLE" 5 "PEDESTRIAN" 6 "ROAD_BOUNDRY" 7 "STATIC_OBJECT" 8 "TRAFFIC_LIGHT" 9 "TRAFFIC_SIGN" 10 "TWO_WHEELERS" 11 "RESERVED" 12 "RESERVED" 14 "OBJECT_UNDETERMIND" 15 "VEHICLE_UNDETERMIND";
VAL_ 728 OBJ_CLS_TYPE6_025 0 "UNKNOWN_MOVING_OBJ" 1 "CAR" 2 "TRUCK" 3 "MOTOR_BIKE" 4 "BICYCLE" 5 "PEDESTRIAN" 6 "ROAD_BOUNDRY" 7 "STATIC_OBJECT" 8 "TRAFFIC_LIGHT" 9 "TRAFFIC_SIGN" 10 "TWO_WHEELERS" 11 "RESERVED" 12 "RESERVED" 14 "OBJECT_UNDETERMIND" 15 "VEHICLE_UNDETERMIND";
VAL_ 729 OBJ_TRACK_MOTION_MODEL_026 0 "INVALID" 1 "CCV" 2 "CTCA" 3 "CCA";
VAL_ 729 OBJ_MOVEMENT_STATUS_026 0 "UNKNOWN" 1 "MOVING" 2 "SLOW_MOVING" 3 "FAST_MOVING" 4 "STATIONARY" 5 "STOPPED" 6 "RESERVED1" 7 "RESERVED2";
VAL_ 729 OBJ_MEASUREMENT_STATUS_026 0 "Invalid" 1 "New" 2 "Predicted" 3 "PartlyMeasured" 4 "Measured" 5 "Occluded";
VAL_ 729 OBJ_CLS_TYPE1_026 0 "UNKNOWN_MOVING_OBJ" 1 "CAR" 2 "TRUCK" 3 "MOTOR_BIKE" 4 "BICYCLE" 5 "PEDESTRIAN" 6 "ROAD_BOUNDRY" 7 "STATIC_OBJECT" 8 "TRAFFIC_LIGHT" 9 "TRAFFIC_SIGN" 10 "TWO_WHEELERS" 11 "RESERVED" 12 "RESERVED" 14 "OBJECT_UNDETERMIND" 15 "VEHICLE_UNDETERMIND";
VAL_ 729 OBJ_CLS_TYPE2_026 0 "UNKNOWN_MOVING_OBJ" 1 "CAR" 2 "TRUCK" 3 "MOTOR_BIKE" 4 "BICYCLE" 5 "PEDESTRIAN" 6 "ROAD_BOUNDRY" 7 "STATIC_OBJECT" 8 "TRAFFIC_LIGHT" 9 "TRAFFIC_SIGN" 10 "TWO_WHEELERS" 11 "RESERVED" 12 "RESERVED" 14 "OBJECT_UNDETERMIND" 15 "VEHICLE_UNDETERMIND";
VAL_ 729 OBJ_CLS_TYPE3_026 0 "UNKNOWN_MOVING_OBJ" 1 "CAR" 2 "TRUCK" 3 "MOTOR_BIKE" 4 "BICYCLE" 5 "PEDESTRIAN" 6 "ROAD_BOUNDRY" 7 "STATIC_OBJECT" 8 "TRAFFIC_LIGHT" 9 "TRAFFIC_SIGN" 10 "TWO_WHEELERS" 11 "RESERVED" 12 "RESERVED" 14 "OBJECT_UNDETERMIND" 15 "VEHICLE_UNDETERMIND";
VAL_ 729 OBJ_CLS_TYPE4_026 0 "UNKNOWN_MOVING_OBJ" 1 "CAR" 2 "TRUCK" 3 "MOTOR_BIKE" 4 "BICYCLE" 5 "PEDESTRIAN" 6 "ROAD_BOUNDRY" 7 "STATIC_OBJECT" 8 "TRAFFIC_LIGHT" 9 "TRAFFIC_SIGN" 10 "TWO_WHEELERS" 11 "RESERVED" 12 "RESERVED" 14 "OBJECT_UNDETERMIND" 15 "VEHICLE_UNDETERMIND";
VAL_ 729 OBJ_CLS_TYPE5_026 0 "UNKNOWN_MOVING_OBJ" 1 "CAR" 2 "TRUCK" 3 "MOTOR_BIKE" 4 "BICYCLE" 5 "PEDESTRIAN" 6 "ROAD_BOUNDRY" 7 "STATIC_OBJECT" 8 "TRAFFIC_LIGHT" 9 "TRAFFIC_SIGN" 10 "TWO_WHEELERS" 11 "RESERVED" 12 "RESERVED" 14 "OBJECT_UNDETERMIND" 15 "VEHICLE_UNDETERMIND";
VAL_ 729 OBJ_CLS_TYPE6_026 0 "UNKNOWN_MOVING_OBJ" 1 "CAR" 2 "TRUCK" 3 "MOTOR_BIKE" 4 "BICYCLE" 5 "PEDESTRIAN" 6 "ROAD_BOUNDRY" 7 "STATIC_OBJECT" 8 "TRAFFIC_LIGHT" 9 "TRAFFIC_SIGN" 10 "TWO_WHEELERS" 11 "RESERVED" 12 "RESERVED" 14 "OBJECT_UNDETERMIND" 15 "VEHICLE_UNDETERMIND";
VAL_ 730 OBJ_TRACK_MOTION_MODEL_027 0 "INVALID" 1 "CCV" 2 "CTCA" 3 "CCA";
VAL_ 730 OBJ_MOVEMENT_STATUS_027 0 "UNKNOWN" 1 "MOVING" 2 "SLOW_MOVING" 3 "FAST_MOVING" 4 "STATIONARY" 5 "STOPPED" 6 "RESERVED1" 7 "RESERVED2";
VAL_ 730 OBJ_MEASUREMENT_STATUS_027 0 "Invalid" 1 "New" 2 "Predicted" 3 "PartlyMeasured" 4 "Measured" 5 "Occluded";
VAL_ 730 OBJ_CLS_TYPE1_027 0 "UNKNOWN_MOVING_OBJ" 1 "CAR" 2 "TRUCK" 3 "MOTOR_BIKE" 4 "BICYCLE" 5 "PEDESTRIAN" 6 "ROAD_BOUNDRY" 7 "STATIC_OBJECT" 8 "TRAFFIC_LIGHT" 9 "TRAFFIC_SIGN" 10 "TWO_WHEELERS" 11 "RESERVED" 12 "RESERVED" 14 "OBJECT_UNDETERMIND" 15 "VEHICLE_UNDETERMIND";
VAL_ 730 OBJ_CLS_TYPE2_027 0 "UNKNOWN_MOVING_OBJ" 1 "CAR" 2 "TRUCK" 3 "MOTOR_BIKE" 4 "BICYCLE" 5 "PEDESTRIAN" 6 "ROAD_BOUNDRY" 7 "STATIC_OBJECT" 8 "TRAFFIC_LIGHT" 9 "TRAFFIC_SIGN" 10 "TWO_WHEELERS" 11 "RESERVED" 12 "RESERVED" 14 "OBJECT_UNDETERMIND" 15 "VEHICLE_UNDETERMIND";
VAL_ 730 OBJ_CLS_TYPE3_027 0 "UNKNOWN_MOVING_OBJ" 1 "CAR" 2 "TRUCK" 3 "MOTOR_BIKE" 4 "BICYCLE" 5 "PEDESTRIAN" 6 "ROAD_BOUNDRY" 7 "STATIC_OBJECT" 8 "TRAFFIC_LIGHT" 9 "TRAFFIC_SIGN" 10 "TWO_WHEELERS" 11 "RESERVED" 12 "RESERVED" 14 "OBJECT_UNDETERMIND" 15 "VEHICLE_UNDETERMIND";
VAL_ 730 OBJ_CLS_TYPE4_027 0 "UNKNOWN_MOVING_OBJ" 1 "CAR" 2 "TRUCK" 3 "MOTOR_BIKE" 4 "BICYCLE" 5 "PEDESTRIAN" 6 "ROAD_BOUNDRY" 7 "STATIC_OBJECT" 8 "TRAFFIC_LIGHT" 9 "TRAFFIC_SIGN" 10 "TWO_WHEELERS" 11 "RESERVED" 12 "RESERVED" 14 "OBJECT_UNDETERMIND" 15 "VEHICLE_UNDETERMIND";
VAL_ 730 OBJ_CLS_TYPE5_027 0 "UNKNOWN_MOVING_OBJ" 1 "CAR" 2 "TRUCK" 3 "MOTOR_BIKE" 4 "BICYCLE" 5 "PEDESTRIAN" 6 "ROAD_BOUNDRY" 7 "STATIC_OBJECT" 8 "TRAFFIC_LIGHT" 9 "TRAFFIC_SIGN" 10 "TWO_WHEELERS" 11 "RESERVED" 12 "RESERVED" 14 "OBJECT_UNDETERMIND" 15 "VEHICLE_UNDETERMIND";
VAL_ 730 OBJ_CLS_TYPE6_027 0 "UNKNOWN_MOVING_OBJ" 1 "CAR" 2 "TRUCK" 3 "MOTOR_BIKE" 4 "BICYCLE" 5 "PEDESTRIAN" 6 "ROAD_BOUNDRY" 7 "STATIC_OBJECT" 8 "TRAFFIC_LIGHT" 9 "TRAFFIC_SIGN" 10 "TWO_WHEELERS" 11 "RESERVED" 12 "RESERVED" 14 "OBJECT_UNDETERMIND" 15 "VEHICLE_UNDETERMIND";
VAL_ 731 OBJ_TRACK_MOTION_MODEL_028 0 "INVALID" 1 "CCV" 2 "CTCA" 3 "CCA";
VAL_ 731 OBJ_MOVEMENT_STATUS_028 0 "UNKNOWN" 1 "MOVING" 2 "SLOW_MOVING" 3 "FAST_MOVING" 4 "STATIONARY" 5 "STOPPED" 6 "RESERVED1" 7 "RESERVED2";
VAL_ 731 OBJ_MEASUREMENT_STATUS_028 0 "Invalid" 1 "New" 2 "Predicted" 3 "PartlyMeasured" 4 "Measured" 5 "Occluded";
VAL_ 731 OBJ_CLS_TYPE1_028 0 "UNKNOWN_MOVING_OBJ" 1 "CAR" 2 "TRUCK" 3 "MOTOR_BIKE" 4 "BICYCLE" 5 "PEDESTRIAN" 6 "ROAD_BOUNDRY" 7 "STATIC_OBJECT" 8 "TRAFFIC_LIGHT" 9 "TRAFFIC_SIGN" 10 "TWO_WHEELERS" 11 "RESERVED" 12 "RESERVED" 14 "OBJECT_UNDETERMIND" 15 "VEHICLE_UNDETERMIND";
VAL_ 731 OBJ_CLS_TYPE2_028 0 "UNKNOWN_MOVING_OBJ" 1 "CAR" 2 "TRUCK" 3 "MOTOR_BIKE" 4 "BICYCLE" 5 "PEDESTRIAN" 6 "ROAD_BOUNDRY" 7 "STATIC_OBJECT" 8 "TRAFFIC_LIGHT" 9 "TRAFFIC_SIGN" 10 "TWO_WHEELERS" 11 "RESERVED" 12 "RESERVED" 14 "OBJECT_UNDETERMIND" 15 "VEHICLE_UNDETERMIND";
VAL_ 731 OBJ_CLS_TYPE3_028 0 "UNKNOWN_MOVING_OBJ" 1 "CAR" 2 "TRUCK" 3 "MOTOR_BIKE" 4 "BICYCLE" 5 "PEDESTRIAN" 6 "ROAD_BOUNDRY" 7 "STATIC_OBJECT" 8 "TRAFFIC_LIGHT" 9 "TRAFFIC_SIGN" 10 "TWO_WHEELERS" 11 "RESERVED" 12 "RESERVED" 14 "OBJECT_UNDETERMIND" 15 "VEHICLE_UNDETERMIND";
VAL_ 731 OBJ_CLS_TYPE4_028 0 "UNKNOWN_MOVING_OBJ" 1 "CAR" 2 "TRUCK" 3 "MOTOR_BIKE" 4 "BICYCLE" 5 "PEDESTRIAN" 6 "ROAD_BOUNDRY" 7 "STATIC_OBJECT" 8 "TRAFFIC_LIGHT" 9 "TRAFFIC_SIGN" 10 "TWO_WHEELERS" 11 "RESERVED" 12 "RESERVED" 14 "OBJECT_UNDETERMIND" 15 "VEHICLE_UNDETERMIND";
VAL_ 731 OBJ_CLS_TYPE5_028 0 "UNKNOWN_MOVING_OBJ" 1 "CAR" 2 "TRUCK" 3 "MOTOR_BIKE" 4 "BICYCLE" 5 "PEDESTRIAN" 6 "ROAD_BOUNDRY" 7 "STATIC_OBJECT" 8 "TRAFFIC_LIGHT" 9 "TRAFFIC_SIGN" 10 "TWO_WHEELERS" 11 "RESERVED" 12 "RESERVED" 14 "OBJECT_UNDETERMIND" 15 "VEHICLE_UNDETERMIND";
VAL_ 731 OBJ_CLS_TYPE6_028 0 "UNKNOWN_MOVING_OBJ" 1 "CAR" 2 "TRUCK" 3 "MOTOR_BIKE" 4 "BICYCLE" 5 "PEDESTRIAN" 6 "ROAD_BOUNDRY" 7 "STATIC_OBJECT" 8 "TRAFFIC_LIGHT" 9 "TRAFFIC_SIGN" 10 "TWO_WHEELERS" 11 "RESERVED" 12 "RESERVED" 14 "OBJECT_UNDETERMIND" 15 "VEHICLE_UNDETERMIND";
VAL_ 732 OBJ_TRACK_MOTION_MODEL_029 0 "INVALID" 1 "CCV" 2 "CTCA" 3 "CCA";
VAL_ 732 OBJ_MOVEMENT_STATUS_029 0 "UNKNOWN" 1 "MOVING" 2 "SLOW_MOVING" 3 "FAST_MOVING" 4 "STATIONARY" 5 "STOPPED" 6 "RESERVED1" 7 "RESERVED2";
VAL_ 732 OBJ_MEASUREMENT_STATUS_029 0 "Invalid" 1 "New" 2 "Predicted" 3 "PartlyMeasured" 4 "Measured" 5 "Occluded";
VAL_ 732 OBJ_CLS_TYPE1_029 0 "UNKNOWN_MOVING_OBJ" 1 "CAR" 2 "TRUCK" 3 "MOTOR_BIKE" 4 "BICYCLE" 5 "PEDESTRIAN" 6 "ROAD_BOUNDRY" 7 "STATIC_OBJECT" 8 "TRAFFIC_LIGHT" 9 "TRAFFIC_SIGN" 10 "TWO_WHEELERS" 11 "RESERVED" 12 "RESERVED" 14 "OBJECT_UNDETERMIND" 15 "VEHICLE_UNDETERMIND";
VAL_ 732 OBJ_CLS_TYPE2_029 0 "UNKNOWN_MOVING_OBJ" 1 "CAR" 2 "TRUCK" 3 "MOTOR_BIKE" 4 "BICYCLE" 5 "PEDESTRIAN" 6 "ROAD_BOUNDRY" 7 "STATIC_OBJECT" 8 "TRAFFIC_LIGHT" 9 "TRAFFIC_SIGN" 10 "TWO_WHEELERS" 11 "RESERVED" 12 "RESERVED" 14 "OBJECT_UNDETERMIND" 15 "VEHICLE_UNDETERMIND";
VAL_ 732 OBJ_CLS_TYPE3_029 0 "UNKNOWN_MOVING_OBJ" 1 "CAR" 2 "TRUCK" 3 "MOTOR_BIKE" 4 "BICYCLE" 5 "PEDESTRIAN" 6 "ROAD_BOUNDRY" 7 "STATIC_OBJECT" 8 "TRAFFIC_LIGHT" 9 "TRAFFIC_SIGN" 10 "TWO_WHEELERS" 11 "RESERVED" 12 "RESERVED" 14 "OBJECT_UNDETERMIND" 15 "VEHICLE_UNDETERMIND";
VAL_ 732 OBJ_CLS_TYPE4_029 0 "UNKNOWN_MOVING_OBJ" 1 "CAR" 2 "TRUCK" 3 "MOTOR_BIKE" 4 "BICYCLE" 5 "PEDESTRIAN" 6 "ROAD_BOUNDRY" 7 "STATIC_OBJECT" 8 "TRAFFIC_LIGHT" 9 "TRAFFIC_SIGN" 10 "TWO_WHEELERS" 11 "RESERVED" 12 "RESERVED" 14 "OBJECT_UNDETERMIND" 15 "VEHICLE_UNDETERMIND";
VAL_ 732 OBJ_CLS_TYPE5_029 0 "UNKNOWN_MOVING_OBJ" 1 "CAR" 2 "TRUCK" 3 "MOTOR_BIKE" 4 "BICYCLE" 5 "PEDESTRIAN" 6 "ROAD_BOUNDRY" 7 "STATIC_OBJECT" 8 "TRAFFIC_LIGHT" 9 "TRAFFIC_SIGN" 10 "TWO_WHEELERS" 11 "RESERVED" 12 "RESERVED" 14 "OBJECT_UNDETERMIND" 15 "VEHICLE_UNDETERMIND";
VAL_ 732 OBJ_CLS_TYPE6_029 0 "UNKNOWN_MOVING_OBJ" 1 "CAR" 2 "TRUCK" 3 "MOTOR_BIKE" 4 "BICYCLE" 5 "PEDESTRIAN" 6 "ROAD_BOUNDRY" 7 "STATIC_OBJECT" 8 "TRAFFIC_LIGHT" 9 "TRAFFIC_SIGN" 10 "TWO_WHEELERS" 11 "RESERVED" 12 "RESERVED" 14 "OBJECT_UNDETERMIND" 15 "VEHICLE_UNDETERMIND";
VAL_ 733 OBJ_TRACK_MOTION_MODEL_030 0 "INVALID" 1 "CCV" 2 "CTCA" 3 "CCA";
VAL_ 733 OBJ_MOVEMENT_STATUS_030 0 "UNKNOWN" 1 "MOVING" 2 "SLOW_MOVING" 3 "FAST_MOVING" 4 "STATIONARY" 5 "STOPPED" 6 "RESERVED1" 7 "RESERVED2";
VAL_ 733 OBJ_MEASUREMENT_STATUS_030 0 "Invalid" 1 "New" 2 "Predicted" 3 "PartlyMeasured" 4 "Measured" 5 "Occluded";
VAL_ 733 OBJ_CLS_TYPE1_030 0 "UNKNOWN_MOVING_OBJ" 1 "CAR" 2 "TRUCK" 3 "MOTOR_BIKE" 4 "BICYCLE" 5 "PEDESTRIAN" 6 "ROAD_BOUNDRY" 7 "STATIC_OBJECT" 8 "TRAFFIC_LIGHT" 9 "TRAFFIC_SIGN" 10 "TWO_WHEELERS" 11 "RESERVED" 12 "RESERVED" 14 "OBJECT_UNDETERMIND" 15 "VEHICLE_UNDETERMIND";
VAL_ 733 OBJ_CLS_TYPE2_030 0 "UNKNOWN_MOVING_OBJ" 1 "CAR" 2 "TRUCK" 3 "MOTOR_BIKE" 4 "BICYCLE" 5 "PEDESTRIAN" 6 "ROAD_BOUNDRY" 7 "STATIC_OBJECT" 8 "TRAFFIC_LIGHT" 9 "TRAFFIC_SIGN" 10 "TWO_WHEELERS" 11 "RESERVED" 12 "RESERVED" 14 "OBJECT_UNDETERMIND" 15 "VEHICLE_UNDETERMIND";
VAL_ 733 OBJ_CLS_TYPE3_030 0 "UNKNOWN_MOVING_OBJ" 1 "CAR" 2 "TRUCK" 3 "MOTOR_BIKE" 4 "BICYCLE" 5 "PEDESTRIAN" 6 "ROAD_BOUNDRY" 7 "STATIC_OBJECT" 8 "TRAFFIC_LIGHT" 9 "TRAFFIC_SIGN" 10 "TWO_WHEELERS" 11 "RESERVED" 12 "RESERVED" 14 "OBJECT_UNDETERMIND" 15 "VEHICLE_UNDETERMIND";
VAL_ 733 OBJ_CLS_TYPE4_030 0 "UNKNOWN_MOVING_OBJ" 1 "CAR" 2 "TRUCK" 3 "MOTOR_BIKE" 4 "BICYCLE" 5 "PEDESTRIAN" 6 "ROAD_BOUNDRY" 7 "STATIC_OBJECT" 8 "TRAFFIC_LIGHT" 9 "TRAFFIC_SIGN" 10 "TWO_WHEELERS" 11 "RESERVED" 12 "RESERVED" 14 "OBJECT_UNDETERMIND" 15 "VEHICLE_UNDETERMIND";
VAL_ 733 OBJ_CLS_TYPE5_030 0 "UNKNOWN_MOVING_OBJ" 1 "CAR" 2 "TRUCK" 3 "MOTOR_BIKE" 4 "BICYCLE" 5 "PEDESTRIAN" 6 "ROAD_BOUNDRY" 7 "STATIC_OBJECT" 8 "TRAFFIC_LIGHT" 9 "TRAFFIC_SIGN" 10 "TWO_WHEELERS" 11 "RESERVED" 12 "RESERVED" 14 "OBJECT_UNDETERMIND" 15 "VEHICLE_UNDETERMIND";
VAL_ 733 OBJ_CLS_TYPE6_030 0 "UNKNOWN_MOVING_OBJ" 1 "CAR" 2 "TRUCK" 3 "MOTOR_BIKE" 4 "BICYCLE" 5 "PEDESTRIAN" 6 "ROAD_BOUNDRY" 7 "STATIC_OBJECT" 8 "TRAFFIC_LIGHT" 9 "TRAFFIC_SIGN" 10 "TWO_WHEELERS" 11 "RESERVED" 12 "RESERVED" 14 "OBJECT_UNDETERMIND" 15 "VEHICLE_UNDETERMIND";
VAL_ 734 OBJ_TRACK_MOTION_MODEL_031 0 "INVALID" 1 "CCV" 2 "CTCA" 3 "CCA";
VAL_ 734 OBJ_MOVEMENT_STATUS_031 0 "UNKNOWN" 1 "MOVING" 2 "SLOW_MOVING" 3 "FAST_MOVING" 4 "STATIONARY" 5 "STOPPED" 6 "RESERVED1" 7 "RESERVED2";
VAL_ 734 OBJ_MEASUREMENT_STATUS_031 0 "Invalid" 1 "New" 2 "Predicted" 3 "PartlyMeasured" 4 "Measured" 5 "Occluded";
VAL_ 734 OBJ_CLS_TYPE1_031 0 "UNKNOWN_MOVING_OBJ" 1 "CAR" 2 "TRUCK" 3 "MOTOR_BIKE" 4 "BICYCLE" 5 "PEDESTRIAN" 6 "ROAD_BOUNDRY" 7 "STATIC_OBJECT" 8 "TRAFFIC_LIGHT" 9 "TRAFFIC_SIGN" 10 "TWO_WHEELERS" 11 "RESERVED" 12 "RESERVED" 14 "OBJECT_UNDETERMIND" 15 "VEHICLE_UNDETERMIND";
VAL_ 734 OBJ_CLS_TYPE2_031 0 "UNKNOWN_MOVING_OBJ" 1 "CAR" 2 "TRUCK" 3 "MOTOR_BIKE" 4 "BICYCLE" 5 "PEDESTRIAN" 6 "ROAD_BOUNDRY" 7 "STATIC_OBJECT" 8 "TRAFFIC_LIGHT" 9 "TRAFFIC_SIGN" 10 "TWO_WHEELERS" 11 "RESERVED" 12 "RESERVED" 14 "OBJECT_UNDETERMIND" 15 "VEHICLE_UNDETERMIND";
VAL_ 734 OBJ_CLS_TYPE3_031 0 "UNKNOWN_MOVING_OBJ" 1 "CAR" 2 "TRUCK" 3 "MOTOR_BIKE" 4 "BICYCLE" 5 "PEDESTRIAN" 6 "ROAD_BOUNDRY" 7 "STATIC_OBJECT" 8 "TRAFFIC_LIGHT" 9 "TRAFFIC_SIGN" 10 "TWO_WHEELERS" 11 "RESERVED" 12 "RESERVED" 14 "OBJECT_UNDETERMIND" 15 "VEHICLE_UNDETERMIND";
VAL_ 734 OBJ_CLS_TYPE4_031 0 "UNKNOWN_MOVING_OBJ" 1 "CAR" 2 "TRUCK" 3 "MOTOR_BIKE" 4 "BICYCLE" 5 "PEDESTRIAN" 6 "ROAD_BOUNDRY" 7 "STATIC_OBJECT" 8 "TRAFFIC_LIGHT" 9 "TRAFFIC_SIGN" 10 "TWO_WHEELERS" 11 "RESERVED" 12 "RESERVED" 14 "OBJECT_UNDETERMIND" 15 "VEHICLE_UNDETERMIND";
VAL_ 734 OBJ_CLS_TYPE5_031 0 "UNKNOWN_MOVING_OBJ" 1 "CAR" 2 "TRUCK" 3 "MOTOR_BIKE" 4 "BICYCLE" 5 "PEDESTRIAN" 6 "ROAD_BOUNDRY" 7 "STATIC_OBJECT" 8 "TRAFFIC_LIGHT" 9 "TRAFFIC_SIGN" 10 "TWO_WHEELERS" 11 "RESERVED" 12 "RESERVED" 14 "OBJECT_UNDETERMIND" 15 "VEHICLE_UNDETERMIND";
VAL_ 734 OBJ_CLS_TYPE6_031 0 "UNKNOWN_MOVING_OBJ" 1 "CAR" 2 "TRUCK" 3 "MOTOR_BIKE" 4 "BICYCLE" 5 "PEDESTRIAN" 6 "ROAD_BOUNDRY" 7 "STATIC_OBJECT" 8 "TRAFFIC_LIGHT" 9 "TRAFFIC_SIGN" 10 "TWO_WHEELERS" 11 "RESERVED" 12 "RESERVED" 14 "OBJECT_UNDETERMIND" 15 "VEHICLE_UNDETERMIND";
SIG_GROUP_ 718 TrackerObject015 1 : OBJ_ACCEL_ERR_CRR_COEF_015 OBJ_VELOCITY_ERR_CRR_COEF_015 OBJ_POS_ERR_CRR_COEF_015 OBJ_YAW_RATE_015 OBJ_YAW_RATE_ERR_015 OBJ_GROUP_ID_015 OBJ_REF_PT_LAT_OFFSET_015 OBJ_REF_PT_LONG_OFFSET_015 OBJ_RCS_015 OBJ_YAW_ANGLE_ERR_015 OBJ_CLS_TYPE6_015 OBJ_CLS_TYPE6_PROB_015 OBJ_CLS_TYPE5_PROB_015 OBJ_CLS_TYPE5_015 OBJ_CLS_TYPE4_PROB_015 OBJ_CLS_TYPE4_015 OBJ_CLS_TYPE3_PROB_015 OBJ_CLS_TYPE3_015 OBJ_CLS_TYPE2_PROB_015 OBJ_CLS_TYPE2_015 OBJ_DIMENSION_WIDTH_ERR_015 OBJ_DIMENSION_LENGTH_ERR_015 OBJ_TIMESTAMP_OFFSET_015 OBJ_CLS_TYPE1_PROB_015 OBJ_VEH_TRACK_FLAG_015 OBJ_ACCELERATION_LAT_015 OBJ_ACCELERATION_LONG_015 OBJ_VELOCITY_LAT_015 OBJ_VELOCITY_LONG_015 OBJ_POS_LAT_015 OBJ_POS_LONG_015 OBJ_MEASUREMENT_STATUS_015 OBJ_MOVEMENT_STATUS_015 OBJ_CLS_TYPE1_015 OBJ_ID_015 OBJ_YAW_ANGLE_015 OBJ_EXISTENCE_PROB_015 OBJ_DIMENSION_LENGTH_015 OBJ_DIMENSION_WIDTH_015 OBJ_TRACK_MOTION_MODEL_015 OBJ_POS_LAT_ERR_015 OBJ_POS_LONG_ERR_015 OBJ_VELOCITY_LAT_ERR_015 OBJ_VELOCITY_LONG_ERR_015 OBJ_ACCELERATION_LAT_ERR_015 OBJ_ACCELERATION_LONG_ERR_015 OBJ_ALIVE_TIME_015;
SIG_GROUP_ 719 TrackerObject016 1 : OBJ_ACCEL_ERR_CRR_COEF_016 OBJ_VELOCITY_ERR_CRR_COEF_016 OBJ_POS_ERR_CRR_COEF_016 OBJ_YAW_RATE_016 OBJ_YAW_RATE_ERR_016 OBJ_GROUP_ID_016 OBJ_REF_PT_LAT_OFFSET_016 OBJ_REF_PT_LONG_OFFSET_016 OBJ_RCS_016 OBJ_YAW_ANGLE_ERR_016 OBJ_CLS_TYPE6_016 OBJ_CLS_TYPE6_PROB_016 OBJ_CLS_TYPE5_PROB_016 OBJ_CLS_TYPE5_016 OBJ_CLS_TYPE4_PROB_016 OBJ_CLS_TYPE4_016 OBJ_CLS_TYPE3_PROB_016 OBJ_CLS_TYPE3_016 OBJ_CLS_TYPE2_PROB_016 OBJ_CLS_TYPE2_016 OBJ_DIMENSION_WIDTH_ERR_016 OBJ_DIMENSION_LENGTH_ERR_016 OBJ_TIMESTAMP_OFFSET_016 OBJ_CLS_TYPE1_PROB_016 OBJ_VEH_TRACK_FLAG_016 OBJ_ACCELERATION_LAT_016 OBJ_ACCELERATION_LONG_016 OBJ_VELOCITY_LAT_016 OBJ_VELOCITY_LONG_016 OBJ_POS_LAT_016 OBJ_POS_LONG_016 OBJ_MEASUREMENT_STATUS_016 OBJ_MOVEMENT_STATUS_016 OBJ_CLS_TYPE1_016 OBJ_ID_016 OBJ_YAW_ANGLE_016 OBJ_EXISTENCE_PROB_016 OBJ_DIMENSION_LENGTH_016 OBJ_DIMENSION_WIDTH_016 OBJ_TRACK_MOTION_MODEL_016 OBJ_POS_LAT_ERR_016 OBJ_POS_LONG_ERR_016 OBJ_VELOCITY_LAT_ERR_016 OBJ_VELOCITY_LONG_ERR_016 OBJ_ACCELERATION_LAT_ERR_016 OBJ_ACCELERATION_LONG_ERR_016 OBJ_ALIVE_TIME_016;
SIG_GROUP_ 720 TrackerObject017 1 : OBJ_ACCEL_ERR_CRR_COEF_017 OBJ_VELOCITY_ERR_CRR_COEF_017 OBJ_POS_ERR_CRR_COEF_017 OBJ_YAW_RATE_017 OBJ_YAW_RATE_ERR_017 OBJ_GROUP_ID_017 OBJ_REF_PT_LAT_OFFSET_017 OBJ_REF_PT_LONG_OFFSET_017 OBJ_RCS_017 OBJ_YAW_ANGLE_ERR_017 OBJ_CLS_TYPE6_017 OBJ_CLS_TYPE6_PROB_017 OBJ_CLS_TYPE5_PROB_017 OBJ_CLS_TYPE5_017 OBJ_CLS_TYPE4_PROB_017 OBJ_CLS_TYPE4_017 OBJ_CLS_TYPE3_PROB_017 OBJ_CLS_TYPE3_017 OBJ_CLS_TYPE2_PROB_017 OBJ_CLS_TYPE2_017 OBJ_DIMENSION_WIDTH_ERR_017 OBJ_DIMENSION_LENGTH_ERR_017 OBJ_TIMESTAMP_OFFSET_017 OBJ_CLS_TYPE1_PROB_017 OBJ_VEH_TRACK_FLAG_017 OBJ_ACCELERATION_LAT_017 OBJ_ACCELERATION_LONG_017 OBJ_VELOCITY_LAT_017 OBJ_VELOCITY_LONG_017 OBJ_POS_LAT_017 OBJ_POS_LONG_017 OBJ_MEASUREMENT_STATUS_017 OBJ_MOVEMENT_STATUS_017 OBJ_CLS_TYPE1_017 OBJ_ID_017 OBJ_YAW_ANGLE_017 OBJ_EXISTENCE_PROB_017 OBJ_DIMENSION_LENGTH_017 OBJ_DIMENSION_WIDTH_017 OBJ_TRACK_MOTION_MODEL_017 OBJ_POS_LAT_ERR_017 OBJ_POS_LONG_ERR_017 OBJ_VELOCITY_LAT_ERR_017 OBJ_VELOCITY_LONG_ERR_017 OBJ_ACCELERATION_LAT_ERR_017 OBJ_ACCELERATION_LONG_ERR_017 OBJ_ALIVE_TIME_017;
SIG_GROUP_ 721 TrackerObject018 1 : OBJ_ACCEL_ERR_CRR_COEF_018 OBJ_VELOCITY_ERR_CRR_COEF_018 OBJ_POS_ERR_CRR_COEF_018 OBJ_YAW_RATE_018 OBJ_YAW_RATE_ERR_018 OBJ_GROUP_ID_018 OBJ_REF_PT_LAT_OFFSET_018 OBJ_REF_PT_LONG_OFFSET_018 OBJ_RCS_018 OBJ_YAW_ANGLE_ERR_018 OBJ_CLS_TYPE6_018 OBJ_CLS_TYPE6_PROB_018 OBJ_CLS_TYPE5_PROB_018 OBJ_CLS_TYPE5_018 OBJ_CLS_TYPE4_PROB_018 OBJ_CLS_TYPE4_018 OBJ_CLS_TYPE3_PROB_018 OBJ_CLS_TYPE3_018 OBJ_CLS_TYPE2_PROB_018 OBJ_CLS_TYPE2_018 OBJ_DIMENSION_WIDTH_ERR_018 OBJ_DIMENSION_LENGTH_ERR_018 OBJ_TIMESTAMP_OFFSET_018 OBJ_CLS_TYPE1_PROB_018 OBJ_VEH_TRACK_FLAG_018 OBJ_ACCELERATION_LAT_018 OBJ_ACCELERATION_LONG_018 OBJ_VELOCITY_LAT_018 OBJ_VELOCITY_LONG_018 OBJ_POS_LAT_018 OBJ_POS_LONG_018 OBJ_MEASUREMENT_STATUS_018 OBJ_MOVEMENT_STATUS_018 OBJ_CLS_TYPE1_018 OBJ_ID_018 OBJ_YAW_ANGLE_018 OBJ_EXISTENCE_PROB_018 OBJ_DIMENSION_LENGTH_018 OBJ_DIMENSION_WIDTH_018 OBJ_TRACK_MOTION_MODEL_018 OBJ_POS_LAT_ERR_018 OBJ_POS_LONG_ERR_018 OBJ_VELOCITY_LAT_ERR_018 OBJ_VELOCITY_LONG_ERR_018 OBJ_ACCELERATION_LAT_ERR_018 OBJ_ACCELERATION_LONG_ERR_018 OBJ_ALIVE_TIME_018;
SIG_GROUP_ 722 TrackerObject019 1 : OBJ_ACCEL_ERR_CRR_COEF_019 OBJ_VELOCITY_ERR_CRR_COEF_019 OBJ_POS_ERR_CRR_COEF_019 OBJ_YAW_RATE_019 OBJ_YAW_RATE_ERR_019 OBJ_GROUP_ID_019 OBJ_REF_PT_LAT_OFFSET_019 OBJ_REF_PT_LONG_OFFSET_019 OBJ_RCS_019 OBJ_YAW_ANGLE_ERR_019 OBJ_CLS_TYPE6_019 OBJ_CLS_TYPE6_PROB_019 OBJ_CLS_TYPE5_PROB_019 OBJ_CLS_TYPE5_019 OBJ_CLS_TYPE4_PROB_019 OBJ_CLS_TYPE4_019 OBJ_CLS_TYPE3_PROB_019 OBJ_CLS_TYPE3_019 OBJ_CLS_TYPE2_PROB_019 OBJ_CLS_TYPE2_019 OBJ_DIMENSION_WIDTH_ERR_019 OBJ_DIMENSION_LENGTH_ERR_019 OBJ_TIMESTAMP_OFFSET_019 OBJ_CLS_TYPE1_PROB_019 OBJ_VEH_TRACK_FLAG_019 OBJ_ACCELERATION_LAT_019 OBJ_ACCELERATION_LONG_019 OBJ_VELOCITY_LAT_019 OBJ_VELOCITY_LONG_019 OBJ_POS_LAT_019 OBJ_POS_LONG_019 OBJ_MEASUREMENT_STATUS_019 OBJ_MOVEMENT_STATUS_019 OBJ_CLS_TYPE1_019 OBJ_ID_019 OBJ_YAW_ANGLE_019 OBJ_EXISTENCE_PROB_019 OBJ_DIMENSION_LENGTH_019 OBJ_DIMENSION_WIDTH_019 OBJ_TRACK_MOTION_MODEL_019 OBJ_POS_LAT_ERR_019 OBJ_POS_LONG_ERR_019 OBJ_VELOCITY_LAT_ERR_019 OBJ_VELOCITY_LONG_ERR_019 OBJ_ACCELERATION_LAT_ERR_019 OBJ_ACCELERATION_LONG_ERR_019 OBJ_ALIVE_TIME_019;
SIG_GROUP_ 723 TrackerObject020 1 : OBJ_ACCEL_ERR_CRR_COEF_020 OBJ_VELOCITY_ERR_CRR_COEF_020 OBJ_POS_ERR_CRR_COEF_020 OBJ_YAW_RATE_020 OBJ_YAW_RATE_ERR_020 OBJ_GROUP_ID_020 OBJ_REF_PT_LAT_OFFSET_020 OBJ_REF_PT_LONG_OFFSET_020 OBJ_RCS_020 OBJ_YAW_ANGLE_ERR_020 OBJ_CLS_TYPE6_020 OBJ_CLS_TYPE6_PROB_020 OBJ_CLS_TYPE5_PROB_020 OBJ_CLS_TYPE5_020 OBJ_CLS_TYPE4_PROB_020 OBJ_CLS_TYPE4_020 OBJ_CLS_TYPE3_PROB_020 OBJ_CLS_TYPE3_020 OBJ_CLS_TYPE2_PROB_020 OBJ_CLS_TYPE2_020 OBJ_DIMENSION_WIDTH_ERR_020 OBJ_DIMENSION_LENGTH_ERR_020 OBJ_TIMESTAMP_OFFSET_020 OBJ_CLS_TYPE1_PROB_020 OBJ_VEH_TRACK_FLAG_020 OBJ_ACCELERATION_LAT_020 OBJ_ACCELERATION_LONG_020 OBJ_VELOCITY_LAT_020 OBJ_VELOCITY_LONG_020 OBJ_POS_LAT_020 OBJ_POS_LONG_020 OBJ_MEASUREMENT_STATUS_020 OBJ_MOVEMENT_STATUS_020 OBJ_CLS_TYPE1_020 OBJ_ID_020 OBJ_YAW_ANGLE_020 OBJ_EXISTENCE_PROB_020 OBJ_DIMENSION_LENGTH_020 OBJ_DIMENSION_WIDTH_020 OBJ_TRACK_MOTION_MODEL_020 OBJ_POS_LAT_ERR_020 OBJ_POS_LONG_ERR_020 OBJ_VELOCITY_LAT_ERR_020 OBJ_VELOCITY_LONG_ERR_020 OBJ_ACCELERATION_LAT_ERR_020 OBJ_ACCELERATION_LONG_ERR_020 OBJ_ALIVE_TIME_020;
SIG_GROUP_ 724 TrackerObject021 1 : OBJ_ACCEL_ERR_CRR_COEF_021 OBJ_VELOCITY_ERR_CRR_COEF_021 OBJ_POS_ERR_CRR_COEF_021 OBJ_YAW_RATE_021 OBJ_YAW_RATE_ERR_021 OBJ_GROUP_ID_021 OBJ_REF_PT_LAT_OFFSET_021 OBJ_REF_PT_LONG_OFFSET_021 OBJ_RCS_021 OBJ_YAW_ANGLE_ERR_021 OBJ_CLS_TYPE6_021 OBJ_CLS_TYPE6_PROB_021 OBJ_CLS_TYPE5_PROB_021 OBJ_CLS_TYPE5_021 OBJ_CLS_TYPE4_PROB_021 OBJ_CLS_TYPE4_021 OBJ_CLS_TYPE3_PROB_021 OBJ_CLS_TYPE3_021 OBJ_CLS_TYPE2_PROB_021 OBJ_CLS_TYPE2_021 OBJ_DIMENSION_WIDTH_ERR_021 OBJ_DIMENSION_LENGTH_ERR_021 OBJ_TIMESTAMP_OFFSET_021 OBJ_CLS_TYPE1_PROB_021 OBJ_VEH_TRACK_FLAG_021 OBJ_ACCELERATION_LAT_021 OBJ_ACCELERATION_LONG_021 OBJ_VELOCITY_LAT_021 OBJ_VELOCITY_LONG_021 OBJ_POS_LAT_021 OBJ_POS_LONG_021 OBJ_MEASUREMENT_STATUS_021 OBJ_MOVEMENT_STATUS_021 OBJ_CLS_TYPE1_021 OBJ_ID_021 OBJ_YAW_ANGLE_021 OBJ_EXISTENCE_PROB_021 OBJ_DIMENSION_LENGTH_021 OBJ_DIMENSION_WIDTH_021 OBJ_TRACK_MOTION_MODEL_021 OBJ_POS_LAT_ERR_021 OBJ_POS_LONG_ERR_021 OBJ_VELOCITY_LAT_ERR_021 OBJ_VELOCITY_LONG_ERR_021 OBJ_ACCELERATION_LAT_ERR_021 OBJ_ACCELERATION_LONG_ERR_021 OBJ_ALIVE_TIME_021;
SIG_GROUP_ 725 TrackerObject022 1 : OBJ_ACCEL_ERR_CRR_COEF_022 OBJ_VELOCITY_ERR_CRR_COEF_022 OBJ_POS_ERR_CRR_COEF_022 OBJ_YAW_RATE_022 OBJ_YAW_RATE_ERR_022 OBJ_GROUP_ID_022 OBJ_REF_PT_LAT_OFFSET_022 OBJ_REF_PT_LONG_OFFSET_022 OBJ_RCS_022 OBJ_YAW_ANGLE_ERR_022 OBJ_CLS_TYPE6_022 OBJ_CLS_TYPE6_PROB_022 OBJ_CLS_TYPE5_PROB_022 OBJ_CLS_TYPE5_022 OBJ_CLS_TYPE4_PROB_022 OBJ_CLS_TYPE4_022 OBJ_CLS_TYPE3_PROB_022 OBJ_CLS_TYPE3_022 OBJ_CLS_TYPE2_PROB_022 OBJ_CLS_TYPE2_022 OBJ_DIMENSION_WIDTH_ERR_022 OBJ_DIMENSION_LENGTH_ERR_022 OBJ_TIMESTAMP_OFFSET_022 OBJ_CLS_TYPE1_PROB_022 OBJ_VEH_TRACK_FLAG_022 OBJ_ACCELERATION_LAT_022 OBJ_ACCELERATION_LONG_022 OBJ_VELOCITY_LAT_022 OBJ_VELOCITY_LONG_022 OBJ_POS_LAT_022 OBJ_POS_LONG_022 OBJ_MEASUREMENT_STATUS_022 OBJ_MOVEMENT_STATUS_022 OBJ_CLS_TYPE1_022 OBJ_ID_022 OBJ_YAW_ANGLE_022 OBJ_EXISTENCE_PROB_022 OBJ_DIMENSION_LENGTH_022 OBJ_DIMENSION_WIDTH_022 OBJ_TRACK_MOTION_MODEL_022 OBJ_POS_LAT_ERR_022 OBJ_POS_LONG_ERR_022 OBJ_VELOCITY_LAT_ERR_022 OBJ_VELOCITY_LONG_ERR_022 OBJ_ACCELERATION_LAT_ERR_022 OBJ_ACCELERATION_LONG_ERR_022 OBJ_ALIVE_TIME_022;
SIG_GROUP_ 726 TrackerObject023 1 : OBJ_ACCEL_ERR_CRR_COEF_023 OBJ_VELOCITY_ERR_CRR_COEF_023 OBJ_POS_ERR_CRR_COEF_023 OBJ_YAW_RATE_023 OBJ_YAW_RATE_ERR_023 OBJ_GROUP_ID_023 OBJ_REF_PT_LAT_OFFSET_023 OBJ_REF_PT_LONG_OFFSET_023 OBJ_RCS_023 OBJ_YAW_ANGLE_ERR_023 OBJ_CLS_TYPE6_023 OBJ_CLS_TYPE6_PROB_023 OBJ_CLS_TYPE5_PROB_023 OBJ_CLS_TYPE5_023 OBJ_CLS_TYPE4_PROB_023 OBJ_CLS_TYPE4_023 OBJ_CLS_TYPE3_PROB_023 OBJ_CLS_TYPE3_023 OBJ_CLS_TYPE2_PROB_023 OBJ_CLS_TYPE2_023 OBJ_DIMENSION_WIDTH_ERR_023 OBJ_DIMENSION_LENGTH_ERR_023 OBJ_TIMESTAMP_OFFSET_023 OBJ_CLS_TYPE1_PROB_023 OBJ_VEH_TRACK_FLAG_023 OBJ_ACCELERATION_LAT_023 OBJ_ACCELERATION_LONG_023 OBJ_VELOCITY_LAT_023 OBJ_VELOCITY_LONG_023 OBJ_POS_LAT_023 OBJ_POS_LONG_023 OBJ_MEASUREMENT_STATUS_023 OBJ_MOVEMENT_STATUS_023 OBJ_CLS_TYPE1_023 OBJ_ID_023 OBJ_YAW_ANGLE_023 OBJ_EXISTENCE_PROB_023 OBJ_DIMENSION_LENGTH_023 OBJ_DIMENSION_WIDTH_023 OBJ_TRACK_MOTION_MODEL_023 OBJ_POS_LAT_ERR_023 OBJ_POS_LONG_ERR_023 OBJ_VELOCITY_LAT_ERR_023 OBJ_VELOCITY_LONG_ERR_023 OBJ_ACCELERATION_LAT_ERR_023 OBJ_ACCELERATION_LONG_ERR_023 OBJ_ALIVE_TIME_023;
SIG_GROUP_ 727 TrackerObject024 1 : OBJ_ACCEL_ERR_CRR_COEF_024 OBJ_VELOCITY_ERR_CRR_COEF_024 OBJ_POS_ERR_CRR_COEF_024 OBJ_YAW_RATE_024 OBJ_YAW_RATE_ERR_024 OBJ_GROUP_ID_024 OBJ_REF_PT_LAT_OFFSET_024 OBJ_REF_PT_LONG_OFFSET_024 OBJ_RCS_024 OBJ_YAW_ANGLE_ERR_024 OBJ_CLS_TYPE6_024 OBJ_CLS_TYPE6_PROB_024 OBJ_CLS_TYPE5_PROB_024 OBJ_CLS_TYPE5_024 OBJ_CLS_TYPE4_PROB_024 OBJ_CLS_TYPE4_024 OBJ_CLS_TYPE3_PROB_024 OBJ_CLS_TYPE3_024 OBJ_CLS_TYPE2_PROB_024 OBJ_CLS_TYPE2_024 OBJ_DIMENSION_WIDTH_ERR_024 OBJ_DIMENSION_LENGTH_ERR_024 OBJ_TIMESTAMP_OFFSET_024 OBJ_CLS_TYPE1_PROB_024 OBJ_VEH_TRACK_FLAG_024 OBJ_ACCELERATION_LAT_024 OBJ_ACCELERATION_LONG_024 OBJ_VELOCITY_LAT_024 OBJ_VELOCITY_LONG_024 OBJ_POS_LAT_024 OBJ_POS_LONG_024 OBJ_MEASUREMENT_STATUS_024 OBJ_MOVEMENT_STATUS_024 OBJ_CLS_TYPE1_024 OBJ_ID_024 OBJ_YAW_ANGLE_024 OBJ_EXISTENCE_PROB_024 OBJ_DIMENSION_LENGTH_024 OBJ_DIMENSION_WIDTH_024 OBJ_TRACK_MOTION_MODEL_024 OBJ_POS_LAT_ERR_024 OBJ_POS_LONG_ERR_024 OBJ_VELOCITY_LAT_ERR_024 OBJ_VELOCITY_LONG_ERR_024 OBJ_ACCELERATION_LAT_ERR_024 OBJ_ACCELERATION_LONG_ERR_024 OBJ_ALIVE_TIME_024;
SIG_GROUP_ 728 TrackerObject025 1 : OBJ_ACCEL_ERR_CRR_COEF_025 OBJ_VELOCITY_ERR_CRR_COEF_025 OBJ_POS_ERR_CRR_COEF_025 OBJ_YAW_RATE_025 OBJ_YAW_RATE_ERR_025 OBJ_GROUP_ID_025 OBJ_REF_PT_LAT_OFFSET_025 OBJ_REF_PT_LONG_OFFSET_025 OBJ_RCS_025 OBJ_YAW_ANGLE_ERR_025 OBJ_CLS_TYPE6_025 OBJ_CLS_TYPE6_PROB_025 OBJ_CLS_TYPE5_PROB_025 OBJ_CLS_TYPE5_025 OBJ_CLS_TYPE4_PROB_025 OBJ_CLS_TYPE4_025 OBJ_CLS_TYPE3_PROB_025 OBJ_CLS_TYPE3_025 OBJ_CLS_TYPE2_PROB_025 OBJ_CLS_TYPE2_025 OBJ_DIMENSION_WIDTH_ERR_025 OBJ_DIMENSION_LENGTH_ERR_025 OBJ_TIMESTAMP_OFFSET_025 OBJ_CLS_TYPE1_PROB_025 OBJ_VEH_TRACK_FLAG_025 OBJ_ACCELERATION_LAT_025 OBJ_ACCELERATION_LONG_025 OBJ_VELOCITY_LAT_025 OBJ_VELOCITY_LONG_025 OBJ_POS_LAT_025 OBJ_POS_LONG_025 OBJ_MEASUREMENT_STATUS_025 OBJ_MOVEMENT_STATUS_025 OBJ_CLS_TYPE1_025 OBJ_ID_025 OBJ_YAW_ANGLE_025 OBJ_EXISTENCE_PROB_025 OBJ_DIMENSION_LENGTH_025 OBJ_DIMENSION_WIDTH_025 OBJ_TRACK_MOTION_MODEL_025 OBJ_POS_LAT_ERR_025 OBJ_POS_LONG_ERR_025 OBJ_VELOCITY_LAT_ERR_025 OBJ_VELOCITY_LONG_ERR_025 OBJ_ACCELERATION_LAT_ERR_025 OBJ_ACCELERATION_LONG_ERR_025 OBJ_ALIVE_TIME_025;
SIG_GROUP_ 729 TrackerObject026 1 : OBJ_ACCEL_ERR_CRR_COEF_026 OBJ_VELOCITY_ERR_CRR_COEF_026 OBJ_POS_ERR_CRR_COEF_026 OBJ_YAW_RATE_026 OBJ_YAW_RATE_ERR_026 OBJ_GROUP_ID_026 OBJ_REF_PT_LAT_OFFSET_026 OBJ_REF_PT_LONG_OFFSET_026 OBJ_RCS_026 OBJ_YAW_ANGLE_ERR_026 OBJ_CLS_TYPE6_026 OBJ_CLS_TYPE6_PROB_026 OBJ_CLS_TYPE5_PROB_026 OBJ_CLS_TYPE5_026 OBJ_CLS_TYPE4_PROB_026 OBJ_CLS_TYPE4_026 OBJ_CLS_TYPE3_PROB_026 OBJ_CLS_TYPE3_026 OBJ_CLS_TYPE2_PROB_026 OBJ_CLS_TYPE2_026 OBJ_DIMENSION_WIDTH_ERR_026 OBJ_DIMENSION_LENGTH_ERR_026 OBJ_TIMESTAMP_OFFSET_026 OBJ_CLS_TYPE1_PROB_026 OBJ_VEH_TRACK_FLAG_026 OBJ_ACCELERATION_LAT_026 OBJ_ACCELERATION_LONG_026 OBJ_VELOCITY_LAT_026 OBJ_VELOCITY_LONG_026 OBJ_POS_LAT_026 OBJ_POS_LONG_026 OBJ_MEASUREMENT_STATUS_026 OBJ_MOVEMENT_STATUS_026 OBJ_CLS_TYPE1_026 OBJ_ID_026 OBJ_YAW_ANGLE_026 OBJ_EXISTENCE_PROB_026 OBJ_DIMENSION_LENGTH_026 OBJ_DIMENSION_WIDTH_026 OBJ_TRACK_MOTION_MODEL_026 OBJ_POS_LAT_ERR_026 OBJ_POS_LONG_ERR_026 OBJ_VELOCITY_LAT_ERR_026 OBJ_VELOCITY_LONG_ERR_026 OBJ_ACCELERATION_LAT_ERR_026 OBJ_ACCELERATION_LONG_ERR_026 OBJ_ALIVE_TIME_026;
SIG_GROUP_ 730 TrackerObject027 1 : OBJ_ACCEL_ERR_CRR_COEF_027 OBJ_VELOCITY_ERR_CRR_COEF_027 OBJ_POS_ERR_CRR_COEF_027 OBJ_YAW_RATE_027 OBJ_YAW_RATE_ERR_027 OBJ_GROUP_ID_027 OBJ_REF_PT_LAT_OFFSET_027 OBJ_REF_PT_LONG_OFFSET_027 OBJ_RCS_027 OBJ_YAW_ANGLE_ERR_027 OBJ_CLS_TYPE6_027 OBJ_CLS_TYPE6_PROB_027 OBJ_CLS_TYPE5_PROB_027 OBJ_CLS_TYPE5_027 OBJ_CLS_TYPE4_PROB_027 OBJ_CLS_TYPE4_027 OBJ_CLS_TYPE3_PROB_027 OBJ_CLS_TYPE3_027 OBJ_CLS_TYPE2_PROB_027 OBJ_CLS_TYPE2_027 OBJ_DIMENSION_WIDTH_ERR_027 OBJ_DIMENSION_LENGTH_ERR_027 OBJ_TIMESTAMP_OFFSET_027 OBJ_CLS_TYPE1_PROB_027 OBJ_VEH_TRACK_FLAG_027 OBJ_ACCELERATION_LAT_027 OBJ_ACCELERATION_LONG_027 OBJ_VELOCITY_LAT_027 OBJ_VELOCITY_LONG_027 OBJ_POS_LAT_027 OBJ_POS_LONG_027 OBJ_MEASUREMENT_STATUS_027 OBJ_MOVEMENT_STATUS_027 OBJ_CLS_TYPE1_027 OBJ_ID_027 OBJ_YAW_ANGLE_027 OBJ_EXISTENCE_PROB_027 OBJ_DIMENSION_LENGTH_027 OBJ_DIMENSION_WIDTH_027 OBJ_TRACK_MOTION_MODEL_027 OBJ_POS_LAT_ERR_027 OBJ_POS_LONG_ERR_027 OBJ_VELOCITY_LAT_ERR_027 OBJ_VELOCITY_LONG_ERR_027 OBJ_ACCELERATION_LAT_ERR_027 OBJ_ACCELERATION_LONG_ERR_027 OBJ_ALIVE_TIME_027;
SIG_GROUP_ 731 TrackerObject028 1 : OBJ_ACCEL_ERR_CRR_COEF_028 OBJ_VELOCITY_ERR_CRR_COEF_028 OBJ_POS_ERR_CRR_COEF_028 OBJ_YAW_RATE_028 OBJ_YAW_RATE_ERR_028 OBJ_GROUP_ID_028 OBJ_REF_PT_LAT_OFFSET_028 OBJ_REF_PT_LONG_OFFSET_028 OBJ_RCS_028 OBJ_YAW_ANGLE_ERR_028 OBJ_CLS_TYPE6_028 OBJ_CLS_TYPE6_PROB_028 OBJ_CLS_TYPE5_PROB_028 OBJ_CLS_TYPE5_028 OBJ_CLS_TYPE4_PROB_028 OBJ_CLS_TYPE4_028 OBJ_CLS_TYPE3_PROB_028 OBJ_CLS_TYPE3_028 OBJ_CLS_TYPE2_PROB_028 OBJ_CLS_TYPE2_028 OBJ_DIMENSION_WIDTH_ERR_028 OBJ_DIMENSION_LENGTH_ERR_028 OBJ_TIMESTAMP_OFFSET_028 OBJ_CLS_TYPE1_PROB_028 OBJ_VEH_TRACK_FLAG_028 OBJ_ACCELERATION_LAT_028 OBJ_ACCELERATION_LONG_028 OBJ_VELOCITY_LAT_028 OBJ_VELOCITY_LONG_028 OBJ_POS_LAT_028 OBJ_POS_LONG_028 OBJ_MEASUREMENT_STATUS_028 OBJ_MOVEMENT_STATUS_028 OBJ_CLS_TYPE1_028 OBJ_ID_028 OBJ_YAW_ANGLE_028 OBJ_EXISTENCE_PROB_028 OBJ_DIMENSION_LENGTH_028 OBJ_DIMENSION_WIDTH_028 OBJ_TRACK_MOTION_MODEL_028 OBJ_POS_LAT_ERR_028 OBJ_POS_LONG_ERR_028 OBJ_VELOCITY_LAT_ERR_028 OBJ_VELOCITY_LONG_ERR_028 OBJ_ACCELERATION_LAT_ERR_028 OBJ_ACCELERATION_LONG_ERR_028 OBJ_ALIVE_TIME_028;
SIG_GROUP_ 732 TrackerObject029 1 : OBJ_ACCEL_ERR_CRR_COEF_029 OBJ_VELOCITY_ERR_CRR_COEF_029 OBJ_POS_ERR_CRR_COEF_029 OBJ_YAW_RATE_029 OBJ_YAW_RATE_ERR_029 OBJ_GROUP_ID_029 OBJ_REF_PT_LAT_OFFSET_029 OBJ_REF_PT_LONG_OFFSET_029 OBJ_RCS_029 OBJ_YAW_ANGLE_ERR_029 OBJ_CLS_TYPE6_029 OBJ_CLS_TYPE6_PROB_029 OBJ_CLS_TYPE5_PROB_029 OBJ_CLS_TYPE5_029 OBJ_CLS_TYPE4_PROB_029 OBJ_CLS_TYPE4_029 OBJ_CLS_TYPE3_PROB_029 OBJ_CLS_TYPE3_029 OBJ_CLS_TYPE2_PROB_029 OBJ_CLS_TYPE2_029 OBJ_DIMENSION_WIDTH_ERR_029 OBJ_DIMENSION_LENGTH_ERR_029 OBJ_TIMESTAMP_OFFSET_029 OBJ_CLS_TYPE1_PROB_029 OBJ_VEH_TRACK_FLAG_029 OBJ_ACCELERATION_LAT_029 OBJ_ACCELERATION_LONG_029 OBJ_VELOCITY_LAT_029 OBJ_VELOCITY_LONG_029 OBJ_POS_LAT_029 OBJ_POS_LONG_029 OBJ_MEASUREMENT_STATUS_029 OBJ_MOVEMENT_STATUS_029 OBJ_CLS_TYPE1_029 OBJ_ID_029 OBJ_YAW_ANGLE_029 OBJ_EXISTENCE_PROB_029 OBJ_DIMENSION_LENGTH_029 OBJ_DIMENSION_WIDTH_029 OBJ_TRACK_MOTION_MODEL_029 OBJ_POS_LAT_ERR_029 OBJ_POS_LONG_ERR_029 OBJ_VELOCITY_LAT_ERR_029 OBJ_VELOCITY_LONG_ERR_029 OBJ_ACCELERATION_LAT_ERR_029 OBJ_ACCELERATION_LONG_ERR_029 OBJ_ALIVE_TIME_029;
SIG_GROUP_ 733 TrackerObject030 1 : OBJ_ACCEL_ERR_CRR_COEF_030 OBJ_VELOCITY_ERR_CRR_COEF_030 OBJ_POS_ERR_CRR_COEF_030 OBJ_YAW_RATE_030 OBJ_YAW_RATE_ERR_030 OBJ_GROUP_ID_030 OBJ_REF_PT_LAT_OFFSET_030 OBJ_REF_PT_LONG_OFFSET_030 OBJ_RCS_030 OBJ_YAW_ANGLE_ERR_030 OBJ_CLS_TYPE6_030 OBJ_CLS_TYPE6_PROB_030 OBJ_CLS_TYPE5_PROB_030 OBJ_CLS_TYPE5_030 OBJ_CLS_TYPE4_PROB_030 OBJ_CLS_TYPE4_030 OBJ_CLS_TYPE3_PROB_030 OBJ_CLS_TYPE3_030 OBJ_CLS_TYPE2_PROB_030 OBJ_CLS_TYPE2_030 OBJ_DIMENSION_WIDTH_ERR_030 OBJ_DIMENSION_LENGTH_ERR_030 OBJ_TIMESTAMP_OFFSET_030 OBJ_CLS_TYPE1_PROB_030 OBJ_VEH_TRACK_FLAG_030 OBJ_ACCELERATION_LAT_030 OBJ_ACCELERATION_LONG_030 OBJ_VELOCITY_LAT_030 OBJ_VELOCITY_LONG_030 OBJ_POS_LAT_030 OBJ_POS_LONG_030 OBJ_MEASUREMENT_STATUS_030 OBJ_MOVEMENT_STATUS_030 OBJ_CLS_TYPE1_030 OBJ_ID_030 OBJ_YAW_ANGLE_030 OBJ_EXISTENCE_PROB_030 OBJ_DIMENSION_LENGTH_030 OBJ_DIMENSION_WIDTH_030 OBJ_TRACK_MOTION_MODEL_030 OBJ_POS_LAT_ERR_030 OBJ_POS_LONG_ERR_030 OBJ_VELOCITY_LAT_ERR_030 OBJ_VELOCITY_LONG_ERR_030 OBJ_ACCELERATION_LAT_ERR_030 OBJ_ACCELERATION_LONG_ERR_030 OBJ_ALIVE_TIME_030;
SIG_GROUP_ 734 TrackerObject031 1 : OBJ_ACCEL_ERR_CRR_COEF_031 OBJ_VELOCITY_ERR_CRR_COEF_031 OBJ_POS_ERR_CRR_COEF_031 OBJ_YAW_RATE_031 OBJ_YAW_RATE_ERR_031 OBJ_GROUP_ID_031 OBJ_REF_PT_LAT_OFFSET_031 OBJ_REF_PT_LONG_OFFSET_031 OBJ_RCS_031 OBJ_YAW_ANGLE_ERR_031 OBJ_CLS_TYPE6_031 OBJ_CLS_TYPE6_PROB_031 OBJ_CLS_TYPE5_PROB_031 OBJ_CLS_TYPE5_031 OBJ_CLS_TYPE4_PROB_031 OBJ_CLS_TYPE4_031 OBJ_CLS_TYPE3_PROB_031 OBJ_CLS_TYPE3_031 OBJ_CLS_TYPE2_PROB_031 OBJ_CLS_TYPE2_031 OBJ_DIMENSION_WIDTH_ERR_031 OBJ_DIMENSION_LENGTH_ERR_031 OBJ_TIMESTAMP_OFFSET_031 OBJ_CLS_TYPE1_PROB_031 OBJ_VEH_TRACK_FLAG_031 OBJ_ACCELERATION_LAT_031 OBJ_ACCELERATION_LONG_031 OBJ_VELOCITY_LAT_031 OBJ_VELOCITY_LONG_031 OBJ_POS_LAT_031 OBJ_POS_LONG_031 OBJ_MEASUREMENT_STATUS_031 OBJ_MOVEMENT_STATUS_031 OBJ_CLS_TYPE1_031 OBJ_ID_031 OBJ_YAW_ANGLE_031 OBJ_EXISTENCE_PROB_031 OBJ_DIMENSION_LENGTH_031 OBJ_DIMENSION_WIDTH_031 OBJ_TRACK_MOTION_MODEL_031 OBJ_POS_LAT_ERR_031 OBJ_POS_LONG_ERR_031 OBJ_VELOCITY_LAT_ERR_031 OBJ_VELOCITY_LONG_ERR_031 OBJ_ACCELERATION_LAT_ERR_031 OBJ_ACCELERATION_LONG_ERR_031 OBJ_ALIVE_TIME_031;

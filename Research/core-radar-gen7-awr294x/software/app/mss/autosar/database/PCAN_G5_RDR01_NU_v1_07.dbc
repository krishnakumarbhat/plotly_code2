VERSION "created by canmatrix"

NS_ :

BS_:

BU_: External_Tool ASDM G5_RDR01

BO_ 368 RDR_TRACKER_OBJ_049: 64 G5_RDR01
 SG_ OBJ_ALIVE_TIME_049 : 255|16@0+ (1,0) [0|65535] "ms" ASDM
 SG_ OBJ_ACCELERATION_LONG_ERR_049 : 215|8@0+ (0.025,0) [0|6.375] "m/s^2" ASDM
 SG_ OBJ_ACCELERATION_LAT_ERR_049 : 223|8@0+ (0.025,0) [0|6.375] "m/s^2" ASDM
 SG_ OBJ_VELOCITY_LONG_ERR_049 : 143|8@0+ (0.05,0) [0|12.75] "m/s" ASDM
 SG_ OBJ_VELOCITY_LAT_ERR_049 : 151|8@0+ (0.05,0) [0|12.75] "m/s" ASDM
 SG_ OBJ_POS_LONG_ERR_049 : 95|8@0+ (0.025,0) [0|6.375] "m" ASDM
 SG_ OBJ_POS_LAT_ERR_049 : 103|8@0+ (0.025,0) [0|6.375] "m" ASDM
 SG_ OBJ_TRACK_MOTION_MODEL_049 : 9|2@0+ (1,0) [1|3] "NA" ASDM
 SG_ OBJ_DIMENSION_WIDTH_049 : 17|10@0+ (0.01,0) [0|10.23] "m" ASDM
 SG_ OBJ_DIMENSION_LENGTH_049 : 37|12@0+ (0.01,0) [0|40.95] "m" ASDM
 SG_ OBJ_EXISTENCE_PROB_049 : 229|14@0+ (0.0001,0) [0|1] "NA" ASDM
 SG_ OBJ_YAW_ANGLE_049 : 155|12@0+ (0.005,-10) [-10|10.475] "rad" ASDM
 SG_ OBJ_YAW_ANGLE_ERR_049 : 175|7@0+ (0.01,0) [0|1.27] "rad" ASDM
 SG_ OBJ_ID_049 : 7|8@0+ (1,0) [0|255] "NA" ASDM
 SG_ OBJ_MOVEMENT_STATUS_049 : 196|3@0+ (1,0) [0|3] "NA" ASDM
 SG_ OBJ_MEASUREMENT_STATUS_049 : 14|3@0+ (1,0) [0|7] "NA" ASDM
 SG_ OBJ_POS_LONG_049 : 63|16@0+ (0.01,-327) [-327|327] "m" ASDM
 SG_ OBJ_POS_LAT_049 : 79|16@0+ (0.01,-327) [-327|327] "m" ASDM
 SG_ OBJ_VELOCITY_LONG_049 : 110|15@0+ (0.01,-163) [-163|163] "m/s" ASDM
 SG_ OBJ_VELOCITY_LAT_049 : 126|15@0+ (0.01,-163) [-163|163] "m/s" ASDM
 SG_ OBJ_ACCELERATION_LONG_049 : 193|10@0+ (0.05,-20) [-20|20] "m/s^2" ASDM
 SG_ OBJ_ACCELERATION_LAT_049 : 177|10@0+ (0.05,-20) [-20|20] "m/s^2" ASDM
 SG_ OBJ_VEH_TRACK_FLAG_049 : 10|1@0+ (1,0) [0|1] "NA" ASDM
 SG_ OBJ_MH_CYCLE_COUNTER_049 : 487|8@0+ (1,0) [0|255] "NA" ASDM
 SG_ OBJ_MH_CRC16_049 : 495|16@0+ (1,0) [0|65535] "NA" ASDM
 SG_ OBJ_TIMESTAMP_OFFSET_049 : 247|8@0+ (1,-127) [-127|128] "ms" ASDM
 SG_ OBJ_DIMENSION_WIDTH_ERR_049 : 23|6@0+ (0.01,0) [0|0.63] "m" ASDM
 SG_ OBJ_DIMENSION_LENGTH_ERR_049 : 41|10@0+ (0.01,0) [0|10.23] "m" ASDM
 SG_ OBJ_CLS_TYPE1_049 : 271|4@0+ (1,0) [0|15] "NA" ASDM
 SG_ OBJ_CLS_TYPE1_PROB_049 : 303|8@0+ (0.004,0) [0|1] "NA" ASDM
 SG_ OBJ_CLS_TYPE2_049 : 267|4@0+ (1,0) [0|15] "NA" ASDM
 SG_ OBJ_CLS_TYPE2_PROB_049 : 311|8@0+ (0.004,0) [0|1] "NA" ASDM
 SG_ OBJ_CLS_TYPE3_049 : 279|4@0+ (1,0) [0|15] "NA" ASDM
 SG_ OBJ_CLS_TYPE3_PROB_049 : 319|8@0+ (0.004,0) [0|1] "NA" ASDM
 SG_ OBJ_CLS_TYPE4_049 : 275|4@0+ (1,0) [0|15] "NA" ASDM
 SG_ OBJ_CLS_TYPE4_PROB_049 : 327|8@0+ (0.004,0) [0|1] "NA" ASDM
 SG_ OBJ_CLS_TYPE5_049 : 287|4@0+ (1,0) [0|15] "NA" ASDM
 SG_ OBJ_CLS_TYPE5_PROB_049 : 335|8@0+ (0.004,0) [0|1] "NA" ASDM
 SG_ OBJ_CLS_TYPE6_049 : 282|4@0+ (1,0) [0|15] "NA" ASDM
 SG_ OBJ_CLS_TYPE6_PROB_049 : 343|8@0+ (0.004,0) [0|1] "NA" ASDM
 SG_ OBJ_RCS_049 : 351|7@0+ (1,-64) [-64|63] "dBsm" ASDM
 SG_ OBJ_REF_PT_LONG_OFFSET_049 : 357|14@0+ (0.0001,0) [0|1] "NA" ASDM
 SG_ OBJ_REF_PT_LAT_OFFSET_049 : 370|14@0+ (0.0001,0) [0|1] "NA" ASDM
 SG_ OBJ_YAW_RATE_049 : 399|10@0+ (0.005,-2.24) [-2.24|2.24] "rad/s" ASDM
 SG_ OBJ_YAW_RATE_ERR_049 : 388|5@0+ (0.025,0) [0|0.775] "rad/s" ASDM
 SG_ OBJ_GROUP_ID_049 : 405|6@0+ (1,0) [0|63] "NA" ASDM
 SG_ OBJ_POS_ERR_CRR_COEF_049 : 415|8@0+ (0.01,-1.2) [-1.2|1] "NA" ASDM
 SG_ OBJ_VELOCITY_ERR_CRR_COEF_049 : 423|8@0+ (0.01,-1.2) [-1.2|1] "NA" ASDM
 SG_ OBJ_ACCEL_ERR_CRR_COEF_049 : 431|8@0+ (0.01,-1.2) [-1.2|1] "NA" ASDM

BO_ 369 RDR_TRACKER_OBJ_050: 64 G5_RDR01
 SG_ OBJ_ALIVE_TIME_050 : 255|16@0+ (1,0) [0|65535] "ms" ASDM
 SG_ OBJ_ACCELERATION_LONG_ERR_050 : 215|8@0+ (0.025,0) [0|6.375] "m/s^2" ASDM
 SG_ OBJ_ACCELERATION_LAT_ERR_050 : 223|8@0+ (0.025,0) [0|6.375] "m/s^2" ASDM
 SG_ OBJ_VELOCITY_LONG_ERR_050 : 143|8@0+ (0.05,0) [0|12.75] "m/s" ASDM
 SG_ OBJ_VELOCITY_LAT_ERR_050 : 151|8@0+ (0.05,0) [0|12.75] "m/s" ASDM
 SG_ OBJ_POS_LONG_ERR_050 : 95|8@0+ (0.025,0) [0|6.375] "m" ASDM
 SG_ OBJ_POS_LAT_ERR_050 : 103|8@0+ (0.025,0) [0|6.375] "m" ASDM
 SG_ OBJ_TRACK_MOTION_MODEL_050 : 9|2@0+ (1,0) [1|3] "NA" ASDM
 SG_ OBJ_DIMENSION_WIDTH_050 : 17|10@0+ (0.01,0) [0|10.23] "m" ASDM
 SG_ OBJ_DIMENSION_LENGTH_050 : 37|12@0+ (0.01,0) [0|40.95] "m" ASDM
 SG_ OBJ_EXISTENCE_PROB_050 : 229|14@0+ (0.0001,0) [0|1] "NA" ASDM
 SG_ OBJ_YAW_ANGLE_050 : 155|12@0+ (0.005,-10) [-10|10.475] "rad" ASDM
 SG_ OBJ_YAW_ANGLE_ERR_050 : 175|7@0+ (0.01,0) [0|1.27] "rad" ASDM
 SG_ OBJ_ID_050 : 7|8@0+ (1,0) [0|255] "NA" ASDM
 SG_ OBJ_MOVEMENT_STATUS_050 : 196|3@0+ (1,0) [0|3] "NA" ASDM
 SG_ OBJ_MEASUREMENT_STATUS_050 : 14|3@0+ (1,0) [0|7] "NA" ASDM
 SG_ OBJ_POS_LONG_050 : 63|16@0+ (0.01,-327) [-327|327] "m" ASDM
 SG_ OBJ_POS_LAT_050 : 79|16@0+ (0.01,-327) [-327|327] "m" ASDM
 SG_ OBJ_VELOCITY_LONG_050 : 110|15@0+ (0.01,-163) [-163|163] "m/s" ASDM
 SG_ OBJ_VELOCITY_LAT_050 : 126|15@0+ (0.01,-163) [-163|163] "m/s" ASDM
 SG_ OBJ_ACCELERATION_LONG_050 : 193|10@0+ (0.05,-20) [-20|20] "m/s^2" ASDM
 SG_ OBJ_ACCELERATION_LAT_050 : 177|10@0+ (0.05,-20) [-20|20] "m/s^2" ASDM
 SG_ OBJ_VEH_TRACK_FLAG_050 : 10|1@0+ (1,0) [0|1] "NA" ASDM
 SG_ OBJ_MH_CYCLE_COUNTER_050 : 487|8@0+ (1,0) [0|255] "NA" ASDM
 SG_ OBJ_MH_CRC16_050 : 495|16@0+ (1,0) [0|65535] "NA" ASDM
 SG_ OBJ_TIMESTAMP_OFFSET_050 : 247|8@0+ (1,-127) [-127|128] "ms" ASDM
 SG_ OBJ_DIMENSION_WIDTH_ERR_050 : 23|6@0+ (0.01,0) [0|0.63] "m" ASDM
 SG_ OBJ_DIMENSION_LENGTH_ERR_050 : 41|10@0+ (0.01,0) [0|10.23] "m" ASDM
 SG_ OBJ_CLS_TYPE1_050 : 271|4@0+ (1,0) [0|15] "NA" ASDM
 SG_ OBJ_CLS_TYPE1_PROB_050 : 303|8@0+ (0.004,0) [0|1] "NA" ASDM
 SG_ OBJ_CLS_TYPE2_050 : 267|4@0+ (1,0) [0|15] "NA" ASDM
 SG_ OBJ_CLS_TYPE2_PROB_050 : 311|8@0+ (0.004,0) [0|1] "NA" ASDM
 SG_ OBJ_CLS_TYPE3_050 : 279|4@0+ (1,0) [0|15] "NA" ASDM
 SG_ OBJ_CLS_TYPE3_PROB_050 : 319|8@0+ (0.004,0) [0|1] "NA" ASDM
 SG_ OBJ_CLS_TYPE4_050 : 275|4@0+ (1,0) [0|15] "NA" ASDM
 SG_ OBJ_CLS_TYPE4_PROB_050 : 327|8@0+ (0.004,0) [0|1] "NA" ASDM
 SG_ OBJ_CLS_TYPE5_050 : 287|4@0+ (1,0) [0|15] "NA" ASDM
 SG_ OBJ_CLS_TYPE5_PROB_050 : 335|8@0+ (0.004,0) [0|1] "NA" ASDM
 SG_ OBJ_CLS_TYPE6_050 : 282|4@0+ (1,0) [0|15] "NA" ASDM
 SG_ OBJ_CLS_TYPE6_PROB_050 : 343|8@0+ (0.004,0) [0|1] "NA" ASDM
 SG_ OBJ_RCS_050 : 351|7@0+ (1,-64) [-64|63] "dBsm" ASDM
 SG_ OBJ_REF_PT_LONG_OFFSET_050 : 357|14@0+ (0.0001,0) [0|1] "NA" ASDM
 SG_ OBJ_REF_PT_LAT_OFFSET_050 : 370|14@0+ (0.0001,0) [0|1] "NA" ASDM
 SG_ OBJ_YAW_RATE_050 : 399|10@0+ (0.005,-2.24) [-2.24|2.24] "rad/s" ASDM
 SG_ OBJ_YAW_RATE_ERR_050 : 388|5@0+ (0.025,0) [0|0.775] "rad/s" ASDM
 SG_ OBJ_GROUP_ID_050 : 405|6@0+ (1,0) [0|63] "NA" ASDM
 SG_ OBJ_POS_ERR_CRR_COEF_050 : 415|8@0+ (0.01,-1.2) [-1.2|1] "NA" ASDM
 SG_ OBJ_VELOCITY_ERR_CRR_COEF_050 : 423|8@0+ (0.01,-1.2) [-1.2|1] "NA" ASDM
 SG_ OBJ_ACCEL_ERR_CRR_COEF_050 : 431|8@0+ (0.01,-1.2) [-1.2|1] "NA" ASDM

BO_ 370 RDR_TRACKER_OBJ_051: 64 G5_RDR01
 SG_ OBJ_ALIVE_TIME_051 : 255|16@0+ (1,0) [0|65535] "ms" ASDM
 SG_ OBJ_ACCELERATION_LONG_ERR_051 : 215|8@0+ (0.025,0) [0|6.375] "m/s^2" ASDM
 SG_ OBJ_ACCELERATION_LAT_ERR_051 : 223|8@0+ (0.025,0) [0|6.375] "m/s^2" ASDM
 SG_ OBJ_VELOCITY_LONG_ERR_051 : 143|8@0+ (0.05,0) [0|12.75] "m/s" ASDM
 SG_ OBJ_VELOCITY_LAT_ERR_051 : 151|8@0+ (0.05,0) [0|12.75] "m/s" ASDM
 SG_ OBJ_POS_LONG_ERR_051 : 95|8@0+ (0.025,0) [0|6.375] "m" ASDM
 SG_ OBJ_POS_LAT_ERR_051 : 103|8@0+ (0.025,0) [0|6.375] "m" ASDM
 SG_ OBJ_TRACK_MOTION_MODEL_051 : 9|2@0+ (1,0) [1|3] "NA" ASDM
 SG_ OBJ_DIMENSION_WIDTH_051 : 17|10@0+ (0.01,0) [0|10.23] "m" ASDM
 SG_ OBJ_DIMENSION_LENGTH_051 : 37|12@0+ (0.01,0) [0|40.95] "m" ASDM
 SG_ OBJ_EXISTENCE_PROB_051 : 229|14@0+ (0.0001,0) [0|1] "NA" ASDM
 SG_ OBJ_YAW_ANGLE_051 : 155|12@0+ (0.005,-10) [-10|10.475] "rad" ASDM
 SG_ OBJ_YAW_ANGLE_ERR_051 : 175|7@0+ (0.01,0) [0|1.27] "rad" ASDM
 SG_ OBJ_ID_051 : 7|8@0+ (1,0) [0|255] "NA" ASDM
 SG_ OBJ_MOVEMENT_STATUS_051 : 196|3@0+ (1,0) [0|3] "NA" ASDM
 SG_ OBJ_MEASUREMENT_STATUS_051 : 14|3@0+ (1,0) [0|7] "NA" ASDM
 SG_ OBJ_POS_LONG_051 : 63|16@0+ (0.01,-327) [-327|327] "m" ASDM
 SG_ OBJ_POS_LAT_051 : 79|16@0+ (0.01,-327) [-327|327] "m" ASDM
 SG_ OBJ_VELOCITY_LONG_051 : 110|15@0+ (0.01,-163) [-163|163] "m/s" ASDM
 SG_ OBJ_VELOCITY_LAT_051 : 126|15@0+ (0.01,-163) [-163|163] "m/s" ASDM
 SG_ OBJ_ACCELERATION_LONG_051 : 193|10@0+ (0.05,-20) [-20|20] "m/s^2" ASDM
 SG_ OBJ_ACCELERATION_LAT_051 : 177|10@0+ (0.05,-20) [-20|20] "m/s^2" ASDM
 SG_ OBJ_VEH_TRACK_FLAG_051 : 10|1@0+ (1,0) [0|1] "NA" ASDM
 SG_ OBJ_MH_CYCLE_COUNTER_051 : 487|8@0+ (1,0) [0|255] "NA" ASDM
 SG_ OBJ_MH_CRC16_051 : 495|16@0+ (1,0) [0|65535] "NA" ASDM
 SG_ OBJ_TIMESTAMP_OFFSET_051 : 247|8@0+ (1,-127) [-127|128] "ms" ASDM
 SG_ OBJ_DIMENSION_WIDTH_ERR_051 : 23|6@0+ (0.01,0) [0|0.63] "m" ASDM
 SG_ OBJ_DIMENSION_LENGTH_ERR_051 : 41|10@0+ (0.01,0) [0|10.23] "m" ASDM
 SG_ OBJ_CLS_TYPE1_051 : 271|4@0+ (1,0) [0|15] "NA" ASDM
 SG_ OBJ_CLS_TYPE1_PROB_051 : 303|8@0+ (0.004,0) [0|1] "NA" ASDM
 SG_ OBJ_CLS_TYPE2_051 : 267|4@0+ (1,0) [0|15] "NA" ASDM
 SG_ OBJ_CLS_TYPE2_PROB_051 : 311|8@0+ (0.004,0) [0|1] "NA" ASDM
 SG_ OBJ_CLS_TYPE3_051 : 279|4@0+ (1,0) [0|15] "NA" ASDM
 SG_ OBJ_CLS_TYPE3_PROB_051 : 319|8@0+ (0.004,0) [0|1] "NA" ASDM
 SG_ OBJ_CLS_TYPE4_051 : 275|4@0+ (1,0) [0|15] "NA" ASDM
 SG_ OBJ_CLS_TYPE4_PROB_051 : 327|8@0+ (0.004,0) [0|1] "NA" ASDM
 SG_ OBJ_CLS_TYPE5_051 : 287|4@0+ (1,0) [0|15] "NA" ASDM
 SG_ OBJ_CLS_TYPE5_PROB_051 : 335|8@0+ (0.004,0) [0|1] "NA" ASDM
 SG_ OBJ_CLS_TYPE6_051 : 282|4@0+ (1,0) [0|15] "NA" ASDM
 SG_ OBJ_CLS_TYPE6_PROB_051 : 343|8@0+ (0.004,0) [0|1] "NA" ASDM
 SG_ OBJ_RCS_051 : 351|7@0+ (1,-64) [-64|63] "dBsm" ASDM
 SG_ OBJ_REF_PT_LONG_OFFSET_051 : 357|14@0+ (0.0001,0) [0|1] "NA" ASDM
 SG_ OBJ_REF_PT_LAT_OFFSET_051 : 370|14@0+ (0.0001,0) [0|1] "NA" ASDM
 SG_ OBJ_YAW_RATE_051 : 399|10@0+ (0.005,-2.24) [-2.24|2.24] "rad/s" ASDM
 SG_ OBJ_YAW_RATE_ERR_051 : 388|5@0+ (0.025,0) [0|0.775] "rad/s" ASDM
 SG_ OBJ_GROUP_ID_051 : 405|6@0+ (1,0) [0|63] "NA" ASDM
 SG_ OBJ_POS_ERR_CRR_COEF_051 : 415|8@0+ (0.01,-1.2) [-1.2|1] "NA" ASDM
 SG_ OBJ_VELOCITY_ERR_CRR_COEF_051 : 423|8@0+ (0.01,-1.2) [-1.2|1] "NA" ASDM
 SG_ OBJ_ACCEL_ERR_CRR_COEF_051 : 431|8@0+ (0.01,-1.2) [-1.2|1] "NA" ASDM

BO_ 371 RDR_TRACKER_OBJ_052: 64 G5_RDR01
 SG_ OBJ_ALIVE_TIME_052 : 255|16@0+ (1,0) [0|65535] "ms" ASDM
 SG_ OBJ_ACCELERATION_LONG_ERR_052 : 215|8@0+ (0.025,0) [0|6.375] "m/s^2" ASDM
 SG_ OBJ_ACCELERATION_LAT_ERR_052 : 223|8@0+ (0.025,0) [0|6.375] "m/s^2" ASDM
 SG_ OBJ_VELOCITY_LONG_ERR_052 : 143|8@0+ (0.05,0) [0|12.75] "m/s" ASDM
 SG_ OBJ_VELOCITY_LAT_ERR_052 : 151|8@0+ (0.05,0) [0|12.75] "m/s" ASDM
 SG_ OBJ_POS_LONG_ERR_052 : 95|8@0+ (0.025,0) [0|6.375] "m" ASDM
 SG_ OBJ_POS_LAT_ERR_052 : 103|8@0+ (0.025,0) [0|6.375] "m" ASDM
 SG_ OBJ_TRACK_MOTION_MODEL_052 : 9|2@0+ (1,0) [1|3] "NA" ASDM
 SG_ OBJ_DIMENSION_WIDTH_052 : 17|10@0+ (0.01,0) [0|10.23] "m" ASDM
 SG_ OBJ_DIMENSION_LENGTH_052 : 37|12@0+ (0.01,0) [0|40.95] "m" ASDM
 SG_ OBJ_EXISTENCE_PROB_052 : 229|14@0+ (0.0001,0) [0|1] "NA" ASDM
 SG_ OBJ_YAW_ANGLE_052 : 155|12@0+ (0.005,-10) [-10|10.475] "rad" ASDM
 SG_ OBJ_YAW_ANGLE_ERR_052 : 175|7@0+ (0.01,0) [0|1.27] "rad" ASDM
 SG_ OBJ_ID_052 : 7|8@0+ (1,0) [0|255] "NA" ASDM
 SG_ OBJ_MOVEMENT_STATUS_052 : 196|3@0+ (1,0) [0|3] "NA" ASDM
 SG_ OBJ_MEASUREMENT_STATUS_052 : 14|3@0+ (1,0) [0|7] "NA" ASDM
 SG_ OBJ_POS_LONG_052 : 63|16@0+ (0.01,-327) [-327|327] "m" ASDM
 SG_ OBJ_POS_LAT_052 : 79|16@0+ (0.01,-327) [-327|327] "m" ASDM
 SG_ OBJ_VELOCITY_LONG_052 : 110|15@0+ (0.01,-163) [-163|163] "m/s" ASDM
 SG_ OBJ_VELOCITY_LAT_052 : 126|15@0+ (0.01,-163) [-163|163] "m/s" ASDM
 SG_ OBJ_ACCELERATION_LONG_052 : 193|10@0+ (0.05,-20) [-20|20] "m/s^2" ASDM
 SG_ OBJ_ACCELERATION_LAT_052 : 177|10@0+ (0.05,-20) [-20|20] "m/s^2" ASDM
 SG_ OBJ_VEH_TRACK_FLAG_052 : 10|1@0+ (1,0) [0|1] "NA" ASDM
 SG_ OBJ_MH_CYCLE_COUNTER_052 : 487|8@0+ (1,0) [0|255] "NA" ASDM
 SG_ OBJ_MH_CRC16_052 : 495|16@0+ (1,0) [0|65535] "NA" ASDM
 SG_ OBJ_TIMESTAMP_OFFSET_052 : 247|8@0+ (1,-127) [-127|128] "ms" ASDM
 SG_ OBJ_DIMENSION_WIDTH_ERR_052 : 23|6@0+ (0.01,0) [0|0.63] "m" ASDM
 SG_ OBJ_DIMENSION_LENGTH_ERR_052 : 41|10@0+ (0.01,0) [0|10.23] "m" ASDM
 SG_ OBJ_CLS_TYPE1_052 : 271|4@0+ (1,0) [0|15] "NA" ASDM
 SG_ OBJ_CLS_TYPE1_PROB_052 : 303|8@0+ (0.004,0) [0|1] "NA" ASDM
 SG_ OBJ_CLS_TYPE2_052 : 267|4@0+ (1,0) [0|15] "NA" ASDM
 SG_ OBJ_CLS_TYPE2_PROB_052 : 311|8@0+ (0.004,0) [0|1] "NA" ASDM
 SG_ OBJ_CLS_TYPE3_052 : 279|4@0+ (1,0) [0|15] "NA" ASDM
 SG_ OBJ_CLS_TYPE3_PROB_052 : 319|8@0+ (0.004,0) [0|1] "NA" ASDM
 SG_ OBJ_CLS_TYPE4_052 : 275|4@0+ (1,0) [0|15] "NA" ASDM
 SG_ OBJ_CLS_TYPE4_PROB_052 : 327|8@0+ (0.004,0) [0|1] "NA" ASDM
 SG_ OBJ_CLS_TYPE5_052 : 287|4@0+ (1,0) [0|15] "NA" ASDM
 SG_ OBJ_CLS_TYPE5_PROB_052 : 335|8@0+ (0.004,0) [0|1] "NA" ASDM
 SG_ OBJ_CLS_TYPE6_052 : 282|4@0+ (1,0) [0|15] "NA" ASDM
 SG_ OBJ_CLS_TYPE6_PROB_052 : 343|8@0+ (0.004,0) [0|1] "NA" ASDM
 SG_ OBJ_RCS_052 : 351|7@0+ (1,-64) [-64|63] "dBsm" ASDM
 SG_ OBJ_REF_PT_LONG_OFFSET_052 : 357|14@0+ (0.0001,0) [0|1] "NA" ASDM
 SG_ OBJ_REF_PT_LAT_OFFSET_052 : 370|14@0+ (0.0001,0) [0|1] "NA" ASDM
 SG_ OBJ_YAW_RATE_052 : 399|10@0+ (0.005,-2.24) [-2.24|2.24] "rad/s" ASDM
 SG_ OBJ_YAW_RATE_ERR_052 : 388|5@0+ (0.025,0) [0|0.775] "rad/s" ASDM
 SG_ OBJ_GROUP_ID_052 : 405|6@0+ (1,0) [0|63] "NA" ASDM
 SG_ OBJ_POS_ERR_CRR_COEF_052 : 415|8@0+ (0.01,-1.2) [-1.2|1] "NA" ASDM
 SG_ OBJ_VELOCITY_ERR_CRR_COEF_052 : 423|8@0+ (0.01,-1.2) [-1.2|1] "NA" ASDM
 SG_ OBJ_ACCEL_ERR_CRR_COEF_052 : 431|8@0+ (0.01,-1.2) [-1.2|1] "NA" ASDM

BO_ 372 RDR_TRACKER_OBJ_053: 64 G5_RDR01
 SG_ OBJ_ALIVE_TIME_053 : 255|16@0+ (1,0) [0|65535] "ms" ASDM
 SG_ OBJ_ACCELERATION_LONG_ERR_053 : 215|8@0+ (0.025,0) [0|6.375] "m/s^2" ASDM
 SG_ OBJ_ACCELERATION_LAT_ERR_053 : 223|8@0+ (0.025,0) [0|6.375] "m/s^2" ASDM
 SG_ OBJ_VELOCITY_LONG_ERR_053 : 143|8@0+ (0.05,0) [0|12.75] "m/s" ASDM
 SG_ OBJ_VELOCITY_LAT_ERR_053 : 151|8@0+ (0.05,0) [0|12.75] "m/s" ASDM
 SG_ OBJ_POS_LONG_ERR_053 : 95|8@0+ (0.025,0) [0|6.375] "m" ASDM
 SG_ OBJ_POS_LAT_ERR_053 : 103|8@0+ (0.025,0) [0|6.375] "m" ASDM
 SG_ OBJ_TRACK_MOTION_MODEL_053 : 9|2@0+ (1,0) [1|3] "NA" ASDM
 SG_ OBJ_DIMENSION_WIDTH_053 : 17|10@0+ (0.01,0) [0|10.23] "m" ASDM
 SG_ OBJ_DIMENSION_LENGTH_053 : 37|12@0+ (0.01,0) [0|40.95] "m" ASDM
 SG_ OBJ_EXISTENCE_PROB_053 : 229|14@0+ (0.0001,0) [0|1] "NA" ASDM
 SG_ OBJ_YAW_ANGLE_053 : 155|12@0+ (0.005,-10) [-10|10.475] "rad" ASDM
 SG_ OBJ_YAW_ANGLE_ERR_053 : 175|7@0+ (0.01,0) [0|1.27] "rad" ASDM
 SG_ OBJ_ID_053 : 7|8@0+ (1,0) [0|255] "NA" ASDM
 SG_ OBJ_MOVEMENT_STATUS_053 : 196|3@0+ (1,0) [0|3] "NA" ASDM
 SG_ OBJ_MEASUREMENT_STATUS_053 : 14|3@0+ (1,0) [0|7] "NA" ASDM
 SG_ OBJ_POS_LONG_053 : 63|16@0+ (0.01,-327) [-327|327] "m" ASDM
 SG_ OBJ_POS_LAT_053 : 79|16@0+ (0.01,-327) [-327|327] "m" ASDM
 SG_ OBJ_VELOCITY_LONG_053 : 110|15@0+ (0.01,-163) [-163|163] "m/s" ASDM
 SG_ OBJ_VELOCITY_LAT_053 : 126|15@0+ (0.01,-163) [-163|163] "m/s" ASDM
 SG_ OBJ_ACCELERATION_LONG_053 : 193|10@0+ (0.05,-20) [-20|20] "m/s^2" ASDM
 SG_ OBJ_ACCELERATION_LAT_053 : 177|10@0+ (0.05,-20) [-20|20] "m/s^2" ASDM
 SG_ OBJ_VEH_TRACK_FLAG_053 : 10|1@0+ (1,0) [0|1] "NA" ASDM
 SG_ OBJ_MH_CYCLE_COUNTER_053 : 487|8@0+ (1,0) [0|255] "NA" ASDM
 SG_ OBJ_MH_CRC16_053 : 495|16@0+ (1,0) [0|65535] "NA" ASDM
 SG_ OBJ_TIMESTAMP_OFFSET_053 : 247|8@0+ (1,-127) [-127|128] "ms" ASDM
 SG_ OBJ_DIMENSION_WIDTH_ERR_053 : 23|6@0+ (0.01,0) [0|0.63] "m" ASDM
 SG_ OBJ_DIMENSION_LENGTH_ERR_053 : 41|10@0+ (0.01,0) [0|10.23] "m" ASDM
 SG_ OBJ_CLS_TYPE1_053 : 271|4@0+ (1,0) [0|15] "NA" ASDM
 SG_ OBJ_CLS_TYPE1_PROB_053 : 303|8@0+ (0.004,0) [0|1] "NA" ASDM
 SG_ OBJ_CLS_TYPE2_053 : 267|4@0+ (1,0) [0|15] "NA" ASDM
 SG_ OBJ_CLS_TYPE2_PROB_053 : 311|8@0+ (0.004,0) [0|1] "NA" ASDM
 SG_ OBJ_CLS_TYPE3_053 : 279|4@0+ (1,0) [0|15] "NA" ASDM
 SG_ OBJ_CLS_TYPE3_PROB_053 : 319|8@0+ (0.004,0) [0|1] "NA" ASDM
 SG_ OBJ_CLS_TYPE4_053 : 275|4@0+ (1,0) [0|15] "NA" ASDM
 SG_ OBJ_CLS_TYPE4_PROB_053 : 327|8@0+ (0.004,0) [0|1] "NA" ASDM
 SG_ OBJ_CLS_TYPE5_053 : 287|4@0+ (1,0) [0|15] "NA" ASDM
 SG_ OBJ_CLS_TYPE5_PROB_053 : 335|8@0+ (0.004,0) [0|1] "NA" ASDM
 SG_ OBJ_CLS_TYPE6_053 : 282|4@0+ (1,0) [0|15] "NA" ASDM
 SG_ OBJ_CLS_TYPE6_PROB_053 : 343|8@0+ (0.004,0) [0|1] "NA" ASDM
 SG_ OBJ_RCS_053 : 351|7@0+ (1,-64) [-64|63] "dBsm" ASDM
 SG_ OBJ_REF_PT_LONG_OFFSET_053 : 357|14@0+ (0.0001,0) [0|1] "NA" ASDM
 SG_ OBJ_REF_PT_LAT_OFFSET_053 : 370|14@0+ (0.0001,0) [0|1] "NA" ASDM
 SG_ OBJ_YAW_RATE_053 : 399|10@0+ (0.005,-2.24) [-2.24|2.24] "rad/s" ASDM
 SG_ OBJ_YAW_RATE_ERR_053 : 388|5@0+ (0.025,0) [0|0.775] "rad/s" ASDM
 SG_ OBJ_GROUP_ID_053 : 405|6@0+ (1,0) [0|63] "NA" ASDM
 SG_ OBJ_POS_ERR_CRR_COEF_053 : 415|8@0+ (0.01,-1.2) [-1.2|1] "NA" ASDM
 SG_ OBJ_VELOCITY_ERR_CRR_COEF_053 : 423|8@0+ (0.01,-1.2) [-1.2|1] "NA" ASDM
 SG_ OBJ_ACCEL_ERR_CRR_COEF_053 : 431|8@0+ (0.01,-1.2) [-1.2|1] "NA" ASDM

BO_ 373 RDR_TRACKER_OBJ_054: 64 G5_RDR01
 SG_ OBJ_ALIVE_TIME_054 : 255|16@0+ (1,0) [0|65535] "ms" ASDM
 SG_ OBJ_ACCELERATION_LONG_ERR_054 : 215|8@0+ (0.025,0) [0|6.375] "m/s^2" ASDM
 SG_ OBJ_ACCELERATION_LAT_ERR_054 : 223|8@0+ (0.025,0) [0|6.375] "m/s^2" ASDM
 SG_ OBJ_VELOCITY_LONG_ERR_054 : 143|8@0+ (0.05,0) [0|12.75] "m/s" ASDM
 SG_ OBJ_VELOCITY_LAT_ERR_054 : 151|8@0+ (0.05,0) [0|12.75] "m/s" ASDM
 SG_ OBJ_POS_LONG_ERR_054 : 95|8@0+ (0.025,0) [0|6.375] "m" ASDM
 SG_ OBJ_POS_LAT_ERR_054 : 103|8@0+ (0.025,0) [0|6.375] "m" ASDM
 SG_ OBJ_TRACK_MOTION_MODEL_054 : 9|2@0+ (1,0) [1|3] "NA" ASDM
 SG_ OBJ_DIMENSION_WIDTH_054 : 17|10@0+ (0.01,0) [0|10.23] "m" ASDM
 SG_ OBJ_DIMENSION_LENGTH_054 : 37|12@0+ (0.01,0) [0|40.95] "m" ASDM
 SG_ OBJ_EXISTENCE_PROB_054 : 229|14@0+ (0.0001,0) [0|1] "NA" ASDM
 SG_ OBJ_YAW_ANGLE_054 : 155|12@0+ (0.005,-10) [-10|10.475] "rad" ASDM
 SG_ OBJ_YAW_ANGLE_ERR_054 : 175|7@0+ (0.01,0) [0|1.27] "rad" ASDM
 SG_ OBJ_ID_054 : 7|8@0+ (1,0) [0|255] "NA" ASDM
 SG_ OBJ_MOVEMENT_STATUS_054 : 196|3@0+ (1,0) [0|3] "NA" ASDM
 SG_ OBJ_MEASUREMENT_STATUS_054 : 14|3@0+ (1,0) [0|7] "NA" ASDM
 SG_ OBJ_POS_LONG_054 : 63|16@0+ (0.01,-327) [-327|327] "m" ASDM
 SG_ OBJ_POS_LAT_054 : 79|16@0+ (0.01,-327) [-327|327] "m" ASDM
 SG_ OBJ_VELOCITY_LONG_054 : 110|15@0+ (0.01,-163) [-163|163] "m/s" ASDM
 SG_ OBJ_VELOCITY_LAT_054 : 126|15@0+ (0.01,-163) [-163|163] "m/s" ASDM
 SG_ OBJ_ACCELERATION_LONG_054 : 193|10@0+ (0.05,-20) [-20|20] "m/s^2" ASDM
 SG_ OBJ_ACCELERATION_LAT_054 : 177|10@0+ (0.05,-20) [-20|20] "m/s^2" ASDM
 SG_ OBJ_VEH_TRACK_FLAG_054 : 10|1@0+ (1,0) [0|1] "NA" ASDM
 SG_ OBJ_MH_CYCLE_COUNTER_054 : 487|8@0+ (1,0) [0|255] "NA" ASDM
 SG_ OBJ_MH_CRC16_054 : 495|16@0+ (1,0) [0|65535] "NA" ASDM
 SG_ OBJ_TIMESTAMP_OFFSET_054 : 247|8@0+ (1,-127) [-127|128] "ms" ASDM
 SG_ OBJ_DIMENSION_WIDTH_ERR_054 : 23|6@0+ (0.01,0) [0|0.63] "m" ASDM
 SG_ OBJ_DIMENSION_LENGTH_ERR_054 : 41|10@0+ (0.01,0) [0|10.23] "m" ASDM
 SG_ OBJ_CLS_TYPE1_054 : 271|4@0+ (1,0) [0|15] "NA" ASDM
 SG_ OBJ_CLS_TYPE1_PROB_054 : 303|8@0+ (0.004,0) [0|1] "NA" ASDM
 SG_ OBJ_CLS_TYPE2_054 : 267|4@0+ (1,0) [0|15] "NA" ASDM
 SG_ OBJ_CLS_TYPE2_PROB_054 : 311|8@0+ (0.004,0) [0|1] "NA" ASDM
 SG_ OBJ_CLS_TYPE3_054 : 279|4@0+ (1,0) [0|15] "NA" ASDM
 SG_ OBJ_CLS_TYPE3_PROB_054 : 319|8@0+ (0.004,0) [0|1] "NA" ASDM
 SG_ OBJ_CLS_TYPE4_054 : 275|4@0+ (1,0) [0|15] "NA" ASDM
 SG_ OBJ_CLS_TYPE4_PROB_054 : 327|8@0+ (0.004,0) [0|1] "NA" ASDM
 SG_ OBJ_CLS_TYPE5_054 : 287|4@0+ (1,0) [0|15] "NA" ASDM
 SG_ OBJ_CLS_TYPE5_PROB_054 : 335|8@0+ (0.004,0) [0|1] "NA" ASDM
 SG_ OBJ_CLS_TYPE6_054 : 282|4@0+ (1,0) [0|15] "NA" ASDM
 SG_ OBJ_CLS_TYPE6_PROB_054 : 343|8@0+ (0.004,0) [0|1] "NA" ASDM
 SG_ OBJ_RCS_054 : 351|7@0+ (1,-64) [-64|63] "dBsm" ASDM
 SG_ OBJ_REF_PT_LONG_OFFSET_054 : 357|14@0+ (0.0001,0) [0|1] "NA" ASDM
 SG_ OBJ_REF_PT_LAT_OFFSET_054 : 370|14@0+ (0.0001,0) [0|1] "NA" ASDM
 SG_ OBJ_YAW_RATE_054 : 399|10@0+ (0.005,-2.24) [-2.24|2.24] "rad/s" ASDM
 SG_ OBJ_YAW_RATE_ERR_054 : 388|5@0+ (0.025,0) [0|0.775] "rad/s" ASDM
 SG_ OBJ_GROUP_ID_054 : 405|6@0+ (1,0) [0|63] "NA" ASDM
 SG_ OBJ_POS_ERR_CRR_COEF_054 : 415|8@0+ (0.01,-1.2) [-1.2|1] "NA" ASDM
 SG_ OBJ_VELOCITY_ERR_CRR_COEF_054 : 423|8@0+ (0.01,-1.2) [-1.2|1] "NA" ASDM
 SG_ OBJ_ACCEL_ERR_CRR_COEF_054 : 431|8@0+ (0.01,-1.2) [-1.2|1] "NA" ASDM

BO_ 374 RDR_TRACKER_OBJ_055: 64 G5_RDR01
 SG_ OBJ_ALIVE_TIME_055 : 255|16@0+ (1,0) [0|65535] "ms" ASDM
 SG_ OBJ_ACCELERATION_LONG_ERR_055 : 215|8@0+ (0.025,0) [0|6.375] "m/s^2" ASDM
 SG_ OBJ_ACCELERATION_LAT_ERR_055 : 223|8@0+ (0.025,0) [0|6.375] "m/s^2" ASDM
 SG_ OBJ_VELOCITY_LONG_ERR_055 : 143|8@0+ (0.05,0) [0|12.75] "m/s" ASDM
 SG_ OBJ_VELOCITY_LAT_ERR_055 : 151|8@0+ (0.05,0) [0|12.75] "m/s" ASDM
 SG_ OBJ_POS_LONG_ERR_055 : 95|8@0+ (0.025,0) [0|6.375] "m" ASDM
 SG_ OBJ_POS_LAT_ERR_055 : 103|8@0+ (0.025,0) [0|6.375] "m" ASDM
 SG_ OBJ_TRACK_MOTION_MODEL_055 : 9|2@0+ (1,0) [1|3] "NA" ASDM
 SG_ OBJ_DIMENSION_WIDTH_055 : 17|10@0+ (0.01,0) [0|10.23] "m" ASDM
 SG_ OBJ_DIMENSION_LENGTH_055 : 37|12@0+ (0.01,0) [0|40.95] "m" ASDM
 SG_ OBJ_EXISTENCE_PROB_055 : 229|14@0+ (0.0001,0) [0|1] "NA" ASDM
 SG_ OBJ_YAW_ANGLE_055 : 155|12@0+ (0.005,-10) [-10|10.475] "rad" ASDM
 SG_ OBJ_YAW_ANGLE_ERR_055 : 175|7@0+ (0.01,0) [0|1.27] "rad" ASDM
 SG_ OBJ_ID_055 : 7|8@0+ (1,0) [0|255] "NA" ASDM
 SG_ OBJ_MOVEMENT_STATUS_055 : 196|3@0+ (1,0) [0|3] "NA" ASDM
 SG_ OBJ_MEASUREMENT_STATUS_055 : 14|3@0+ (1,0) [0|7] "NA" ASDM
 SG_ OBJ_POS_LONG_055 : 63|16@0+ (0.01,-327) [-327|327] "m" ASDM
 SG_ OBJ_POS_LAT_055 : 79|16@0+ (0.01,-327) [-327|327] "m" ASDM
 SG_ OBJ_VELOCITY_LONG_055 : 110|15@0+ (0.01,-163) [-163|163] "m/s" ASDM
 SG_ OBJ_VELOCITY_LAT_055 : 126|15@0+ (0.01,-163) [-163|163] "m/s" ASDM
 SG_ OBJ_ACCELERATION_LONG_055 : 193|10@0+ (0.05,-20) [-20|20] "m/s^2" ASDM
 SG_ OBJ_ACCELERATION_LAT_055 : 177|10@0+ (0.05,-20) [-20|20] "m/s^2" ASDM
 SG_ OBJ_VEH_TRACK_FLAG_055 : 10|1@0+ (1,0) [0|1] "NA" ASDM
 SG_ OBJ_MH_CYCLE_COUNTER_055 : 487|8@0+ (1,0) [0|255] "NA" ASDM
 SG_ OBJ_MH_CRC16_055 : 495|16@0+ (1,0) [0|65535] "NA" ASDM
 SG_ OBJ_TIMESTAMP_OFFSET_055 : 247|8@0+ (1,-127) [-127|128] "ms" ASDM
 SG_ OBJ_DIMENSION_WIDTH_ERR_055 : 23|6@0+ (0.01,0) [0|0.63] "m" ASDM
 SG_ OBJ_DIMENSION_LENGTH_ERR_055 : 41|10@0+ (0.01,0) [0|10.23] "m" ASDM
 SG_ OBJ_CLS_TYPE1_055 : 271|4@0+ (1,0) [0|15] "NA" ASDM
 SG_ OBJ_CLS_TYPE1_PROB_055 : 303|8@0+ (0.004,0) [0|1] "NA" ASDM
 SG_ OBJ_CLS_TYPE2_055 : 267|4@0+ (1,0) [0|15] "NA" ASDM
 SG_ OBJ_CLS_TYPE2_PROB_055 : 311|8@0+ (0.004,0) [0|1] "NA" ASDM
 SG_ OBJ_CLS_TYPE3_055 : 279|4@0+ (1,0) [0|15] "NA" ASDM
 SG_ OBJ_CLS_TYPE3_PROB_055 : 319|8@0+ (0.004,0) [0|1] "NA" ASDM
 SG_ OBJ_CLS_TYPE4_055 : 275|4@0+ (1,0) [0|15] "NA" ASDM
 SG_ OBJ_CLS_TYPE4_PROB_055 : 327|8@0+ (0.004,0) [0|1] "NA" ASDM
 SG_ OBJ_CLS_TYPE5_055 : 287|4@0+ (1,0) [0|15] "NA" ASDM
 SG_ OBJ_CLS_TYPE5_PROB_055 : 335|8@0+ (0.004,0) [0|1] "NA" ASDM
 SG_ OBJ_CLS_TYPE6_055 : 282|4@0+ (1,0) [0|15] "NA" ASDM
 SG_ OBJ_CLS_TYPE6_PROB_055 : 343|8@0+ (0.004,0) [0|1] "NA" ASDM
 SG_ OBJ_RCS_055 : 351|7@0+ (1,-64) [-64|63] "dBsm" ASDM
 SG_ OBJ_REF_PT_LONG_OFFSET_055 : 357|14@0+ (0.0001,0) [0|1] "NA" ASDM
 SG_ OBJ_REF_PT_LAT_OFFSET_055 : 370|14@0+ (0.0001,0) [0|1] "NA" ASDM
 SG_ OBJ_YAW_RATE_055 : 399|10@0+ (0.005,-2.24) [-2.24|2.24] "rad/s" ASDM
 SG_ OBJ_YAW_RATE_ERR_055 : 388|5@0+ (0.025,0) [0|0.775] "rad/s" ASDM
 SG_ OBJ_GROUP_ID_055 : 405|6@0+ (1,0) [0|63] "NA" ASDM
 SG_ OBJ_POS_ERR_CRR_COEF_055 : 415|8@0+ (0.01,-1.2) [-1.2|1] "NA" ASDM
 SG_ OBJ_VELOCITY_ERR_CRR_COEF_055 : 423|8@0+ (0.01,-1.2) [-1.2|1] "NA" ASDM
 SG_ OBJ_ACCEL_ERR_CRR_COEF_055 : 431|8@0+ (0.01,-1.2) [-1.2|1] "NA" ASDM

BO_ 375 RDR_TRACKER_OBJ_056: 64 G5_RDR01
 SG_ OBJ_ALIVE_TIME_056 : 255|16@0+ (1,0) [0|65535] "ms" ASDM
 SG_ OBJ_ACCELERATION_LONG_ERR_056 : 215|8@0+ (0.025,0) [0|6.375] "m/s^2" ASDM
 SG_ OBJ_ACCELERATION_LAT_ERR_056 : 223|8@0+ (0.025,0) [0|6.375] "m/s^2" ASDM
 SG_ OBJ_VELOCITY_LONG_ERR_056 : 143|8@0+ (0.05,0) [0|12.75] "m/s" ASDM
 SG_ OBJ_VELOCITY_LAT_ERR_056 : 151|8@0+ (0.05,0) [0|12.75] "m/s" ASDM
 SG_ OBJ_POS_LONG_ERR_056 : 95|8@0+ (0.025,0) [0|6.375] "m" ASDM
 SG_ OBJ_POS_LAT_ERR_056 : 103|8@0+ (0.025,0) [0|6.375] "m" ASDM
 SG_ OBJ_TRACK_MOTION_MODEL_056 : 9|2@0+ (1,0) [1|3] "NA" ASDM
 SG_ OBJ_DIMENSION_WIDTH_056 : 17|10@0+ (0.01,0) [0|10.23] "m" ASDM
 SG_ OBJ_DIMENSION_LENGTH_056 : 37|12@0+ (0.01,0) [0|40.95] "m" ASDM
 SG_ OBJ_EXISTENCE_PROB_056 : 229|14@0+ (0.0001,0) [0|1] "NA" ASDM
 SG_ OBJ_YAW_ANGLE_056 : 155|12@0+ (0.005,-10) [-10|10.475] "rad" ASDM
 SG_ OBJ_YAW_ANGLE_ERR_056 : 175|7@0+ (0.01,0) [0|1.27] "rad" ASDM
 SG_ OBJ_ID_056 : 7|8@0+ (1,0) [0|255] "NA" ASDM
 SG_ OBJ_MOVEMENT_STATUS_056 : 196|3@0+ (1,0) [0|3] "NA" ASDM
 SG_ OBJ_MEASUREMENT_STATUS_056 : 14|3@0+ (1,0) [0|7] "NA" ASDM
 SG_ OBJ_POS_LONG_056 : 63|16@0+ (0.01,-327) [-327|327] "m" ASDM
 SG_ OBJ_POS_LAT_056 : 79|16@0+ (0.01,-327) [-327|327] "m" ASDM
 SG_ OBJ_VELOCITY_LONG_056 : 110|15@0+ (0.01,-163) [-163|163] "m/s" ASDM
 SG_ OBJ_VELOCITY_LAT_056 : 126|15@0+ (0.01,-163) [-163|163] "m/s" ASDM
 SG_ OBJ_ACCELERATION_LONG_056 : 193|10@0+ (0.05,-20) [-20|20] "m/s^2" ASDM
 SG_ OBJ_ACCELERATION_LAT_056 : 177|10@0+ (0.05,-20) [-20|20] "m/s^2" ASDM
 SG_ OBJ_VEH_TRACK_FLAG_056 : 10|1@0+ (1,0) [0|1] "NA" ASDM
 SG_ OBJ_MH_CYCLE_COUNTER_056 : 487|8@0+ (1,0) [0|255] "NA" ASDM
 SG_ OBJ_MH_CRC16_056 : 495|16@0+ (1,0) [0|65535] "NA" ASDM
 SG_ OBJ_TIMESTAMP_OFFSET_056 : 247|8@0+ (1,-127) [-127|128] "ms" ASDM
 SG_ OBJ_DIMENSION_WIDTH_ERR_056 : 23|6@0+ (0.01,0) [0|0.63] "m" ASDM
 SG_ OBJ_DIMENSION_LENGTH_ERR_056 : 41|10@0+ (0.01,0) [0|10.23] "m" ASDM
 SG_ OBJ_CLS_TYPE1_056 : 271|4@0+ (1,0) [0|15] "NA" ASDM
 SG_ OBJ_CLS_TYPE1_PROB_056 : 303|8@0+ (0.004,0) [0|1] "NA" ASDM
 SG_ OBJ_CLS_TYPE2_056 : 267|4@0+ (1,0) [0|15] "NA" ASDM
 SG_ OBJ_CLS_TYPE2_PROB_056 : 311|8@0+ (0.004,0) [0|1] "NA" ASDM
 SG_ OBJ_CLS_TYPE3_056 : 279|4@0+ (1,0) [0|15] "NA" ASDM
 SG_ OBJ_CLS_TYPE3_PROB_056 : 319|8@0+ (0.004,0) [0|1] "NA" ASDM
 SG_ OBJ_CLS_TYPE4_056 : 275|4@0+ (1,0) [0|15] "NA" ASDM
 SG_ OBJ_CLS_TYPE4_PROB_056 : 327|8@0+ (0.004,0) [0|1] "NA" ASDM
 SG_ OBJ_CLS_TYPE5_056 : 287|4@0+ (1,0) [0|15] "NA" ASDM
 SG_ OBJ_CLS_TYPE5_PROB_056 : 335|8@0+ (0.004,0) [0|1] "NA" ASDM
 SG_ OBJ_CLS_TYPE6_056 : 282|4@0+ (1,0) [0|15] "NA" ASDM
 SG_ OBJ_CLS_TYPE6_PROB_056 : 343|8@0+ (0.004,0) [0|1] "NA" ASDM
 SG_ OBJ_RCS_056 : 351|7@0+ (1,-64) [-64|63] "dBsm" ASDM
 SG_ OBJ_REF_PT_LONG_OFFSET_056 : 357|14@0+ (0.0001,0) [0|1] "NA" ASDM
 SG_ OBJ_REF_PT_LAT_OFFSET_056 : 370|14@0+ (0.0001,0) [0|1] "NA" ASDM
 SG_ OBJ_YAW_RATE_056 : 399|10@0+ (0.005,-2.24) [-2.24|2.24] "rad/s" ASDM
 SG_ OBJ_YAW_RATE_ERR_056 : 388|5@0+ (0.025,0) [0|0.775] "rad/s" ASDM
 SG_ OBJ_GROUP_ID_056 : 405|6@0+ (1,0) [0|63] "NA" ASDM
 SG_ OBJ_POS_ERR_CRR_COEF_056 : 415|8@0+ (0.01,-1.2) [-1.2|1] "NA" ASDM
 SG_ OBJ_VELOCITY_ERR_CRR_COEF_056 : 423|8@0+ (0.01,-1.2) [-1.2|1] "NA" ASDM
 SG_ OBJ_ACCEL_ERR_CRR_COEF_056 : 431|8@0+ (0.01,-1.2) [-1.2|1] "NA" ASDM

BO_ 376 RDR_TRACKER_OBJ_057: 64 G5_RDR01
 SG_ OBJ_ALIVE_TIME_057 : 255|16@0+ (1,0) [0|65535] "ms" ASDM
 SG_ OBJ_ACCELERATION_LONG_ERR_057 : 215|8@0+ (0.025,0) [0|6.375] "m/s^2" ASDM
 SG_ OBJ_ACCELERATION_LAT_ERR_057 : 223|8@0+ (0.025,0) [0|6.375] "m/s^2" ASDM
 SG_ OBJ_VELOCITY_LONG_ERR_057 : 143|8@0+ (0.05,0) [0|12.75] "m/s" ASDM
 SG_ OBJ_VELOCITY_LAT_ERR_057 : 151|8@0+ (0.05,0) [0|12.75] "m/s" ASDM
 SG_ OBJ_POS_LONG_ERR_057 : 95|8@0+ (0.025,0) [0|6.375] "m" ASDM
 SG_ OBJ_POS_LAT_ERR_057 : 103|8@0+ (0.025,0) [0|6.375] "m" ASDM
 SG_ OBJ_TRACK_MOTION_MODEL_057 : 9|2@0+ (1,0) [1|3] "NA" ASDM
 SG_ OBJ_DIMENSION_WIDTH_057 : 17|10@0+ (0.01,0) [0|10.23] "m" ASDM
 SG_ OBJ_DIMENSION_LENGTH_057 : 37|12@0+ (0.01,0) [0|40.95] "m" ASDM
 SG_ OBJ_EXISTENCE_PROB_057 : 229|14@0+ (0.0001,0) [0|1] "NA" ASDM
 SG_ OBJ_YAW_ANGLE_057 : 155|12@0+ (0.005,-10) [-10|10.475] "rad" ASDM
 SG_ OBJ_YAW_ANGLE_ERR_057 : 175|7@0+ (0.01,0) [0|1.27] "rad" ASDM
 SG_ OBJ_ID_057 : 7|8@0+ (1,0) [0|255] "NA" ASDM
 SG_ OBJ_MOVEMENT_STATUS_057 : 196|3@0+ (1,0) [0|3] "NA" ASDM
 SG_ OBJ_MEASUREMENT_STATUS_057 : 14|3@0+ (1,0) [0|7] "NA" ASDM
 SG_ OBJ_POS_LONG_057 : 63|16@0+ (0.01,-327) [-327|327] "m" ASDM
 SG_ OBJ_POS_LAT_057 : 79|16@0+ (0.01,-327) [-327|327] "m" ASDM
 SG_ OBJ_VELOCITY_LONG_057 : 110|15@0+ (0.01,-163) [-163|163] "m/s" ASDM
 SG_ OBJ_VELOCITY_LAT_057 : 126|15@0+ (0.01,-163) [-163|163] "m/s" ASDM
 SG_ OBJ_ACCELERATION_LONG_057 : 193|10@0+ (0.05,-20) [-20|20] "m/s^2" ASDM
 SG_ OBJ_ACCELERATION_LAT_057 : 177|10@0+ (0.05,-20) [-20|20] "m/s^2" ASDM
 SG_ OBJ_VEH_TRACK_FLAG_057 : 10|1@0+ (1,0) [0|1] "NA" ASDM
 SG_ OBJ_MH_CYCLE_COUNTER_057 : 487|8@0+ (1,0) [0|255] "NA" ASDM
 SG_ OBJ_MH_CRC16_057 : 495|16@0+ (1,0) [0|65535] "NA" ASDM
 SG_ OBJ_TIMESTAMP_OFFSET_057 : 247|8@0+ (1,-127) [-127|128] "ms" ASDM
 SG_ OBJ_DIMENSION_WIDTH_ERR_057 : 23|6@0+ (0.01,0) [0|0.63] "m" ASDM
 SG_ OBJ_DIMENSION_LENGTH_ERR_057 : 41|10@0+ (0.01,0) [0|10.23] "m" ASDM
 SG_ OBJ_CLS_TYPE1_057 : 271|4@0+ (1,0) [0|15] "NA" ASDM
 SG_ OBJ_CLS_TYPE1_PROB_057 : 303|8@0+ (0.004,0) [0|1] "NA" ASDM
 SG_ OBJ_CLS_TYPE2_057 : 267|4@0+ (1,0) [0|15] "NA" ASDM
 SG_ OBJ_CLS_TYPE2_PROB_057 : 311|8@0+ (0.004,0) [0|1] "NA" ASDM
 SG_ OBJ_CLS_TYPE3_057 : 279|4@0+ (1,0) [0|15] "NA" ASDM
 SG_ OBJ_CLS_TYPE3_PROB_057 : 319|8@0+ (0.004,0) [0|1] "NA" ASDM
 SG_ OBJ_CLS_TYPE4_057 : 275|4@0+ (1,0) [0|15] "NA" ASDM
 SG_ OBJ_CLS_TYPE4_PROB_057 : 327|8@0+ (0.004,0) [0|1] "NA" ASDM
 SG_ OBJ_CLS_TYPE5_057 : 287|4@0+ (1,0) [0|15] "NA" ASDM
 SG_ OBJ_CLS_TYPE5_PROB_057 : 335|8@0+ (0.004,0) [0|1] "NA" ASDM
 SG_ OBJ_CLS_TYPE6_057 : 282|4@0+ (1,0) [0|15] "NA" ASDM
 SG_ OBJ_CLS_TYPE6_PROB_057 : 343|8@0+ (0.004,0) [0|1] "NA" ASDM
 SG_ OBJ_RCS_057 : 351|7@0+ (1,-64) [-64|63] "dBsm" ASDM
 SG_ OBJ_REF_PT_LONG_OFFSET_057 : 357|14@0+ (0.0001,0) [0|1] "NA" ASDM
 SG_ OBJ_REF_PT_LAT_OFFSET_057 : 370|14@0+ (0.0001,0) [0|1] "NA" ASDM
 SG_ OBJ_YAW_RATE_057 : 399|10@0+ (0.005,-2.24) [-2.24|2.24] "rad/s" ASDM
 SG_ OBJ_YAW_RATE_ERR_057 : 388|5@0+ (0.025,0) [0|0.775] "rad/s" ASDM
 SG_ OBJ_GROUP_ID_057 : 405|6@0+ (1,0) [0|63] "NA" ASDM
 SG_ OBJ_POS_ERR_CRR_COEF_057 : 415|8@0+ (0.01,-1.2) [-1.2|1] "NA" ASDM
 SG_ OBJ_VELOCITY_ERR_CRR_COEF_057 : 423|8@0+ (0.01,-1.2) [-1.2|1] "NA" ASDM
 SG_ OBJ_ACCEL_ERR_CRR_COEF_057 : 431|8@0+ (0.01,-1.2) [-1.2|1] "NA" ASDM

BO_ 377 RDR_TRACKER_OBJ_058: 64 G5_RDR01
 SG_ OBJ_ALIVE_TIME_058 : 255|16@0+ (1,0) [0|65535] "ms" ASDM
 SG_ OBJ_ACCELERATION_LONG_ERR_058 : 215|8@0+ (0.025,0) [0|6.375] "m/s^2" ASDM
 SG_ OBJ_ACCELERATION_LAT_ERR_058 : 223|8@0+ (0.025,0) [0|6.375] "m/s^2" ASDM
 SG_ OBJ_VELOCITY_LONG_ERR_058 : 143|8@0+ (0.05,0) [0|12.75] "m/s" ASDM
 SG_ OBJ_VELOCITY_LAT_ERR_058 : 151|8@0+ (0.05,0) [0|12.75] "m/s" ASDM
 SG_ OBJ_POS_LONG_ERR_058 : 95|8@0+ (0.025,0) [0|6.375] "m" ASDM
 SG_ OBJ_POS_LAT_ERR_058 : 103|8@0+ (0.025,0) [0|6.375] "m" ASDM
 SG_ OBJ_TRACK_MOTION_MODEL_058 : 9|2@0+ (1,0) [1|3] "NA" ASDM
 SG_ OBJ_DIMENSION_WIDTH_058 : 17|10@0+ (0.01,0) [0|10.23] "m" ASDM
 SG_ OBJ_DIMENSION_LENGTH_058 : 37|12@0+ (0.01,0) [0|40.95] "m" ASDM
 SG_ OBJ_EXISTENCE_PROB_058 : 229|14@0+ (0.0001,0) [0|1] "NA" ASDM
 SG_ OBJ_YAW_ANGLE_058 : 155|12@0+ (0.005,-10) [-10|10.475] "rad" ASDM
 SG_ OBJ_YAW_ANGLE_ERR_058 : 175|7@0+ (0.01,0) [0|1.27] "rad" ASDM
 SG_ OBJ_ID_058 : 7|8@0+ (1,0) [0|255] "NA" ASDM
 SG_ OBJ_MOVEMENT_STATUS_058 : 196|3@0+ (1,0) [0|3] "NA" ASDM
 SG_ OBJ_MEASUREMENT_STATUS_058 : 14|3@0+ (1,0) [0|7] "NA" ASDM
 SG_ OBJ_POS_LONG_058 : 63|16@0+ (0.01,-327) [-327|327] "m" ASDM
 SG_ OBJ_POS_LAT_058 : 79|16@0+ (0.01,-327) [-327|327] "m" ASDM
 SG_ OBJ_VELOCITY_LONG_058 : 110|15@0+ (0.01,-163) [-163|163] "m/s" ASDM
 SG_ OBJ_VELOCITY_LAT_058 : 126|15@0+ (0.01,-163) [-163|163] "m/s" ASDM
 SG_ OBJ_ACCELERATION_LONG_058 : 193|10@0+ (0.05,-20) [-20|20] "m/s^2" ASDM
 SG_ OBJ_ACCELERATION_LAT_058 : 177|10@0+ (0.05,-20) [-20|20] "m/s^2" ASDM
 SG_ OBJ_VEH_TRACK_FLAG_058 : 10|1@0+ (1,0) [0|1] "NA" ASDM
 SG_ OBJ_MH_CYCLE_COUNTER_058 : 487|8@0+ (1,0) [0|255] "NA" ASDM
 SG_ OBJ_MH_CRC16_058 : 495|16@0+ (1,0) [0|65535] "NA" ASDM
 SG_ OBJ_TIMESTAMP_OFFSET_058 : 247|8@0+ (1,-127) [-127|128] "ms" ASDM
 SG_ OBJ_DIMENSION_WIDTH_ERR_058 : 23|6@0+ (0.01,0) [0|0.63] "m" ASDM
 SG_ OBJ_DIMENSION_LENGTH_ERR_058 : 41|10@0+ (0.01,0) [0|10.23] "m" ASDM
 SG_ OBJ_CLS_TYPE1_058 : 271|4@0+ (1,0) [0|15] "NA" ASDM
 SG_ OBJ_CLS_TYPE1_PROB_058 : 303|8@0+ (0.004,0) [0|1] "NA" ASDM
 SG_ OBJ_CLS_TYPE2_058 : 267|4@0+ (1,0) [0|15] "NA" ASDM
 SG_ OBJ_CLS_TYPE2_PROB_058 : 311|8@0+ (0.004,0) [0|1] "NA" ASDM
 SG_ OBJ_CLS_TYPE3_058 : 279|4@0+ (1,0) [0|15] "NA" ASDM
 SG_ OBJ_CLS_TYPE3_PROB_058 : 319|8@0+ (0.004,0) [0|1] "NA" ASDM
 SG_ OBJ_CLS_TYPE4_058 : 275|4@0+ (1,0) [0|15] "NA" ASDM
 SG_ OBJ_CLS_TYPE4_PROB_058 : 327|8@0+ (0.004,0) [0|1] "NA" ASDM
 SG_ OBJ_CLS_TYPE5_058 : 287|4@0+ (1,0) [0|15] "NA" ASDM
 SG_ OBJ_CLS_TYPE5_PROB_058 : 335|8@0+ (0.004,0) [0|1] "NA" ASDM
 SG_ OBJ_CLS_TYPE6_058 : 282|4@0+ (1,0) [0|15] "NA" ASDM
 SG_ OBJ_CLS_TYPE6_PROB_058 : 343|8@0+ (0.004,0) [0|1] "NA" ASDM
 SG_ OBJ_RCS_058 : 351|7@0+ (1,-64) [-64|63] "dBsm" ASDM
 SG_ OBJ_REF_PT_LONG_OFFSET_058 : 357|14@0+ (0.0001,0) [0|1] "NA" ASDM
 SG_ OBJ_REF_PT_LAT_OFFSET_058 : 370|14@0+ (0.0001,0) [0|1] "NA" ASDM
 SG_ OBJ_YAW_RATE_058 : 399|10@0+ (0.005,-2.24) [-2.24|2.24] "rad/s" ASDM
 SG_ OBJ_YAW_RATE_ERR_058 : 388|5@0+ (0.025,0) [0|0.775] "rad/s" ASDM
 SG_ OBJ_GROUP_ID_058 : 405|6@0+ (1,0) [0|63] "NA" ASDM
 SG_ OBJ_POS_ERR_CRR_COEF_058 : 415|8@0+ (0.01,-1.2) [-1.2|1] "NA" ASDM
 SG_ OBJ_VELOCITY_ERR_CRR_COEF_058 : 423|8@0+ (0.01,-1.2) [-1.2|1] "NA" ASDM
 SG_ OBJ_ACCEL_ERR_CRR_COEF_058 : 431|8@0+ (0.01,-1.2) [-1.2|1] "NA" ASDM

BO_ 378 RDR_TRACKER_OBJ_059: 64 G5_RDR01
 SG_ OBJ_ALIVE_TIME_059 : 255|16@0+ (1,0) [0|65535] "ms" ASDM
 SG_ OBJ_ACCELERATION_LONG_ERR_059 : 215|8@0+ (0.025,0) [0|6.375] "m/s^2" ASDM
 SG_ OBJ_ACCELERATION_LAT_ERR_059 : 223|8@0+ (0.025,0) [0|6.375] "m/s^2" ASDM
 SG_ OBJ_VELOCITY_LONG_ERR_059 : 143|8@0+ (0.05,0) [0|12.75] "m/s" ASDM
 SG_ OBJ_VELOCITY_LAT_ERR_059 : 151|8@0+ (0.05,0) [0|12.75] "m/s" ASDM
 SG_ OBJ_POS_LONG_ERR_059 : 95|8@0+ (0.025,0) [0|6.375] "m" ASDM
 SG_ OBJ_POS_LAT_ERR_059 : 103|8@0+ (0.025,0) [0|6.375] "m" ASDM
 SG_ OBJ_TRACK_MOTION_MODEL_059 : 9|2@0+ (1,0) [1|3] "NA" ASDM
 SG_ OBJ_DIMENSION_WIDTH_059 : 17|10@0+ (0.01,0) [0|10.23] "m" ASDM
 SG_ OBJ_DIMENSION_LENGTH_059 : 37|12@0+ (0.01,0) [0|40.95] "m" ASDM
 SG_ OBJ_EXISTENCE_PROB_059 : 229|14@0+ (0.0001,0) [0|1] "NA" ASDM
 SG_ OBJ_YAW_ANGLE_059 : 155|12@0+ (0.005,-10) [-10|10.475] "rad" ASDM
 SG_ OBJ_YAW_ANGLE_ERR_059 : 175|7@0+ (0.01,0) [0|1.27] "rad" ASDM
 SG_ OBJ_ID_059 : 7|8@0+ (1,0) [0|255] "NA" ASDM
 SG_ OBJ_MOVEMENT_STATUS_059 : 196|3@0+ (1,0) [0|3] "NA" ASDM
 SG_ OBJ_MEASUREMENT_STATUS_059 : 14|3@0+ (1,0) [0|7] "NA" ASDM
 SG_ OBJ_POS_LONG_059 : 63|16@0+ (0.01,-327) [-327|327] "m" ASDM
 SG_ OBJ_POS_LAT_059 : 79|16@0+ (0.01,-327) [-327|327] "m" ASDM
 SG_ OBJ_VELOCITY_LONG_059 : 110|15@0+ (0.01,-163) [-163|163] "m/s" ASDM
 SG_ OBJ_VELOCITY_LAT_059 : 126|15@0+ (0.01,-163) [-163|163] "m/s" ASDM
 SG_ OBJ_ACCELERATION_LONG_059 : 193|10@0+ (0.05,-20) [-20|20] "m/s^2" ASDM
 SG_ OBJ_ACCELERATION_LAT_059 : 177|10@0+ (0.05,-20) [-20|20] "m/s^2" ASDM
 SG_ OBJ_VEH_TRACK_FLAG_059 : 10|1@0+ (1,0) [0|1] "NA" ASDM
 SG_ OBJ_MH_CYCLE_COUNTER_059 : 487|8@0+ (1,0) [0|255] "NA" ASDM
 SG_ OBJ_MH_CRC16_059 : 495|16@0+ (1,0) [0|65535] "NA" ASDM
 SG_ OBJ_TIMESTAMP_OFFSET_059 : 247|8@0+ (1,-127) [-127|128] "ms" ASDM
 SG_ OBJ_DIMENSION_WIDTH_ERR_059 : 23|6@0+ (0.01,0) [0|0.63] "m" ASDM
 SG_ OBJ_DIMENSION_LENGTH_ERR_059 : 41|10@0+ (0.01,0) [0|10.23] "m" ASDM
 SG_ OBJ_CLS_TYPE1_059 : 271|4@0+ (1,0) [0|15] "NA" ASDM
 SG_ OBJ_CLS_TYPE1_PROB_059 : 303|8@0+ (0.004,0) [0|1] "NA" ASDM
 SG_ OBJ_CLS_TYPE2_059 : 267|4@0+ (1,0) [0|15] "NA" ASDM
 SG_ OBJ_CLS_TYPE2_PROB_059 : 311|8@0+ (0.004,0) [0|1] "NA" ASDM
 SG_ OBJ_CLS_TYPE3_059 : 279|4@0+ (1,0) [0|15] "NA" ASDM
 SG_ OBJ_CLS_TYPE3_PROB_059 : 319|8@0+ (0.004,0) [0|1] "NA" ASDM
 SG_ OBJ_CLS_TYPE4_059 : 275|4@0+ (1,0) [0|15] "NA" ASDM
 SG_ OBJ_CLS_TYPE4_PROB_059 : 327|8@0+ (0.004,0) [0|1] "NA" ASDM
 SG_ OBJ_CLS_TYPE5_059 : 287|4@0+ (1,0) [0|15] "NA" ASDM
 SG_ OBJ_CLS_TYPE5_PROB_059 : 335|8@0+ (0.004,0) [0|1] "NA" ASDM
 SG_ OBJ_CLS_TYPE6_059 : 282|4@0+ (1,0) [0|15] "NA" ASDM
 SG_ OBJ_CLS_TYPE6_PROB_059 : 343|8@0+ (0.004,0) [0|1] "NA" ASDM
 SG_ OBJ_RCS_059 : 351|7@0+ (1,-64) [-64|63] "dBsm" ASDM
 SG_ OBJ_REF_PT_LONG_OFFSET_059 : 357|14@0+ (0.0001,0) [0|1] "NA" ASDM
 SG_ OBJ_REF_PT_LAT_OFFSET_059 : 370|14@0+ (0.0001,0) [0|1] "NA" ASDM
 SG_ OBJ_YAW_RATE_059 : 399|10@0+ (0.005,-2.24) [-2.24|2.24] "rad/s" ASDM
 SG_ OBJ_YAW_RATE_ERR_059 : 388|5@0+ (0.025,0) [0|0.775] "rad/s" ASDM
 SG_ OBJ_GROUP_ID_059 : 405|6@0+ (1,0) [0|63] "NA" ASDM
 SG_ OBJ_POS_ERR_CRR_COEF_059 : 415|8@0+ (0.01,-1.2) [-1.2|1] "NA" ASDM
 SG_ OBJ_VELOCITY_ERR_CRR_COEF_059 : 423|8@0+ (0.01,-1.2) [-1.2|1] "NA" ASDM
 SG_ OBJ_ACCEL_ERR_CRR_COEF_059 : 431|8@0+ (0.01,-1.2) [-1.2|1] "NA" ASDM

BO_ 379 RDR_TRACKER_OBJ_060: 64 G5_RDR01
 SG_ OBJ_ALIVE_TIME_060 : 255|16@0+ (1,0) [0|65535] "ms" ASDM
 SG_ OBJ_ACCELERATION_LONG_ERR_060 : 215|8@0+ (0.025,0) [0|6.375] "m/s^2" ASDM
 SG_ OBJ_ACCELERATION_LAT_ERR_060 : 223|8@0+ (0.025,0) [0|6.375] "m/s^2" ASDM
 SG_ OBJ_VELOCITY_LONG_ERR_060 : 143|8@0+ (0.05,0) [0|12.75] "m/s" ASDM
 SG_ OBJ_VELOCITY_LAT_ERR_060 : 151|8@0+ (0.05,0) [0|12.75] "m/s" ASDM
 SG_ OBJ_POS_LONG_ERR_060 : 95|8@0+ (0.025,0) [0|6.375] "m" ASDM
 SG_ OBJ_POS_LAT_ERR_060 : 103|8@0+ (0.025,0) [0|6.375] "m" ASDM
 SG_ OBJ_TRACK_MOTION_MODEL_060 : 9|2@0+ (1,0) [1|3] "NA" ASDM
 SG_ OBJ_DIMENSION_WIDTH_060 : 17|10@0+ (0.01,0) [0|10.23] "m" ASDM
 SG_ OBJ_DIMENSION_LENGTH_060 : 37|12@0+ (0.01,0) [0|40.95] "m" ASDM
 SG_ OBJ_EXISTENCE_PROB_060 : 229|14@0+ (0.0001,0) [0|1] "NA" ASDM
 SG_ OBJ_YAW_ANGLE_060 : 155|12@0+ (0.005,-10) [-10|10.475] "rad" ASDM
 SG_ OBJ_YAW_ANGLE_ERR_060 : 175|7@0+ (0.01,0) [0|1.27] "rad" ASDM
 SG_ OBJ_ID_060 : 7|8@0+ (1,0) [0|255] "NA" ASDM
 SG_ OBJ_MOVEMENT_STATUS_060 : 196|3@0+ (1,0) [0|3] "NA" ASDM
 SG_ OBJ_MEASUREMENT_STATUS_060 : 14|3@0+ (1,0) [0|7] "NA" ASDM
 SG_ OBJ_POS_LONG_060 : 63|16@0+ (0.01,-327) [-327|327] "m" ASDM
 SG_ OBJ_POS_LAT_060 : 79|16@0+ (0.01,-327) [-327|327] "m" ASDM
 SG_ OBJ_VELOCITY_LONG_060 : 110|15@0+ (0.01,-163) [-163|163] "m/s" ASDM
 SG_ OBJ_VELOCITY_LAT_060 : 126|15@0+ (0.01,-163) [-163|163] "m/s" ASDM
 SG_ OBJ_ACCELERATION_LONG_060 : 193|10@0+ (0.05,-20) [-20|20] "m/s^2" ASDM
 SG_ OBJ_ACCELERATION_LAT_060 : 177|10@0+ (0.05,-20) [-20|20] "m/s^2" ASDM
 SG_ OBJ_VEH_TRACK_FLAG_060 : 10|1@0+ (1,0) [0|1] "NA" ASDM
 SG_ OBJ_MH_CYCLE_COUNTER_060 : 487|8@0+ (1,0) [0|255] "NA" ASDM
 SG_ OBJ_MH_CRC16_060 : 495|16@0+ (1,0) [0|65535] "NA" ASDM
 SG_ OBJ_TIMESTAMP_OFFSET_060 : 247|8@0+ (1,-127) [-127|128] "ms" ASDM
 SG_ OBJ_DIMENSION_WIDTH_ERR_060 : 23|6@0+ (0.01,0) [0|0.63] "m" ASDM
 SG_ OBJ_DIMENSION_LENGTH_ERR_060 : 41|10@0+ (0.01,0) [0|10.23] "m" ASDM
 SG_ OBJ_CLS_TYPE1_060 : 271|4@0+ (1,0) [0|15] "NA" ASDM
 SG_ OBJ_CLS_TYPE1_PROB_060 : 303|8@0+ (0.004,0) [0|1] "NA" ASDM
 SG_ OBJ_CLS_TYPE2_060 : 267|4@0+ (1,0) [0|15] "NA" ASDM
 SG_ OBJ_CLS_TYPE2_PROB_060 : 311|8@0+ (0.004,0) [0|1] "NA" ASDM
 SG_ OBJ_CLS_TYPE3_060 : 279|4@0+ (1,0) [0|15] "NA" ASDM
 SG_ OBJ_CLS_TYPE3_PROB_060 : 319|8@0+ (0.004,0) [0|1] "NA" ASDM
 SG_ OBJ_CLS_TYPE4_060 : 275|4@0+ (1,0) [0|15] "NA" ASDM
 SG_ OBJ_CLS_TYPE4_PROB_060 : 327|8@0+ (0.004,0) [0|1] "NA" ASDM
 SG_ OBJ_CLS_TYPE5_060 : 287|4@0+ (1,0) [0|15] "NA" ASDM
 SG_ OBJ_CLS_TYPE5_PROB_060 : 335|8@0+ (0.004,0) [0|1] "NA" ASDM
 SG_ OBJ_CLS_TYPE6_060 : 282|4@0+ (1,0) [0|15] "NA" ASDM
 SG_ OBJ_CLS_TYPE6_PROB_060 : 343|8@0+ (0.004,0) [0|1] "NA" ASDM
 SG_ OBJ_RCS_060 : 351|7@0+ (1,-64) [-64|63] "dBsm" ASDM
 SG_ OBJ_REF_PT_LONG_OFFSET_060 : 357|14@0+ (0.0001,0) [0|1] "NA" ASDM
 SG_ OBJ_REF_PT_LAT_OFFSET_060 : 370|14@0+ (0.0001,0) [0|1] "NA" ASDM
 SG_ OBJ_YAW_RATE_060 : 399|10@0+ (0.005,-2.24) [-2.24|2.24] "rad/s" ASDM
 SG_ OBJ_YAW_RATE_ERR_060 : 388|5@0+ (0.025,0) [0|0.775] "rad/s" ASDM
 SG_ OBJ_GROUP_ID_060 : 405|6@0+ (1,0) [0|63] "NA" ASDM
 SG_ OBJ_POS_ERR_CRR_COEF_060 : 415|8@0+ (0.01,-1.2) [-1.2|1] "NA" ASDM
 SG_ OBJ_VELOCITY_ERR_CRR_COEF_060 : 423|8@0+ (0.01,-1.2) [-1.2|1] "NA" ASDM
 SG_ OBJ_ACCEL_ERR_CRR_COEF_060 : 431|8@0+ (0.01,-1.2) [-1.2|1] "NA" ASDM

BO_ 380 RDR_TRACKER_OBJ_061: 64 G5_RDR01
 SG_ OBJ_ALIVE_TIME_061 : 255|16@0+ (1,0) [0|65535] "ms" ASDM
 SG_ OBJ_ACCELERATION_LONG_ERR_061 : 215|8@0+ (0.025,0) [0|6.375] "m/s^2" ASDM
 SG_ OBJ_ACCELERATION_LAT_ERR_061 : 223|8@0+ (0.025,0) [0|6.375] "m/s^2" ASDM
 SG_ OBJ_VELOCITY_LONG_ERR_061 : 143|8@0+ (0.05,0) [0|12.75] "m/s" ASDM
 SG_ OBJ_VELOCITY_LAT_ERR_061 : 151|8@0+ (0.05,0) [0|12.75] "m/s" ASDM
 SG_ OBJ_POS_LONG_ERR_061 : 95|8@0+ (0.025,0) [0|6.375] "m" ASDM
 SG_ OBJ_POS_LAT_ERR_061 : 103|8@0+ (0.025,0) [0|6.375] "m" ASDM
 SG_ OBJ_TRACK_MOTION_MODEL_061 : 9|2@0+ (1,0) [1|3] "NA" ASDM
 SG_ OBJ_DIMENSION_WIDTH_061 : 17|10@0+ (0.01,0) [0|10.23] "m" ASDM
 SG_ OBJ_DIMENSION_LENGTH_061 : 37|12@0+ (0.01,0) [0|40.95] "m" ASDM
 SG_ OBJ_EXISTENCE_PROB_061 : 229|14@0+ (0.0001,0) [0|1] "NA" ASDM
 SG_ OBJ_YAW_ANGLE_061 : 155|12@0+ (0.005,-10) [-10|10.475] "rad" ASDM
 SG_ OBJ_YAW_ANGLE_ERR_061 : 175|7@0+ (0.01,0) [0|1.27] "rad" ASDM
 SG_ OBJ_ID_061 : 7|8@0+ (1,0) [0|255] "NA" ASDM
 SG_ OBJ_MOVEMENT_STATUS_061 : 196|3@0+ (1,0) [0|3] "NA" ASDM
 SG_ OBJ_MEASUREMENT_STATUS_061 : 14|3@0+ (1,0) [0|7] "NA" ASDM
 SG_ OBJ_POS_LONG_061 : 63|16@0+ (0.01,-327) [-327|327] "m" ASDM
 SG_ OBJ_POS_LAT_061 : 79|16@0+ (0.01,-327) [-327|327] "m" ASDM
 SG_ OBJ_VELOCITY_LONG_061 : 110|15@0+ (0.01,-163) [-163|163] "m/s" ASDM
 SG_ OBJ_VELOCITY_LAT_061 : 126|15@0+ (0.01,-163) [-163|163] "m/s" ASDM
 SG_ OBJ_ACCELERATION_LONG_061 : 193|10@0+ (0.05,-20) [-20|20] "m/s^2" ASDM
 SG_ OBJ_ACCELERATION_LAT_061 : 177|10@0+ (0.05,-20) [-20|20] "m/s^2" ASDM
 SG_ OBJ_VEH_TRACK_FLAG_061 : 10|1@0+ (1,0) [0|1] "NA" ASDM
 SG_ OBJ_MH_CYCLE_COUNTER_061 : 487|8@0+ (1,0) [0|255] "NA" ASDM
 SG_ OBJ_MH_CRC16_061 : 495|16@0+ (1,0) [0|65535] "NA" ASDM
 SG_ OBJ_TIMESTAMP_OFFSET_061 : 247|8@0+ (1,-127) [-127|128] "ms" ASDM
 SG_ OBJ_DIMENSION_WIDTH_ERR_061 : 23|6@0+ (0.01,0) [0|0.63] "m" ASDM
 SG_ OBJ_DIMENSION_LENGTH_ERR_061 : 41|10@0+ (0.01,0) [0|10.23] "m" ASDM
 SG_ OBJ_CLS_TYPE1_061 : 271|4@0+ (1,0) [0|15] "NA" ASDM
 SG_ OBJ_CLS_TYPE1_PROB_061 : 303|8@0+ (0.004,0) [0|1] "NA" ASDM
 SG_ OBJ_CLS_TYPE2_061 : 267|4@0+ (1,0) [0|15] "NA" ASDM
 SG_ OBJ_CLS_TYPE2_PROB_061 : 311|8@0+ (0.004,0) [0|1] "NA" ASDM
 SG_ OBJ_CLS_TYPE3_061 : 279|4@0+ (1,0) [0|15] "NA" ASDM
 SG_ OBJ_CLS_TYPE3_PROB_061 : 319|8@0+ (0.004,0) [0|1] "NA" ASDM
 SG_ OBJ_CLS_TYPE4_061 : 275|4@0+ (1,0) [0|15] "NA" ASDM
 SG_ OBJ_CLS_TYPE4_PROB_061 : 327|8@0+ (0.004,0) [0|1] "NA" ASDM
 SG_ OBJ_CLS_TYPE5_061 : 287|4@0+ (1,0) [0|15] "NA" ASDM
 SG_ OBJ_CLS_TYPE5_PROB_061 : 335|8@0+ (0.004,0) [0|1] "NA" ASDM
 SG_ OBJ_CLS_TYPE6_061 : 282|4@0+ (1,0) [0|15] "NA" ASDM
 SG_ OBJ_CLS_TYPE6_PROB_061 : 343|8@0+ (0.004,0) [0|1] "NA" ASDM
 SG_ OBJ_RCS_061 : 351|7@0+ (1,-64) [-64|63] "dBsm" ASDM
 SG_ OBJ_REF_PT_LONG_OFFSET_061 : 357|14@0+ (0.0001,0) [0|1] "NA" ASDM
 SG_ OBJ_REF_PT_LAT_OFFSET_061 : 370|14@0+ (0.0001,0) [0|1] "NA" ASDM
 SG_ OBJ_YAW_RATE_061 : 399|10@0+ (0.005,-2.24) [-2.24|2.24] "rad/s" ASDM
 SG_ OBJ_YAW_RATE_ERR_061 : 388|5@0+ (0.025,0) [0|0.775] "rad/s" ASDM
 SG_ OBJ_GROUP_ID_061 : 405|6@0+ (1,0) [0|63] "NA" ASDM
 SG_ OBJ_POS_ERR_CRR_COEF_061 : 415|8@0+ (0.01,-1.2) [-1.2|1] "NA" ASDM
 SG_ OBJ_VELOCITY_ERR_CRR_COEF_061 : 423|8@0+ (0.01,-1.2) [-1.2|1] "NA" ASDM
 SG_ OBJ_ACCEL_ERR_CRR_COEF_061 : 431|8@0+ (0.01,-1.2) [-1.2|1] "NA" ASDM

BO_ 381 RDR_TRACKER_OBJ_062: 64 G5_RDR01
 SG_ OBJ_ALIVE_TIME_062 : 255|16@0+ (1,0) [0|65535] "ms" ASDM
 SG_ OBJ_ACCELERATION_LONG_ERR_062 : 215|8@0+ (0.025,0) [0|6.375] "m/s^2" ASDM
 SG_ OBJ_ACCELERATION_LAT_ERR_062 : 223|8@0+ (0.025,0) [0|6.375] "m/s^2" ASDM
 SG_ OBJ_VELOCITY_LONG_ERR_062 : 143|8@0+ (0.05,0) [0|12.75] "m/s" ASDM
 SG_ OBJ_VELOCITY_LAT_ERR_062 : 151|8@0+ (0.05,0) [0|12.75] "m/s" ASDM
 SG_ OBJ_POS_LONG_ERR_062 : 95|8@0+ (0.025,0) [0|6.375] "m" ASDM
 SG_ OBJ_POS_LAT_ERR_062 : 103|8@0+ (0.025,0) [0|6.375] "m" ASDM
 SG_ OBJ_TRACK_MOTION_MODEL_062 : 9|2@0+ (1,0) [1|3] "NA" ASDM
 SG_ OBJ_DIMENSION_WIDTH_062 : 17|10@0+ (0.01,0) [0|10.23] "m" ASDM
 SG_ OBJ_DIMENSION_LENGTH_062 : 37|12@0+ (0.01,0) [0|40.95] "m" ASDM
 SG_ OBJ_EXISTENCE_PROB_062 : 229|14@0+ (0.0001,0) [0|1] "NA" ASDM
 SG_ OBJ_YAW_ANGLE_062 : 155|12@0+ (0.005,-10) [-10|10.475] "rad" ASDM
 SG_ OBJ_YAW_ANGLE_ERR_062 : 175|7@0+ (0.01,0) [0|1.27] "rad" ASDM
 SG_ OBJ_ID_062 : 7|8@0+ (1,0) [0|255] "NA" ASDM
 SG_ OBJ_MOVEMENT_STATUS_062 : 196|3@0+ (1,0) [0|3] "NA" ASDM
 SG_ OBJ_MEASUREMENT_STATUS_062 : 14|3@0+ (1,0) [0|7] "NA" ASDM
 SG_ OBJ_POS_LONG_062 : 63|16@0+ (0.01,-327) [-327|327] "m" ASDM
 SG_ OBJ_POS_LAT_062 : 79|16@0+ (0.01,-327) [-327|327] "m" ASDM
 SG_ OBJ_VELOCITY_LONG_062 : 110|15@0+ (0.01,-163) [-163|163] "m/s" ASDM
 SG_ OBJ_VELOCITY_LAT_062 : 126|15@0+ (0.01,-163) [-163|163] "m/s" ASDM
 SG_ OBJ_ACCELERATION_LONG_062 : 193|10@0+ (0.05,-20) [-20|20] "m/s^2" ASDM
 SG_ OBJ_ACCELERATION_LAT_062 : 177|10@0+ (0.05,-20) [-20|20] "m/s^2" ASDM
 SG_ OBJ_VEH_TRACK_FLAG_062 : 10|1@0+ (1,0) [0|1] "NA" ASDM
 SG_ OBJ_MH_CYCLE_COUNTER_062 : 487|8@0+ (1,0) [0|255] "NA" ASDM
 SG_ OBJ_MH_CRC16_062 : 495|16@0+ (1,0) [0|65535] "NA" ASDM
 SG_ OBJ_TIMESTAMP_OFFSET_062 : 247|8@0+ (1,-127) [-127|128] "ms" ASDM
 SG_ OBJ_DIMENSION_WIDTH_ERR_062 : 23|6@0+ (0.01,0) [0|0.63] "m" ASDM
 SG_ OBJ_DIMENSION_LENGTH_ERR_062 : 41|10@0+ (0.01,0) [0|10.23] "m" ASDM
 SG_ OBJ_CLS_TYPE1_062 : 271|4@0+ (1,0) [0|15] "NA" ASDM
 SG_ OBJ_CLS_TYPE1_PROB_062 : 303|8@0+ (0.004,0) [0|1] "NA" ASDM
 SG_ OBJ_CLS_TYPE2_062 : 267|4@0+ (1,0) [0|15] "NA" ASDM
 SG_ OBJ_CLS_TYPE2_PROB_062 : 311|8@0+ (0.004,0) [0|1] "NA" ASDM
 SG_ OBJ_CLS_TYPE3_062 : 279|4@0+ (1,0) [0|15] "NA" ASDM
 SG_ OBJ_CLS_TYPE3_PROB_062 : 319|8@0+ (0.004,0) [0|1] "NA" ASDM
 SG_ OBJ_CLS_TYPE4_062 : 275|4@0+ (1,0) [0|15] "NA" ASDM
 SG_ OBJ_CLS_TYPE4_PROB_062 : 327|8@0+ (0.004,0) [0|1] "NA" ASDM
 SG_ OBJ_CLS_TYPE5_062 : 287|4@0+ (1,0) [0|15] "NA" ASDM
 SG_ OBJ_CLS_TYPE5_PROB_062 : 335|8@0+ (0.004,0) [0|1] "NA" ASDM
 SG_ OBJ_CLS_TYPE6_062 : 282|4@0+ (1,0) [0|15] "NA" ASDM
 SG_ OBJ_CLS_TYPE6_PROB_062 : 343|8@0+ (0.004,0) [0|1] "NA" ASDM
 SG_ OBJ_RCS_062 : 351|7@0+ (1,-64) [-64|63] "dBsm" ASDM
 SG_ OBJ_REF_PT_LONG_OFFSET_062 : 357|14@0+ (0.0001,0) [0|1] "NA" ASDM
 SG_ OBJ_REF_PT_LAT_OFFSET_062 : 370|14@0+ (0.0001,0) [0|1] "NA" ASDM
 SG_ OBJ_YAW_RATE_062 : 399|10@0+ (0.005,-2.24) [-2.24|2.24] "rad/s" ASDM
 SG_ OBJ_YAW_RATE_ERR_062 : 388|5@0+ (0.025,0) [0|0.775] "rad/s" ASDM
 SG_ OBJ_GROUP_ID_062 : 405|6@0+ (1,0) [0|63] "NA" ASDM
 SG_ OBJ_POS_ERR_CRR_COEF_062 : 415|8@0+ (0.01,-1.2) [-1.2|1] "NA" ASDM
 SG_ OBJ_VELOCITY_ERR_CRR_COEF_062 : 423|8@0+ (0.01,-1.2) [-1.2|1] "NA" ASDM
 SG_ OBJ_ACCEL_ERR_CRR_COEF_062 : 431|8@0+ (0.01,-1.2) [-1.2|1] "NA" ASDM

BO_ 382 RDR_TRACKER_OBJ_063: 64 G5_RDR01
 SG_ OBJ_ALIVE_TIME_063 : 255|16@0+ (1,0) [0|65535] "ms" ASDM
 SG_ OBJ_ACCELERATION_LONG_ERR_063 : 215|8@0+ (0.025,0) [0|6.375] "m/s^2" ASDM
 SG_ OBJ_ACCELERATION_LAT_ERR_063 : 223|8@0+ (0.025,0) [0|6.375] "m/s^2" ASDM
 SG_ OBJ_VELOCITY_LONG_ERR_063 : 143|8@0+ (0.05,0) [0|12.75] "m/s" ASDM
 SG_ OBJ_VELOCITY_LAT_ERR_063 : 151|8@0+ (0.05,0) [0|12.75] "m/s" ASDM
 SG_ OBJ_POS_LONG_ERR_063 : 95|8@0+ (0.025,0) [0|6.375] "m" ASDM
 SG_ OBJ_POS_LAT_ERR_063 : 103|8@0+ (0.025,0) [0|6.375] "m" ASDM
 SG_ OBJ_TRACK_MOTION_MODEL_063 : 9|2@0+ (1,0) [1|3] "NA" ASDM
 SG_ OBJ_DIMENSION_WIDTH_063 : 17|10@0+ (0.01,0) [0|10.23] "m" ASDM
 SG_ OBJ_DIMENSION_LENGTH_063 : 37|12@0+ (0.01,0) [0|40.95] "m" ASDM
 SG_ OBJ_EXISTENCE_PROB_063 : 229|14@0+ (0.0001,0) [0|1] "NA" ASDM
 SG_ OBJ_YAW_ANGLE_063 : 155|12@0+ (0.005,-10) [-10|10.475] "rad" ASDM
 SG_ OBJ_YAW_ANGLE_ERR_063 : 175|7@0+ (0.01,0) [0|1.27] "rad" ASDM
 SG_ OBJ_ID_063 : 7|8@0+ (1,0) [0|255] "NA" ASDM
 SG_ OBJ_MOVEMENT_STATUS_063 : 196|3@0+ (1,0) [0|3] "NA" ASDM
 SG_ OBJ_MEASUREMENT_STATUS_063 : 14|3@0+ (1,0) [0|7] "NA" ASDM
 SG_ OBJ_POS_LONG_063 : 63|16@0+ (0.01,-327) [-327|327] "m" ASDM
 SG_ OBJ_POS_LAT_063 : 79|16@0+ (0.01,-327) [-327|327] "m" ASDM
 SG_ OBJ_VELOCITY_LONG_063 : 110|15@0+ (0.01,-163) [-163|163] "m/s" ASDM
 SG_ OBJ_VELOCITY_LAT_063 : 126|15@0+ (0.01,-163) [-163|163] "m/s" ASDM
 SG_ OBJ_ACCELERATION_LONG_063 : 193|10@0+ (0.05,-20) [-20|20] "m/s^2" ASDM
 SG_ OBJ_ACCELERATION_LAT_063 : 177|10@0+ (0.05,-20) [-20|20] "m/s^2" ASDM
 SG_ OBJ_VEH_TRACK_FLAG_063 : 10|1@0+ (1,0) [0|1] "NA" ASDM
 SG_ OBJ_MH_CYCLE_COUNTER_063 : 487|8@0+ (1,0) [0|255] "NA" ASDM
 SG_ OBJ_MH_CRC16_063 : 495|16@0+ (1,0) [0|65535] "NA" ASDM
 SG_ OBJ_TIMESTAMP_OFFSET_063 : 247|8@0+ (1,-127) [-127|128] "ms" ASDM
 SG_ OBJ_DIMENSION_WIDTH_ERR_063 : 23|6@0+ (0.01,0) [0|0.63] "m" ASDM
 SG_ OBJ_DIMENSION_LENGTH_ERR_063 : 41|10@0+ (0.01,0) [0|10.23] "m" ASDM
 SG_ OBJ_CLS_TYPE1_063 : 271|4@0+ (1,0) [0|15] "NA" ASDM
 SG_ OBJ_CLS_TYPE1_PROB_063 : 303|8@0+ (0.004,0) [0|1] "NA" ASDM
 SG_ OBJ_CLS_TYPE2_063 : 267|4@0+ (1,0) [0|15] "NA" ASDM
 SG_ OBJ_CLS_TYPE2_PROB_063 : 311|8@0+ (0.004,0) [0|1] "NA" ASDM
 SG_ OBJ_CLS_TYPE3_063 : 279|4@0+ (1,0) [0|15] "NA" ASDM
 SG_ OBJ_CLS_TYPE3_PROB_063 : 319|8@0+ (0.004,0) [0|1] "NA" ASDM
 SG_ OBJ_CLS_TYPE4_063 : 275|4@0+ (1,0) [0|15] "NA" ASDM
 SG_ OBJ_CLS_TYPE4_PROB_063 : 327|8@0+ (0.004,0) [0|1] "NA" ASDM
 SG_ OBJ_CLS_TYPE5_063 : 287|4@0+ (1,0) [0|15] "NA" ASDM
 SG_ OBJ_CLS_TYPE5_PROB_063 : 335|8@0+ (0.004,0) [0|1] "NA" ASDM
 SG_ OBJ_CLS_TYPE6_063 : 282|4@0+ (1,0) [0|15] "NA" ASDM
 SG_ OBJ_CLS_TYPE6_PROB_063 : 343|8@0+ (0.004,0) [0|1] "NA" ASDM
 SG_ OBJ_RCS_063 : 351|7@0+ (1,-64) [-64|63] "dBsm" ASDM
 SG_ OBJ_REF_PT_LONG_OFFSET_063 : 357|14@0+ (0.0001,0) [0|1] "NA" ASDM
 SG_ OBJ_REF_PT_LAT_OFFSET_063 : 370|14@0+ (0.0001,0) [0|1] "NA" ASDM
 SG_ OBJ_YAW_RATE_063 : 399|10@0+ (0.005,-2.24) [-2.24|2.24] "rad/s" ASDM
 SG_ OBJ_YAW_RATE_ERR_063 : 388|5@0+ (0.025,0) [0|0.775] "rad/s" ASDM
 SG_ OBJ_GROUP_ID_063 : 405|6@0+ (1,0) [0|63] "NA" ASDM
 SG_ OBJ_POS_ERR_CRR_COEF_063 : 415|8@0+ (0.01,-1.2) [-1.2|1] "NA" ASDM
 SG_ OBJ_VELOCITY_ERR_CRR_COEF_063 : 423|8@0+ (0.01,-1.2) [-1.2|1] "NA" ASDM
 SG_ OBJ_ACCEL_ERR_CRR_COEF_063 : 431|8@0+ (0.01,-1.2) [-1.2|1] "NA" ASDM

BO_ 383 RDR_TRACKER_OBJ_064: 64 G5_RDR01
 SG_ OBJ_ALIVE_TIME_064 : 255|16@0+ (1,0) [0|65535] "ms" ASDM
 SG_ OBJ_ACCELERATION_LONG_ERR_064 : 215|8@0+ (0.025,0) [0|6.375] "m/s^2" ASDM
 SG_ OBJ_ACCELERATION_LAT_ERR_064 : 223|8@0+ (0.025,0) [0|6.375] "m/s^2" ASDM
 SG_ OBJ_VELOCITY_LONG_ERR_064 : 143|8@0+ (0.05,0) [0|12.75] "m/s" ASDM
 SG_ OBJ_VELOCITY_LAT_ERR_064 : 151|8@0+ (0.05,0) [0|12.75] "m/s" ASDM
 SG_ OBJ_POS_LONG_ERR_064 : 95|8@0+ (0.025,0) [0|6.375] "m" ASDM
 SG_ OBJ_POS_LAT_ERR_064 : 103|8@0+ (0.025,0) [0|6.375] "m" ASDM
 SG_ OBJ_TRACK_MOTION_MODEL_064 : 9|2@0+ (1,0) [1|3] "NA" ASDM
 SG_ OBJ_DIMENSION_WIDTH_064 : 17|10@0+ (0.01,0) [0|10.23] "m" ASDM
 SG_ OBJ_DIMENSION_LENGTH_064 : 37|12@0+ (0.01,0) [0|40.95] "m" ASDM
 SG_ OBJ_EXISTENCE_PROB_064 : 229|14@0+ (0.0001,0) [0|1] "NA" ASDM
 SG_ OBJ_YAW_ANGLE_064 : 155|12@0+ (0.005,-10) [-10|10.475] "rad" ASDM
 SG_ OBJ_YAW_ANGLE_ERR_064 : 175|7@0+ (0.01,0) [0|1.27] "rad" ASDM
 SG_ OBJ_ID_064 : 7|8@0+ (1,0) [0|255] "NA" ASDM
 SG_ OBJ_MOVEMENT_STATUS_064 : 196|3@0+ (1,0) [0|3] "NA" ASDM
 SG_ OBJ_MEASUREMENT_STATUS_064 : 14|3@0+ (1,0) [0|7] "NA" ASDM
 SG_ OBJ_POS_LONG_064 : 63|16@0+ (0.01,-327) [-327|327] "m" ASDM
 SG_ OBJ_POS_LAT_064 : 79|16@0+ (0.01,-327) [-327|327] "m" ASDM
 SG_ OBJ_VELOCITY_LONG_064 : 110|15@0+ (0.01,-163) [-163|163] "m/s" ASDM
 SG_ OBJ_VELOCITY_LAT_064 : 126|15@0+ (0.01,-163) [-163|163] "m/s" ASDM
 SG_ OBJ_ACCELERATION_LONG_064 : 193|10@0+ (0.05,-20) [-20|20] "m/s^2" ASDM
 SG_ OBJ_ACCELERATION_LAT_064 : 177|10@0+ (0.05,-20) [-20|20] "m/s^2" ASDM
 SG_ OBJ_VEH_TRACK_FLAG_064 : 10|1@0+ (1,0) [0|1] "NA" ASDM
 SG_ OBJ_MH_CYCLE_COUNTER_064 : 487|8@0+ (1,0) [0|255] "NA" ASDM
 SG_ OBJ_MH_CRC16_064 : 495|16@0+ (1,0) [0|65535] "NA" ASDM
 SG_ OBJ_TIMESTAMP_OFFSET_064 : 247|8@0+ (1,-127) [-127|128] "ms" ASDM
 SG_ OBJ_DIMENSION_WIDTH_ERR_064 : 23|6@0+ (0.01,0) [0|0.63] "m" ASDM
 SG_ OBJ_DIMENSION_LENGTH_ERR_064 : 41|10@0+ (0.01,0) [0|10.23] "m" ASDM
 SG_ OBJ_CLS_TYPE1_064 : 271|4@0+ (1,0) [0|15] "NA" ASDM
 SG_ OBJ_CLS_TYPE1_PROB_064 : 303|8@0+ (0.004,0) [0|1] "NA" ASDM
 SG_ OBJ_CLS_TYPE2_064 : 267|4@0+ (1,0) [0|15] "NA" ASDM
 SG_ OBJ_CLS_TYPE2_PROB_064 : 311|8@0+ (0.004,0) [0|1] "NA" ASDM
 SG_ OBJ_CLS_TYPE3_064 : 279|4@0+ (1,0) [0|15] "NA" ASDM
 SG_ OBJ_CLS_TYPE3_PROB_064 : 319|8@0+ (0.004,0) [0|1] "NA" ASDM
 SG_ OBJ_CLS_TYPE4_064 : 275|4@0+ (1,0) [0|15] "NA" ASDM
 SG_ OBJ_CLS_TYPE4_PROB_064 : 327|8@0+ (0.004,0) [0|1] "NA" ASDM
 SG_ OBJ_CLS_TYPE5_064 : 287|4@0+ (1,0) [0|15] "NA" ASDM
 SG_ OBJ_CLS_TYPE5_PROB_064 : 335|8@0+ (0.004,0) [0|1] "NA" ASDM
 SG_ OBJ_CLS_TYPE6_064 : 282|4@0+ (1,0) [0|15] "NA" ASDM
 SG_ OBJ_CLS_TYPE6_PROB_064 : 343|8@0+ (0.004,0) [0|1] "NA" ASDM
 SG_ OBJ_RCS_064 : 351|7@0+ (1,-64) [-64|63] "dBsm" ASDM
 SG_ OBJ_REF_PT_LONG_OFFSET_064 : 357|14@0+ (0.0001,0) [0|1] "NA" ASDM
 SG_ OBJ_REF_PT_LAT_OFFSET_064 : 370|14@0+ (0.0001,0) [0|1] "NA" ASDM
 SG_ OBJ_YAW_RATE_064 : 399|10@0+ (0.005,-2.24) [-2.24|2.24] "rad/s" ASDM
 SG_ OBJ_YAW_RATE_ERR_064 : 388|5@0+ (0.025,0) [0|0.775] "rad/s" ASDM
 SG_ OBJ_GROUP_ID_064 : 405|6@0+ (1,0) [0|63] "NA" ASDM
 SG_ OBJ_POS_ERR_CRR_COEF_064 : 415|8@0+ (0.01,-1.2) [-1.2|1] "NA" ASDM
 SG_ OBJ_VELOCITY_ERR_CRR_COEF_064 : 423|8@0+ (0.01,-1.2) [-1.2|1] "NA" ASDM
 SG_ OBJ_ACCEL_ERR_CRR_COEF_064 : 431|8@0+ (0.01,-1.2) [-1.2|1] "NA" ASDM

CM_ SG_ 368 OBJ_ALIVE_TIME_049 "Time since object initialization in msec. Tracker internal may have bigger values. On the output interface, we should saturate the signal in that case.";
CM_ SG_ 368 OBJ_ACCELERATION_LONG_ERR_049 "acceleration along Longi  direction";
CM_ SG_ 368 OBJ_ACCELERATION_LAT_ERR_049 "acceleration along Lat direction error";
CM_ SG_ 368 OBJ_POS_LONG_ERR_049 "Lat-position error of object track's centroid in VCS coordinate";
CM_ SG_ 368 OBJ_POS_LAT_ERR_049 "Lat-position error of object track's centroid in VCS coordinate";
CM_ SG_ 368 OBJ_TRACK_MOTION_MODEL_049 "Object tracking uses a motion model for tracking moving items";
CM_ SG_ 368 OBJ_DIMENSION_WIDTH_049 "Lat distance from centroid to edge of bounding box.";
CM_ SG_ 368 OBJ_DIMENSION_LENGTH_049 "Longi distance from centroid to edge of bounding box.";
CM_ SG_ 368 OBJ_EXISTENCE_PROB_049 "Probability that the target is an actual target";
CM_ SG_ 368 OBJ_YAW_ANGLE_049 "Orientation of track's bounding box in VCS coordinate";
CM_ SG_ 368 OBJ_ID_049 "ID of object tracks, zero-ID represents an inactive track";
CM_ SG_ 368 OBJ_MOVEMENT_STATUS_049 "Information about a possible movement of the object during tracking";
CM_ SG_ 368 OBJ_MEASUREMENT_STATUS_049 "Objects should be sent out as fast as possible, even if not all statuses are observed and the object’s
signals might not be fully filled.";
CM_ SG_ 368 OBJ_POS_LONG_049 "Long-position of object track's centroid in VCS coordinate";
CM_ SG_ 368 OBJ_POS_LAT_049 "Lat-position of object track's centroid in VCS coordinate";
CM_ SG_ 368 OBJ_VELOCITY_LONG_049 "Over-the-ground velocity of object track's centroid along Long direction (in VCS coordinate)";
CM_ SG_ 368 OBJ_VELOCITY_LAT_049 "Over-the-ground velocity of object track's centroid along Lat direction (in VCS coordinate)";
CM_ SG_ 368 OBJ_ACCELERATION_LONG_049 "Over-the-ground track acceleration along Longi direction (in VCS coordinate)";
CM_ SG_ 368 OBJ_ACCELERATION_LAT_049 "Over-the-ground track acceleration along Lat direction (in VCS coordinate)";
CM_ SG_ 368 OBJ_VEH_TRACK_FLAG_049 "Indicates if current track is a vehicle";
CM_ SG_ 368 OBJ_TIMESTAMP_OFFSET_049 "A timestamp offset from the object list header timestamp for each object as we have different timestamps from different sensors leading to different timestamps on each object";
CM_ SG_ 368 OBJ_DIMENSION_WIDTH_ERR_049 "Lat distance or length error";
CM_ SG_ 368 OBJ_DIMENSION_LENGTH_ERR_049 "Longi distance or length error";
CM_ SG_ 368 OBJ_CLS_TYPE1_049 "Classification Type 1(Highest Prob), selected from ENUM list";
CM_ SG_ 368 OBJ_CLS_TYPE1_PROB_049 "Classification Type 1 probablity";
CM_ SG_ 368 OBJ_CLS_TYPE6_049 "Classification Type 6(Lowest Prob), selected from ENUM list";
CM_ SG_ 368 OBJ_CLS_TYPE6_PROB_049 "Classification Type 1 probablity";
CM_ SG_ 368 OBJ_RCS_049 "Representative RCS of the complete recognized object, Not implemented";
CM_ SG_ 368 OBJ_REF_PT_LONG_OFFSET_049 "Outer edges of the recognized object’s bounding box in Y axis";
CM_ SG_ 368 OBJ_REF_PT_LAT_OFFSET_049 "Outer edges of the recognized object’s bounding box in X axis";
CM_ SG_ 368 OBJ_YAW_RATE_049 "Orientation rate of track's bounding box in VCS coordinate";
CM_ SG_ 368 OBJ_GROUP_ID_049 "Objects which are linked together shall have same group ID";
CM_ SG_ 368 OBJ_POS_ERR_CRR_COEF_049 "vx-vy correlation due to small error in radial direction and big in cross radial - position Correlation Coefficient Error";
CM_ SG_ 368 OBJ_VELOCITY_ERR_CRR_COEF_049 "vx-vy correlation due to small error in radial direction and big in cross radial - velocity Correlation Coefficient Error";
CM_ SG_ 368 OBJ_ACCEL_ERR_CRR_COEF_049 "vx-vy correlation due to small error in radial direction and big in cross radial - Acceleration Correlation Coefficient Error";
CM_ SG_ 369 OBJ_ALIVE_TIME_050 "Time since object initialization in msec. Tracker internal may have bigger values. On the output interface, we should saturate the signal in that case.";
CM_ SG_ 369 OBJ_ACCELERATION_LONG_ERR_050 "acceleration along Longi  direction";
CM_ SG_ 369 OBJ_ACCELERATION_LAT_ERR_050 "acceleration along Lat direction error";
CM_ SG_ 369 OBJ_POS_LONG_ERR_050 "Lat-position error of object track's centroid in VCS coordinate";
CM_ SG_ 369 OBJ_POS_LAT_ERR_050 "Lat-position error of object track's centroid in VCS coordinate";
CM_ SG_ 369 OBJ_TRACK_MOTION_MODEL_050 "Object tracking uses a motion model for tracking moving items";
CM_ SG_ 369 OBJ_DIMENSION_WIDTH_050 "Lat distance from centroid to edge of bounding box.";
CM_ SG_ 369 OBJ_DIMENSION_LENGTH_050 "Longi distance from centroid to edge of bounding box.";
CM_ SG_ 369 OBJ_EXISTENCE_PROB_050 "Probability that the target is an actual target";
CM_ SG_ 369 OBJ_YAW_ANGLE_050 "Orientation of track's bounding box in VCS coordinate";
CM_ SG_ 369 OBJ_ID_050 "ID of object tracks, zero-ID represents an inactive track";
CM_ SG_ 369 OBJ_MOVEMENT_STATUS_050 "Information about a possible movement of the object during tracking";
CM_ SG_ 369 OBJ_MEASUREMENT_STATUS_050 "Objects should be sent out as fast as possible, even if not all statuses are observed and the object’s
signals might not be fully filled.";
CM_ SG_ 369 OBJ_POS_LONG_050 "Long-position of object track's centroid in VCS coordinate";
CM_ SG_ 369 OBJ_POS_LAT_050 "Lat-position of object track's centroid in VCS coordinate";
CM_ SG_ 369 OBJ_VELOCITY_LONG_050 "Over-the-ground velocity of object track's centroid along Long direction (in VCS coordinate)";
CM_ SG_ 369 OBJ_VELOCITY_LAT_050 "Over-the-ground velocity of object track's centroid along Lat direction (in VCS coordinate)";
CM_ SG_ 369 OBJ_ACCELERATION_LONG_050 "Over-the-ground track acceleration along Longi direction (in VCS coordinate)";
CM_ SG_ 369 OBJ_ACCELERATION_LAT_050 "Over-the-ground track acceleration along Lat direction (in VCS coordinate)";
CM_ SG_ 369 OBJ_VEH_TRACK_FLAG_050 "Indicates if current track is a vehicle";
CM_ SG_ 369 OBJ_TIMESTAMP_OFFSET_050 "A timestamp offset from the object list header timestamp for each object as we have different timestamps from different sensors leading to different timestamps on each object";
CM_ SG_ 369 OBJ_DIMENSION_WIDTH_ERR_050 "Lat distance or length error";
CM_ SG_ 369 OBJ_DIMENSION_LENGTH_ERR_050 "Longi distance or length error";
CM_ SG_ 369 OBJ_CLS_TYPE1_050 "Classification Type 1(Highest Prob), selected from ENUM list";
CM_ SG_ 369 OBJ_CLS_TYPE1_PROB_050 "Classification Type 1 probablity";
CM_ SG_ 369 OBJ_CLS_TYPE6_050 "Classification Type 6(Lowest Prob), selected from ENUM list";
CM_ SG_ 369 OBJ_CLS_TYPE6_PROB_050 "Classification Type 1 probablity";
CM_ SG_ 369 OBJ_RCS_050 "Representative RCS of the complete recognized object, Not implemented";
CM_ SG_ 369 OBJ_REF_PT_LONG_OFFSET_050 "Outer edges of the recognized object’s bounding box in Y axis";
CM_ SG_ 369 OBJ_REF_PT_LAT_OFFSET_050 "Outer edges of the recognized object’s bounding box in X axis";
CM_ SG_ 369 OBJ_YAW_RATE_050 "Orientation rate of track's bounding box in VCS coordinate";
CM_ SG_ 369 OBJ_GROUP_ID_050 "Objects which are linked together shall have same group ID";
CM_ SG_ 369 OBJ_POS_ERR_CRR_COEF_050 "vx-vy correlation due to small error in radial direction and big in cross radial - position Correlation Coefficient Error";
CM_ SG_ 369 OBJ_VELOCITY_ERR_CRR_COEF_050 "vx-vy correlation due to small error in radial direction and big in cross radial - velocity Correlation Coefficient Error";
CM_ SG_ 369 OBJ_ACCEL_ERR_CRR_COEF_050 "vx-vy correlation due to small error in radial direction and big in cross radial - Acceleration Correlation Coefficient Error";
CM_ SG_ 370 OBJ_ALIVE_TIME_051 "Time since object initialization in msec. Tracker internal may have bigger values. On the output interface, we should saturate the signal in that case.";
CM_ SG_ 370 OBJ_ACCELERATION_LONG_ERR_051 "acceleration along Longi  direction";
CM_ SG_ 370 OBJ_ACCELERATION_LAT_ERR_051 "acceleration along Lat direction error";
CM_ SG_ 370 OBJ_POS_LONG_ERR_051 "Lat-position error of object track's centroid in VCS coordinate";
CM_ SG_ 370 OBJ_POS_LAT_ERR_051 "Lat-position error of object track's centroid in VCS coordinate";
CM_ SG_ 370 OBJ_TRACK_MOTION_MODEL_051 "Object tracking uses a motion model for tracking moving items";
CM_ SG_ 370 OBJ_DIMENSION_WIDTH_051 "Lat distance from centroid to edge of bounding box.";
CM_ SG_ 370 OBJ_DIMENSION_LENGTH_051 "Longi distance from centroid to edge of bounding box.";
CM_ SG_ 370 OBJ_EXISTENCE_PROB_051 "Probability that the target is an actual target";
CM_ SG_ 370 OBJ_YAW_ANGLE_051 "Orientation of track's bounding box in VCS coordinate";
CM_ SG_ 370 OBJ_ID_051 "ID of object tracks, zero-ID represents an inactive track";
CM_ SG_ 370 OBJ_MOVEMENT_STATUS_051 "Information about a possible movement of the object during tracking";
CM_ SG_ 370 OBJ_MEASUREMENT_STATUS_051 "Objects should be sent out as fast as possible, even if not all statuses are observed and the object’s
signals might not be fully filled.";
CM_ SG_ 370 OBJ_POS_LONG_051 "Long-position of object track's centroid in VCS coordinate";
CM_ SG_ 370 OBJ_POS_LAT_051 "Lat-position of object track's centroid in VCS coordinate";
CM_ SG_ 370 OBJ_VELOCITY_LONG_051 "Over-the-ground velocity of object track's centroid along Long direction (in VCS coordinate)";
CM_ SG_ 370 OBJ_VELOCITY_LAT_051 "Over-the-ground velocity of object track's centroid along Lat direction (in VCS coordinate)";
CM_ SG_ 370 OBJ_ACCELERATION_LONG_051 "Over-the-ground track acceleration along Longi direction (in VCS coordinate)";
CM_ SG_ 370 OBJ_ACCELERATION_LAT_051 "Over-the-ground track acceleration along Lat direction (in VCS coordinate)";
CM_ SG_ 370 OBJ_VEH_TRACK_FLAG_051 "Indicates if current track is a vehicle";
CM_ SG_ 370 OBJ_TIMESTAMP_OFFSET_051 "A timestamp offset from the object list header timestamp for each object as we have different timestamps from different sensors leading to different timestamps on each object";
CM_ SG_ 370 OBJ_DIMENSION_WIDTH_ERR_051 "Lat distance or length error";
CM_ SG_ 370 OBJ_DIMENSION_LENGTH_ERR_051 "Longi distance or length error";
CM_ SG_ 370 OBJ_CLS_TYPE1_051 "Classification Type 1(Highest Prob), selected from ENUM list";
CM_ SG_ 370 OBJ_CLS_TYPE1_PROB_051 "Classification Type 1 probablity";
CM_ SG_ 370 OBJ_CLS_TYPE6_051 "Classification Type 6(Lowest Prob), selected from ENUM list";
CM_ SG_ 370 OBJ_CLS_TYPE6_PROB_051 "Classification Type 1 probablity";
CM_ SG_ 370 OBJ_RCS_051 "Representative RCS of the complete recognized object, Not implemented";
CM_ SG_ 370 OBJ_REF_PT_LONG_OFFSET_051 "Outer edges of the recognized object’s bounding box in Y axis";
CM_ SG_ 370 OBJ_REF_PT_LAT_OFFSET_051 "Outer edges of the recognized object’s bounding box in X axis";
CM_ SG_ 370 OBJ_YAW_RATE_051 "Orientation rate of track's bounding box in VCS coordinate";
CM_ SG_ 370 OBJ_GROUP_ID_051 "Objects which are linked together shall have same group ID";
CM_ SG_ 370 OBJ_POS_ERR_CRR_COEF_051 "vx-vy correlation due to small error in radial direction and big in cross radial - position Correlation Coefficient Error";
CM_ SG_ 370 OBJ_VELOCITY_ERR_CRR_COEF_051 "vx-vy correlation due to small error in radial direction and big in cross radial - velocity Correlation Coefficient Error";
CM_ SG_ 370 OBJ_ACCEL_ERR_CRR_COEF_051 "vx-vy correlation due to small error in radial direction and big in cross radial - Acceleration Correlation Coefficient Error";
CM_ SG_ 371 OBJ_ALIVE_TIME_052 "Time since object initialization in msec. Tracker internal may have bigger values. On the output interface, we should saturate the signal in that case.";
CM_ SG_ 371 OBJ_ACCELERATION_LONG_ERR_052 "acceleration along Longi  direction";
CM_ SG_ 371 OBJ_ACCELERATION_LAT_ERR_052 "acceleration along Lat direction error";
CM_ SG_ 371 OBJ_POS_LONG_ERR_052 "Lat-position error of object track's centroid in VCS coordinate";
CM_ SG_ 371 OBJ_POS_LAT_ERR_052 "Lat-position error of object track's centroid in VCS coordinate";
CM_ SG_ 371 OBJ_TRACK_MOTION_MODEL_052 "Object tracking uses a motion model for tracking moving items";
CM_ SG_ 371 OBJ_DIMENSION_WIDTH_052 "Lat distance from centroid to edge of bounding box.";
CM_ SG_ 371 OBJ_DIMENSION_LENGTH_052 "Longi distance from centroid to edge of bounding box.";
CM_ SG_ 371 OBJ_EXISTENCE_PROB_052 "Probability that the target is an actual target";
CM_ SG_ 371 OBJ_YAW_ANGLE_052 "Orientation of track's bounding box in VCS coordinate";
CM_ SG_ 371 OBJ_ID_052 "ID of object tracks, zero-ID represents an inactive track";
CM_ SG_ 371 OBJ_MOVEMENT_STATUS_052 "Information about a possible movement of the object during tracking";
CM_ SG_ 371 OBJ_MEASUREMENT_STATUS_052 "Objects should be sent out as fast as possible, even if not all statuses are observed and the object’s
signals might not be fully filled.";
CM_ SG_ 371 OBJ_POS_LONG_052 "Long-position of object track's centroid in VCS coordinate";
CM_ SG_ 371 OBJ_POS_LAT_052 "Lat-position of object track's centroid in VCS coordinate";
CM_ SG_ 371 OBJ_VELOCITY_LONG_052 "Over-the-ground velocity of object track's centroid along Long direction (in VCS coordinate)";
CM_ SG_ 371 OBJ_VELOCITY_LAT_052 "Over-the-ground velocity of object track's centroid along Lat direction (in VCS coordinate)";
CM_ SG_ 371 OBJ_ACCELERATION_LONG_052 "Over-the-ground track acceleration along Longi direction (in VCS coordinate)";
CM_ SG_ 371 OBJ_ACCELERATION_LAT_052 "Over-the-ground track acceleration along Lat direction (in VCS coordinate)";
CM_ SG_ 371 OBJ_VEH_TRACK_FLAG_052 "Indicates if current track is a vehicle";
CM_ SG_ 371 OBJ_TIMESTAMP_OFFSET_052 "A timestamp offset from the object list header timestamp for each object as we have different timestamps from different sensors leading to different timestamps on each object";
CM_ SG_ 371 OBJ_DIMENSION_WIDTH_ERR_052 "Lat distance or length error";
CM_ SG_ 371 OBJ_DIMENSION_LENGTH_ERR_052 "Longi distance or length error";
CM_ SG_ 371 OBJ_CLS_TYPE1_052 "Classification Type 1(Highest Prob), selected from ENUM list";
CM_ SG_ 371 OBJ_CLS_TYPE1_PROB_052 "Classification Type 1 probablity";
CM_ SG_ 371 OBJ_CLS_TYPE6_052 "Classification Type 6(Lowest Prob), selected from ENUM list";
CM_ SG_ 371 OBJ_CLS_TYPE6_PROB_052 "Classification Type 1 probablity";
CM_ SG_ 371 OBJ_RCS_052 "Representative RCS of the complete recognized object, Not implemented";
CM_ SG_ 371 OBJ_REF_PT_LONG_OFFSET_052 "Outer edges of the recognized object’s bounding box in Y axis";
CM_ SG_ 371 OBJ_REF_PT_LAT_OFFSET_052 "Outer edges of the recognized object’s bounding box in X axis";
CM_ SG_ 371 OBJ_YAW_RATE_052 "Orientation rate of track's bounding box in VCS coordinate";
CM_ SG_ 371 OBJ_GROUP_ID_052 "Objects which are linked together shall have same group ID";
CM_ SG_ 371 OBJ_POS_ERR_CRR_COEF_052 "vx-vy correlation due to small error in radial direction and big in cross radial - position Correlation Coefficient Error";
CM_ SG_ 371 OBJ_VELOCITY_ERR_CRR_COEF_052 "vx-vy correlation due to small error in radial direction and big in cross radial - velocity Correlation Coefficient Error";
CM_ SG_ 371 OBJ_ACCEL_ERR_CRR_COEF_052 "vx-vy correlation due to small error in radial direction and big in cross radial - Acceleration Correlation Coefficient Error";
CM_ SG_ 372 OBJ_ALIVE_TIME_053 "Time since object initialization in msec. Tracker internal may have bigger values. On the output interface, we should saturate the signal in that case.";
CM_ SG_ 372 OBJ_ACCELERATION_LONG_ERR_053 "acceleration along Longi  direction";
CM_ SG_ 372 OBJ_ACCELERATION_LAT_ERR_053 "acceleration along Lat direction error";
CM_ SG_ 372 OBJ_POS_LONG_ERR_053 "Lat-position error of object track's centroid in VCS coordinate";
CM_ SG_ 372 OBJ_POS_LAT_ERR_053 "Lat-position error of object track's centroid in VCS coordinate";
CM_ SG_ 372 OBJ_TRACK_MOTION_MODEL_053 "Object tracking uses a motion model for tracking moving items";
CM_ SG_ 372 OBJ_DIMENSION_WIDTH_053 "Lat distance from centroid to edge of bounding box.";
CM_ SG_ 372 OBJ_DIMENSION_LENGTH_053 "Longi distance from centroid to edge of bounding box.";
CM_ SG_ 372 OBJ_EXISTENCE_PROB_053 "Probability that the target is an actual target";
CM_ SG_ 372 OBJ_YAW_ANGLE_053 "Orientation of track's bounding box in VCS coordinate";
CM_ SG_ 372 OBJ_ID_053 "ID of object tracks, zero-ID represents an inactive track";
CM_ SG_ 372 OBJ_MOVEMENT_STATUS_053 "Information about a possible movement of the object during tracking";
CM_ SG_ 372 OBJ_MEASUREMENT_STATUS_053 "Objects should be sent out as fast as possible, even if not all statuses are observed and the object’s
signals might not be fully filled.";
CM_ SG_ 372 OBJ_POS_LONG_053 "Long-position of object track's centroid in VCS coordinate";
CM_ SG_ 372 OBJ_POS_LAT_053 "Lat-position of object track's centroid in VCS coordinate";
CM_ SG_ 372 OBJ_VELOCITY_LONG_053 "Over-the-ground velocity of object track's centroid along Long direction (in VCS coordinate)";
CM_ SG_ 372 OBJ_VELOCITY_LAT_053 "Over-the-ground velocity of object track's centroid along Lat direction (in VCS coordinate)";
CM_ SG_ 372 OBJ_ACCELERATION_LONG_053 "Over-the-ground track acceleration along Longi direction (in VCS coordinate)";
CM_ SG_ 372 OBJ_ACCELERATION_LAT_053 "Over-the-ground track acceleration along Lat direction (in VCS coordinate)";
CM_ SG_ 372 OBJ_VEH_TRACK_FLAG_053 "Indicates if current track is a vehicle";
CM_ SG_ 372 OBJ_TIMESTAMP_OFFSET_053 "A timestamp offset from the object list header timestamp for each object as we have different timestamps from different sensors leading to different timestamps on each object";
CM_ SG_ 372 OBJ_DIMENSION_WIDTH_ERR_053 "Lat distance or length error";
CM_ SG_ 372 OBJ_DIMENSION_LENGTH_ERR_053 "Longi distance or length error";
CM_ SG_ 372 OBJ_CLS_TYPE1_053 "Classification Type 1(Highest Prob), selected from ENUM list";
CM_ SG_ 372 OBJ_CLS_TYPE1_PROB_053 "Classification Type 1 probablity";
CM_ SG_ 372 OBJ_CLS_TYPE6_053 "Classification Type 6(Lowest Prob), selected from ENUM list";
CM_ SG_ 372 OBJ_CLS_TYPE6_PROB_053 "Classification Type 1 probablity";
CM_ SG_ 372 OBJ_RCS_053 "Representative RCS of the complete recognized object, Not implemented";
CM_ SG_ 372 OBJ_REF_PT_LONG_OFFSET_053 "Outer edges of the recognized object’s bounding box in Y axis";
CM_ SG_ 372 OBJ_REF_PT_LAT_OFFSET_053 "Outer edges of the recognized object’s bounding box in X axis";
CM_ SG_ 372 OBJ_YAW_RATE_053 "Orientation rate of track's bounding box in VCS coordinate";
CM_ SG_ 372 OBJ_GROUP_ID_053 "Objects which are linked together shall have same group ID";
CM_ SG_ 372 OBJ_POS_ERR_CRR_COEF_053 "vx-vy correlation due to small error in radial direction and big in cross radial - position Correlation Coefficient Error";
CM_ SG_ 372 OBJ_VELOCITY_ERR_CRR_COEF_053 "vx-vy correlation due to small error in radial direction and big in cross radial - velocity Correlation Coefficient Error";
CM_ SG_ 372 OBJ_ACCEL_ERR_CRR_COEF_053 "vx-vy correlation due to small error in radial direction and big in cross radial - Acceleration Correlation Coefficient Error";
CM_ SG_ 373 OBJ_ALIVE_TIME_054 "Time since object initialization in msec. Tracker internal may have bigger values. On the output interface, we should saturate the signal in that case.";
CM_ SG_ 373 OBJ_ACCELERATION_LONG_ERR_054 "acceleration along Longi  direction";
CM_ SG_ 373 OBJ_ACCELERATION_LAT_ERR_054 "acceleration along Lat direction error";
CM_ SG_ 373 OBJ_POS_LONG_ERR_054 "Lat-position error of object track's centroid in VCS coordinate";
CM_ SG_ 373 OBJ_POS_LAT_ERR_054 "Lat-position error of object track's centroid in VCS coordinate";
CM_ SG_ 373 OBJ_TRACK_MOTION_MODEL_054 "Object tracking uses a motion model for tracking moving items";
CM_ SG_ 373 OBJ_DIMENSION_WIDTH_054 "Lat distance from centroid to edge of bounding box.";
CM_ SG_ 373 OBJ_DIMENSION_LENGTH_054 "Longi distance from centroid to edge of bounding box.";
CM_ SG_ 373 OBJ_EXISTENCE_PROB_054 "Probability that the target is an actual target";
CM_ SG_ 373 OBJ_YAW_ANGLE_054 "Orientation of track's bounding box in VCS coordinate";
CM_ SG_ 373 OBJ_ID_054 "ID of object tracks, zero-ID represents an inactive track";
CM_ SG_ 373 OBJ_MOVEMENT_STATUS_054 "Information about a possible movement of the object during tracking";
CM_ SG_ 373 OBJ_MEASUREMENT_STATUS_054 "Objects should be sent out as fast as possible, even if not all statuses are observed and the object’s
signals might not be fully filled.";
CM_ SG_ 373 OBJ_POS_LONG_054 "Long-position of object track's centroid in VCS coordinate";
CM_ SG_ 373 OBJ_POS_LAT_054 "Lat-position of object track's centroid in VCS coordinate";
CM_ SG_ 373 OBJ_VELOCITY_LONG_054 "Over-the-ground velocity of object track's centroid along Long direction (in VCS coordinate)";
CM_ SG_ 373 OBJ_VELOCITY_LAT_054 "Over-the-ground velocity of object track's centroid along Lat direction (in VCS coordinate)";
CM_ SG_ 373 OBJ_ACCELERATION_LONG_054 "Over-the-ground track acceleration along Longi direction (in VCS coordinate)";
CM_ SG_ 373 OBJ_ACCELERATION_LAT_054 "Over-the-ground track acceleration along Lat direction (in VCS coordinate)";
CM_ SG_ 373 OBJ_VEH_TRACK_FLAG_054 "Indicates if current track is a vehicle";
CM_ SG_ 373 OBJ_TIMESTAMP_OFFSET_054 "A timestamp offset from the object list header timestamp for each object as we have different timestamps from different sensors leading to different timestamps on each object";
CM_ SG_ 373 OBJ_DIMENSION_WIDTH_ERR_054 "Lat distance or length error";
CM_ SG_ 373 OBJ_DIMENSION_LENGTH_ERR_054 "Longi distance or length error";
CM_ SG_ 373 OBJ_CLS_TYPE1_054 "Classification Type 1(Highest Prob), selected from ENUM list";
CM_ SG_ 373 OBJ_CLS_TYPE1_PROB_054 "Classification Type 1 probablity";
CM_ SG_ 373 OBJ_CLS_TYPE6_054 "Classification Type 6(Lowest Prob), selected from ENUM list";
CM_ SG_ 373 OBJ_CLS_TYPE6_PROB_054 "Classification Type 1 probablity";
CM_ SG_ 373 OBJ_RCS_054 "Representative RCS of the complete recognized object, Not implemented";
CM_ SG_ 373 OBJ_REF_PT_LONG_OFFSET_054 "Outer edges of the recognized object’s bounding box in Y axis";
CM_ SG_ 373 OBJ_REF_PT_LAT_OFFSET_054 "Outer edges of the recognized object’s bounding box in X axis";
CM_ SG_ 373 OBJ_YAW_RATE_054 "Orientation rate of track's bounding box in VCS coordinate";
CM_ SG_ 373 OBJ_GROUP_ID_054 "Objects which are linked together shall have same group ID";
CM_ SG_ 373 OBJ_POS_ERR_CRR_COEF_054 "vx-vy correlation due to small error in radial direction and big in cross radial - position Correlation Coefficient Error";
CM_ SG_ 373 OBJ_VELOCITY_ERR_CRR_COEF_054 "vx-vy correlation due to small error in radial direction and big in cross radial - velocity Correlation Coefficient Error";
CM_ SG_ 373 OBJ_ACCEL_ERR_CRR_COEF_054 "vx-vy correlation due to small error in radial direction and big in cross radial - Acceleration Correlation Coefficient Error";
CM_ SG_ 374 OBJ_ALIVE_TIME_055 "Time since object initialization in msec. Tracker internal may have bigger values. On the output interface, we should saturate the signal in that case.";
CM_ SG_ 374 OBJ_ACCELERATION_LONG_ERR_055 "acceleration along Longi  direction";
CM_ SG_ 374 OBJ_ACCELERATION_LAT_ERR_055 "acceleration along Lat direction error";
CM_ SG_ 374 OBJ_POS_LONG_ERR_055 "Lat-position error of object track's centroid in VCS coordinate";
CM_ SG_ 374 OBJ_POS_LAT_ERR_055 "Lat-position error of object track's centroid in VCS coordinate";
CM_ SG_ 374 OBJ_TRACK_MOTION_MODEL_055 "Object tracking uses a motion model for tracking moving items";
CM_ SG_ 374 OBJ_DIMENSION_WIDTH_055 "Lat distance from centroid to edge of bounding box.";
CM_ SG_ 374 OBJ_DIMENSION_LENGTH_055 "Longi distance from centroid to edge of bounding box.";
CM_ SG_ 374 OBJ_EXISTENCE_PROB_055 "Probability that the target is an actual target";
CM_ SG_ 374 OBJ_YAW_ANGLE_055 "Orientation of track's bounding box in VCS coordinate";
CM_ SG_ 374 OBJ_ID_055 "ID of object tracks, zero-ID represents an inactive track";
CM_ SG_ 374 OBJ_MOVEMENT_STATUS_055 "Information about a possible movement of the object during tracking";
CM_ SG_ 374 OBJ_MEASUREMENT_STATUS_055 "Objects should be sent out as fast as possible, even if not all statuses are observed and the object’s
signals might not be fully filled.";
CM_ SG_ 374 OBJ_POS_LONG_055 "Long-position of object track's centroid in VCS coordinate";
CM_ SG_ 374 OBJ_POS_LAT_055 "Lat-position of object track's centroid in VCS coordinate";
CM_ SG_ 374 OBJ_VELOCITY_LONG_055 "Over-the-ground velocity of object track's centroid along Long direction (in VCS coordinate)";
CM_ SG_ 374 OBJ_VELOCITY_LAT_055 "Over-the-ground velocity of object track's centroid along Lat direction (in VCS coordinate)";
CM_ SG_ 374 OBJ_ACCELERATION_LONG_055 "Over-the-ground track acceleration along Longi direction (in VCS coordinate)";
CM_ SG_ 374 OBJ_ACCELERATION_LAT_055 "Over-the-ground track acceleration along Lat direction (in VCS coordinate)";
CM_ SG_ 374 OBJ_VEH_TRACK_FLAG_055 "Indicates if current track is a vehicle";
CM_ SG_ 374 OBJ_TIMESTAMP_OFFSET_055 "A timestamp offset from the object list header timestamp for each object as we have different timestamps from different sensors leading to different timestamps on each object";
CM_ SG_ 374 OBJ_DIMENSION_WIDTH_ERR_055 "Lat distance or length error";
CM_ SG_ 374 OBJ_DIMENSION_LENGTH_ERR_055 "Longi distance or length error";
CM_ SG_ 374 OBJ_CLS_TYPE1_055 "Classification Type 1(Highest Prob), selected from ENUM list";
CM_ SG_ 374 OBJ_CLS_TYPE1_PROB_055 "Classification Type 1 probablity";
CM_ SG_ 374 OBJ_CLS_TYPE6_055 "Classification Type 6(Lowest Prob), selected from ENUM list";
CM_ SG_ 374 OBJ_CLS_TYPE6_PROB_055 "Classification Type 1 probablity";
CM_ SG_ 374 OBJ_RCS_055 "Representative RCS of the complete recognized object, Not implemented";
CM_ SG_ 374 OBJ_REF_PT_LONG_OFFSET_055 "Outer edges of the recognized object’s bounding box in Y axis";
CM_ SG_ 374 OBJ_REF_PT_LAT_OFFSET_055 "Outer edges of the recognized object’s bounding box in X axis";
CM_ SG_ 374 OBJ_YAW_RATE_055 "Orientation rate of track's bounding box in VCS coordinate";
CM_ SG_ 374 OBJ_GROUP_ID_055 "Objects which are linked together shall have same group ID";
CM_ SG_ 374 OBJ_POS_ERR_CRR_COEF_055 "vx-vy correlation due to small error in radial direction and big in cross radial - position Correlation Coefficient Error";
CM_ SG_ 374 OBJ_VELOCITY_ERR_CRR_COEF_055 "vx-vy correlation due to small error in radial direction and big in cross radial - velocity Correlation Coefficient Error";
CM_ SG_ 374 OBJ_ACCEL_ERR_CRR_COEF_055 "vx-vy correlation due to small error in radial direction and big in cross radial - Acceleration Correlation Coefficient Error";
CM_ SG_ 375 OBJ_ALIVE_TIME_056 "Time since object initialization in msec. Tracker internal may have bigger values. On the output interface, we should saturate the signal in that case.";
CM_ SG_ 375 OBJ_ACCELERATION_LONG_ERR_056 "acceleration along Longi  direction";
CM_ SG_ 375 OBJ_ACCELERATION_LAT_ERR_056 "acceleration along Lat direction error";
CM_ SG_ 375 OBJ_POS_LONG_ERR_056 "Lat-position error of object track's centroid in VCS coordinate";
CM_ SG_ 375 OBJ_POS_LAT_ERR_056 "Lat-position error of object track's centroid in VCS coordinate";
CM_ SG_ 375 OBJ_TRACK_MOTION_MODEL_056 "Object tracking uses a motion model for tracking moving items";
CM_ SG_ 375 OBJ_DIMENSION_WIDTH_056 "Lat distance from centroid to edge of bounding box.";
CM_ SG_ 375 OBJ_DIMENSION_LENGTH_056 "Longi distance from centroid to edge of bounding box.";
CM_ SG_ 375 OBJ_EXISTENCE_PROB_056 "Probability that the target is an actual target";
CM_ SG_ 375 OBJ_YAW_ANGLE_056 "Orientation of track's bounding box in VCS coordinate";
CM_ SG_ 375 OBJ_ID_056 "ID of object tracks, zero-ID represents an inactive track";
CM_ SG_ 375 OBJ_MOVEMENT_STATUS_056 "Information about a possible movement of the object during tracking";
CM_ SG_ 375 OBJ_MEASUREMENT_STATUS_056 "Objects should be sent out as fast as possible, even if not all statuses are observed and the object’s
signals might not be fully filled.";
CM_ SG_ 375 OBJ_POS_LONG_056 "Long-position of object track's centroid in VCS coordinate";
CM_ SG_ 375 OBJ_POS_LAT_056 "Lat-position of object track's centroid in VCS coordinate";
CM_ SG_ 375 OBJ_VELOCITY_LONG_056 "Over-the-ground velocity of object track's centroid along Long direction (in VCS coordinate)";
CM_ SG_ 375 OBJ_VELOCITY_LAT_056 "Over-the-ground velocity of object track's centroid along Lat direction (in VCS coordinate)";
CM_ SG_ 375 OBJ_ACCELERATION_LONG_056 "Over-the-ground track acceleration along Longi direction (in VCS coordinate)";
CM_ SG_ 375 OBJ_ACCELERATION_LAT_056 "Over-the-ground track acceleration along Lat direction (in VCS coordinate)";
CM_ SG_ 375 OBJ_VEH_TRACK_FLAG_056 "Indicates if current track is a vehicle";
CM_ SG_ 375 OBJ_TIMESTAMP_OFFSET_056 "A timestamp offset from the object list header timestamp for each object as we have different timestamps from different sensors leading to different timestamps on each object";
CM_ SG_ 375 OBJ_DIMENSION_WIDTH_ERR_056 "Lat distance or length error";
CM_ SG_ 375 OBJ_DIMENSION_LENGTH_ERR_056 "Longi distance or length error";
CM_ SG_ 375 OBJ_CLS_TYPE1_056 "Classification Type 1(Highest Prob), selected from ENUM list";
CM_ SG_ 375 OBJ_CLS_TYPE1_PROB_056 "Classification Type 1 probablity";
CM_ SG_ 375 OBJ_CLS_TYPE6_056 "Classification Type 6(Lowest Prob), selected from ENUM list";
CM_ SG_ 375 OBJ_CLS_TYPE6_PROB_056 "Classification Type 1 probablity";
CM_ SG_ 375 OBJ_RCS_056 "Representative RCS of the complete recognized object, Not implemented";
CM_ SG_ 375 OBJ_REF_PT_LONG_OFFSET_056 "Outer edges of the recognized object’s bounding box in Y axis";
CM_ SG_ 375 OBJ_REF_PT_LAT_OFFSET_056 "Outer edges of the recognized object’s bounding box in X axis";
CM_ SG_ 375 OBJ_YAW_RATE_056 "Orientation rate of track's bounding box in VCS coordinate";
CM_ SG_ 375 OBJ_GROUP_ID_056 "Objects which are linked together shall have same group ID";
CM_ SG_ 375 OBJ_POS_ERR_CRR_COEF_056 "vx-vy correlation due to small error in radial direction and big in cross radial - position Correlation Coefficient Error";
CM_ SG_ 375 OBJ_VELOCITY_ERR_CRR_COEF_056 "vx-vy correlation due to small error in radial direction and big in cross radial - velocity Correlation Coefficient Error";
CM_ SG_ 375 OBJ_ACCEL_ERR_CRR_COEF_056 "vx-vy correlation due to small error in radial direction and big in cross radial - Acceleration Correlation Coefficient Error";
CM_ SG_ 376 OBJ_ALIVE_TIME_057 "Time since object initialization in msec. Tracker internal may have bigger values. On the output interface, we should saturate the signal in that case.";
CM_ SG_ 376 OBJ_ACCELERATION_LONG_ERR_057 "acceleration along Longi  direction";
CM_ SG_ 376 OBJ_ACCELERATION_LAT_ERR_057 "acceleration along Lat direction error";
CM_ SG_ 376 OBJ_POS_LONG_ERR_057 "Lat-position error of object track's centroid in VCS coordinate";
CM_ SG_ 376 OBJ_POS_LAT_ERR_057 "Lat-position error of object track's centroid in VCS coordinate";
CM_ SG_ 376 OBJ_TRACK_MOTION_MODEL_057 "Object tracking uses a motion model for tracking moving items";
CM_ SG_ 376 OBJ_DIMENSION_WIDTH_057 "Lat distance from centroid to edge of bounding box.";
CM_ SG_ 376 OBJ_DIMENSION_LENGTH_057 "Longi distance from centroid to edge of bounding box.";
CM_ SG_ 376 OBJ_EXISTENCE_PROB_057 "Probability that the target is an actual target";
CM_ SG_ 376 OBJ_YAW_ANGLE_057 "Orientation of track's bounding box in VCS coordinate";
CM_ SG_ 376 OBJ_ID_057 "ID of object tracks, zero-ID represents an inactive track";
CM_ SG_ 376 OBJ_MOVEMENT_STATUS_057 "Information about a possible movement of the object during tracking";
CM_ SG_ 376 OBJ_MEASUREMENT_STATUS_057 "Objects should be sent out as fast as possible, even if not all statuses are observed and the object’s
signals might not be fully filled.";
CM_ SG_ 376 OBJ_POS_LONG_057 "Long-position of object track's centroid in VCS coordinate";
CM_ SG_ 376 OBJ_POS_LAT_057 "Lat-position of object track's centroid in VCS coordinate";
CM_ SG_ 376 OBJ_VELOCITY_LONG_057 "Over-the-ground velocity of object track's centroid along Long direction (in VCS coordinate)";
CM_ SG_ 376 OBJ_VELOCITY_LAT_057 "Over-the-ground velocity of object track's centroid along Lat direction (in VCS coordinate)";
CM_ SG_ 376 OBJ_ACCELERATION_LONG_057 "Over-the-ground track acceleration along Longi direction (in VCS coordinate)";
CM_ SG_ 376 OBJ_ACCELERATION_LAT_057 "Over-the-ground track acceleration along Lat direction (in VCS coordinate)";
CM_ SG_ 376 OBJ_VEH_TRACK_FLAG_057 "Indicates if current track is a vehicle";
CM_ SG_ 376 OBJ_TIMESTAMP_OFFSET_057 "A timestamp offset from the object list header timestamp for each object as we have different timestamps from different sensors leading to different timestamps on each object";
CM_ SG_ 376 OBJ_DIMENSION_WIDTH_ERR_057 "Lat distance or length error";
CM_ SG_ 376 OBJ_DIMENSION_LENGTH_ERR_057 "Longi distance or length error";
CM_ SG_ 376 OBJ_CLS_TYPE1_057 "Classification Type 1(Highest Prob), selected from ENUM list";
CM_ SG_ 376 OBJ_CLS_TYPE1_PROB_057 "Classification Type 1 probablity";
CM_ SG_ 376 OBJ_CLS_TYPE6_057 "Classification Type 6(Lowest Prob), selected from ENUM list";
CM_ SG_ 376 OBJ_CLS_TYPE6_PROB_057 "Classification Type 1 probablity";
CM_ SG_ 376 OBJ_RCS_057 "Representative RCS of the complete recognized object, Not implemented";
CM_ SG_ 376 OBJ_REF_PT_LONG_OFFSET_057 "Outer edges of the recognized object’s bounding box in Y axis";
CM_ SG_ 376 OBJ_REF_PT_LAT_OFFSET_057 "Outer edges of the recognized object’s bounding box in X axis";
CM_ SG_ 376 OBJ_YAW_RATE_057 "Orientation rate of track's bounding box in VCS coordinate";
CM_ SG_ 376 OBJ_GROUP_ID_057 "Objects which are linked together shall have same group ID";
CM_ SG_ 376 OBJ_POS_ERR_CRR_COEF_057 "vx-vy correlation due to small error in radial direction and big in cross radial - position Correlation Coefficient Error";
CM_ SG_ 376 OBJ_VELOCITY_ERR_CRR_COEF_057 "vx-vy correlation due to small error in radial direction and big in cross radial - velocity Correlation Coefficient Error";
CM_ SG_ 376 OBJ_ACCEL_ERR_CRR_COEF_057 "vx-vy correlation due to small error in radial direction and big in cross radial - Acceleration Correlation Coefficient Error";
CM_ SG_ 377 OBJ_ALIVE_TIME_058 "Time since object initialization in msec. Tracker internal may have bigger values. On the output interface, we should saturate the signal in that case.";
CM_ SG_ 377 OBJ_ACCELERATION_LONG_ERR_058 "acceleration along Longi  direction";
CM_ SG_ 377 OBJ_ACCELERATION_LAT_ERR_058 "acceleration along Lat direction error";
CM_ SG_ 377 OBJ_POS_LONG_ERR_058 "Lat-position error of object track's centroid in VCS coordinate";
CM_ SG_ 377 OBJ_POS_LAT_ERR_058 "Lat-position error of object track's centroid in VCS coordinate";
CM_ SG_ 377 OBJ_TRACK_MOTION_MODEL_058 "Object tracking uses a motion model for tracking moving items";
CM_ SG_ 377 OBJ_DIMENSION_WIDTH_058 "Lat distance from centroid to edge of bounding box.";
CM_ SG_ 377 OBJ_DIMENSION_LENGTH_058 "Longi distance from centroid to edge of bounding box.";
CM_ SG_ 377 OBJ_EXISTENCE_PROB_058 "Probability that the target is an actual target";
CM_ SG_ 377 OBJ_YAW_ANGLE_058 "Orientation of track's bounding box in VCS coordinate";
CM_ SG_ 377 OBJ_ID_058 "ID of object tracks, zero-ID represents an inactive track";
CM_ SG_ 377 OBJ_MOVEMENT_STATUS_058 "Information about a possible movement of the object during tracking";
CM_ SG_ 377 OBJ_MEASUREMENT_STATUS_058 "Objects should be sent out as fast as possible, even if not all statuses are observed and the object’s
signals might not be fully filled.";
CM_ SG_ 377 OBJ_POS_LONG_058 "Long-position of object track's centroid in VCS coordinate";
CM_ SG_ 377 OBJ_POS_LAT_058 "Lat-position of object track's centroid in VCS coordinate";
CM_ SG_ 377 OBJ_VELOCITY_LONG_058 "Over-the-ground velocity of object track's centroid along Long direction (in VCS coordinate)";
CM_ SG_ 377 OBJ_VELOCITY_LAT_058 "Over-the-ground velocity of object track's centroid along Lat direction (in VCS coordinate)";
CM_ SG_ 377 OBJ_ACCELERATION_LONG_058 "Over-the-ground track acceleration along Longi direction (in VCS coordinate)";
CM_ SG_ 377 OBJ_ACCELERATION_LAT_058 "Over-the-ground track acceleration along Lat direction (in VCS coordinate)";
CM_ SG_ 377 OBJ_VEH_TRACK_FLAG_058 "Indicates if current track is a vehicle";
CM_ SG_ 377 OBJ_TIMESTAMP_OFFSET_058 "A timestamp offset from the object list header timestamp for each object as we have different timestamps from different sensors leading to different timestamps on each object";
CM_ SG_ 377 OBJ_DIMENSION_WIDTH_ERR_058 "Lat distance or length error";
CM_ SG_ 377 OBJ_DIMENSION_LENGTH_ERR_058 "Longi distance or length error";
CM_ SG_ 377 OBJ_CLS_TYPE1_058 "Classification Type 1(Highest Prob), selected from ENUM list";
CM_ SG_ 377 OBJ_CLS_TYPE1_PROB_058 "Classification Type 1 probablity";
CM_ SG_ 377 OBJ_CLS_TYPE6_058 "Classification Type 6(Lowest Prob), selected from ENUM list";
CM_ SG_ 377 OBJ_CLS_TYPE6_PROB_058 "Classification Type 1 probablity";
CM_ SG_ 377 OBJ_RCS_058 "Representative RCS of the complete recognized object, Not implemented";
CM_ SG_ 377 OBJ_REF_PT_LONG_OFFSET_058 "Outer edges of the recognized object’s bounding box in Y axis";
CM_ SG_ 377 OBJ_REF_PT_LAT_OFFSET_058 "Outer edges of the recognized object’s bounding box in X axis";
CM_ SG_ 377 OBJ_YAW_RATE_058 "Orientation rate of track's bounding box in VCS coordinate";
CM_ SG_ 377 OBJ_GROUP_ID_058 "Objects which are linked together shall have same group ID";
CM_ SG_ 377 OBJ_POS_ERR_CRR_COEF_058 "vx-vy correlation due to small error in radial direction and big in cross radial - position Correlation Coefficient Error";
CM_ SG_ 377 OBJ_VELOCITY_ERR_CRR_COEF_058 "vx-vy correlation due to small error in radial direction and big in cross radial - velocity Correlation Coefficient Error";
CM_ SG_ 377 OBJ_ACCEL_ERR_CRR_COEF_058 "vx-vy correlation due to small error in radial direction and big in cross radial - Acceleration Correlation Coefficient Error";
CM_ SG_ 378 OBJ_ALIVE_TIME_059 "Time since object initialization in msec. Tracker internal may have bigger values. On the output interface, we should saturate the signal in that case.";
CM_ SG_ 378 OBJ_ACCELERATION_LONG_ERR_059 "acceleration along Longi  direction";
CM_ SG_ 378 OBJ_ACCELERATION_LAT_ERR_059 "acceleration along Lat direction error";
CM_ SG_ 378 OBJ_POS_LONG_ERR_059 "Lat-position error of object track's centroid in VCS coordinate";
CM_ SG_ 378 OBJ_POS_LAT_ERR_059 "Lat-position error of object track's centroid in VCS coordinate";
CM_ SG_ 378 OBJ_TRACK_MOTION_MODEL_059 "Object tracking uses a motion model for tracking moving items";
CM_ SG_ 378 OBJ_DIMENSION_WIDTH_059 "Lat distance from centroid to edge of bounding box.";
CM_ SG_ 378 OBJ_DIMENSION_LENGTH_059 "Longi distance from centroid to edge of bounding box.";
CM_ SG_ 378 OBJ_EXISTENCE_PROB_059 "Probability that the target is an actual target";
CM_ SG_ 378 OBJ_YAW_ANGLE_059 "Orientation of track's bounding box in VCS coordinate";
CM_ SG_ 378 OBJ_ID_059 "ID of object tracks, zero-ID represents an inactive track";
CM_ SG_ 378 OBJ_MOVEMENT_STATUS_059 "Information about a possible movement of the object during tracking";
CM_ SG_ 378 OBJ_MEASUREMENT_STATUS_059 "Objects should be sent out as fast as possible, even if not all statuses are observed and the object’s
signals might not be fully filled.";
CM_ SG_ 378 OBJ_POS_LONG_059 "Long-position of object track's centroid in VCS coordinate";
CM_ SG_ 378 OBJ_POS_LAT_059 "Lat-position of object track's centroid in VCS coordinate";
CM_ SG_ 378 OBJ_VELOCITY_LONG_059 "Over-the-ground velocity of object track's centroid along Long direction (in VCS coordinate)";
CM_ SG_ 378 OBJ_VELOCITY_LAT_059 "Over-the-ground velocity of object track's centroid along Lat direction (in VCS coordinate)";
CM_ SG_ 378 OBJ_ACCELERATION_LONG_059 "Over-the-ground track acceleration along Longi direction (in VCS coordinate)";
CM_ SG_ 378 OBJ_ACCELERATION_LAT_059 "Over-the-ground track acceleration along Lat direction (in VCS coordinate)";
CM_ SG_ 378 OBJ_VEH_TRACK_FLAG_059 "Indicates if current track is a vehicle";
CM_ SG_ 378 OBJ_TIMESTAMP_OFFSET_059 "A timestamp offset from the object list header timestamp for each object as we have different timestamps from different sensors leading to different timestamps on each object";
CM_ SG_ 378 OBJ_DIMENSION_WIDTH_ERR_059 "Lat distance or length error";
CM_ SG_ 378 OBJ_DIMENSION_LENGTH_ERR_059 "Longi distance or length error";
CM_ SG_ 378 OBJ_CLS_TYPE1_059 "Classification Type 1(Highest Prob), selected from ENUM list";
CM_ SG_ 378 OBJ_CLS_TYPE1_PROB_059 "Classification Type 1 probablity";
CM_ SG_ 378 OBJ_CLS_TYPE6_059 "Classification Type 6(Lowest Prob), selected from ENUM list";
CM_ SG_ 378 OBJ_CLS_TYPE6_PROB_059 "Classification Type 1 probablity";
CM_ SG_ 378 OBJ_RCS_059 "Representative RCS of the complete recognized object, Not implemented";
CM_ SG_ 378 OBJ_REF_PT_LONG_OFFSET_059 "Outer edges of the recognized object’s bounding box in Y axis";
CM_ SG_ 378 OBJ_REF_PT_LAT_OFFSET_059 "Outer edges of the recognized object’s bounding box in X axis";
CM_ SG_ 378 OBJ_YAW_RATE_059 "Orientation rate of track's bounding box in VCS coordinate";
CM_ SG_ 378 OBJ_GROUP_ID_059 "Objects which are linked together shall have same group ID";
CM_ SG_ 378 OBJ_POS_ERR_CRR_COEF_059 "vx-vy correlation due to small error in radial direction and big in cross radial - position Correlation Coefficient Error";
CM_ SG_ 378 OBJ_VELOCITY_ERR_CRR_COEF_059 "vx-vy correlation due to small error in radial direction and big in cross radial - velocity Correlation Coefficient Error";
CM_ SG_ 378 OBJ_ACCEL_ERR_CRR_COEF_059 "vx-vy correlation due to small error in radial direction and big in cross radial - Acceleration Correlation Coefficient Error";
CM_ SG_ 379 OBJ_ALIVE_TIME_060 "Time since object initialization in msec. Tracker internal may have bigger values. On the output interface, we should saturate the signal in that case.";
CM_ SG_ 379 OBJ_ACCELERATION_LONG_ERR_060 "acceleration along Longi  direction";
CM_ SG_ 379 OBJ_ACCELERATION_LAT_ERR_060 "acceleration along Lat direction error";
CM_ SG_ 379 OBJ_POS_LONG_ERR_060 "Lat-position error of object track's centroid in VCS coordinate";
CM_ SG_ 379 OBJ_POS_LAT_ERR_060 "Lat-position error of object track's centroid in VCS coordinate";
CM_ SG_ 379 OBJ_TRACK_MOTION_MODEL_060 "Object tracking uses a motion model for tracking moving items";
CM_ SG_ 379 OBJ_DIMENSION_WIDTH_060 "Lat distance from centroid to edge of bounding box.";
CM_ SG_ 379 OBJ_DIMENSION_LENGTH_060 "Longi distance from centroid to edge of bounding box.";
CM_ SG_ 379 OBJ_EXISTENCE_PROB_060 "Probability that the target is an actual target";
CM_ SG_ 379 OBJ_YAW_ANGLE_060 "Orientation of track's bounding box in VCS coordinate";
CM_ SG_ 379 OBJ_ID_060 "ID of object tracks, zero-ID represents an inactive track";
CM_ SG_ 379 OBJ_MOVEMENT_STATUS_060 "Information about a possible movement of the object during tracking";
CM_ SG_ 379 OBJ_MEASUREMENT_STATUS_060 "Objects should be sent out as fast as possible, even if not all statuses are observed and the object’s
signals might not be fully filled.";
CM_ SG_ 379 OBJ_POS_LONG_060 "Long-position of object track's centroid in VCS coordinate";
CM_ SG_ 379 OBJ_POS_LAT_060 "Lat-position of object track's centroid in VCS coordinate";
CM_ SG_ 379 OBJ_VELOCITY_LONG_060 "Over-the-ground velocity of object track's centroid along Long direction (in VCS coordinate)";
CM_ SG_ 379 OBJ_VELOCITY_LAT_060 "Over-the-ground velocity of object track's centroid along Lat direction (in VCS coordinate)";
CM_ SG_ 379 OBJ_ACCELERATION_LONG_060 "Over-the-ground track acceleration along Longi direction (in VCS coordinate)";
CM_ SG_ 379 OBJ_ACCELERATION_LAT_060 "Over-the-ground track acceleration along Lat direction (in VCS coordinate)";
CM_ SG_ 379 OBJ_VEH_TRACK_FLAG_060 "Indicates if current track is a vehicle";
CM_ SG_ 379 OBJ_TIMESTAMP_OFFSET_060 "A timestamp offset from the object list header timestamp for each object as we have different timestamps from different sensors leading to different timestamps on each object";
CM_ SG_ 379 OBJ_DIMENSION_WIDTH_ERR_060 "Lat distance or length error";
CM_ SG_ 379 OBJ_DIMENSION_LENGTH_ERR_060 "Longi distance or length error";
CM_ SG_ 379 OBJ_CLS_TYPE1_060 "Classification Type 1(Highest Prob), selected from ENUM list";
CM_ SG_ 379 OBJ_CLS_TYPE1_PROB_060 "Classification Type 1 probablity";
CM_ SG_ 379 OBJ_CLS_TYPE6_060 "Classification Type 6(Lowest Prob), selected from ENUM list";
CM_ SG_ 379 OBJ_CLS_TYPE6_PROB_060 "Classification Type 1 probablity";
CM_ SG_ 379 OBJ_RCS_060 "Representative RCS of the complete recognized object, Not implemented";
CM_ SG_ 379 OBJ_REF_PT_LONG_OFFSET_060 "Outer edges of the recognized object’s bounding box in Y axis";
CM_ SG_ 379 OBJ_REF_PT_LAT_OFFSET_060 "Outer edges of the recognized object’s bounding box in X axis";
CM_ SG_ 379 OBJ_YAW_RATE_060 "Orientation rate of track's bounding box in VCS coordinate";
CM_ SG_ 379 OBJ_GROUP_ID_060 "Objects which are linked together shall have same group ID";
CM_ SG_ 379 OBJ_POS_ERR_CRR_COEF_060 "vx-vy correlation due to small error in radial direction and big in cross radial - position Correlation Coefficient Error";
CM_ SG_ 379 OBJ_VELOCITY_ERR_CRR_COEF_060 "vx-vy correlation due to small error in radial direction and big in cross radial - velocity Correlation Coefficient Error";
CM_ SG_ 379 OBJ_ACCEL_ERR_CRR_COEF_060 "vx-vy correlation due to small error in radial direction and big in cross radial - Acceleration Correlation Coefficient Error";
CM_ SG_ 380 OBJ_ALIVE_TIME_061 "Time since object initialization in msec. Tracker internal may have bigger values. On the output interface, we should saturate the signal in that case.";
CM_ SG_ 380 OBJ_ACCELERATION_LONG_ERR_061 "acceleration along Longi  direction";
CM_ SG_ 380 OBJ_ACCELERATION_LAT_ERR_061 "acceleration along Lat direction error";
CM_ SG_ 380 OBJ_POS_LONG_ERR_061 "Lat-position error of object track's centroid in VCS coordinate";
CM_ SG_ 380 OBJ_POS_LAT_ERR_061 "Lat-position error of object track's centroid in VCS coordinate";
CM_ SG_ 380 OBJ_TRACK_MOTION_MODEL_061 "Object tracking uses a motion model for tracking moving items";
CM_ SG_ 380 OBJ_DIMENSION_WIDTH_061 "Lat distance from centroid to edge of bounding box.";
CM_ SG_ 380 OBJ_DIMENSION_LENGTH_061 "Longi distance from centroid to edge of bounding box.";
CM_ SG_ 380 OBJ_EXISTENCE_PROB_061 "Probability that the target is an actual target";
CM_ SG_ 380 OBJ_YAW_ANGLE_061 "Orientation of track's bounding box in VCS coordinate";
CM_ SG_ 380 OBJ_ID_061 "ID of object tracks, zero-ID represents an inactive track";
CM_ SG_ 380 OBJ_MOVEMENT_STATUS_061 "Information about a possible movement of the object during tracking";
CM_ SG_ 380 OBJ_MEASUREMENT_STATUS_061 "Objects should be sent out as fast as possible, even if not all statuses are observed and the object’s
signals might not be fully filled.";
CM_ SG_ 380 OBJ_POS_LONG_061 "Long-position of object track's centroid in VCS coordinate";
CM_ SG_ 380 OBJ_POS_LAT_061 "Lat-position of object track's centroid in VCS coordinate";
CM_ SG_ 380 OBJ_VELOCITY_LONG_061 "Over-the-ground velocity of object track's centroid along Long direction (in VCS coordinate)";
CM_ SG_ 380 OBJ_VELOCITY_LAT_061 "Over-the-ground velocity of object track's centroid along Lat direction (in VCS coordinate)";
CM_ SG_ 380 OBJ_ACCELERATION_LONG_061 "Over-the-ground track acceleration along Longi direction (in VCS coordinate)";
CM_ SG_ 380 OBJ_ACCELERATION_LAT_061 "Over-the-ground track acceleration along Lat direction (in VCS coordinate)";
CM_ SG_ 380 OBJ_VEH_TRACK_FLAG_061 "Indicates if current track is a vehicle";
CM_ SG_ 380 OBJ_TIMESTAMP_OFFSET_061 "A timestamp offset from the object list header timestamp for each object as we have different timestamps from different sensors leading to different timestamps on each object";
CM_ SG_ 380 OBJ_DIMENSION_WIDTH_ERR_061 "Lat distance or length error";
CM_ SG_ 380 OBJ_DIMENSION_LENGTH_ERR_061 "Longi distance or length error";
CM_ SG_ 380 OBJ_CLS_TYPE1_061 "Classification Type 1(Highest Prob), selected from ENUM list";
CM_ SG_ 380 OBJ_CLS_TYPE1_PROB_061 "Classification Type 1 probablity";
CM_ SG_ 380 OBJ_CLS_TYPE6_061 "Classification Type 6(Lowest Prob), selected from ENUM list";
CM_ SG_ 380 OBJ_CLS_TYPE6_PROB_061 "Classification Type 1 probablity";
CM_ SG_ 380 OBJ_RCS_061 "Representative RCS of the complete recognized object, Not implemented";
CM_ SG_ 380 OBJ_REF_PT_LONG_OFFSET_061 "Outer edges of the recognized object’s bounding box in Y axis";
CM_ SG_ 380 OBJ_REF_PT_LAT_OFFSET_061 "Outer edges of the recognized object’s bounding box in X axis";
CM_ SG_ 380 OBJ_YAW_RATE_061 "Orientation rate of track's bounding box in VCS coordinate";
CM_ SG_ 380 OBJ_GROUP_ID_061 "Objects which are linked together shall have same group ID";
CM_ SG_ 380 OBJ_POS_ERR_CRR_COEF_061 "vx-vy correlation due to small error in radial direction and big in cross radial - position Correlation Coefficient Error";
CM_ SG_ 380 OBJ_VELOCITY_ERR_CRR_COEF_061 "vx-vy correlation due to small error in radial direction and big in cross radial - velocity Correlation Coefficient Error";
CM_ SG_ 380 OBJ_ACCEL_ERR_CRR_COEF_061 "vx-vy correlation due to small error in radial direction and big in cross radial - Acceleration Correlation Coefficient Error";
CM_ SG_ 381 OBJ_ALIVE_TIME_062 "Time since object initialization in msec. Tracker internal may have bigger values. On the output interface, we should saturate the signal in that case.";
CM_ SG_ 381 OBJ_ACCELERATION_LONG_ERR_062 "acceleration along Longi  direction";
CM_ SG_ 381 OBJ_ACCELERATION_LAT_ERR_062 "acceleration along Lat direction error";
CM_ SG_ 381 OBJ_POS_LONG_ERR_062 "Lat-position error of object track's centroid in VCS coordinate";
CM_ SG_ 381 OBJ_POS_LAT_ERR_062 "Lat-position error of object track's centroid in VCS coordinate";
CM_ SG_ 381 OBJ_TRACK_MOTION_MODEL_062 "Object tracking uses a motion model for tracking moving items";
CM_ SG_ 381 OBJ_DIMENSION_WIDTH_062 "Lat distance from centroid to edge of bounding box.";
CM_ SG_ 381 OBJ_DIMENSION_LENGTH_062 "Longi distance from centroid to edge of bounding box.";
CM_ SG_ 381 OBJ_EXISTENCE_PROB_062 "Probability that the target is an actual target";
CM_ SG_ 381 OBJ_YAW_ANGLE_062 "Orientation of track's bounding box in VCS coordinate";
CM_ SG_ 381 OBJ_ID_062 "ID of object tracks, zero-ID represents an inactive track";
CM_ SG_ 381 OBJ_MOVEMENT_STATUS_062 "Information about a possible movement of the object during tracking";
CM_ SG_ 381 OBJ_MEASUREMENT_STATUS_062 "Objects should be sent out as fast as possible, even if not all statuses are observed and the object’s
signals might not be fully filled.";
CM_ SG_ 381 OBJ_POS_LONG_062 "Long-position of object track's centroid in VCS coordinate";
CM_ SG_ 381 OBJ_POS_LAT_062 "Lat-position of object track's centroid in VCS coordinate";
CM_ SG_ 381 OBJ_VELOCITY_LONG_062 "Over-the-ground velocity of object track's centroid along Long direction (in VCS coordinate)";
CM_ SG_ 381 OBJ_VELOCITY_LAT_062 "Over-the-ground velocity of object track's centroid along Lat direction (in VCS coordinate)";
CM_ SG_ 381 OBJ_ACCELERATION_LONG_062 "Over-the-ground track acceleration along Longi direction (in VCS coordinate)";
CM_ SG_ 381 OBJ_ACCELERATION_LAT_062 "Over-the-ground track acceleration along Lat direction (in VCS coordinate)";
CM_ SG_ 381 OBJ_VEH_TRACK_FLAG_062 "Indicates if current track is a vehicle";
CM_ SG_ 381 OBJ_TIMESTAMP_OFFSET_062 "A timestamp offset from the object list header timestamp for each object as we have different timestamps from different sensors leading to different timestamps on each object";
CM_ SG_ 381 OBJ_DIMENSION_WIDTH_ERR_062 "Lat distance or length error";
CM_ SG_ 381 OBJ_DIMENSION_LENGTH_ERR_062 "Longi distance or length error";
CM_ SG_ 381 OBJ_CLS_TYPE1_062 "Classification Type 1(Highest Prob), selected from ENUM list";
CM_ SG_ 381 OBJ_CLS_TYPE1_PROB_062 "Classification Type 1 probablity";
CM_ SG_ 381 OBJ_CLS_TYPE6_062 "Classification Type 6(Lowest Prob), selected from ENUM list";
CM_ SG_ 381 OBJ_CLS_TYPE6_PROB_062 "Classification Type 1 probablity";
CM_ SG_ 381 OBJ_RCS_062 "Representative RCS of the complete recognized object, Not implemented";
CM_ SG_ 381 OBJ_REF_PT_LONG_OFFSET_062 "Outer edges of the recognized object’s bounding box in Y axis";
CM_ SG_ 381 OBJ_REF_PT_LAT_OFFSET_062 "Outer edges of the recognized object’s bounding box in X axis";
CM_ SG_ 381 OBJ_YAW_RATE_062 "Orientation rate of track's bounding box in VCS coordinate";
CM_ SG_ 381 OBJ_GROUP_ID_062 "Objects which are linked together shall have same group ID";
CM_ SG_ 381 OBJ_POS_ERR_CRR_COEF_062 "vx-vy correlation due to small error in radial direction and big in cross radial - position Correlation Coefficient Error";
CM_ SG_ 381 OBJ_VELOCITY_ERR_CRR_COEF_062 "vx-vy correlation due to small error in radial direction and big in cross radial - velocity Correlation Coefficient Error";
CM_ SG_ 381 OBJ_ACCEL_ERR_CRR_COEF_062 "vx-vy correlation due to small error in radial direction and big in cross radial - Acceleration Correlation Coefficient Error";
CM_ SG_ 382 OBJ_ALIVE_TIME_063 "Time since object initialization in msec. Tracker internal may have bigger values. On the output interface, we should saturate the signal in that case.";
CM_ SG_ 382 OBJ_ACCELERATION_LONG_ERR_063 "acceleration along Longi  direction";
CM_ SG_ 382 OBJ_ACCELERATION_LAT_ERR_063 "acceleration along Lat direction error";
CM_ SG_ 382 OBJ_POS_LONG_ERR_063 "Lat-position error of object track's centroid in VCS coordinate";
CM_ SG_ 382 OBJ_POS_LAT_ERR_063 "Lat-position error of object track's centroid in VCS coordinate";
CM_ SG_ 382 OBJ_TRACK_MOTION_MODEL_063 "Object tracking uses a motion model for tracking moving items";
CM_ SG_ 382 OBJ_DIMENSION_WIDTH_063 "Lat distance from centroid to edge of bounding box.";
CM_ SG_ 382 OBJ_DIMENSION_LENGTH_063 "Longi distance from centroid to edge of bounding box.";
CM_ SG_ 382 OBJ_EXISTENCE_PROB_063 "Probability that the target is an actual target";
CM_ SG_ 382 OBJ_YAW_ANGLE_063 "Orientation of track's bounding box in VCS coordinate";
CM_ SG_ 382 OBJ_ID_063 "ID of object tracks, zero-ID represents an inactive track";
CM_ SG_ 382 OBJ_MOVEMENT_STATUS_063 "Information about a possible movement of the object during tracking";
CM_ SG_ 382 OBJ_MEASUREMENT_STATUS_063 "Objects should be sent out as fast as possible, even if not all statuses are observed and the object’s
signals might not be fully filled.";
CM_ SG_ 382 OBJ_POS_LONG_063 "Long-position of object track's centroid in VCS coordinate";
CM_ SG_ 382 OBJ_POS_LAT_063 "Lat-position of object track's centroid in VCS coordinate";
CM_ SG_ 382 OBJ_VELOCITY_LONG_063 "Over-the-ground velocity of object track's centroid along Long direction (in VCS coordinate)";
CM_ SG_ 382 OBJ_VELOCITY_LAT_063 "Over-the-ground velocity of object track's centroid along Lat direction (in VCS coordinate)";
CM_ SG_ 382 OBJ_ACCELERATION_LONG_063 "Over-the-ground track acceleration along Longi direction (in VCS coordinate)";
CM_ SG_ 382 OBJ_ACCELERATION_LAT_063 "Over-the-ground track acceleration along Lat direction (in VCS coordinate)";
CM_ SG_ 382 OBJ_VEH_TRACK_FLAG_063 "Indicates if current track is a vehicle";
CM_ SG_ 382 OBJ_TIMESTAMP_OFFSET_063 "A timestamp offset from the object list header timestamp for each object as we have different timestamps from different sensors leading to different timestamps on each object";
CM_ SG_ 382 OBJ_DIMENSION_WIDTH_ERR_063 "Lat distance or length error";
CM_ SG_ 382 OBJ_DIMENSION_LENGTH_ERR_063 "Longi distance or length error";
CM_ SG_ 382 OBJ_CLS_TYPE1_063 "Classification Type 1(Highest Prob), selected from ENUM list";
CM_ SG_ 382 OBJ_CLS_TYPE1_PROB_063 "Classification Type 1 probablity";
CM_ SG_ 382 OBJ_CLS_TYPE6_063 "Classification Type 6(Lowest Prob), selected from ENUM list";
CM_ SG_ 382 OBJ_CLS_TYPE6_PROB_063 "Classification Type 1 probablity";
CM_ SG_ 382 OBJ_RCS_063 "Representative RCS of the complete recognized object, Not implemented";
CM_ SG_ 382 OBJ_REF_PT_LONG_OFFSET_063 "Outer edges of the recognized object’s bounding box in Y axis";
CM_ SG_ 382 OBJ_REF_PT_LAT_OFFSET_063 "Outer edges of the recognized object’s bounding box in X axis";
CM_ SG_ 382 OBJ_YAW_RATE_063 "Orientation rate of track's bounding box in VCS coordinate";
CM_ SG_ 382 OBJ_GROUP_ID_063 "Objects which are linked together shall have same group ID";
CM_ SG_ 382 OBJ_POS_ERR_CRR_COEF_063 "vx-vy correlation due to small error in radial direction and big in cross radial - position Correlation Coefficient Error";
CM_ SG_ 382 OBJ_VELOCITY_ERR_CRR_COEF_063 "vx-vy correlation due to small error in radial direction and big in cross radial - velocity Correlation Coefficient Error";
CM_ SG_ 382 OBJ_ACCEL_ERR_CRR_COEF_063 "vx-vy correlation due to small error in radial direction and big in cross radial - Acceleration Correlation Coefficient Error";
CM_ SG_ 383 OBJ_ALIVE_TIME_064 "Time since object initialization in msec. Tracker internal may have bigger values. On the output interface, we should saturate the signal in that case.";
CM_ SG_ 383 OBJ_ACCELERATION_LONG_ERR_064 "acceleration along Longi  direction";
CM_ SG_ 383 OBJ_ACCELERATION_LAT_ERR_064 "acceleration along Lat direction error";
CM_ SG_ 383 OBJ_POS_LONG_ERR_064 "Lat-position error of object track's centroid in VCS coordinate";
CM_ SG_ 383 OBJ_POS_LAT_ERR_064 "Lat-position error of object track's centroid in VCS coordinate";
CM_ SG_ 383 OBJ_TRACK_MOTION_MODEL_064 "Object tracking uses a motion model for tracking moving items";
CM_ SG_ 383 OBJ_DIMENSION_WIDTH_064 "Lat distance from centroid to edge of bounding box.";
CM_ SG_ 383 OBJ_DIMENSION_LENGTH_064 "Longi distance from centroid to edge of bounding box.";
CM_ SG_ 383 OBJ_EXISTENCE_PROB_064 "Probability that the target is an actual target";
CM_ SG_ 383 OBJ_YAW_ANGLE_064 "Orientation of track's bounding box in VCS coordinate";
CM_ SG_ 383 OBJ_ID_064 "ID of object tracks, zero-ID represents an inactive track";
CM_ SG_ 383 OBJ_MOVEMENT_STATUS_064 "Information about a possible movement of the object during tracking";
CM_ SG_ 383 OBJ_MEASUREMENT_STATUS_064 "Objects should be sent out as fast as possible, even if not all statuses are observed and the object’s
signals might not be fully filled.";
CM_ SG_ 383 OBJ_POS_LONG_064 "Long-position of object track's centroid in VCS coordinate";
CM_ SG_ 383 OBJ_POS_LAT_064 "Lat-position of object track's centroid in VCS coordinate";
CM_ SG_ 383 OBJ_VELOCITY_LONG_064 "Over-the-ground velocity of object track's centroid along Long direction (in VCS coordinate)";
CM_ SG_ 383 OBJ_VELOCITY_LAT_064 "Over-the-ground velocity of object track's centroid along Lat direction (in VCS coordinate)";
CM_ SG_ 383 OBJ_ACCELERATION_LONG_064 "Over-the-ground track acceleration along Longi direction (in VCS coordinate)";
CM_ SG_ 383 OBJ_ACCELERATION_LAT_064 "Over-the-ground track acceleration along Lat direction (in VCS coordinate)";
CM_ SG_ 383 OBJ_VEH_TRACK_FLAG_064 "Indicates if current track is a vehicle";
CM_ SG_ 383 OBJ_TIMESTAMP_OFFSET_064 "A timestamp offset from the object list header timestamp for each object as we have different timestamps from different sensors leading to different timestamps on each object";
CM_ SG_ 383 OBJ_DIMENSION_WIDTH_ERR_064 "Lat distance or length error";
CM_ SG_ 383 OBJ_DIMENSION_LENGTH_ERR_064 "Longi distance or length error";
CM_ SG_ 383 OBJ_CLS_TYPE1_064 "Classification Type 1(Highest Prob), selected from ENUM list";
CM_ SG_ 383 OBJ_CLS_TYPE1_PROB_064 "Classification Type 1 probablity";
CM_ SG_ 383 OBJ_CLS_TYPE6_064 "Classification Type 6(Lowest Prob), selected from ENUM list";
CM_ SG_ 383 OBJ_CLS_TYPE6_PROB_064 "Classification Type 1 probablity";
CM_ SG_ 383 OBJ_RCS_064 "Representative RCS of the complete recognized object, Not implemented";
CM_ SG_ 383 OBJ_REF_PT_LONG_OFFSET_064 "Outer edges of the recognized object’s bounding box in Y axis";
CM_ SG_ 383 OBJ_REF_PT_LAT_OFFSET_064 "Outer edges of the recognized object’s bounding box in X axis";
CM_ SG_ 383 OBJ_YAW_RATE_064 "Orientation rate of track's bounding box in VCS coordinate";
CM_ SG_ 383 OBJ_GROUP_ID_064 "Objects which are linked together shall have same group ID";
CM_ SG_ 383 OBJ_POS_ERR_CRR_COEF_064 "vx-vy correlation due to small error in radial direction and big in cross radial - position Correlation Coefficient Error";
CM_ SG_ 383 OBJ_VELOCITY_ERR_CRR_COEF_064 "vx-vy correlation due to small error in radial direction and big in cross radial - velocity Correlation Coefficient Error";
CM_ SG_ 383 OBJ_ACCEL_ERR_CRR_COEF_064 "vx-vy correlation due to small error in radial direction and big in cross radial - Acceleration Correlation Coefficient Error";

BA_DEF_ BO_ "CanTpBs" INT 0 255;
BA_DEF_ BO_ "EventRateOfChange" INT 10 10000;
BA_DEF_ BO_ "GenMsgCycleTime" INT 0 100000;
BA_DEF_ BO_ "GenMsgILSupport" ENUM  "No","Yes";
BA_DEF_ BO_ "GenMsgNrOfRepetition" INT 0 100;
BA_DEF_ BO_ "GenMsgSendType" ENUM  "FixedPeriodic","Event","EnabledPeriodic","NotUsed","NotUsed","EventPeriodic","NotUsed","NotUsed","NoMsgSendType";
BA_DEF_ BO_ "NetworkInitialization" ENUM  "No","Yes";
BA_DEF_ BO_ "VFrameFormat" ENUM  "StandardCAN","ExtendedCAN","reserved","reserved","reserved","reserved","reserved","reserved","reserved","reserved","reserved","reserved","reserved","reserved","StandardCAN_FD","ExtendedCAN_FD";
BA_DEF_ SG_ "GenSigCmt" STRING;
BA_DEF_ SG_ "GenSigCycleTime" INT 0 0;
BA_DEF_ SG_ "GenSigSendType" ENUM  "Cyclic","OnWrite","vector_leerstring","OnChange","vector_leerstring","IfActive","vector_leerstring","NoSigSendType";
BA_DEF_ SG_ "GenSigStartValue" INT 0 1000000000;
BA_DEF_ SG_ "GenSigTimeoutTime" INT 0 0;
BA_DEF_ SG_ "GenSigVtEn" STRING;
BA_DEF_ SG_ "GenSigVtName" STRING;
BA_DEF_DEF_ "CanTpBs" 255;
BA_DEF_DEF_ "EventRateOfChange" 10000;
BA_DEF_DEF_ "GenMsgCycleTime" 0;
BA_DEF_DEF_ "GenMsgILSupport" "Yes";
BA_DEF_DEF_ "GenMsgNrOfRepetition" 0;
BA_DEF_DEF_ "GenMsgSendType" "NoMsgSendType";
BA_DEF_DEF_ "GenSigCmt" "";
BA_DEF_DEF_ "GenSigCycleTime" 0;
BA_DEF_DEF_ "GenSigSendType" "NoSigSendType";
BA_DEF_DEF_ "GenSigStartValue" 0;
BA_DEF_DEF_ "GenSigTimeoutTime" 0;
BA_DEF_DEF_ "GenSigVtEn" "";
BA_DEF_DEF_ "GenSigVtName" "";
BA_DEF_DEF_ "NetworkInitialization" "Yes";
BA_DEF_DEF_ "VFrameFormat" "StandardCAN_FD";
BA_ "GenMsgSendType" BO_ 368 1;
BA_ "GenMsgSendType" BO_ 369 1;
BA_ "GenMsgSendType" BO_ 370 1;
BA_ "GenMsgSendType" BO_ 371 1;
BA_ "GenMsgSendType" BO_ 372 1;
BA_ "GenMsgSendType" BO_ 373 1;
BA_ "GenMsgSendType" BO_ 374 1;
BA_ "GenMsgSendType" BO_ 375 1;
BA_ "GenMsgSendType" BO_ 376 1;
BA_ "GenMsgSendType" BO_ 377 1;
BA_ "GenMsgSendType" BO_ 378 1;
BA_ "GenMsgSendType" BO_ 379 1;
BA_ "GenMsgSendType" BO_ 380 1;
BA_ "GenMsgSendType" BO_ 381 1;
BA_ "GenMsgSendType" BO_ 382 1;
BA_ "GenMsgSendType" BO_ 383 1;
BA_ "GenSigStartValue" SG_ 368 OBJ_YAW_ANGLE_049 2000;
BA_ "GenSigStartValue" SG_ 368 OBJ_POS_LONG_049 32700;
BA_ "GenSigStartValue" SG_ 368 OBJ_POS_LAT_049 32700;
BA_ "GenSigStartValue" SG_ 368 OBJ_VELOCITY_LONG_049 16300;
BA_ "GenSigStartValue" SG_ 368 OBJ_VELOCITY_LAT_049 16300;
BA_ "GenSigStartValue" SG_ 368 OBJ_ACCELERATION_LONG_049 400;
BA_ "GenSigStartValue" SG_ 368 OBJ_ACCELERATION_LAT_049 400;
BA_ "GenSigStartValue" SG_ 368 OBJ_TIMESTAMP_OFFSET_049 127;
BA_ "GenSigStartValue" SG_ 368 OBJ_RCS_049 64;
BA_ "GenSigStartValue" SG_ 368 OBJ_YAW_RATE_049 448;
BA_ "GenSigStartValue" SG_ 368 OBJ_POS_ERR_CRR_COEF_049 120;
BA_ "GenSigStartValue" SG_ 368 OBJ_VELOCITY_ERR_CRR_COEF_049 120;
BA_ "GenSigStartValue" SG_ 368 OBJ_ACCEL_ERR_CRR_COEF_049 120;
BA_ "GenSigStartValue" SG_ 369 OBJ_YAW_ANGLE_050 2000;
BA_ "GenSigStartValue" SG_ 369 OBJ_POS_LONG_050 32700;
BA_ "GenSigStartValue" SG_ 369 OBJ_POS_LAT_050 32700;
BA_ "GenSigStartValue" SG_ 369 OBJ_VELOCITY_LONG_050 16300;
BA_ "GenSigStartValue" SG_ 369 OBJ_VELOCITY_LAT_050 16300;
BA_ "GenSigStartValue" SG_ 369 OBJ_ACCELERATION_LONG_050 400;
BA_ "GenSigStartValue" SG_ 369 OBJ_ACCELERATION_LAT_050 400;
BA_ "GenSigStartValue" SG_ 369 OBJ_TIMESTAMP_OFFSET_050 127;
BA_ "GenSigStartValue" SG_ 369 OBJ_RCS_050 64;
BA_ "GenSigStartValue" SG_ 369 OBJ_YAW_RATE_050 448;
BA_ "GenSigStartValue" SG_ 369 OBJ_POS_ERR_CRR_COEF_050 120;
BA_ "GenSigStartValue" SG_ 369 OBJ_VELOCITY_ERR_CRR_COEF_050 120;
BA_ "GenSigStartValue" SG_ 369 OBJ_ACCEL_ERR_CRR_COEF_050 120;
BA_ "GenSigStartValue" SG_ 370 OBJ_YAW_ANGLE_051 2000;
BA_ "GenSigStartValue" SG_ 370 OBJ_POS_LONG_051 32700;
BA_ "GenSigStartValue" SG_ 370 OBJ_POS_LAT_051 32700;
BA_ "GenSigStartValue" SG_ 370 OBJ_VELOCITY_LONG_051 16300;
BA_ "GenSigStartValue" SG_ 370 OBJ_VELOCITY_LAT_051 16300;
BA_ "GenSigStartValue" SG_ 370 OBJ_ACCELERATION_LONG_051 400;
BA_ "GenSigStartValue" SG_ 370 OBJ_ACCELERATION_LAT_051 400;
BA_ "GenSigStartValue" SG_ 370 OBJ_TIMESTAMP_OFFSET_051 127;
BA_ "GenSigStartValue" SG_ 370 OBJ_RCS_051 64;
BA_ "GenSigStartValue" SG_ 370 OBJ_YAW_RATE_051 448;
BA_ "GenSigStartValue" SG_ 370 OBJ_POS_ERR_CRR_COEF_051 120;
BA_ "GenSigStartValue" SG_ 370 OBJ_VELOCITY_ERR_CRR_COEF_051 120;
BA_ "GenSigStartValue" SG_ 370 OBJ_ACCEL_ERR_CRR_COEF_051 120;
BA_ "GenSigStartValue" SG_ 371 OBJ_YAW_ANGLE_052 2000;
BA_ "GenSigStartValue" SG_ 371 OBJ_POS_LONG_052 32700;
BA_ "GenSigStartValue" SG_ 371 OBJ_POS_LAT_052 32700;
BA_ "GenSigStartValue" SG_ 371 OBJ_VELOCITY_LONG_052 16300;
BA_ "GenSigStartValue" SG_ 371 OBJ_VELOCITY_LAT_052 16300;
BA_ "GenSigStartValue" SG_ 371 OBJ_ACCELERATION_LONG_052 400;
BA_ "GenSigStartValue" SG_ 371 OBJ_ACCELERATION_LAT_052 400;
BA_ "GenSigStartValue" SG_ 371 OBJ_TIMESTAMP_OFFSET_052 127;
BA_ "GenSigStartValue" SG_ 371 OBJ_RCS_052 64;
BA_ "GenSigStartValue" SG_ 371 OBJ_YAW_RATE_052 448;
BA_ "GenSigStartValue" SG_ 371 OBJ_POS_ERR_CRR_COEF_052 120;
BA_ "GenSigStartValue" SG_ 371 OBJ_VELOCITY_ERR_CRR_COEF_052 120;
BA_ "GenSigStartValue" SG_ 371 OBJ_ACCEL_ERR_CRR_COEF_052 120;
BA_ "GenSigStartValue" SG_ 372 OBJ_YAW_ANGLE_053 2000;
BA_ "GenSigStartValue" SG_ 372 OBJ_POS_LONG_053 32700;
BA_ "GenSigStartValue" SG_ 372 OBJ_POS_LAT_053 32700;
BA_ "GenSigStartValue" SG_ 372 OBJ_VELOCITY_LONG_053 16300;
BA_ "GenSigStartValue" SG_ 372 OBJ_VELOCITY_LAT_053 16300;
BA_ "GenSigStartValue" SG_ 372 OBJ_ACCELERATION_LONG_053 400;
BA_ "GenSigStartValue" SG_ 372 OBJ_ACCELERATION_LAT_053 400;
BA_ "GenSigStartValue" SG_ 372 OBJ_TIMESTAMP_OFFSET_053 127;
BA_ "GenSigStartValue" SG_ 372 OBJ_RCS_053 64;
BA_ "GenSigStartValue" SG_ 372 OBJ_YAW_RATE_053 448;
BA_ "GenSigStartValue" SG_ 372 OBJ_POS_ERR_CRR_COEF_053 120;
BA_ "GenSigStartValue" SG_ 372 OBJ_VELOCITY_ERR_CRR_COEF_053 120;
BA_ "GenSigStartValue" SG_ 372 OBJ_ACCEL_ERR_CRR_COEF_053 120;
BA_ "GenSigStartValue" SG_ 373 OBJ_YAW_ANGLE_054 2000;
BA_ "GenSigStartValue" SG_ 373 OBJ_POS_LONG_054 32700;
BA_ "GenSigStartValue" SG_ 373 OBJ_POS_LAT_054 32700;
BA_ "GenSigStartValue" SG_ 373 OBJ_VELOCITY_LONG_054 16300;
BA_ "GenSigStartValue" SG_ 373 OBJ_VELOCITY_LAT_054 16300;
BA_ "GenSigStartValue" SG_ 373 OBJ_ACCELERATION_LONG_054 400;
BA_ "GenSigStartValue" SG_ 373 OBJ_ACCELERATION_LAT_054 400;
BA_ "GenSigStartValue" SG_ 373 OBJ_TIMESTAMP_OFFSET_054 127;
BA_ "GenSigStartValue" SG_ 373 OBJ_RCS_054 64;
BA_ "GenSigStartValue" SG_ 373 OBJ_YAW_RATE_054 448;
BA_ "GenSigStartValue" SG_ 373 OBJ_POS_ERR_CRR_COEF_054 120;
BA_ "GenSigStartValue" SG_ 373 OBJ_VELOCITY_ERR_CRR_COEF_054 120;
BA_ "GenSigStartValue" SG_ 373 OBJ_ACCEL_ERR_CRR_COEF_054 120;
BA_ "GenSigStartValue" SG_ 374 OBJ_YAW_ANGLE_055 2000;
BA_ "GenSigStartValue" SG_ 374 OBJ_POS_LONG_055 32700;
BA_ "GenSigStartValue" SG_ 374 OBJ_POS_LAT_055 32700;
BA_ "GenSigStartValue" SG_ 374 OBJ_VELOCITY_LONG_055 16300;
BA_ "GenSigStartValue" SG_ 374 OBJ_VELOCITY_LAT_055 16300;
BA_ "GenSigStartValue" SG_ 374 OBJ_ACCELERATION_LONG_055 400;
BA_ "GenSigStartValue" SG_ 374 OBJ_ACCELERATION_LAT_055 400;
BA_ "GenSigStartValue" SG_ 374 OBJ_TIMESTAMP_OFFSET_055 127;
BA_ "GenSigStartValue" SG_ 374 OBJ_RCS_055 64;
BA_ "GenSigStartValue" SG_ 374 OBJ_YAW_RATE_055 448;
BA_ "GenSigStartValue" SG_ 374 OBJ_POS_ERR_CRR_COEF_055 120;
BA_ "GenSigStartValue" SG_ 374 OBJ_VELOCITY_ERR_CRR_COEF_055 120;
BA_ "GenSigStartValue" SG_ 374 OBJ_ACCEL_ERR_CRR_COEF_055 120;
BA_ "GenSigStartValue" SG_ 375 OBJ_YAW_ANGLE_056 2000;
BA_ "GenSigStartValue" SG_ 375 OBJ_POS_LONG_056 32700;
BA_ "GenSigStartValue" SG_ 375 OBJ_POS_LAT_056 32700;
BA_ "GenSigStartValue" SG_ 375 OBJ_VELOCITY_LONG_056 16300;
BA_ "GenSigStartValue" SG_ 375 OBJ_VELOCITY_LAT_056 16300;
BA_ "GenSigStartValue" SG_ 375 OBJ_ACCELERATION_LONG_056 400;
BA_ "GenSigStartValue" SG_ 375 OBJ_ACCELERATION_LAT_056 400;
BA_ "GenSigStartValue" SG_ 375 OBJ_TIMESTAMP_OFFSET_056 127;
BA_ "GenSigStartValue" SG_ 375 OBJ_RCS_056 64;
BA_ "GenSigStartValue" SG_ 375 OBJ_YAW_RATE_056 448;
BA_ "GenSigStartValue" SG_ 375 OBJ_POS_ERR_CRR_COEF_056 120;
BA_ "GenSigStartValue" SG_ 375 OBJ_VELOCITY_ERR_CRR_COEF_056 120;
BA_ "GenSigStartValue" SG_ 375 OBJ_ACCEL_ERR_CRR_COEF_056 120;
BA_ "GenSigStartValue" SG_ 376 OBJ_YAW_ANGLE_057 2000;
BA_ "GenSigStartValue" SG_ 376 OBJ_POS_LONG_057 32700;
BA_ "GenSigStartValue" SG_ 376 OBJ_POS_LAT_057 32700;
BA_ "GenSigStartValue" SG_ 376 OBJ_VELOCITY_LONG_057 16300;
BA_ "GenSigStartValue" SG_ 376 OBJ_VELOCITY_LAT_057 16300;
BA_ "GenSigStartValue" SG_ 376 OBJ_ACCELERATION_LONG_057 400;
BA_ "GenSigStartValue" SG_ 376 OBJ_ACCELERATION_LAT_057 400;
BA_ "GenSigStartValue" SG_ 376 OBJ_TIMESTAMP_OFFSET_057 127;
BA_ "GenSigStartValue" SG_ 376 OBJ_RCS_057 64;
BA_ "GenSigStartValue" SG_ 376 OBJ_YAW_RATE_057 448;
BA_ "GenSigStartValue" SG_ 376 OBJ_POS_ERR_CRR_COEF_057 120;
BA_ "GenSigStartValue" SG_ 376 OBJ_VELOCITY_ERR_CRR_COEF_057 120;
BA_ "GenSigStartValue" SG_ 376 OBJ_ACCEL_ERR_CRR_COEF_057 120;
BA_ "GenSigStartValue" SG_ 377 OBJ_YAW_ANGLE_058 2000;
BA_ "GenSigStartValue" SG_ 377 OBJ_POS_LONG_058 32700;
BA_ "GenSigStartValue" SG_ 377 OBJ_POS_LAT_058 32700;
BA_ "GenSigStartValue" SG_ 377 OBJ_VELOCITY_LONG_058 16300;
BA_ "GenSigStartValue" SG_ 377 OBJ_VELOCITY_LAT_058 16300;
BA_ "GenSigStartValue" SG_ 377 OBJ_ACCELERATION_LONG_058 400;
BA_ "GenSigStartValue" SG_ 377 OBJ_ACCELERATION_LAT_058 400;
BA_ "GenSigStartValue" SG_ 377 OBJ_TIMESTAMP_OFFSET_058 127;
BA_ "GenSigStartValue" SG_ 377 OBJ_RCS_058 64;
BA_ "GenSigStartValue" SG_ 377 OBJ_YAW_RATE_058 448;
BA_ "GenSigStartValue" SG_ 377 OBJ_POS_ERR_CRR_COEF_058 120;
BA_ "GenSigStartValue" SG_ 377 OBJ_VELOCITY_ERR_CRR_COEF_058 120;
BA_ "GenSigStartValue" SG_ 377 OBJ_ACCEL_ERR_CRR_COEF_058 120;
BA_ "GenSigStartValue" SG_ 378 OBJ_YAW_ANGLE_059 2000;
BA_ "GenSigStartValue" SG_ 378 OBJ_POS_LONG_059 32700;
BA_ "GenSigStartValue" SG_ 378 OBJ_POS_LAT_059 32700;
BA_ "GenSigStartValue" SG_ 378 OBJ_VELOCITY_LONG_059 16300;
BA_ "GenSigStartValue" SG_ 378 OBJ_VELOCITY_LAT_059 16300;
BA_ "GenSigStartValue" SG_ 378 OBJ_ACCELERATION_LONG_059 400;
BA_ "GenSigStartValue" SG_ 378 OBJ_ACCELERATION_LAT_059 400;
BA_ "GenSigStartValue" SG_ 378 OBJ_TIMESTAMP_OFFSET_059 127;
BA_ "GenSigStartValue" SG_ 378 OBJ_RCS_059 64;
BA_ "GenSigStartValue" SG_ 378 OBJ_YAW_RATE_059 448;
BA_ "GenSigStartValue" SG_ 378 OBJ_POS_ERR_CRR_COEF_059 120;
BA_ "GenSigStartValue" SG_ 378 OBJ_VELOCITY_ERR_CRR_COEF_059 120;
BA_ "GenSigStartValue" SG_ 378 OBJ_ACCEL_ERR_CRR_COEF_059 120;
BA_ "GenSigStartValue" SG_ 379 OBJ_YAW_ANGLE_060 2000;
BA_ "GenSigStartValue" SG_ 379 OBJ_POS_LONG_060 32700;
BA_ "GenSigStartValue" SG_ 379 OBJ_POS_LAT_060 32700;
BA_ "GenSigStartValue" SG_ 379 OBJ_VELOCITY_LONG_060 16300;
BA_ "GenSigStartValue" SG_ 379 OBJ_VELOCITY_LAT_060 16300;
BA_ "GenSigStartValue" SG_ 379 OBJ_ACCELERATION_LONG_060 400;
BA_ "GenSigStartValue" SG_ 379 OBJ_ACCELERATION_LAT_060 400;
BA_ "GenSigStartValue" SG_ 379 OBJ_TIMESTAMP_OFFSET_060 127;
BA_ "GenSigStartValue" SG_ 379 OBJ_RCS_060 64;
BA_ "GenSigStartValue" SG_ 379 OBJ_YAW_RATE_060 448;
BA_ "GenSigStartValue" SG_ 379 OBJ_POS_ERR_CRR_COEF_060 120;
BA_ "GenSigStartValue" SG_ 379 OBJ_VELOCITY_ERR_CRR_COEF_060 120;
BA_ "GenSigStartValue" SG_ 379 OBJ_ACCEL_ERR_CRR_COEF_060 120;
BA_ "GenSigStartValue" SG_ 380 OBJ_YAW_ANGLE_061 2000;
BA_ "GenSigStartValue" SG_ 380 OBJ_POS_LONG_061 32700;
BA_ "GenSigStartValue" SG_ 380 OBJ_POS_LAT_061 32700;
BA_ "GenSigStartValue" SG_ 380 OBJ_VELOCITY_LONG_061 16300;
BA_ "GenSigStartValue" SG_ 380 OBJ_VELOCITY_LAT_061 16300;
BA_ "GenSigStartValue" SG_ 380 OBJ_ACCELERATION_LONG_061 400;
BA_ "GenSigStartValue" SG_ 380 OBJ_ACCELERATION_LAT_061 400;
BA_ "GenSigStartValue" SG_ 380 OBJ_TIMESTAMP_OFFSET_061 127;
BA_ "GenSigStartValue" SG_ 380 OBJ_RCS_061 64;
BA_ "GenSigStartValue" SG_ 380 OBJ_YAW_RATE_061 448;
BA_ "GenSigStartValue" SG_ 380 OBJ_POS_ERR_CRR_COEF_061 120;
BA_ "GenSigStartValue" SG_ 380 OBJ_VELOCITY_ERR_CRR_COEF_061 120;
BA_ "GenSigStartValue" SG_ 380 OBJ_ACCEL_ERR_CRR_COEF_061 120;
BA_ "GenSigStartValue" SG_ 381 OBJ_YAW_ANGLE_062 2000;
BA_ "GenSigStartValue" SG_ 381 OBJ_POS_LONG_062 32700;
BA_ "GenSigStartValue" SG_ 381 OBJ_POS_LAT_062 32700;
BA_ "GenSigStartValue" SG_ 381 OBJ_VELOCITY_LONG_062 16300;
BA_ "GenSigStartValue" SG_ 381 OBJ_VELOCITY_LAT_062 16300;
BA_ "GenSigStartValue" SG_ 381 OBJ_ACCELERATION_LONG_062 400;
BA_ "GenSigStartValue" SG_ 381 OBJ_ACCELERATION_LAT_062 400;
BA_ "GenSigStartValue" SG_ 381 OBJ_TIMESTAMP_OFFSET_062 127;
BA_ "GenSigStartValue" SG_ 381 OBJ_RCS_062 64;
BA_ "GenSigStartValue" SG_ 381 OBJ_YAW_RATE_062 448;
BA_ "GenSigStartValue" SG_ 381 OBJ_POS_ERR_CRR_COEF_062 120;
BA_ "GenSigStartValue" SG_ 381 OBJ_VELOCITY_ERR_CRR_COEF_062 120;
BA_ "GenSigStartValue" SG_ 381 OBJ_ACCEL_ERR_CRR_COEF_062 120;
BA_ "GenSigStartValue" SG_ 382 OBJ_YAW_ANGLE_063 2000;
BA_ "GenSigStartValue" SG_ 382 OBJ_POS_LONG_063 32700;
BA_ "GenSigStartValue" SG_ 382 OBJ_POS_LAT_063 32700;
BA_ "GenSigStartValue" SG_ 382 OBJ_VELOCITY_LONG_063 16300;
BA_ "GenSigStartValue" SG_ 382 OBJ_VELOCITY_LAT_063 16300;
BA_ "GenSigStartValue" SG_ 382 OBJ_ACCELERATION_LONG_063 400;
BA_ "GenSigStartValue" SG_ 382 OBJ_ACCELERATION_LAT_063 400;
BA_ "GenSigStartValue" SG_ 382 OBJ_TIMESTAMP_OFFSET_063 127;
BA_ "GenSigStartValue" SG_ 382 OBJ_RCS_063 64;
BA_ "GenSigStartValue" SG_ 382 OBJ_YAW_RATE_063 448;
BA_ "GenSigStartValue" SG_ 382 OBJ_POS_ERR_CRR_COEF_063 120;
BA_ "GenSigStartValue" SG_ 382 OBJ_VELOCITY_ERR_CRR_COEF_063 120;
BA_ "GenSigStartValue" SG_ 382 OBJ_ACCEL_ERR_CRR_COEF_063 120;
BA_ "GenSigStartValue" SG_ 383 OBJ_YAW_ANGLE_064 2000;
BA_ "GenSigStartValue" SG_ 383 OBJ_POS_LONG_064 32700;
BA_ "GenSigStartValue" SG_ 383 OBJ_POS_LAT_064 32700;
BA_ "GenSigStartValue" SG_ 383 OBJ_VELOCITY_LONG_064 16300;
BA_ "GenSigStartValue" SG_ 383 OBJ_VELOCITY_LAT_064 16300;
BA_ "GenSigStartValue" SG_ 383 OBJ_ACCELERATION_LONG_064 400;
BA_ "GenSigStartValue" SG_ 383 OBJ_ACCELERATION_LAT_064 400;
BA_ "GenSigStartValue" SG_ 383 OBJ_TIMESTAMP_OFFSET_064 127;
BA_ "GenSigStartValue" SG_ 383 OBJ_RCS_064 64;
BA_ "GenSigStartValue" SG_ 383 OBJ_YAW_RATE_064 448;
BA_ "GenSigStartValue" SG_ 383 OBJ_POS_ERR_CRR_COEF_064 120;
BA_ "GenSigStartValue" SG_ 383 OBJ_VELOCITY_ERR_CRR_COEF_064 120;
BA_ "GenSigStartValue" SG_ 383 OBJ_ACCEL_ERR_CRR_COEF_064 120;
VAL_ 368 OBJ_TRACK_MOTION_MODEL_049 0 "INVALID" 1 "CCV" 2 "CTCA" 3 "CCA";
VAL_ 368 OBJ_MOVEMENT_STATUS_049 0 "UNKNOWN" 1 "MOVING" 2 "SLOW_MOVING" 3 "FAST_MOVING" 4 "STATIONARY" 5 "STOPPED" 6 "RESERVED1" 7 "RESERVED2";
VAL_ 368 OBJ_MEASUREMENT_STATUS_049 0 "Invalid" 1 "New" 2 "Predicted" 3 "PartlyMeasured" 4 "Measured" 5 "Occluded";
VAL_ 368 OBJ_CLS_TYPE1_049 0 "UNKNOWN_MOVING_OBJ" 1 "CAR" 2 "TRUCK" 3 "MOTOR_BIKE" 4 "BICYCLE" 5 "PEDESTRIAN" 6 "ROAD_BOUNDRY" 7 "STATIC_OBJECT" 8 "TRAFFIC_LIGHT" 9 "TRAFFIC_SIGN" 10 "TWO_WHEELERS" 11 "RESERVED" 12 "RESERVED" 14 "OBJECT_UNDETERMIND" 15 "VEHICLE_UNDETERMIND";
VAL_ 368 OBJ_CLS_TYPE2_049 0 "UNKNOWN_MOVING_OBJ" 1 "CAR" 2 "TRUCK" 3 "MOTOR_BIKE" 4 "BICYCLE" 5 "PEDESTRIAN" 6 "ROAD_BOUNDRY" 7 "STATIC_OBJECT" 8 "TRAFFIC_LIGHT" 9 "TRAFFIC_SIGN" 10 "TWO_WHEELERS" 11 "RESERVED" 12 "RESERVED" 14 "OBJECT_UNDETERMIND" 15 "VEHICLE_UNDETERMIND";
VAL_ 368 OBJ_CLS_TYPE3_049 0 "UNKNOWN_MOVING_OBJ" 1 "CAR" 2 "TRUCK" 3 "MOTOR_BIKE" 4 "BICYCLE" 5 "PEDESTRIAN" 6 "ROAD_BOUNDRY" 7 "STATIC_OBJECT" 8 "TRAFFIC_LIGHT" 9 "TRAFFIC_SIGN" 10 "TWO_WHEELERS" 11 "RESERVED" 12 "RESERVED" 14 "OBJECT_UNDETERMIND" 15 "VEHICLE_UNDETERMIND";
VAL_ 368 OBJ_CLS_TYPE4_049 0 "UNKNOWN_MOVING_OBJ" 1 "CAR" 2 "TRUCK" 3 "MOTOR_BIKE" 4 "BICYCLE" 5 "PEDESTRIAN" 6 "ROAD_BOUNDRY" 7 "STATIC_OBJECT" 8 "TRAFFIC_LIGHT" 9 "TRAFFIC_SIGN" 10 "TWO_WHEELERS" 11 "RESERVED" 12 "RESERVED" 14 "OBJECT_UNDETERMIND" 15 "VEHICLE_UNDETERMIND";
VAL_ 368 OBJ_CLS_TYPE5_049 0 "UNKNOWN_MOVING_OBJ" 1 "CAR" 2 "TRUCK" 3 "MOTOR_BIKE" 4 "BICYCLE" 5 "PEDESTRIAN" 6 "ROAD_BOUNDRY" 7 "STATIC_OBJECT" 8 "TRAFFIC_LIGHT" 9 "TRAFFIC_SIGN" 10 "TWO_WHEELERS" 11 "RESERVED" 12 "RESERVED" 14 "OBJECT_UNDETERMIND" 15 "VEHICLE_UNDETERMIND";
VAL_ 368 OBJ_CLS_TYPE6_049 0 "UNKNOWN_MOVING_OBJ" 1 "CAR" 2 "TRUCK" 3 "MOTOR_BIKE" 4 "BICYCLE" 5 "PEDESTRIAN" 6 "ROAD_BOUNDRY" 7 "STATIC_OBJECT" 8 "TRAFFIC_LIGHT" 9 "TRAFFIC_SIGN" 10 "TWO_WHEELERS" 11 "RESERVED" 12 "RESERVED" 14 "OBJECT_UNDETERMIND" 15 "VEHICLE_UNDETERMIND";
VAL_ 369 OBJ_TRACK_MOTION_MODEL_050 0 "INVALID" 1 "CCV" 2 "CTCA" 3 "CCA";
VAL_ 369 OBJ_MOVEMENT_STATUS_050 0 "UNKNOWN" 1 "MOVING" 2 "SLOW_MOVING" 3 "FAST_MOVING" 4 "STATIONARY" 5 "STOPPED" 6 "RESERVED1" 7 "RESERVED2";
VAL_ 369 OBJ_MEASUREMENT_STATUS_050 0 "Invalid" 1 "New" 2 "Predicted" 3 "PartlyMeasured" 4 "Measured" 5 "Occluded";
VAL_ 369 OBJ_CLS_TYPE1_050 0 "UNKNOWN_MOVING_OBJ" 1 "CAR" 2 "TRUCK" 3 "MOTOR_BIKE" 4 "BICYCLE" 5 "PEDESTRIAN" 6 "ROAD_BOUNDRY" 7 "STATIC_OBJECT" 8 "TRAFFIC_LIGHT" 9 "TRAFFIC_SIGN" 10 "TWO_WHEELERS" 11 "RESERVED" 12 "RESERVED" 14 "OBJECT_UNDETERMIND" 15 "VEHICLE_UNDETERMIND";
VAL_ 369 OBJ_CLS_TYPE2_050 0 "UNKNOWN_MOVING_OBJ" 1 "CAR" 2 "TRUCK" 3 "MOTOR_BIKE" 4 "BICYCLE" 5 "PEDESTRIAN" 6 "ROAD_BOUNDRY" 7 "STATIC_OBJECT" 8 "TRAFFIC_LIGHT" 9 "TRAFFIC_SIGN" 10 "TWO_WHEELERS" 11 "RESERVED" 12 "RESERVED" 14 "OBJECT_UNDETERMIND" 15 "VEHICLE_UNDETERMIND";
VAL_ 369 OBJ_CLS_TYPE3_050 0 "UNKNOWN_MOVING_OBJ" 1 "CAR" 2 "TRUCK" 3 "MOTOR_BIKE" 4 "BICYCLE" 5 "PEDESTRIAN" 6 "ROAD_BOUNDRY" 7 "STATIC_OBJECT" 8 "TRAFFIC_LIGHT" 9 "TRAFFIC_SIGN" 10 "TWO_WHEELERS" 11 "RESERVED" 12 "RESERVED" 14 "OBJECT_UNDETERMIND" 15 "VEHICLE_UNDETERMIND";
VAL_ 369 OBJ_CLS_TYPE4_050 0 "UNKNOWN_MOVING_OBJ" 1 "CAR" 2 "TRUCK" 3 "MOTOR_BIKE" 4 "BICYCLE" 5 "PEDESTRIAN" 6 "ROAD_BOUNDRY" 7 "STATIC_OBJECT" 8 "TRAFFIC_LIGHT" 9 "TRAFFIC_SIGN" 10 "TWO_WHEELERS" 11 "RESERVED" 12 "RESERVED" 14 "OBJECT_UNDETERMIND" 15 "VEHICLE_UNDETERMIND";
VAL_ 369 OBJ_CLS_TYPE5_050 0 "UNKNOWN_MOVING_OBJ" 1 "CAR" 2 "TRUCK" 3 "MOTOR_BIKE" 4 "BICYCLE" 5 "PEDESTRIAN" 6 "ROAD_BOUNDRY" 7 "STATIC_OBJECT" 8 "TRAFFIC_LIGHT" 9 "TRAFFIC_SIGN" 10 "TWO_WHEELERS" 11 "RESERVED" 12 "RESERVED" 14 "OBJECT_UNDETERMIND" 15 "VEHICLE_UNDETERMIND";
VAL_ 369 OBJ_CLS_TYPE6_050 0 "UNKNOWN_MOVING_OBJ" 1 "CAR" 2 "TRUCK" 3 "MOTOR_BIKE" 4 "BICYCLE" 5 "PEDESTRIAN" 6 "ROAD_BOUNDRY" 7 "STATIC_OBJECT" 8 "TRAFFIC_LIGHT" 9 "TRAFFIC_SIGN" 10 "TWO_WHEELERS" 11 "RESERVED" 12 "RESERVED" 14 "OBJECT_UNDETERMIND" 15 "VEHICLE_UNDETERMIND";
VAL_ 370 OBJ_TRACK_MOTION_MODEL_051 0 "INVALID" 1 "CCV" 2 "CTCA" 3 "CCA";
VAL_ 370 OBJ_MOVEMENT_STATUS_051 0 "UNKNOWN" 1 "MOVING" 2 "SLOW_MOVING" 3 "FAST_MOVING" 4 "STATIONARY" 5 "STOPPED" 6 "RESERVED1" 7 "RESERVED2";
VAL_ 370 OBJ_MEASUREMENT_STATUS_051 0 "Invalid" 1 "New" 2 "Predicted" 3 "PartlyMeasured" 4 "Measured" 5 "Occluded";
VAL_ 370 OBJ_CLS_TYPE1_051 0 "UNKNOWN_MOVING_OBJ" 1 "CAR" 2 "TRUCK" 3 "MOTOR_BIKE" 4 "BICYCLE" 5 "PEDESTRIAN" 6 "ROAD_BOUNDRY" 7 "STATIC_OBJECT" 8 "TRAFFIC_LIGHT" 9 "TRAFFIC_SIGN" 10 "TWO_WHEELERS" 11 "RESERVED" 12 "RESERVED" 14 "OBJECT_UNDETERMIND" 15 "VEHICLE_UNDETERMIND";
VAL_ 370 OBJ_CLS_TYPE2_051 0 "UNKNOWN_MOVING_OBJ" 1 "CAR" 2 "TRUCK" 3 "MOTOR_BIKE" 4 "BICYCLE" 5 "PEDESTRIAN" 6 "ROAD_BOUNDRY" 7 "STATIC_OBJECT" 8 "TRAFFIC_LIGHT" 9 "TRAFFIC_SIGN" 10 "TWO_WHEELERS" 11 "RESERVED" 12 "RESERVED" 14 "OBJECT_UNDETERMIND" 15 "VEHICLE_UNDETERMIND";
VAL_ 370 OBJ_CLS_TYPE3_051 0 "UNKNOWN_MOVING_OBJ" 1 "CAR" 2 "TRUCK" 3 "MOTOR_BIKE" 4 "BICYCLE" 5 "PEDESTRIAN" 6 "ROAD_BOUNDRY" 7 "STATIC_OBJECT" 8 "TRAFFIC_LIGHT" 9 "TRAFFIC_SIGN" 10 "TWO_WHEELERS" 11 "RESERVED" 12 "RESERVED" 14 "OBJECT_UNDETERMIND" 15 "VEHICLE_UNDETERMIND";
VAL_ 370 OBJ_CLS_TYPE4_051 0 "UNKNOWN_MOVING_OBJ" 1 "CAR" 2 "TRUCK" 3 "MOTOR_BIKE" 4 "BICYCLE" 5 "PEDESTRIAN" 6 "ROAD_BOUNDRY" 7 "STATIC_OBJECT" 8 "TRAFFIC_LIGHT" 9 "TRAFFIC_SIGN" 10 "TWO_WHEELERS" 11 "RESERVED" 12 "RESERVED" 14 "OBJECT_UNDETERMIND" 15 "VEHICLE_UNDETERMIND";
VAL_ 370 OBJ_CLS_TYPE5_051 0 "UNKNOWN_MOVING_OBJ" 1 "CAR" 2 "TRUCK" 3 "MOTOR_BIKE" 4 "BICYCLE" 5 "PEDESTRIAN" 6 "ROAD_BOUNDRY" 7 "STATIC_OBJECT" 8 "TRAFFIC_LIGHT" 9 "TRAFFIC_SIGN" 10 "TWO_WHEELERS" 11 "RESERVED" 12 "RESERVED" 14 "OBJECT_UNDETERMIND" 15 "VEHICLE_UNDETERMIND";
VAL_ 370 OBJ_CLS_TYPE6_051 0 "UNKNOWN_MOVING_OBJ" 1 "CAR" 2 "TRUCK" 3 "MOTOR_BIKE" 4 "BICYCLE" 5 "PEDESTRIAN" 6 "ROAD_BOUNDRY" 7 "STATIC_OBJECT" 8 "TRAFFIC_LIGHT" 9 "TRAFFIC_SIGN" 10 "TWO_WHEELERS" 11 "RESERVED" 12 "RESERVED" 14 "OBJECT_UNDETERMIND" 15 "VEHICLE_UNDETERMIND";
VAL_ 371 OBJ_TRACK_MOTION_MODEL_052 0 "INVALID" 1 "CCV" 2 "CTCA" 3 "CCA";
VAL_ 371 OBJ_MOVEMENT_STATUS_052 0 "UNKNOWN" 1 "MOVING" 2 "SLOW_MOVING" 3 "FAST_MOVING" 4 "STATIONARY" 5 "STOPPED" 6 "RESERVED1" 7 "RESERVED2";
VAL_ 371 OBJ_MEASUREMENT_STATUS_052 0 "Invalid" 1 "New" 2 "Predicted" 3 "PartlyMeasured" 4 "Measured" 5 "Occluded";
VAL_ 371 OBJ_CLS_TYPE1_052 0 "UNKNOWN_MOVING_OBJ" 1 "CAR" 2 "TRUCK" 3 "MOTOR_BIKE" 4 "BICYCLE" 5 "PEDESTRIAN" 6 "ROAD_BOUNDRY" 7 "STATIC_OBJECT" 8 "TRAFFIC_LIGHT" 9 "TRAFFIC_SIGN" 10 "TWO_WHEELERS" 11 "RESERVED" 12 "RESERVED" 14 "OBJECT_UNDETERMIND" 15 "VEHICLE_UNDETERMIND";
VAL_ 371 OBJ_CLS_TYPE2_052 0 "UNKNOWN_MOVING_OBJ" 1 "CAR" 2 "TRUCK" 3 "MOTOR_BIKE" 4 "BICYCLE" 5 "PEDESTRIAN" 6 "ROAD_BOUNDRY" 7 "STATIC_OBJECT" 8 "TRAFFIC_LIGHT" 9 "TRAFFIC_SIGN" 10 "TWO_WHEELERS" 11 "RESERVED" 12 "RESERVED" 14 "OBJECT_UNDETERMIND" 15 "VEHICLE_UNDETERMIND";
VAL_ 371 OBJ_CLS_TYPE3_052 0 "UNKNOWN_MOVING_OBJ" 1 "CAR" 2 "TRUCK" 3 "MOTOR_BIKE" 4 "BICYCLE" 5 "PEDESTRIAN" 6 "ROAD_BOUNDRY" 7 "STATIC_OBJECT" 8 "TRAFFIC_LIGHT" 9 "TRAFFIC_SIGN" 10 "TWO_WHEELERS" 11 "RESERVED" 12 "RESERVED" 14 "OBJECT_UNDETERMIND" 15 "VEHICLE_UNDETERMIND";
VAL_ 371 OBJ_CLS_TYPE4_052 0 "UNKNOWN_MOVING_OBJ" 1 "CAR" 2 "TRUCK" 3 "MOTOR_BIKE" 4 "BICYCLE" 5 "PEDESTRIAN" 6 "ROAD_BOUNDRY" 7 "STATIC_OBJECT" 8 "TRAFFIC_LIGHT" 9 "TRAFFIC_SIGN" 10 "TWO_WHEELERS" 11 "RESERVED" 12 "RESERVED" 14 "OBJECT_UNDETERMIND" 15 "VEHICLE_UNDETERMIND";
VAL_ 371 OBJ_CLS_TYPE5_052 0 "UNKNOWN_MOVING_OBJ" 1 "CAR" 2 "TRUCK" 3 "MOTOR_BIKE" 4 "BICYCLE" 5 "PEDESTRIAN" 6 "ROAD_BOUNDRY" 7 "STATIC_OBJECT" 8 "TRAFFIC_LIGHT" 9 "TRAFFIC_SIGN" 10 "TWO_WHEELERS" 11 "RESERVED" 12 "RESERVED" 14 "OBJECT_UNDETERMIND" 15 "VEHICLE_UNDETERMIND";
VAL_ 371 OBJ_CLS_TYPE6_052 0 "UNKNOWN_MOVING_OBJ" 1 "CAR" 2 "TRUCK" 3 "MOTOR_BIKE" 4 "BICYCLE" 5 "PEDESTRIAN" 6 "ROAD_BOUNDRY" 7 "STATIC_OBJECT" 8 "TRAFFIC_LIGHT" 9 "TRAFFIC_SIGN" 10 "TWO_WHEELERS" 11 "RESERVED" 12 "RESERVED" 14 "OBJECT_UNDETERMIND" 15 "VEHICLE_UNDETERMIND";
VAL_ 372 OBJ_TRACK_MOTION_MODEL_053 0 "INVALID" 1 "CCV" 2 "CTCA" 3 "CCA";
VAL_ 372 OBJ_MOVEMENT_STATUS_053 0 "UNKNOWN" 1 "MOVING" 2 "SLOW_MOVING" 3 "FAST_MOVING" 4 "STATIONARY" 5 "STOPPED" 6 "RESERVED1" 7 "RESERVED2";
VAL_ 372 OBJ_MEASUREMENT_STATUS_053 0 "Invalid" 1 "New" 2 "Predicted" 3 "PartlyMeasured" 4 "Measured" 5 "Occluded";
VAL_ 372 OBJ_CLS_TYPE1_053 0 "UNKNOWN_MOVING_OBJ" 1 "CAR" 2 "TRUCK" 3 "MOTOR_BIKE" 4 "BICYCLE" 5 "PEDESTRIAN" 6 "ROAD_BOUNDRY" 7 "STATIC_OBJECT" 8 "TRAFFIC_LIGHT" 9 "TRAFFIC_SIGN" 10 "TWO_WHEELERS" 11 "RESERVED" 12 "RESERVED" 14 "OBJECT_UNDETERMIND" 15 "VEHICLE_UNDETERMIND";
VAL_ 372 OBJ_CLS_TYPE2_053 0 "UNKNOWN_MOVING_OBJ" 1 "CAR" 2 "TRUCK" 3 "MOTOR_BIKE" 4 "BICYCLE" 5 "PEDESTRIAN" 6 "ROAD_BOUNDRY" 7 "STATIC_OBJECT" 8 "TRAFFIC_LIGHT" 9 "TRAFFIC_SIGN" 10 "TWO_WHEELERS" 11 "RESERVED" 12 "RESERVED" 14 "OBJECT_UNDETERMIND" 15 "VEHICLE_UNDETERMIND";
VAL_ 372 OBJ_CLS_TYPE3_053 0 "UNKNOWN_MOVING_OBJ" 1 "CAR" 2 "TRUCK" 3 "MOTOR_BIKE" 4 "BICYCLE" 5 "PEDESTRIAN" 6 "ROAD_BOUNDRY" 7 "STATIC_OBJECT" 8 "TRAFFIC_LIGHT" 9 "TRAFFIC_SIGN" 10 "TWO_WHEELERS" 11 "RESERVED" 12 "RESERVED" 14 "OBJECT_UNDETERMIND" 15 "VEHICLE_UNDETERMIND";
VAL_ 372 OBJ_CLS_TYPE4_053 0 "UNKNOWN_MOVING_OBJ" 1 "CAR" 2 "TRUCK" 3 "MOTOR_BIKE" 4 "BICYCLE" 5 "PEDESTRIAN" 6 "ROAD_BOUNDRY" 7 "STATIC_OBJECT" 8 "TRAFFIC_LIGHT" 9 "TRAFFIC_SIGN" 10 "TWO_WHEELERS" 11 "RESERVED" 12 "RESERVED" 14 "OBJECT_UNDETERMIND" 15 "VEHICLE_UNDETERMIND";
VAL_ 372 OBJ_CLS_TYPE5_053 0 "UNKNOWN_MOVING_OBJ" 1 "CAR" 2 "TRUCK" 3 "MOTOR_BIKE" 4 "BICYCLE" 5 "PEDESTRIAN" 6 "ROAD_BOUNDRY" 7 "STATIC_OBJECT" 8 "TRAFFIC_LIGHT" 9 "TRAFFIC_SIGN" 10 "TWO_WHEELERS" 11 "RESERVED" 12 "RESERVED" 14 "OBJECT_UNDETERMIND" 15 "VEHICLE_UNDETERMIND";
VAL_ 372 OBJ_CLS_TYPE6_053 0 "UNKNOWN_MOVING_OBJ" 1 "CAR" 2 "TRUCK" 3 "MOTOR_BIKE" 4 "BICYCLE" 5 "PEDESTRIAN" 6 "ROAD_BOUNDRY" 7 "STATIC_OBJECT" 8 "TRAFFIC_LIGHT" 9 "TRAFFIC_SIGN" 10 "TWO_WHEELERS" 11 "RESERVED" 12 "RESERVED" 14 "OBJECT_UNDETERMIND" 15 "VEHICLE_UNDETERMIND";
VAL_ 373 OBJ_TRACK_MOTION_MODEL_054 0 "INVALID" 1 "CCV" 2 "CTCA" 3 "CCA";
VAL_ 373 OBJ_MOVEMENT_STATUS_054 0 "UNKNOWN" 1 "MOVING" 2 "SLOW_MOVING" 3 "FAST_MOVING" 4 "STATIONARY" 5 "STOPPED" 6 "RESERVED1" 7 "RESERVED2";
VAL_ 373 OBJ_MEASUREMENT_STATUS_054 0 "Invalid" 1 "New" 2 "Predicted" 3 "PartlyMeasured" 4 "Measured" 5 "Occluded";
VAL_ 373 OBJ_CLS_TYPE1_054 0 "UNKNOWN_MOVING_OBJ" 1 "CAR" 2 "TRUCK" 3 "MOTOR_BIKE" 4 "BICYCLE" 5 "PEDESTRIAN" 6 "ROAD_BOUNDRY" 7 "STATIC_OBJECT" 8 "TRAFFIC_LIGHT" 9 "TRAFFIC_SIGN" 10 "TWO_WHEELERS" 11 "RESERVED" 12 "RESERVED" 14 "OBJECT_UNDETERMIND" 15 "VEHICLE_UNDETERMIND";
VAL_ 373 OBJ_CLS_TYPE2_054 0 "UNKNOWN_MOVING_OBJ" 1 "CAR" 2 "TRUCK" 3 "MOTOR_BIKE" 4 "BICYCLE" 5 "PEDESTRIAN" 6 "ROAD_BOUNDRY" 7 "STATIC_OBJECT" 8 "TRAFFIC_LIGHT" 9 "TRAFFIC_SIGN" 10 "TWO_WHEELERS" 11 "RESERVED" 12 "RESERVED" 14 "OBJECT_UNDETERMIND" 15 "VEHICLE_UNDETERMIND";
VAL_ 373 OBJ_CLS_TYPE3_054 0 "UNKNOWN_MOVING_OBJ" 1 "CAR" 2 "TRUCK" 3 "MOTOR_BIKE" 4 "BICYCLE" 5 "PEDESTRIAN" 6 "ROAD_BOUNDRY" 7 "STATIC_OBJECT" 8 "TRAFFIC_LIGHT" 9 "TRAFFIC_SIGN" 10 "TWO_WHEELERS" 11 "RESERVED" 12 "RESERVED" 14 "OBJECT_UNDETERMIND" 15 "VEHICLE_UNDETERMIND";
VAL_ 373 OBJ_CLS_TYPE4_054 0 "UNKNOWN_MOVING_OBJ" 1 "CAR" 2 "TRUCK" 3 "MOTOR_BIKE" 4 "BICYCLE" 5 "PEDESTRIAN" 6 "ROAD_BOUNDRY" 7 "STATIC_OBJECT" 8 "TRAFFIC_LIGHT" 9 "TRAFFIC_SIGN" 10 "TWO_WHEELERS" 11 "RESERVED" 12 "RESERVED" 14 "OBJECT_UNDETERMIND" 15 "VEHICLE_UNDETERMIND";
VAL_ 373 OBJ_CLS_TYPE5_054 0 "UNKNOWN_MOVING_OBJ" 1 "CAR" 2 "TRUCK" 3 "MOTOR_BIKE" 4 "BICYCLE" 5 "PEDESTRIAN" 6 "ROAD_BOUNDRY" 7 "STATIC_OBJECT" 8 "TRAFFIC_LIGHT" 9 "TRAFFIC_SIGN" 10 "TWO_WHEELERS" 11 "RESERVED" 12 "RESERVED" 14 "OBJECT_UNDETERMIND" 15 "VEHICLE_UNDETERMIND";
VAL_ 373 OBJ_CLS_TYPE6_054 0 "UNKNOWN_MOVING_OBJ" 1 "CAR" 2 "TRUCK" 3 "MOTOR_BIKE" 4 "BICYCLE" 5 "PEDESTRIAN" 6 "ROAD_BOUNDRY" 7 "STATIC_OBJECT" 8 "TRAFFIC_LIGHT" 9 "TRAFFIC_SIGN" 10 "TWO_WHEELERS" 11 "RESERVED" 12 "RESERVED" 14 "OBJECT_UNDETERMIND" 15 "VEHICLE_UNDETERMIND";
VAL_ 374 OBJ_TRACK_MOTION_MODEL_055 0 "INVALID" 1 "CCV" 2 "CTCA" 3 "CCA";
VAL_ 374 OBJ_MOVEMENT_STATUS_055 0 "UNKNOWN" 1 "MOVING" 2 "SLOW_MOVING" 3 "FAST_MOVING" 4 "STATIONARY" 5 "STOPPED" 6 "RESERVED1" 7 "RESERVED2";
VAL_ 374 OBJ_MEASUREMENT_STATUS_055 0 "Invalid" 1 "New" 2 "Predicted" 3 "PartlyMeasured" 4 "Measured" 5 "Occluded";
VAL_ 374 OBJ_CLS_TYPE1_055 0 "UNKNOWN_MOVING_OBJ" 1 "CAR" 2 "TRUCK" 3 "MOTOR_BIKE" 4 "BICYCLE" 5 "PEDESTRIAN" 6 "ROAD_BOUNDRY" 7 "STATIC_OBJECT" 8 "TRAFFIC_LIGHT" 9 "TRAFFIC_SIGN" 10 "TWO_WHEELERS" 11 "RESERVED" 12 "RESERVED" 14 "OBJECT_UNDETERMIND" 15 "VEHICLE_UNDETERMIND";
VAL_ 374 OBJ_CLS_TYPE2_055 0 "UNKNOWN_MOVING_OBJ" 1 "CAR" 2 "TRUCK" 3 "MOTOR_BIKE" 4 "BICYCLE" 5 "PEDESTRIAN" 6 "ROAD_BOUNDRY" 7 "STATIC_OBJECT" 8 "TRAFFIC_LIGHT" 9 "TRAFFIC_SIGN" 10 "TWO_WHEELERS" 11 "RESERVED" 12 "RESERVED" 14 "OBJECT_UNDETERMIND" 15 "VEHICLE_UNDETERMIND";
VAL_ 374 OBJ_CLS_TYPE3_055 0 "UNKNOWN_MOVING_OBJ" 1 "CAR" 2 "TRUCK" 3 "MOTOR_BIKE" 4 "BICYCLE" 5 "PEDESTRIAN" 6 "ROAD_BOUNDRY" 7 "STATIC_OBJECT" 8 "TRAFFIC_LIGHT" 9 "TRAFFIC_SIGN" 10 "TWO_WHEELERS" 11 "RESERVED" 12 "RESERVED" 14 "OBJECT_UNDETERMIND" 15 "VEHICLE_UNDETERMIND";
VAL_ 374 OBJ_CLS_TYPE4_055 0 "UNKNOWN_MOVING_OBJ" 1 "CAR" 2 "TRUCK" 3 "MOTOR_BIKE" 4 "BICYCLE" 5 "PEDESTRIAN" 6 "ROAD_BOUNDRY" 7 "STATIC_OBJECT" 8 "TRAFFIC_LIGHT" 9 "TRAFFIC_SIGN" 10 "TWO_WHEELERS" 11 "RESERVED" 12 "RESERVED" 14 "OBJECT_UNDETERMIND" 15 "VEHICLE_UNDETERMIND";
VAL_ 374 OBJ_CLS_TYPE5_055 0 "UNKNOWN_MOVING_OBJ" 1 "CAR" 2 "TRUCK" 3 "MOTOR_BIKE" 4 "BICYCLE" 5 "PEDESTRIAN" 6 "ROAD_BOUNDRY" 7 "STATIC_OBJECT" 8 "TRAFFIC_LIGHT" 9 "TRAFFIC_SIGN" 10 "TWO_WHEELERS" 11 "RESERVED" 12 "RESERVED" 14 "OBJECT_UNDETERMIND" 15 "VEHICLE_UNDETERMIND";
VAL_ 374 OBJ_CLS_TYPE6_055 0 "UNKNOWN_MOVING_OBJ" 1 "CAR" 2 "TRUCK" 3 "MOTOR_BIKE" 4 "BICYCLE" 5 "PEDESTRIAN" 6 "ROAD_BOUNDRY" 7 "STATIC_OBJECT" 8 "TRAFFIC_LIGHT" 9 "TRAFFIC_SIGN" 10 "TWO_WHEELERS" 11 "RESERVED" 12 "RESERVED" 14 "OBJECT_UNDETERMIND" 15 "VEHICLE_UNDETERMIND";
VAL_ 375 OBJ_TRACK_MOTION_MODEL_056 0 "INVALID" 1 "CCV" 2 "CTCA" 3 "CCA";
VAL_ 375 OBJ_MOVEMENT_STATUS_056 0 "UNKNOWN" 1 "MOVING" 2 "SLOW_MOVING" 3 "FAST_MOVING" 4 "STATIONARY" 5 "STOPPED" 6 "RESERVED1" 7 "RESERVED2";
VAL_ 375 OBJ_MEASUREMENT_STATUS_056 0 "Invalid" 1 "New" 2 "Predicted" 3 "PartlyMeasured" 4 "Measured" 5 "Occluded";
VAL_ 375 OBJ_CLS_TYPE1_056 0 "UNKNOWN_MOVING_OBJ" 1 "CAR" 2 "TRUCK" 3 "MOTOR_BIKE" 4 "BICYCLE" 5 "PEDESTRIAN" 6 "ROAD_BOUNDRY" 7 "STATIC_OBJECT" 8 "TRAFFIC_LIGHT" 9 "TRAFFIC_SIGN" 10 "TWO_WHEELERS" 11 "RESERVED" 12 "RESERVED" 14 "OBJECT_UNDETERMIND" 15 "VEHICLE_UNDETERMIND";
VAL_ 375 OBJ_CLS_TYPE2_056 0 "UNKNOWN_MOVING_OBJ" 1 "CAR" 2 "TRUCK" 3 "MOTOR_BIKE" 4 "BICYCLE" 5 "PEDESTRIAN" 6 "ROAD_BOUNDRY" 7 "STATIC_OBJECT" 8 "TRAFFIC_LIGHT" 9 "TRAFFIC_SIGN" 10 "TWO_WHEELERS" 11 "RESERVED" 12 "RESERVED" 14 "OBJECT_UNDETERMIND" 15 "VEHICLE_UNDETERMIND";
VAL_ 375 OBJ_CLS_TYPE3_056 0 "UNKNOWN_MOVING_OBJ" 1 "CAR" 2 "TRUCK" 3 "MOTOR_BIKE" 4 "BICYCLE" 5 "PEDESTRIAN" 6 "ROAD_BOUNDRY" 7 "STATIC_OBJECT" 8 "TRAFFIC_LIGHT" 9 "TRAFFIC_SIGN" 10 "TWO_WHEELERS" 11 "RESERVED" 12 "RESERVED" 14 "OBJECT_UNDETERMIND" 15 "VEHICLE_UNDETERMIND";
VAL_ 375 OBJ_CLS_TYPE4_056 0 "UNKNOWN_MOVING_OBJ" 1 "CAR" 2 "TRUCK" 3 "MOTOR_BIKE" 4 "BICYCLE" 5 "PEDESTRIAN" 6 "ROAD_BOUNDRY" 7 "STATIC_OBJECT" 8 "TRAFFIC_LIGHT" 9 "TRAFFIC_SIGN" 10 "TWO_WHEELERS" 11 "RESERVED" 12 "RESERVED" 14 "OBJECT_UNDETERMIND" 15 "VEHICLE_UNDETERMIND";
VAL_ 375 OBJ_CLS_TYPE5_056 0 "UNKNOWN_MOVING_OBJ" 1 "CAR" 2 "TRUCK" 3 "MOTOR_BIKE" 4 "BICYCLE" 5 "PEDESTRIAN" 6 "ROAD_BOUNDRY" 7 "STATIC_OBJECT" 8 "TRAFFIC_LIGHT" 9 "TRAFFIC_SIGN" 10 "TWO_WHEELERS" 11 "RESERVED" 12 "RESERVED" 14 "OBJECT_UNDETERMIND" 15 "VEHICLE_UNDETERMIND";
VAL_ 375 OBJ_CLS_TYPE6_056 0 "UNKNOWN_MOVING_OBJ" 1 "CAR" 2 "TRUCK" 3 "MOTOR_BIKE" 4 "BICYCLE" 5 "PEDESTRIAN" 6 "ROAD_BOUNDRY" 7 "STATIC_OBJECT" 8 "TRAFFIC_LIGHT" 9 "TRAFFIC_SIGN" 10 "TWO_WHEELERS" 11 "RESERVED" 12 "RESERVED" 14 "OBJECT_UNDETERMIND" 15 "VEHICLE_UNDETERMIND";
VAL_ 376 OBJ_TRACK_MOTION_MODEL_057 0 "INVALID" 1 "CCV" 2 "CTCA" 3 "CCA";
VAL_ 376 OBJ_MOVEMENT_STATUS_057 0 "UNKNOWN" 1 "MOVING" 2 "SLOW_MOVING" 3 "FAST_MOVING" 4 "STATIONARY" 5 "STOPPED" 6 "RESERVED1" 7 "RESERVED2";
VAL_ 376 OBJ_MEASUREMENT_STATUS_057 0 "Invalid" 1 "New" 2 "Predicted" 3 "PartlyMeasured" 4 "Measured" 5 "Occluded";
VAL_ 376 OBJ_CLS_TYPE1_057 0 "UNKNOWN_MOVING_OBJ" 1 "CAR" 2 "TRUCK" 3 "MOTOR_BIKE" 4 "BICYCLE" 5 "PEDESTRIAN" 6 "ROAD_BOUNDRY" 7 "STATIC_OBJECT" 8 "TRAFFIC_LIGHT" 9 "TRAFFIC_SIGN" 10 "TWO_WHEELERS" 11 "RESERVED" 12 "RESERVED" 14 "OBJECT_UNDETERMIND" 15 "VEHICLE_UNDETERMIND";
VAL_ 376 OBJ_CLS_TYPE2_057 0 "UNKNOWN_MOVING_OBJ" 1 "CAR" 2 "TRUCK" 3 "MOTOR_BIKE" 4 "BICYCLE" 5 "PEDESTRIAN" 6 "ROAD_BOUNDRY" 7 "STATIC_OBJECT" 8 "TRAFFIC_LIGHT" 9 "TRAFFIC_SIGN" 10 "TWO_WHEELERS" 11 "RESERVED" 12 "RESERVED" 14 "OBJECT_UNDETERMIND" 15 "VEHICLE_UNDETERMIND";
VAL_ 376 OBJ_CLS_TYPE3_057 0 "UNKNOWN_MOVING_OBJ" 1 "CAR" 2 "TRUCK" 3 "MOTOR_BIKE" 4 "BICYCLE" 5 "PEDESTRIAN" 6 "ROAD_BOUNDRY" 7 "STATIC_OBJECT" 8 "TRAFFIC_LIGHT" 9 "TRAFFIC_SIGN" 10 "TWO_WHEELERS" 11 "RESERVED" 12 "RESERVED" 14 "OBJECT_UNDETERMIND" 15 "VEHICLE_UNDETERMIND";
VAL_ 376 OBJ_CLS_TYPE4_057 0 "UNKNOWN_MOVING_OBJ" 1 "CAR" 2 "TRUCK" 3 "MOTOR_BIKE" 4 "BICYCLE" 5 "PEDESTRIAN" 6 "ROAD_BOUNDRY" 7 "STATIC_OBJECT" 8 "TRAFFIC_LIGHT" 9 "TRAFFIC_SIGN" 10 "TWO_WHEELERS" 11 "RESERVED" 12 "RESERVED" 14 "OBJECT_UNDETERMIND" 15 "VEHICLE_UNDETERMIND";
VAL_ 376 OBJ_CLS_TYPE5_057 0 "UNKNOWN_MOVING_OBJ" 1 "CAR" 2 "TRUCK" 3 "MOTOR_BIKE" 4 "BICYCLE" 5 "PEDESTRIAN" 6 "ROAD_BOUNDRY" 7 "STATIC_OBJECT" 8 "TRAFFIC_LIGHT" 9 "TRAFFIC_SIGN" 10 "TWO_WHEELERS" 11 "RESERVED" 12 "RESERVED" 14 "OBJECT_UNDETERMIND" 15 "VEHICLE_UNDETERMIND";
VAL_ 376 OBJ_CLS_TYPE6_057 0 "UNKNOWN_MOVING_OBJ" 1 "CAR" 2 "TRUCK" 3 "MOTOR_BIKE" 4 "BICYCLE" 5 "PEDESTRIAN" 6 "ROAD_BOUNDRY" 7 "STATIC_OBJECT" 8 "TRAFFIC_LIGHT" 9 "TRAFFIC_SIGN" 10 "TWO_WHEELERS" 11 "RESERVED" 12 "RESERVED" 14 "OBJECT_UNDETERMIND" 15 "VEHICLE_UNDETERMIND";
VAL_ 377 OBJ_TRACK_MOTION_MODEL_058 0 "INVALID" 1 "CCV" 2 "CTCA" 3 "CCA";
VAL_ 377 OBJ_MOVEMENT_STATUS_058 0 "UNKNOWN" 1 "MOVING" 2 "SLOW_MOVING" 3 "FAST_MOVING" 4 "STATIONARY" 5 "STOPPED" 6 "RESERVED1" 7 "RESERVED2";
VAL_ 377 OBJ_MEASUREMENT_STATUS_058 0 "Invalid" 1 "New" 2 "Predicted" 3 "PartlyMeasured" 4 "Measured" 5 "Occluded";
VAL_ 377 OBJ_CLS_TYPE1_058 0 "UNKNOWN_MOVING_OBJ" 1 "CAR" 2 "TRUCK" 3 "MOTOR_BIKE" 4 "BICYCLE" 5 "PEDESTRIAN" 6 "ROAD_BOUNDRY" 7 "STATIC_OBJECT" 8 "TRAFFIC_LIGHT" 9 "TRAFFIC_SIGN" 10 "TWO_WHEELERS" 11 "RESERVED" 12 "RESERVED" 14 "OBJECT_UNDETERMIND" 15 "VEHICLE_UNDETERMIND";
VAL_ 377 OBJ_CLS_TYPE2_058 0 "UNKNOWN_MOVING_OBJ" 1 "CAR" 2 "TRUCK" 3 "MOTOR_BIKE" 4 "BICYCLE" 5 "PEDESTRIAN" 6 "ROAD_BOUNDRY" 7 "STATIC_OBJECT" 8 "TRAFFIC_LIGHT" 9 "TRAFFIC_SIGN" 10 "TWO_WHEELERS" 11 "RESERVED" 12 "RESERVED" 14 "OBJECT_UNDETERMIND" 15 "VEHICLE_UNDETERMIND";
VAL_ 377 OBJ_CLS_TYPE3_058 0 "UNKNOWN_MOVING_OBJ" 1 "CAR" 2 "TRUCK" 3 "MOTOR_BIKE" 4 "BICYCLE" 5 "PEDESTRIAN" 6 "ROAD_BOUNDRY" 7 "STATIC_OBJECT" 8 "TRAFFIC_LIGHT" 9 "TRAFFIC_SIGN" 10 "TWO_WHEELERS" 11 "RESERVED" 12 "RESERVED" 14 "OBJECT_UNDETERMIND" 15 "VEHICLE_UNDETERMIND";
VAL_ 377 OBJ_CLS_TYPE4_058 0 "UNKNOWN_MOVING_OBJ" 1 "CAR" 2 "TRUCK" 3 "MOTOR_BIKE" 4 "BICYCLE" 5 "PEDESTRIAN" 6 "ROAD_BOUNDRY" 7 "STATIC_OBJECT" 8 "TRAFFIC_LIGHT" 9 "TRAFFIC_SIGN" 10 "TWO_WHEELERS" 11 "RESERVED" 12 "RESERVED" 14 "OBJECT_UNDETERMIND" 15 "VEHICLE_UNDETERMIND";
VAL_ 377 OBJ_CLS_TYPE5_058 0 "UNKNOWN_MOVING_OBJ" 1 "CAR" 2 "TRUCK" 3 "MOTOR_BIKE" 4 "BICYCLE" 5 "PEDESTRIAN" 6 "ROAD_BOUNDRY" 7 "STATIC_OBJECT" 8 "TRAFFIC_LIGHT" 9 "TRAFFIC_SIGN" 10 "TWO_WHEELERS" 11 "RESERVED" 12 "RESERVED" 14 "OBJECT_UNDETERMIND" 15 "VEHICLE_UNDETERMIND";
VAL_ 377 OBJ_CLS_TYPE6_058 0 "UNKNOWN_MOVING_OBJ" 1 "CAR" 2 "TRUCK" 3 "MOTOR_BIKE" 4 "BICYCLE" 5 "PEDESTRIAN" 6 "ROAD_BOUNDRY" 7 "STATIC_OBJECT" 8 "TRAFFIC_LIGHT" 9 "TRAFFIC_SIGN" 10 "TWO_WHEELERS" 11 "RESERVED" 12 "RESERVED" 14 "OBJECT_UNDETERMIND" 15 "VEHICLE_UNDETERMIND";
VAL_ 378 OBJ_TRACK_MOTION_MODEL_059 0 "INVALID" 1 "CCV" 2 "CTCA" 3 "CCA";
VAL_ 378 OBJ_MOVEMENT_STATUS_059 0 "UNKNOWN" 1 "MOVING" 2 "SLOW_MOVING" 3 "FAST_MOVING" 4 "STATIONARY" 5 "STOPPED" 6 "RESERVED1" 7 "RESERVED2";
VAL_ 378 OBJ_MEASUREMENT_STATUS_059 0 "Invalid" 1 "New" 2 "Predicted" 3 "PartlyMeasured" 4 "Measured" 5 "Occluded";
VAL_ 378 OBJ_CLS_TYPE1_059 0 "UNKNOWN_MOVING_OBJ" 1 "CAR" 2 "TRUCK" 3 "MOTOR_BIKE" 4 "BICYCLE" 5 "PEDESTRIAN" 6 "ROAD_BOUNDRY" 7 "STATIC_OBJECT" 8 "TRAFFIC_LIGHT" 9 "TRAFFIC_SIGN" 10 "TWO_WHEELERS" 11 "RESERVED" 12 "RESERVED" 14 "OBJECT_UNDETERMIND" 15 "VEHICLE_UNDETERMIND";
VAL_ 378 OBJ_CLS_TYPE2_059 0 "UNKNOWN_MOVING_OBJ" 1 "CAR" 2 "TRUCK" 3 "MOTOR_BIKE" 4 "BICYCLE" 5 "PEDESTRIAN" 6 "ROAD_BOUNDRY" 7 "STATIC_OBJECT" 8 "TRAFFIC_LIGHT" 9 "TRAFFIC_SIGN" 10 "TWO_WHEELERS" 11 "RESERVED" 12 "RESERVED" 14 "OBJECT_UNDETERMIND" 15 "VEHICLE_UNDETERMIND";
VAL_ 378 OBJ_CLS_TYPE3_059 0 "UNKNOWN_MOVING_OBJ" 1 "CAR" 2 "TRUCK" 3 "MOTOR_BIKE" 4 "BICYCLE" 5 "PEDESTRIAN" 6 "ROAD_BOUNDRY" 7 "STATIC_OBJECT" 8 "TRAFFIC_LIGHT" 9 "TRAFFIC_SIGN" 10 "TWO_WHEELERS" 11 "RESERVED" 12 "RESERVED" 14 "OBJECT_UNDETERMIND" 15 "VEHICLE_UNDETERMIND";
VAL_ 378 OBJ_CLS_TYPE4_059 0 "UNKNOWN_MOVING_OBJ" 1 "CAR" 2 "TRUCK" 3 "MOTOR_BIKE" 4 "BICYCLE" 5 "PEDESTRIAN" 6 "ROAD_BOUNDRY" 7 "STATIC_OBJECT" 8 "TRAFFIC_LIGHT" 9 "TRAFFIC_SIGN" 10 "TWO_WHEELERS" 11 "RESERVED" 12 "RESERVED" 14 "OBJECT_UNDETERMIND" 15 "VEHICLE_UNDETERMIND";
VAL_ 378 OBJ_CLS_TYPE5_059 0 "UNKNOWN_MOVING_OBJ" 1 "CAR" 2 "TRUCK" 3 "MOTOR_BIKE" 4 "BICYCLE" 5 "PEDESTRIAN" 6 "ROAD_BOUNDRY" 7 "STATIC_OBJECT" 8 "TRAFFIC_LIGHT" 9 "TRAFFIC_SIGN" 10 "TWO_WHEELERS" 11 "RESERVED" 12 "RESERVED" 14 "OBJECT_UNDETERMIND" 15 "VEHICLE_UNDETERMIND";
VAL_ 378 OBJ_CLS_TYPE6_059 0 "UNKNOWN_MOVING_OBJ" 1 "CAR" 2 "TRUCK" 3 "MOTOR_BIKE" 4 "BICYCLE" 5 "PEDESTRIAN" 6 "ROAD_BOUNDRY" 7 "STATIC_OBJECT" 8 "TRAFFIC_LIGHT" 9 "TRAFFIC_SIGN" 10 "TWO_WHEELERS" 11 "RESERVED" 12 "RESERVED" 14 "OBJECT_UNDETERMIND" 15 "VEHICLE_UNDETERMIND";
VAL_ 379 OBJ_TRACK_MOTION_MODEL_060 0 "INVALID" 1 "CCV" 2 "CTCA" 3 "CCA";
VAL_ 379 OBJ_MOVEMENT_STATUS_060 0 "UNKNOWN" 1 "MOVING" 2 "SLOW_MOVING" 3 "FAST_MOVING" 4 "STATIONARY" 5 "STOPPED" 6 "RESERVED1" 7 "RESERVED2";
VAL_ 379 OBJ_MEASUREMENT_STATUS_060 0 "Invalid" 1 "New" 2 "Predicted" 3 "PartlyMeasured" 4 "Measured" 5 "Occluded";
VAL_ 379 OBJ_CLS_TYPE1_060 0 "UNKNOWN_MOVING_OBJ" 1 "CAR" 2 "TRUCK" 3 "MOTOR_BIKE" 4 "BICYCLE" 5 "PEDESTRIAN" 6 "ROAD_BOUNDRY" 7 "STATIC_OBJECT" 8 "TRAFFIC_LIGHT" 9 "TRAFFIC_SIGN" 10 "TWO_WHEELERS" 11 "RESERVED" 12 "RESERVED" 14 "OBJECT_UNDETERMIND" 15 "VEHICLE_UNDETERMIND";
VAL_ 379 OBJ_CLS_TYPE2_060 0 "UNKNOWN_MOVING_OBJ" 1 "CAR" 2 "TRUCK" 3 "MOTOR_BIKE" 4 "BICYCLE" 5 "PEDESTRIAN" 6 "ROAD_BOUNDRY" 7 "STATIC_OBJECT" 8 "TRAFFIC_LIGHT" 9 "TRAFFIC_SIGN" 10 "TWO_WHEELERS" 11 "RESERVED" 12 "RESERVED" 14 "OBJECT_UNDETERMIND" 15 "VEHICLE_UNDETERMIND";
VAL_ 379 OBJ_CLS_TYPE3_060 0 "UNKNOWN_MOVING_OBJ" 1 "CAR" 2 "TRUCK" 3 "MOTOR_BIKE" 4 "BICYCLE" 5 "PEDESTRIAN" 6 "ROAD_BOUNDRY" 7 "STATIC_OBJECT" 8 "TRAFFIC_LIGHT" 9 "TRAFFIC_SIGN" 10 "TWO_WHEELERS" 11 "RESERVED" 12 "RESERVED" 14 "OBJECT_UNDETERMIND" 15 "VEHICLE_UNDETERMIND";
VAL_ 379 OBJ_CLS_TYPE4_060 0 "UNKNOWN_MOVING_OBJ" 1 "CAR" 2 "TRUCK" 3 "MOTOR_BIKE" 4 "BICYCLE" 5 "PEDESTRIAN" 6 "ROAD_BOUNDRY" 7 "STATIC_OBJECT" 8 "TRAFFIC_LIGHT" 9 "TRAFFIC_SIGN" 10 "TWO_WHEELERS" 11 "RESERVED" 12 "RESERVED" 14 "OBJECT_UNDETERMIND" 15 "VEHICLE_UNDETERMIND";
VAL_ 379 OBJ_CLS_TYPE5_060 0 "UNKNOWN_MOVING_OBJ" 1 "CAR" 2 "TRUCK" 3 "MOTOR_BIKE" 4 "BICYCLE" 5 "PEDESTRIAN" 6 "ROAD_BOUNDRY" 7 "STATIC_OBJECT" 8 "TRAFFIC_LIGHT" 9 "TRAFFIC_SIGN" 10 "TWO_WHEELERS" 11 "RESERVED" 12 "RESERVED" 14 "OBJECT_UNDETERMIND" 15 "VEHICLE_UNDETERMIND";
VAL_ 379 OBJ_CLS_TYPE6_060 0 "UNKNOWN_MOVING_OBJ" 1 "CAR" 2 "TRUCK" 3 "MOTOR_BIKE" 4 "BICYCLE" 5 "PEDESTRIAN" 6 "ROAD_BOUNDRY" 7 "STATIC_OBJECT" 8 "TRAFFIC_LIGHT" 9 "TRAFFIC_SIGN" 10 "TWO_WHEELERS" 11 "RESERVED" 12 "RESERVED" 14 "OBJECT_UNDETERMIND" 15 "VEHICLE_UNDETERMIND";
VAL_ 380 OBJ_TRACK_MOTION_MODEL_061 0 "INVALID" 1 "CCV" 2 "CTCA" 3 "CCA";
VAL_ 380 OBJ_MOVEMENT_STATUS_061 0 "UNKNOWN" 1 "MOVING" 2 "SLOW_MOVING" 3 "FAST_MOVING" 4 "STATIONARY" 5 "STOPPED" 6 "RESERVED1" 7 "RESERVED2";
VAL_ 380 OBJ_MEASUREMENT_STATUS_061 0 "Invalid" 1 "New" 2 "Predicted" 3 "PartlyMeasured" 4 "Measured" 5 "Occluded";
VAL_ 380 OBJ_CLS_TYPE1_061 0 "UNKNOWN_MOVING_OBJ" 1 "CAR" 2 "TRUCK" 3 "MOTOR_BIKE" 4 "BICYCLE" 5 "PEDESTRIAN" 6 "ROAD_BOUNDRY" 7 "STATIC_OBJECT" 8 "TRAFFIC_LIGHT" 9 "TRAFFIC_SIGN" 10 "TWO_WHEELERS" 11 "RESERVED" 12 "RESERVED" 14 "OBJECT_UNDETERMIND" 15 "VEHICLE_UNDETERMIND";
VAL_ 380 OBJ_CLS_TYPE2_061 0 "UNKNOWN_MOVING_OBJ" 1 "CAR" 2 "TRUCK" 3 "MOTOR_BIKE" 4 "BICYCLE" 5 "PEDESTRIAN" 6 "ROAD_BOUNDRY" 7 "STATIC_OBJECT" 8 "TRAFFIC_LIGHT" 9 "TRAFFIC_SIGN" 10 "TWO_WHEELERS" 11 "RESERVED" 12 "RESERVED" 14 "OBJECT_UNDETERMIND" 15 "VEHICLE_UNDETERMIND";
VAL_ 380 OBJ_CLS_TYPE3_061 0 "UNKNOWN_MOVING_OBJ" 1 "CAR" 2 "TRUCK" 3 "MOTOR_BIKE" 4 "BICYCLE" 5 "PEDESTRIAN" 6 "ROAD_BOUNDRY" 7 "STATIC_OBJECT" 8 "TRAFFIC_LIGHT" 9 "TRAFFIC_SIGN" 10 "TWO_WHEELERS" 11 "RESERVED" 12 "RESERVED" 14 "OBJECT_UNDETERMIND" 15 "VEHICLE_UNDETERMIND";
VAL_ 380 OBJ_CLS_TYPE4_061 0 "UNKNOWN_MOVING_OBJ" 1 "CAR" 2 "TRUCK" 3 "MOTOR_BIKE" 4 "BICYCLE" 5 "PEDESTRIAN" 6 "ROAD_BOUNDRY" 7 "STATIC_OBJECT" 8 "TRAFFIC_LIGHT" 9 "TRAFFIC_SIGN" 10 "TWO_WHEELERS" 11 "RESERVED" 12 "RESERVED" 14 "OBJECT_UNDETERMIND" 15 "VEHICLE_UNDETERMIND";
VAL_ 380 OBJ_CLS_TYPE5_061 0 "UNKNOWN_MOVING_OBJ" 1 "CAR" 2 "TRUCK" 3 "MOTOR_BIKE" 4 "BICYCLE" 5 "PEDESTRIAN" 6 "ROAD_BOUNDRY" 7 "STATIC_OBJECT" 8 "TRAFFIC_LIGHT" 9 "TRAFFIC_SIGN" 10 "TWO_WHEELERS" 11 "RESERVED" 12 "RESERVED" 14 "OBJECT_UNDETERMIND" 15 "VEHICLE_UNDETERMIND";
VAL_ 380 OBJ_CLS_TYPE6_061 0 "UNKNOWN_MOVING_OBJ" 1 "CAR" 2 "TRUCK" 3 "MOTOR_BIKE" 4 "BICYCLE" 5 "PEDESTRIAN" 6 "ROAD_BOUNDRY" 7 "STATIC_OBJECT" 8 "TRAFFIC_LIGHT" 9 "TRAFFIC_SIGN" 10 "TWO_WHEELERS" 11 "RESERVED" 12 "RESERVED" 14 "OBJECT_UNDETERMIND" 15 "VEHICLE_UNDETERMIND";
VAL_ 381 OBJ_TRACK_MOTION_MODEL_062 0 "INVALID" 1 "CCV" 2 "CTCA" 3 "CCA";
VAL_ 381 OBJ_MOVEMENT_STATUS_062 0 "UNKNOWN" 1 "MOVING" 2 "SLOW_MOVING" 3 "FAST_MOVING" 4 "STATIONARY" 5 "STOPPED" 6 "RESERVED1" 7 "RESERVED2";
VAL_ 381 OBJ_MEASUREMENT_STATUS_062 0 "Invalid" 1 "New" 2 "Predicted" 3 "PartlyMeasured" 4 "Measured" 5 "Occluded";
VAL_ 381 OBJ_CLS_TYPE1_062 0 "UNKNOWN_MOVING_OBJ" 1 "CAR" 2 "TRUCK" 3 "MOTOR_BIKE" 4 "BICYCLE" 5 "PEDESTRIAN" 6 "ROAD_BOUNDRY" 7 "STATIC_OBJECT" 8 "TRAFFIC_LIGHT" 9 "TRAFFIC_SIGN" 10 "TWO_WHEELERS" 11 "RESERVED" 12 "RESERVED" 14 "OBJECT_UNDETERMIND" 15 "VEHICLE_UNDETERMIND";
VAL_ 381 OBJ_CLS_TYPE2_062 0 "UNKNOWN_MOVING_OBJ" 1 "CAR" 2 "TRUCK" 3 "MOTOR_BIKE" 4 "BICYCLE" 5 "PEDESTRIAN" 6 "ROAD_BOUNDRY" 7 "STATIC_OBJECT" 8 "TRAFFIC_LIGHT" 9 "TRAFFIC_SIGN" 10 "TWO_WHEELERS" 11 "RESERVED" 12 "RESERVED" 14 "OBJECT_UNDETERMIND" 15 "VEHICLE_UNDETERMIND";
VAL_ 381 OBJ_CLS_TYPE3_062 0 "UNKNOWN_MOVING_OBJ" 1 "CAR" 2 "TRUCK" 3 "MOTOR_BIKE" 4 "BICYCLE" 5 "PEDESTRIAN" 6 "ROAD_BOUNDRY" 7 "STATIC_OBJECT" 8 "TRAFFIC_LIGHT" 9 "TRAFFIC_SIGN" 10 "TWO_WHEELERS" 11 "RESERVED" 12 "RESERVED" 14 "OBJECT_UNDETERMIND" 15 "VEHICLE_UNDETERMIND";
VAL_ 381 OBJ_CLS_TYPE4_062 0 "UNKNOWN_MOVING_OBJ" 1 "CAR" 2 "TRUCK" 3 "MOTOR_BIKE" 4 "BICYCLE" 5 "PEDESTRIAN" 6 "ROAD_BOUNDRY" 7 "STATIC_OBJECT" 8 "TRAFFIC_LIGHT" 9 "TRAFFIC_SIGN" 10 "TWO_WHEELERS" 11 "RESERVED" 12 "RESERVED" 14 "OBJECT_UNDETERMIND" 15 "VEHICLE_UNDETERMIND";
VAL_ 381 OBJ_CLS_TYPE5_062 0 "UNKNOWN_MOVING_OBJ" 1 "CAR" 2 "TRUCK" 3 "MOTOR_BIKE" 4 "BICYCLE" 5 "PEDESTRIAN" 6 "ROAD_BOUNDRY" 7 "STATIC_OBJECT" 8 "TRAFFIC_LIGHT" 9 "TRAFFIC_SIGN" 10 "TWO_WHEELERS" 11 "RESERVED" 12 "RESERVED" 14 "OBJECT_UNDETERMIND" 15 "VEHICLE_UNDETERMIND";
VAL_ 381 OBJ_CLS_TYPE6_062 0 "UNKNOWN_MOVING_OBJ" 1 "CAR" 2 "TRUCK" 3 "MOTOR_BIKE" 4 "BICYCLE" 5 "PEDESTRIAN" 6 "ROAD_BOUNDRY" 7 "STATIC_OBJECT" 8 "TRAFFIC_LIGHT" 9 "TRAFFIC_SIGN" 10 "TWO_WHEELERS" 11 "RESERVED" 12 "RESERVED" 14 "OBJECT_UNDETERMIND" 15 "VEHICLE_UNDETERMIND";
VAL_ 382 OBJ_TRACK_MOTION_MODEL_063 0 "INVALID" 1 "CCV" 2 "CTCA" 3 "CCA";
VAL_ 382 OBJ_MOVEMENT_STATUS_063 0 "UNKNOWN" 1 "MOVING" 2 "SLOW_MOVING" 3 "FAST_MOVING" 4 "STATIONARY" 5 "STOPPED" 6 "RESERVED1" 7 "RESERVED2";
VAL_ 382 OBJ_MEASUREMENT_STATUS_063 0 "Invalid" 1 "New" 2 "Predicted" 3 "PartlyMeasured" 4 "Measured" 5 "Occluded";
VAL_ 382 OBJ_CLS_TYPE1_063 0 "UNKNOWN_MOVING_OBJ" 1 "CAR" 2 "TRUCK" 3 "MOTOR_BIKE" 4 "BICYCLE" 5 "PEDESTRIAN" 6 "ROAD_BOUNDRY" 7 "STATIC_OBJECT" 8 "TRAFFIC_LIGHT" 9 "TRAFFIC_SIGN" 10 "TWO_WHEELERS" 11 "RESERVED" 12 "RESERVED" 14 "OBJECT_UNDETERMIND" 15 "VEHICLE_UNDETERMIND";
VAL_ 382 OBJ_CLS_TYPE2_063 0 "UNKNOWN_MOVING_OBJ" 1 "CAR" 2 "TRUCK" 3 "MOTOR_BIKE" 4 "BICYCLE" 5 "PEDESTRIAN" 6 "ROAD_BOUNDRY" 7 "STATIC_OBJECT" 8 "TRAFFIC_LIGHT" 9 "TRAFFIC_SIGN" 10 "TWO_WHEELERS" 11 "RESERVED" 12 "RESERVED" 14 "OBJECT_UNDETERMIND" 15 "VEHICLE_UNDETERMIND";
VAL_ 382 OBJ_CLS_TYPE3_063 0 "UNKNOWN_MOVING_OBJ" 1 "CAR" 2 "TRUCK" 3 "MOTOR_BIKE" 4 "BICYCLE" 5 "PEDESTRIAN" 6 "ROAD_BOUNDRY" 7 "STATIC_OBJECT" 8 "TRAFFIC_LIGHT" 9 "TRAFFIC_SIGN" 10 "TWO_WHEELERS" 11 "RESERVED" 12 "RESERVED" 14 "OBJECT_UNDETERMIND" 15 "VEHICLE_UNDETERMIND";
VAL_ 382 OBJ_CLS_TYPE4_063 0 "UNKNOWN_MOVING_OBJ" 1 "CAR" 2 "TRUCK" 3 "MOTOR_BIKE" 4 "BICYCLE" 5 "PEDESTRIAN" 6 "ROAD_BOUNDRY" 7 "STATIC_OBJECT" 8 "TRAFFIC_LIGHT" 9 "TRAFFIC_SIGN" 10 "TWO_WHEELERS" 11 "RESERVED" 12 "RESERVED" 14 "OBJECT_UNDETERMIND" 15 "VEHICLE_UNDETERMIND";
VAL_ 382 OBJ_CLS_TYPE5_063 0 "UNKNOWN_MOVING_OBJ" 1 "CAR" 2 "TRUCK" 3 "MOTOR_BIKE" 4 "BICYCLE" 5 "PEDESTRIAN" 6 "ROAD_BOUNDRY" 7 "STATIC_OBJECT" 8 "TRAFFIC_LIGHT" 9 "TRAFFIC_SIGN" 10 "TWO_WHEELERS" 11 "RESERVED" 12 "RESERVED" 14 "OBJECT_UNDETERMIND" 15 "VEHICLE_UNDETERMIND";
VAL_ 382 OBJ_CLS_TYPE6_063 0 "UNKNOWN_MOVING_OBJ" 1 "CAR" 2 "TRUCK" 3 "MOTOR_BIKE" 4 "BICYCLE" 5 "PEDESTRIAN" 6 "ROAD_BOUNDRY" 7 "STATIC_OBJECT" 8 "TRAFFIC_LIGHT" 9 "TRAFFIC_SIGN" 10 "TWO_WHEELERS" 11 "RESERVED" 12 "RESERVED" 14 "OBJECT_UNDETERMIND" 15 "VEHICLE_UNDETERMIND";
VAL_ 383 OBJ_TRACK_MOTION_MODEL_064 0 "INVALID" 1 "CCV" 2 "CTCA" 3 "CCA";
VAL_ 383 OBJ_MOVEMENT_STATUS_064 0 "UNKNOWN" 1 "MOVING" 2 "SLOW_MOVING" 3 "FAST_MOVING" 4 "STATIONARY" 5 "STOPPED" 6 "RESERVED1" 7 "RESERVED2";
VAL_ 383 OBJ_MEASUREMENT_STATUS_064 0 "Invalid" 1 "New" 2 "Predicted" 3 "PartlyMeasured" 4 "Measured" 5 "Occluded";
VAL_ 383 OBJ_CLS_TYPE1_064 0 "UNKNOWN_MOVING_OBJ" 1 "CAR" 2 "TRUCK" 3 "MOTOR_BIKE" 4 "BICYCLE" 5 "PEDESTRIAN" 6 "ROAD_BOUNDRY" 7 "STATIC_OBJECT" 8 "TRAFFIC_LIGHT" 9 "TRAFFIC_SIGN" 10 "TWO_WHEELERS" 11 "RESERVED" 12 "RESERVED" 14 "OBJECT_UNDETERMIND" 15 "VEHICLE_UNDETERMIND";
VAL_ 383 OBJ_CLS_TYPE2_064 0 "UNKNOWN_MOVING_OBJ" 1 "CAR" 2 "TRUCK" 3 "MOTOR_BIKE" 4 "BICYCLE" 5 "PEDESTRIAN" 6 "ROAD_BOUNDRY" 7 "STATIC_OBJECT" 8 "TRAFFIC_LIGHT" 9 "TRAFFIC_SIGN" 10 "TWO_WHEELERS" 11 "RESERVED" 12 "RESERVED" 14 "OBJECT_UNDETERMIND" 15 "VEHICLE_UNDETERMIND";
VAL_ 383 OBJ_CLS_TYPE3_064 0 "UNKNOWN_MOVING_OBJ" 1 "CAR" 2 "TRUCK" 3 "MOTOR_BIKE" 4 "BICYCLE" 5 "PEDESTRIAN" 6 "ROAD_BOUNDRY" 7 "STATIC_OBJECT" 8 "TRAFFIC_LIGHT" 9 "TRAFFIC_SIGN" 10 "TWO_WHEELERS" 11 "RESERVED" 12 "RESERVED" 14 "OBJECT_UNDETERMIND" 15 "VEHICLE_UNDETERMIND";
VAL_ 383 OBJ_CLS_TYPE4_064 0 "UNKNOWN_MOVING_OBJ" 1 "CAR" 2 "TRUCK" 3 "MOTOR_BIKE" 4 "BICYCLE" 5 "PEDESTRIAN" 6 "ROAD_BOUNDRY" 7 "STATIC_OBJECT" 8 "TRAFFIC_LIGHT" 9 "TRAFFIC_SIGN" 10 "TWO_WHEELERS" 11 "RESERVED" 12 "RESERVED" 14 "OBJECT_UNDETERMIND" 15 "VEHICLE_UNDETERMIND";
VAL_ 383 OBJ_CLS_TYPE5_064 0 "UNKNOWN_MOVING_OBJ" 1 "CAR" 2 "TRUCK" 3 "MOTOR_BIKE" 4 "BICYCLE" 5 "PEDESTRIAN" 6 "ROAD_BOUNDRY" 7 "STATIC_OBJECT" 8 "TRAFFIC_LIGHT" 9 "TRAFFIC_SIGN" 10 "TWO_WHEELERS" 11 "RESERVED" 12 "RESERVED" 14 "OBJECT_UNDETERMIND" 15 "VEHICLE_UNDETERMIND";
VAL_ 383 OBJ_CLS_TYPE6_064 0 "UNKNOWN_MOVING_OBJ" 1 "CAR" 2 "TRUCK" 3 "MOTOR_BIKE" 4 "BICYCLE" 5 "PEDESTRIAN" 6 "ROAD_BOUNDRY" 7 "STATIC_OBJECT" 8 "TRAFFIC_LIGHT" 9 "TRAFFIC_SIGN" 10 "TWO_WHEELERS" 11 "RESERVED" 12 "RESERVED" 14 "OBJECT_UNDETERMIND" 15 "VEHICLE_UNDETERMIND";
SIG_GROUP_ 368 TrackerObject049 1 : OBJ_ACCEL_ERR_CRR_COEF_049 OBJ_VELOCITY_ERR_CRR_COEF_049 OBJ_POS_ERR_CRR_COEF_049 OBJ_YAW_RATE_049 OBJ_YAW_RATE_ERR_049 OBJ_GROUP_ID_049 OBJ_REF_PT_LAT_OFFSET_049 OBJ_REF_PT_LONG_OFFSET_049 OBJ_RCS_049 OBJ_YAW_ANGLE_ERR_049 OBJ_CLS_TYPE6_049 OBJ_CLS_TYPE6_PROB_049 OBJ_CLS_TYPE5_PROB_049 OBJ_CLS_TYPE5_049 OBJ_CLS_TYPE4_PROB_049 OBJ_CLS_TYPE4_049 OBJ_CLS_TYPE3_PROB_049 OBJ_CLS_TYPE3_049 OBJ_CLS_TYPE2_PROB_049 OBJ_CLS_TYPE2_049 OBJ_DIMENSION_WIDTH_ERR_049 OBJ_DIMENSION_LENGTH_ERR_049 OBJ_TIMESTAMP_OFFSET_049 OBJ_CLS_TYPE1_PROB_049 OBJ_VEH_TRACK_FLAG_049 OBJ_ACCELERATION_LAT_049 OBJ_ACCELERATION_LONG_049 OBJ_VELOCITY_LAT_049 OBJ_VELOCITY_LONG_049 OBJ_POS_LAT_049 OBJ_POS_LONG_049 OBJ_MEASUREMENT_STATUS_049 OBJ_MOVEMENT_STATUS_049 OBJ_CLS_TYPE1_049 OBJ_ID_049 OBJ_YAW_ANGLE_049 OBJ_EXISTENCE_PROB_049 OBJ_DIMENSION_LENGTH_049 OBJ_DIMENSION_WIDTH_049 OBJ_TRACK_MOTION_MODEL_049 OBJ_POS_LAT_ERR_049 OBJ_POS_LONG_ERR_049 OBJ_VELOCITY_LAT_ERR_049 OBJ_VELOCITY_LONG_ERR_049 OBJ_ACCELERATION_LAT_ERR_049 OBJ_ACCELERATION_LONG_ERR_049 OBJ_ALIVE_TIME_049;
SIG_GROUP_ 369 TrackerObject050 1 : OBJ_ACCEL_ERR_CRR_COEF_050 OBJ_VELOCITY_ERR_CRR_COEF_050 OBJ_POS_ERR_CRR_COEF_050 OBJ_YAW_RATE_050 OBJ_YAW_RATE_ERR_050 OBJ_GROUP_ID_050 OBJ_REF_PT_LAT_OFFSET_050 OBJ_REF_PT_LONG_OFFSET_050 OBJ_RCS_050 OBJ_YAW_ANGLE_ERR_050 OBJ_CLS_TYPE6_050 OBJ_CLS_TYPE6_PROB_050 OBJ_CLS_TYPE5_PROB_050 OBJ_CLS_TYPE5_050 OBJ_CLS_TYPE4_PROB_050 OBJ_CLS_TYPE4_050 OBJ_CLS_TYPE3_PROB_050 OBJ_CLS_TYPE3_050 OBJ_CLS_TYPE2_PROB_050 OBJ_CLS_TYPE2_050 OBJ_DIMENSION_WIDTH_ERR_050 OBJ_DIMENSION_LENGTH_ERR_050 OBJ_TIMESTAMP_OFFSET_050 OBJ_CLS_TYPE1_PROB_050 OBJ_VEH_TRACK_FLAG_050 OBJ_ACCELERATION_LAT_050 OBJ_ACCELERATION_LONG_050 OBJ_VELOCITY_LAT_050 OBJ_VELOCITY_LONG_050 OBJ_POS_LAT_050 OBJ_POS_LONG_050 OBJ_MEASUREMENT_STATUS_050 OBJ_MOVEMENT_STATUS_050 OBJ_CLS_TYPE1_050 OBJ_ID_050 OBJ_YAW_ANGLE_050 OBJ_EXISTENCE_PROB_050 OBJ_DIMENSION_LENGTH_050 OBJ_DIMENSION_WIDTH_050 OBJ_TRACK_MOTION_MODEL_050 OBJ_POS_LAT_ERR_050 OBJ_POS_LONG_ERR_050 OBJ_VELOCITY_LAT_ERR_050 OBJ_VELOCITY_LONG_ERR_050 OBJ_ACCELERATION_LAT_ERR_050 OBJ_ACCELERATION_LONG_ERR_050 OBJ_ALIVE_TIME_050;
SIG_GROUP_ 370 TrackerObject051 1 : OBJ_ACCEL_ERR_CRR_COEF_051 OBJ_VELOCITY_ERR_CRR_COEF_051 OBJ_POS_ERR_CRR_COEF_051 OBJ_YAW_RATE_051 OBJ_YAW_RATE_ERR_051 OBJ_GROUP_ID_051 OBJ_REF_PT_LAT_OFFSET_051 OBJ_REF_PT_LONG_OFFSET_051 OBJ_RCS_051 OBJ_YAW_ANGLE_ERR_051 OBJ_CLS_TYPE6_051 OBJ_CLS_TYPE6_PROB_051 OBJ_CLS_TYPE5_PROB_051 OBJ_CLS_TYPE5_051 OBJ_CLS_TYPE4_PROB_051 OBJ_CLS_TYPE4_051 OBJ_CLS_TYPE3_PROB_051 OBJ_CLS_TYPE3_051 OBJ_CLS_TYPE2_PROB_051 OBJ_CLS_TYPE2_051 OBJ_DIMENSION_WIDTH_ERR_051 OBJ_DIMENSION_LENGTH_ERR_051 OBJ_TIMESTAMP_OFFSET_051 OBJ_CLS_TYPE1_PROB_051 OBJ_VEH_TRACK_FLAG_051 OBJ_ACCELERATION_LAT_051 OBJ_ACCELERATION_LONG_051 OBJ_VELOCITY_LAT_051 OBJ_VELOCITY_LONG_051 OBJ_POS_LAT_051 OBJ_POS_LONG_051 OBJ_MEASUREMENT_STATUS_051 OBJ_MOVEMENT_STATUS_051 OBJ_CLS_TYPE1_051 OBJ_ID_051 OBJ_YAW_ANGLE_051 OBJ_EXISTENCE_PROB_051 OBJ_DIMENSION_LENGTH_051 OBJ_DIMENSION_WIDTH_051 OBJ_TRACK_MOTION_MODEL_051 OBJ_POS_LAT_ERR_051 OBJ_POS_LONG_ERR_051 OBJ_VELOCITY_LAT_ERR_051 OBJ_VELOCITY_LONG_ERR_051 OBJ_ACCELERATION_LAT_ERR_051 OBJ_ACCELERATION_LONG_ERR_051 OBJ_ALIVE_TIME_051;
SIG_GROUP_ 371 TrackerObject052 1 : OBJ_ACCEL_ERR_CRR_COEF_052 OBJ_VELOCITY_ERR_CRR_COEF_052 OBJ_POS_ERR_CRR_COEF_052 OBJ_YAW_RATE_052 OBJ_YAW_RATE_ERR_052 OBJ_GROUP_ID_052 OBJ_REF_PT_LAT_OFFSET_052 OBJ_REF_PT_LONG_OFFSET_052 OBJ_RCS_052 OBJ_YAW_ANGLE_ERR_052 OBJ_CLS_TYPE6_052 OBJ_CLS_TYPE6_PROB_052 OBJ_CLS_TYPE5_PROB_052 OBJ_CLS_TYPE5_052 OBJ_CLS_TYPE4_PROB_052 OBJ_CLS_TYPE4_052 OBJ_CLS_TYPE3_PROB_052 OBJ_CLS_TYPE3_052 OBJ_CLS_TYPE2_PROB_052 OBJ_CLS_TYPE2_052 OBJ_DIMENSION_WIDTH_ERR_052 OBJ_DIMENSION_LENGTH_ERR_052 OBJ_TIMESTAMP_OFFSET_052 OBJ_CLS_TYPE1_PROB_052 OBJ_VEH_TRACK_FLAG_052 OBJ_ACCELERATION_LAT_052 OBJ_ACCELERATION_LONG_052 OBJ_VELOCITY_LAT_052 OBJ_VELOCITY_LONG_052 OBJ_POS_LAT_052 OBJ_POS_LONG_052 OBJ_MEASUREMENT_STATUS_052 OBJ_MOVEMENT_STATUS_052 OBJ_CLS_TYPE1_052 OBJ_ID_052 OBJ_YAW_ANGLE_052 OBJ_EXISTENCE_PROB_052 OBJ_DIMENSION_LENGTH_052 OBJ_DIMENSION_WIDTH_052 OBJ_TRACK_MOTION_MODEL_052 OBJ_POS_LAT_ERR_052 OBJ_POS_LONG_ERR_052 OBJ_VELOCITY_LAT_ERR_052 OBJ_VELOCITY_LONG_ERR_052 OBJ_ACCELERATION_LAT_ERR_052 OBJ_ACCELERATION_LONG_ERR_052 OBJ_ALIVE_TIME_052;
SIG_GROUP_ 372 TrackerObject053 1 : OBJ_ACCEL_ERR_CRR_COEF_053 OBJ_VELOCITY_ERR_CRR_COEF_053 OBJ_POS_ERR_CRR_COEF_053 OBJ_YAW_RATE_053 OBJ_YAW_RATE_ERR_053 OBJ_GROUP_ID_053 OBJ_REF_PT_LAT_OFFSET_053 OBJ_REF_PT_LONG_OFFSET_053 OBJ_RCS_053 OBJ_YAW_ANGLE_ERR_053 OBJ_CLS_TYPE6_053 OBJ_CLS_TYPE6_PROB_053 OBJ_CLS_TYPE5_PROB_053 OBJ_CLS_TYPE5_053 OBJ_CLS_TYPE4_PROB_053 OBJ_CLS_TYPE4_053 OBJ_CLS_TYPE3_PROB_053 OBJ_CLS_TYPE3_053 OBJ_CLS_TYPE2_PROB_053 OBJ_CLS_TYPE2_053 OBJ_DIMENSION_WIDTH_ERR_053 OBJ_DIMENSION_LENGTH_ERR_053 OBJ_TIMESTAMP_OFFSET_053 OBJ_CLS_TYPE1_PROB_053 OBJ_VEH_TRACK_FLAG_053 OBJ_ACCELERATION_LAT_053 OBJ_ACCELERATION_LONG_053 OBJ_VELOCITY_LAT_053 OBJ_VELOCITY_LONG_053 OBJ_POS_LAT_053 OBJ_POS_LONG_053 OBJ_MEASUREMENT_STATUS_053 OBJ_MOVEMENT_STATUS_053 OBJ_CLS_TYPE1_053 OBJ_ID_053 OBJ_YAW_ANGLE_053 OBJ_EXISTENCE_PROB_053 OBJ_DIMENSION_LENGTH_053 OBJ_DIMENSION_WIDTH_053 OBJ_TRACK_MOTION_MODEL_053 OBJ_POS_LAT_ERR_053 OBJ_POS_LONG_ERR_053 OBJ_VELOCITY_LAT_ERR_053 OBJ_VELOCITY_LONG_ERR_053 OBJ_ACCELERATION_LAT_ERR_053 OBJ_ACCELERATION_LONG_ERR_053 OBJ_ALIVE_TIME_053;
SIG_GROUP_ 373 TrackerObject054 1 : OBJ_ACCEL_ERR_CRR_COEF_054 OBJ_VELOCITY_ERR_CRR_COEF_054 OBJ_POS_ERR_CRR_COEF_054 OBJ_YAW_RATE_054 OBJ_YAW_RATE_ERR_054 OBJ_GROUP_ID_054 OBJ_REF_PT_LAT_OFFSET_054 OBJ_REF_PT_LONG_OFFSET_054 OBJ_RCS_054 OBJ_YAW_ANGLE_ERR_054 OBJ_CLS_TYPE6_054 OBJ_CLS_TYPE6_PROB_054 OBJ_CLS_TYPE5_PROB_054 OBJ_CLS_TYPE5_054 OBJ_CLS_TYPE4_PROB_054 OBJ_CLS_TYPE4_054 OBJ_CLS_TYPE3_PROB_054 OBJ_CLS_TYPE3_054 OBJ_CLS_TYPE2_PROB_054 OBJ_CLS_TYPE2_054 OBJ_DIMENSION_WIDTH_ERR_054 OBJ_DIMENSION_LENGTH_ERR_054 OBJ_TIMESTAMP_OFFSET_054 OBJ_CLS_TYPE1_PROB_054 OBJ_VEH_TRACK_FLAG_054 OBJ_ACCELERATION_LAT_054 OBJ_ACCELERATION_LONG_054 OBJ_VELOCITY_LAT_054 OBJ_VELOCITY_LONG_054 OBJ_POS_LAT_054 OBJ_POS_LONG_054 OBJ_MEASUREMENT_STATUS_054 OBJ_MOVEMENT_STATUS_054 OBJ_CLS_TYPE1_054 OBJ_ID_054 OBJ_YAW_ANGLE_054 OBJ_EXISTENCE_PROB_054 OBJ_DIMENSION_LENGTH_054 OBJ_DIMENSION_WIDTH_054 OBJ_TRACK_MOTION_MODEL_054 OBJ_POS_LAT_ERR_054 OBJ_POS_LONG_ERR_054 OBJ_VELOCITY_LAT_ERR_054 OBJ_VELOCITY_LONG_ERR_054 OBJ_ACCELERATION_LAT_ERR_054 OBJ_ACCELERATION_LONG_ERR_054 OBJ_ALIVE_TIME_054;
SIG_GROUP_ 374 TrackerObject055 1 : OBJ_ACCEL_ERR_CRR_COEF_055 OBJ_VELOCITY_ERR_CRR_COEF_055 OBJ_POS_ERR_CRR_COEF_055 OBJ_YAW_RATE_055 OBJ_YAW_RATE_ERR_055 OBJ_GROUP_ID_055 OBJ_REF_PT_LAT_OFFSET_055 OBJ_REF_PT_LONG_OFFSET_055 OBJ_RCS_055 OBJ_YAW_ANGLE_ERR_055 OBJ_CLS_TYPE6_055 OBJ_CLS_TYPE6_PROB_055 OBJ_CLS_TYPE5_PROB_055 OBJ_CLS_TYPE5_055 OBJ_CLS_TYPE4_PROB_055 OBJ_CLS_TYPE4_055 OBJ_CLS_TYPE3_PROB_055 OBJ_CLS_TYPE3_055 OBJ_CLS_TYPE2_PROB_055 OBJ_CLS_TYPE2_055 OBJ_DIMENSION_WIDTH_ERR_055 OBJ_DIMENSION_LENGTH_ERR_055 OBJ_TIMESTAMP_OFFSET_055 OBJ_CLS_TYPE1_PROB_055 OBJ_VEH_TRACK_FLAG_055 OBJ_ACCELERATION_LAT_055 OBJ_ACCELERATION_LONG_055 OBJ_VELOCITY_LAT_055 OBJ_VELOCITY_LONG_055 OBJ_POS_LAT_055 OBJ_POS_LONG_055 OBJ_MEASUREMENT_STATUS_055 OBJ_MOVEMENT_STATUS_055 OBJ_CLS_TYPE1_055 OBJ_ID_055 OBJ_YAW_ANGLE_055 OBJ_EXISTENCE_PROB_055 OBJ_DIMENSION_LENGTH_055 OBJ_DIMENSION_WIDTH_055 OBJ_TRACK_MOTION_MODEL_055 OBJ_POS_LAT_ERR_055 OBJ_POS_LONG_ERR_055 OBJ_VELOCITY_LAT_ERR_055 OBJ_VELOCITY_LONG_ERR_055 OBJ_ACCELERATION_LAT_ERR_055 OBJ_ACCELERATION_LONG_ERR_055 OBJ_ALIVE_TIME_055;
SIG_GROUP_ 375 TrackerObject056 1 : OBJ_ACCEL_ERR_CRR_COEF_056 OBJ_VELOCITY_ERR_CRR_COEF_056 OBJ_POS_ERR_CRR_COEF_056 OBJ_YAW_RATE_056 OBJ_YAW_RATE_ERR_056 OBJ_GROUP_ID_056 OBJ_REF_PT_LAT_OFFSET_056 OBJ_REF_PT_LONG_OFFSET_056 OBJ_RCS_056 OBJ_YAW_ANGLE_ERR_056 OBJ_CLS_TYPE6_056 OBJ_CLS_TYPE6_PROB_056 OBJ_CLS_TYPE5_PROB_056 OBJ_CLS_TYPE5_056 OBJ_CLS_TYPE4_PROB_056 OBJ_CLS_TYPE4_056 OBJ_CLS_TYPE3_PROB_056 OBJ_CLS_TYPE3_056 OBJ_CLS_TYPE2_PROB_056 OBJ_CLS_TYPE2_056 OBJ_DIMENSION_WIDTH_ERR_056 OBJ_DIMENSION_LENGTH_ERR_056 OBJ_TIMESTAMP_OFFSET_056 OBJ_CLS_TYPE1_PROB_056 OBJ_VEH_TRACK_FLAG_056 OBJ_ACCELERATION_LAT_056 OBJ_ACCELERATION_LONG_056 OBJ_VELOCITY_LAT_056 OBJ_VELOCITY_LONG_056 OBJ_POS_LAT_056 OBJ_POS_LONG_056 OBJ_MEASUREMENT_STATUS_056 OBJ_MOVEMENT_STATUS_056 OBJ_CLS_TYPE1_056 OBJ_ID_056 OBJ_YAW_ANGLE_056 OBJ_EXISTENCE_PROB_056 OBJ_DIMENSION_LENGTH_056 OBJ_DIMENSION_WIDTH_056 OBJ_TRACK_MOTION_MODEL_056 OBJ_POS_LAT_ERR_056 OBJ_POS_LONG_ERR_056 OBJ_VELOCITY_LAT_ERR_056 OBJ_VELOCITY_LONG_ERR_056 OBJ_ACCELERATION_LAT_ERR_056 OBJ_ACCELERATION_LONG_ERR_056 OBJ_ALIVE_TIME_056;
SIG_GROUP_ 376 TrackerObject057 1 : OBJ_ACCEL_ERR_CRR_COEF_057 OBJ_VELOCITY_ERR_CRR_COEF_057 OBJ_POS_ERR_CRR_COEF_057 OBJ_YAW_RATE_057 OBJ_YAW_RATE_ERR_057 OBJ_GROUP_ID_057 OBJ_REF_PT_LAT_OFFSET_057 OBJ_REF_PT_LONG_OFFSET_057 OBJ_RCS_057 OBJ_YAW_ANGLE_ERR_057 OBJ_CLS_TYPE6_057 OBJ_CLS_TYPE6_PROB_057 OBJ_CLS_TYPE5_PROB_057 OBJ_CLS_TYPE5_057 OBJ_CLS_TYPE4_PROB_057 OBJ_CLS_TYPE4_057 OBJ_CLS_TYPE3_PROB_057 OBJ_CLS_TYPE3_057 OBJ_CLS_TYPE2_PROB_057 OBJ_CLS_TYPE2_057 OBJ_DIMENSION_WIDTH_ERR_057 OBJ_DIMENSION_LENGTH_ERR_057 OBJ_TIMESTAMP_OFFSET_057 OBJ_CLS_TYPE1_PROB_057 OBJ_VEH_TRACK_FLAG_057 OBJ_ACCELERATION_LAT_057 OBJ_ACCELERATION_LONG_057 OBJ_VELOCITY_LAT_057 OBJ_VELOCITY_LONG_057 OBJ_POS_LAT_057 OBJ_POS_LONG_057 OBJ_MEASUREMENT_STATUS_057 OBJ_MOVEMENT_STATUS_057 OBJ_CLS_TYPE1_057 OBJ_ID_057 OBJ_YAW_ANGLE_057 OBJ_EXISTENCE_PROB_057 OBJ_DIMENSION_LENGTH_057 OBJ_DIMENSION_WIDTH_057 OBJ_TRACK_MOTION_MODEL_057 OBJ_POS_LAT_ERR_057 OBJ_POS_LONG_ERR_057 OBJ_VELOCITY_LAT_ERR_057 OBJ_VELOCITY_LONG_ERR_057 OBJ_ACCELERATION_LAT_ERR_057 OBJ_ACCELERATION_LONG_ERR_057 OBJ_ALIVE_TIME_057;
SIG_GROUP_ 377 TrackerObject058 1 : OBJ_ACCEL_ERR_CRR_COEF_058 OBJ_VELOCITY_ERR_CRR_COEF_058 OBJ_POS_ERR_CRR_COEF_058 OBJ_YAW_RATE_058 OBJ_YAW_RATE_ERR_058 OBJ_GROUP_ID_058 OBJ_REF_PT_LAT_OFFSET_058 OBJ_REF_PT_LONG_OFFSET_058 OBJ_RCS_058 OBJ_YAW_ANGLE_ERR_058 OBJ_CLS_TYPE6_058 OBJ_CLS_TYPE6_PROB_058 OBJ_CLS_TYPE5_PROB_058 OBJ_CLS_TYPE5_058 OBJ_CLS_TYPE4_PROB_058 OBJ_CLS_TYPE4_058 OBJ_CLS_TYPE3_PROB_058 OBJ_CLS_TYPE3_058 OBJ_CLS_TYPE2_PROB_058 OBJ_CLS_TYPE2_058 OBJ_DIMENSION_WIDTH_ERR_058 OBJ_DIMENSION_LENGTH_ERR_058 OBJ_TIMESTAMP_OFFSET_058 OBJ_CLS_TYPE1_PROB_058 OBJ_VEH_TRACK_FLAG_058 OBJ_ACCELERATION_LAT_058 OBJ_ACCELERATION_LONG_058 OBJ_VELOCITY_LAT_058 OBJ_VELOCITY_LONG_058 OBJ_POS_LAT_058 OBJ_POS_LONG_058 OBJ_MEASUREMENT_STATUS_058 OBJ_MOVEMENT_STATUS_058 OBJ_CLS_TYPE1_058 OBJ_ID_058 OBJ_YAW_ANGLE_058 OBJ_EXISTENCE_PROB_058 OBJ_DIMENSION_LENGTH_058 OBJ_DIMENSION_WIDTH_058 OBJ_TRACK_MOTION_MODEL_058 OBJ_POS_LAT_ERR_058 OBJ_POS_LONG_ERR_058 OBJ_VELOCITY_LAT_ERR_058 OBJ_VELOCITY_LONG_ERR_058 OBJ_ACCELERATION_LAT_ERR_058 OBJ_ACCELERATION_LONG_ERR_058 OBJ_ALIVE_TIME_058;
SIG_GROUP_ 378 TrackerObject059 1 : OBJ_ACCEL_ERR_CRR_COEF_059 OBJ_VELOCITY_ERR_CRR_COEF_059 OBJ_POS_ERR_CRR_COEF_059 OBJ_YAW_RATE_059 OBJ_YAW_RATE_ERR_059 OBJ_GROUP_ID_059 OBJ_REF_PT_LAT_OFFSET_059 OBJ_REF_PT_LONG_OFFSET_059 OBJ_RCS_059 OBJ_YAW_ANGLE_ERR_059 OBJ_CLS_TYPE6_059 OBJ_CLS_TYPE6_PROB_059 OBJ_CLS_TYPE5_PROB_059 OBJ_CLS_TYPE5_059 OBJ_CLS_TYPE4_PROB_059 OBJ_CLS_TYPE4_059 OBJ_CLS_TYPE3_PROB_059 OBJ_CLS_TYPE3_059 OBJ_CLS_TYPE2_PROB_059 OBJ_CLS_TYPE2_059 OBJ_DIMENSION_WIDTH_ERR_059 OBJ_DIMENSION_LENGTH_ERR_059 OBJ_TIMESTAMP_OFFSET_059 OBJ_CLS_TYPE1_PROB_059 OBJ_VEH_TRACK_FLAG_059 OBJ_ACCELERATION_LAT_059 OBJ_ACCELERATION_LONG_059 OBJ_VELOCITY_LAT_059 OBJ_VELOCITY_LONG_059 OBJ_POS_LAT_059 OBJ_POS_LONG_059 OBJ_MEASUREMENT_STATUS_059 OBJ_MOVEMENT_STATUS_059 OBJ_CLS_TYPE1_059 OBJ_ID_059 OBJ_YAW_ANGLE_059 OBJ_EXISTENCE_PROB_059 OBJ_DIMENSION_LENGTH_059 OBJ_DIMENSION_WIDTH_059 OBJ_TRACK_MOTION_MODEL_059 OBJ_POS_LAT_ERR_059 OBJ_POS_LONG_ERR_059 OBJ_VELOCITY_LAT_ERR_059 OBJ_VELOCITY_LONG_ERR_059 OBJ_ACCELERATION_LAT_ERR_059 OBJ_ACCELERATION_LONG_ERR_059 OBJ_ALIVE_TIME_059;
SIG_GROUP_ 379 TrackerObject060 1 : OBJ_ACCEL_ERR_CRR_COEF_060 OBJ_VELOCITY_ERR_CRR_COEF_060 OBJ_POS_ERR_CRR_COEF_060 OBJ_YAW_RATE_060 OBJ_YAW_RATE_ERR_060 OBJ_GROUP_ID_060 OBJ_REF_PT_LAT_OFFSET_060 OBJ_REF_PT_LONG_OFFSET_060 OBJ_RCS_060 OBJ_YAW_ANGLE_ERR_060 OBJ_CLS_TYPE6_060 OBJ_CLS_TYPE6_PROB_060 OBJ_CLS_TYPE5_PROB_060 OBJ_CLS_TYPE5_060 OBJ_CLS_TYPE4_PROB_060 OBJ_CLS_TYPE4_060 OBJ_CLS_TYPE3_PROB_060 OBJ_CLS_TYPE3_060 OBJ_CLS_TYPE2_PROB_060 OBJ_CLS_TYPE2_060 OBJ_DIMENSION_WIDTH_ERR_060 OBJ_DIMENSION_LENGTH_ERR_060 OBJ_TIMESTAMP_OFFSET_060 OBJ_CLS_TYPE1_PROB_060 OBJ_VEH_TRACK_FLAG_060 OBJ_ACCELERATION_LAT_060 OBJ_ACCELERATION_LONG_060 OBJ_VELOCITY_LAT_060 OBJ_VELOCITY_LONG_060 OBJ_POS_LAT_060 OBJ_POS_LONG_060 OBJ_MEASUREMENT_STATUS_060 OBJ_MOVEMENT_STATUS_060 OBJ_CLS_TYPE1_060 OBJ_ID_060 OBJ_YAW_ANGLE_060 OBJ_EXISTENCE_PROB_060 OBJ_DIMENSION_LENGTH_060 OBJ_DIMENSION_WIDTH_060 OBJ_TRACK_MOTION_MODEL_060 OBJ_POS_LAT_ERR_060 OBJ_POS_LONG_ERR_060 OBJ_VELOCITY_LAT_ERR_060 OBJ_VELOCITY_LONG_ERR_060 OBJ_ACCELERATION_LAT_ERR_060 OBJ_ACCELERATION_LONG_ERR_060 OBJ_ALIVE_TIME_060;
SIG_GROUP_ 380 TrackerObject061 1 : OBJ_ACCEL_ERR_CRR_COEF_061 OBJ_VELOCITY_ERR_CRR_COEF_061 OBJ_POS_ERR_CRR_COEF_061 OBJ_YAW_RATE_061 OBJ_YAW_RATE_ERR_061 OBJ_GROUP_ID_061 OBJ_REF_PT_LAT_OFFSET_061 OBJ_REF_PT_LONG_OFFSET_061 OBJ_RCS_061 OBJ_YAW_ANGLE_ERR_061 OBJ_CLS_TYPE6_061 OBJ_CLS_TYPE6_PROB_061 OBJ_CLS_TYPE5_PROB_061 OBJ_CLS_TYPE5_061 OBJ_CLS_TYPE4_PROB_061 OBJ_CLS_TYPE4_061 OBJ_CLS_TYPE3_PROB_061 OBJ_CLS_TYPE3_061 OBJ_CLS_TYPE2_PROB_061 OBJ_CLS_TYPE2_061 OBJ_DIMENSION_WIDTH_ERR_061 OBJ_DIMENSION_LENGTH_ERR_061 OBJ_TIMESTAMP_OFFSET_061 OBJ_CLS_TYPE1_PROB_061 OBJ_VEH_TRACK_FLAG_061 OBJ_ACCELERATION_LAT_061 OBJ_ACCELERATION_LONG_061 OBJ_VELOCITY_LAT_061 OBJ_VELOCITY_LONG_061 OBJ_POS_LAT_061 OBJ_POS_LONG_061 OBJ_MEASUREMENT_STATUS_061 OBJ_MOVEMENT_STATUS_061 OBJ_CLS_TYPE1_061 OBJ_ID_061 OBJ_YAW_ANGLE_061 OBJ_EXISTENCE_PROB_061 OBJ_DIMENSION_LENGTH_061 OBJ_DIMENSION_WIDTH_061 OBJ_TRACK_MOTION_MODEL_061 OBJ_POS_LAT_ERR_061 OBJ_POS_LONG_ERR_061 OBJ_VELOCITY_LAT_ERR_061 OBJ_VELOCITY_LONG_ERR_061 OBJ_ACCELERATION_LAT_ERR_061 OBJ_ACCELERATION_LONG_ERR_061 OBJ_ALIVE_TIME_061;
SIG_GROUP_ 381 TrackerObject062 1 : OBJ_ACCEL_ERR_CRR_COEF_062 OBJ_VELOCITY_ERR_CRR_COEF_062 OBJ_POS_ERR_CRR_COEF_062 OBJ_YAW_RATE_062 OBJ_YAW_RATE_ERR_062 OBJ_GROUP_ID_062 OBJ_REF_PT_LAT_OFFSET_062 OBJ_REF_PT_LONG_OFFSET_062 OBJ_RCS_062 OBJ_YAW_ANGLE_ERR_062 OBJ_CLS_TYPE6_062 OBJ_CLS_TYPE6_PROB_062 OBJ_CLS_TYPE5_PROB_062 OBJ_CLS_TYPE5_062 OBJ_CLS_TYPE4_PROB_062 OBJ_CLS_TYPE4_062 OBJ_CLS_TYPE3_PROB_062 OBJ_CLS_TYPE3_062 OBJ_CLS_TYPE2_PROB_062 OBJ_CLS_TYPE2_062 OBJ_DIMENSION_WIDTH_ERR_062 OBJ_DIMENSION_LENGTH_ERR_062 OBJ_TIMESTAMP_OFFSET_062 OBJ_CLS_TYPE1_PROB_062 OBJ_VEH_TRACK_FLAG_062 OBJ_ACCELERATION_LAT_062 OBJ_ACCELERATION_LONG_062 OBJ_VELOCITY_LAT_062 OBJ_VELOCITY_LONG_062 OBJ_POS_LAT_062 OBJ_POS_LONG_062 OBJ_MEASUREMENT_STATUS_062 OBJ_MOVEMENT_STATUS_062 OBJ_CLS_TYPE1_062 OBJ_ID_062 OBJ_YAW_ANGLE_062 OBJ_EXISTENCE_PROB_062 OBJ_DIMENSION_LENGTH_062 OBJ_DIMENSION_WIDTH_062 OBJ_TRACK_MOTION_MODEL_062 OBJ_POS_LAT_ERR_062 OBJ_POS_LONG_ERR_062 OBJ_VELOCITY_LAT_ERR_062 OBJ_VELOCITY_LONG_ERR_062 OBJ_ACCELERATION_LAT_ERR_062 OBJ_ACCELERATION_LONG_ERR_062 OBJ_ALIVE_TIME_062;
SIG_GROUP_ 382 TrackerObject063 1 : OBJ_ACCEL_ERR_CRR_COEF_063 OBJ_VELOCITY_ERR_CRR_COEF_063 OBJ_POS_ERR_CRR_COEF_063 OBJ_YAW_RATE_063 OBJ_YAW_RATE_ERR_063 OBJ_GROUP_ID_063 OBJ_REF_PT_LAT_OFFSET_063 OBJ_REF_PT_LONG_OFFSET_063 OBJ_RCS_063 OBJ_YAW_ANGLE_ERR_063 OBJ_CLS_TYPE6_063 OBJ_CLS_TYPE6_PROB_063 OBJ_CLS_TYPE5_PROB_063 OBJ_CLS_TYPE5_063 OBJ_CLS_TYPE4_PROB_063 OBJ_CLS_TYPE4_063 OBJ_CLS_TYPE3_PROB_063 OBJ_CLS_TYPE3_063 OBJ_CLS_TYPE2_PROB_063 OBJ_CLS_TYPE2_063 OBJ_DIMENSION_WIDTH_ERR_063 OBJ_DIMENSION_LENGTH_ERR_063 OBJ_TIMESTAMP_OFFSET_063 OBJ_CLS_TYPE1_PROB_063 OBJ_VEH_TRACK_FLAG_063 OBJ_ACCELERATION_LAT_063 OBJ_ACCELERATION_LONG_063 OBJ_VELOCITY_LAT_063 OBJ_VELOCITY_LONG_063 OBJ_POS_LAT_063 OBJ_POS_LONG_063 OBJ_MEASUREMENT_STATUS_063 OBJ_MOVEMENT_STATUS_063 OBJ_CLS_TYPE1_063 OBJ_ID_063 OBJ_YAW_ANGLE_063 OBJ_EXISTENCE_PROB_063 OBJ_DIMENSION_LENGTH_063 OBJ_DIMENSION_WIDTH_063 OBJ_TRACK_MOTION_MODEL_063 OBJ_POS_LAT_ERR_063 OBJ_POS_LONG_ERR_063 OBJ_VELOCITY_LAT_ERR_063 OBJ_VELOCITY_LONG_ERR_063 OBJ_ACCELERATION_LAT_ERR_063 OBJ_ACCELERATION_LONG_ERR_063 OBJ_ALIVE_TIME_063;
SIG_GROUP_ 383 TrackerObject064 1 : OBJ_ACCEL_ERR_CRR_COEF_064 OBJ_VELOCITY_ERR_CRR_COEF_064 OBJ_POS_ERR_CRR_COEF_064 OBJ_YAW_RATE_064 OBJ_YAW_RATE_ERR_064 OBJ_GROUP_ID_064 OBJ_REF_PT_LAT_OFFSET_064 OBJ_REF_PT_LONG_OFFSET_064 OBJ_RCS_064 OBJ_YAW_ANGLE_ERR_064 OBJ_CLS_TYPE6_064 OBJ_CLS_TYPE6_PROB_064 OBJ_CLS_TYPE5_PROB_064 OBJ_CLS_TYPE5_064 OBJ_CLS_TYPE4_PROB_064 OBJ_CLS_TYPE4_064 OBJ_CLS_TYPE3_PROB_064 OBJ_CLS_TYPE3_064 OBJ_CLS_TYPE2_PROB_064 OBJ_CLS_TYPE2_064 OBJ_DIMENSION_WIDTH_ERR_064 OBJ_DIMENSION_LENGTH_ERR_064 OBJ_TIMESTAMP_OFFSET_064 OBJ_CLS_TYPE1_PROB_064 OBJ_VEH_TRACK_FLAG_064 OBJ_ACCELERATION_LAT_064 OBJ_ACCELERATION_LONG_064 OBJ_VELOCITY_LAT_064 OBJ_VELOCITY_LONG_064 OBJ_POS_LAT_064 OBJ_POS_LONG_064 OBJ_MEASUREMENT_STATUS_064 OBJ_MOVEMENT_STATUS_064 OBJ_CLS_TYPE1_064 OBJ_ID_064 OBJ_YAW_ANGLE_064 OBJ_EXISTENCE_PROB_064 OBJ_DIMENSION_LENGTH_064 OBJ_DIMENSION_WIDTH_064 OBJ_TRACK_MOTION_MODEL_064 OBJ_POS_LAT_ERR_064 OBJ_POS_LONG_ERR_064 OBJ_VELOCITY_LAT_ERR_064 OBJ_VELOCITY_LONG_ERR_064 OBJ_ACCELERATION_LAT_ERR_064 OBJ_ACCELERATION_LONG_ERR_064 OBJ_ALIVE_TIME_064;

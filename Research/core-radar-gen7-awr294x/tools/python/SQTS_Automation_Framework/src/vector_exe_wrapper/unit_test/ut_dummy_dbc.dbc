VERSION ""

NS_ :

BS_:

BU_:

BO_ 6 response2: 1 Vector__XXX
 SG_ response2_sig1 : 0|8@1+ (1,0) [0|0] "" Vector__XXX

BO_ 5 command2: 2 Vector__XXX
 SG_ response2_sig1 : 8|8@1+ (1,0) [0|0] "" Vector__XXX
 SG_ command2_sig1 : 0|8@1+ (1,0) [0|0] "" Vector__XXX

BO_ 4 response1: 1 Vector__XXX
 SG_ response1_sig1 : 0|8@1- (1,0) [0|0] "" Vector__XXX

BO_ 3 command1: 1 Vector__XXX
 SG_ command1_sig1 : 0|8@1+ (1,0) [0|0] "" Vector__XXX

BO_ 1 ut_msg_1: 64 Vector__XXX
 SG_ msg1_sig2 : 39|32@0+ (1,0) [0|4294967295] "" Vector__XXX
 SG_ msg1_sig1 : 7|32@0+ (1,0) [0|4294967295] "" Vector__XXX

BO_ 2 ut_msg_2: 64 Vector__XXX
 SG_ msg2_sig4 : 55|16@0+ (1,-500) [-500|65035] "" Vector__XXX
 SG_ msg2_sig1 : 7|16@0+ (4,-131072) [-131072|131068] "" Vector__XXX
 SG_ msg2_sig3 : 39|16@0+ (0.001,0) [0|65.535] "" Vector__XXX
 SG_ msg2_sig2 : 23|16@0+ (0.1,0) [0|6553.5] "" Vector__XXX

BA_DEF_ SG_  "GenSigStartValue" INT 0 0;
BA_DEF_ BO_  "CANFD_BRS" ENUM  "0","1";
BA_DEF_  "DBName" STRING ;
BA_DEF_  "BusType" STRING ;
BA_DEF_ BO_  "VFrameFormat" ENUM  "StandardCAN","ExtendedCAN","reserved","reserved","reserved","reserved","reserved","reserved","reserved","reserved","reserved","reserved","reserved","reserved","StandardCAN_FD","ExtendedCAN_FD";
BA_DEF_DEF_  "GenSigStartValue" 0;
BA_DEF_DEF_  "CANFD_BRS" "1";
BA_DEF_DEF_  "DBName" "";
BA_DEF_DEF_  "BusType" "";
BA_DEF_DEF_  "VFrameFormat" "StandardCAN";
BA_ "BusType" "CAN FD";
BA_ "DBName" "ut_dummy_dbc";
BA_ "VFrameFormat" BO_ 1 14;
BA_ "VFrameFormat" BO_ 2 14;
BA_ "GenSigStartValue" SG_ 1 msg1_sig2 2048;
BA_ "GenSigStartValue" SG_ 1 msg1_sig1 1024;
BA_ "GenSigStartValue" SG_ 2 msg2_sig1 65535;
BA_ "GenSigStartValue" SG_ 2 msg2_sig3 65535;
BA_ "GenSigStartValue" SG_ 2 msg2_sig2 5005;
